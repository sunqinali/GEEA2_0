AUTOSAR XML (schema 4-2-2)
package /AURIX2G/EcucDefs/Spi_ib_bswmd/BswModuleDescriptions
  bsw module description Spi: provided-entrys=Spi_MainFunction_Handling
    bsw internal behavior SpiBehavior
      11 x exclusive area:
        Buffer_Update
        SyncLock
        ChannelLock
        Cancel_Seq
        Queue_Update_QSPI{0..5}
        Queue_Update
      bsw schedulable entity Spi_MainFunction_Handling: implemented-entry=Spi_MainFunction_Handling
      bsw timing event Spi_MainFunction_HandlingTimingEvent0: starts-on-event=Spi_MainFunction_Handling, period=0.005
  bsw module entry Spi_MainFunction_Handling: call-type=SCHEDULED, execution-context=TASK

[part 6 of 6: package /MICROSAR/Dem_swc/ComponentTypes]
AUTOSAR XML (schema 4-2-2)
package /MICROSAR/Dem_swc/ComponentTypes  (continued)
  service sw component type DemSatellite_0: category=SERVICE_COMPONENT  (continued)
    behavior DemSatellite_0InternalBehavior: handle-termination-and-restart=NO-SUPPORT, included-data-type-set=data-type=[Dem_EventIdType, Dem_RatioIdType, Dem_EventStatusType, Dem_UdsStatusByteType, Dem_DTCFormatType, Dem_InitMonitorReasonType, Dem_OperationCycleStateType, Dem_DTCStatusMaskType, Dem_IndicatorStatusType, Dem_MaxDataValueType, Dem_DTCKindType, Dem_DTCGroupType, Dem_IumprDenomCondIdType, Dem_IumprDenomCondStatusType, Dem_DebounceResetStatusType, Dem_DebouncingStateType, Dem_IumprReadinessGroupType, Dem_DTRControlType, Dem_DTCSeverityType, Dem_MonitorStatusType]  (continued)
      4543 x operation invoked event:  (continued)
        OpEventSetEventStatus_SetEventStatus_Event_VCEvEcmPropFr02Tioutd: start-on-event=SetEventStatus, operation=Event_VCEvEcmPropFr02Tioutd.SetEventStatus
        OpEventSetEventStatus_SetEventStatus_Event_Ga_TmSpdSyncFailed: start-on-event=SetEventStatus, operation=Event_Ga_TmSpdSyncFailed.SetEventStatus
        OpEventSetEventStatus_SetEventStatus_Event_INV_RSLVR_EXCT_ELEC_LO: start-on-event=SetEventStatus, operation=Event_INV_RSLVR_EXCT_ELEC_LO.SetEventStatus
        OpEventSetEventStatus_SetEventStatus_Event_VCEvEcmPropXevFr06Tioutd: start-on-event=SetEventStatus, operation=Event_VCEvEcmPropXevFr06Tioutd.SetEventStatus
        OpEventSetEventStatus_SetEventStatus_Event_VcEvCntrWhlMotSysTqAllwd: start-on-event=SetEventStatus, operation=Event_VcEvCntrWhlMotSysTqAllwd.SetEventStatus
        OpEventSetEventStatus_SetEventStatus_Event_INV_UHVDC_1_ELEC_HI: start-on-event=SetEventStatus, operation=Event_INV_UHVDC_1_ELEC_HI.SetEventStatus
        OpEventSetEventStatus_SetEventStatus_Event_INV_EM_STATOR_TEMP2_ELE_FLT: start-on-event=SetEventStatus, operation=Event_INV_EM_STATOR_TEMP2_ELE_FLT.SetEventStatus
        OpEventSetEventStatus_SetEventStatus_Event_AURIX_RST_SNG: start-on-event=SetEventStatus, operation=Event_AURIX_RST_SNG.SetEventStatus
        OpEventSetEventStatus_SetEventStatus_Event_VCEvEcmPropFr24MgmFr01Tioutd: start-on-event=SetEventStatus, operation=Event_VCEvEcmPropFr24MgmFr01Tioutd.SetEventStatus
        OpEventSetEventStatus_SetEventStatus_Event_INV_RSLVR_COS_ELEC_OPEN: start-on-event=SetEventStatus, operation=Event_INV_RSLVR_COS_ELEC_OPEN.SetEventStatus
        OpEventSetEventStatus_SetEventStatus_Event_INV_IAC_V_ELEC_LO: start-on-event=SetEventStatus, operation=Event_INV_IAC_V_ELEC_LO.SetEventStatus
        OpEventSetEventStatus_SetEventStatus_Event_INV_IAC_W_OFFS: start-on-event=SetEventStatus, operation=Event_INV_IAC_W_OFFS.SetEventStatus
        OpEventSetEventStatus_SetEventStatus_Event_INV_EM_STATOR_TEMP2_GRDT: start-on-event=SetEventStatus, operation=Event_INV_EM_STATOR_TEMP2_GRDT.SetEventStatus
        OpEventSetEventStatus_SetEventStatus_Event_INV_EM_OVRSPD_HWP: start-on-event=SetEventStatus, operation=Event_INV_EM_OVRSPD_HWP.SetEventStatus
        OpEventSetEventStatus_SetEventStatus_Event_CU_TEMP_HWP: start-on-event=SetEventStatus, operation=Event_CU_TEMP_HWP.SetEventStatus
        OpEventSetEventStatus_SetEventStatus_Event_INV_UHVDC_1_RNG_HI: start-on-event=SetEventStatus, operation=Event_INV_UHVDC_1_RNG_HI.SetEventStatus
        OpEventSetEventStatus_SetEventStatus_Event_VcEvEMPerfPlaus: start-on-event=SetEventStatus, operation=Event_VcEvEMPerfPlaus.SetEventStatus
        OpEventSetEventStatus_SetEventStatus_Event_VCEvVddmPropFr18Tioutd: start-on-event=SetEventStatus, operation=Event_VCEvVddmPropFr18Tioutd.SetEventStatus
        OpEventSetEventStatus_SetEventStatus_Event_INV_IAC_U_ELEC_HWP: start-on-event=SetEventStatus, operation=Event_INV_IAC_U_ELEC_HWP.SetEventStatus
        OpEventSetEventStatus_SetEventStatus_Event_VCEvVddmPropFr15Tioutd: start-on-event=SetEventStatus, operation=Event_VCEvVddmPropFr15Tioutd.SetEventStatus
        OpEventSetEventStatus_SetEventStatus_Event_Ga_GADisengageFailure: start-on-event=SetEventStatus, operation=Event_Ga_GADisengageFailure.SetEventStatus
        OpEventSetEventStatus_SetEventStatus_Event_CU_TEMP2_RNG_LO: start-on-event=SetEventStatus, operation=Event_CU_TEMP2_RNG_LO.SetEventStatus
        OpEventSetEventStatus_SetEventStatus_Event_INV_RSLVR_SIN_ELEC_OPEN: start-on-event=SetEventStatus, operation=Event_INV_RSLVR_SIN_ELEC_OPEN.SetEventStatus
        OpEventSetEventStatus_SetEventStatus_Event_VcEvChkSum: start-on-event=SetEventStatus, operation=Event_VcEvChkSum.SetEventStatus
        OpEventSetEventStatus_SetEventStatus_Event_PS_P5_UC_FLT: start-on-event=SetEventStatus, operation=Event_PS_P5_UC_FLT.SetEventStatus
        OpEventSetEventStatus_SetEventStatus_Event_INV_RSLVR_COS_ELEC_FLT: start-on-event=SetEventStatus, operation=Event_INV_RSLVR_COS_ELEC_FLT.SetEventStatus
        OpEventSetEventStatus_SetEventStatus_Event_INV_IAC_W_RNG_HI: start-on-event=SetEventStatus, operation=Event_INV_IAC_W_RNG_HI.SetEventStatus
        OpEventSetEventStatus_SetEventStatus_Event_PS_ECUSUPPLY_HIGH: start-on-event=SetEventStatus, operation=Event_PS_ECUSUPPLY_HIGH.SetEventStatus
        OpEventSetEventStatus_SetEventStatus_Event_VCEvEcmPropFr05Tioutd: start-on-event=SetEventStatus, operation=Event_VCEvEcmPropFr05Tioutd.SetEventStatus
        OpEventSetEventStatus_SetEventStatus_Event_PS_ECUSUPPLY_LOW: start-on-event=SetEventStatus, operation=Event_PS_ECUSUPPLY_LOW.SetEventStatus
        OpEventSetEventStatus_SetEventStatus_Event_VcEvChkSumHvSysRlySts: start-on-event=SetEventStatus, operation=Event_VcEvChkSumHvSysRlySts.SetEventStatus
        OpEventSetEventStatus_SetEventStatus_Event_VcEvMonMode: start-on-event=SetEventStatus, operation=Event_VcEvMonMode.SetEventStatus
        OpEventSetEventStatus_SetEventStatus_Event_INV_IAC_OC_SWP: start-on-event=SetEventStatus, operation=Event_INV_IAC_OC_SWP.SetEventStatus
        OpEventSetEventStatus_SetEventStatus_Event_INV_IMMO_AUTHFAIL: start-on-event=SetEventStatus, operation=Event_INV_IMMO_AUTHFAIL.SetEventStatus
        OpEventSetEventStatus_SetEventStatus_Event_PA_OpenCirc_FLT: start-on-event=SetEventStatus, operation=Event_PA_OpenCirc_FLT.SetEventStatus
        OpEventSetEventStatus_SetEventStatus_Event_INV_IAC_V_ELEC_HI: start-on-event=SetEventStatus, operation=Event_INV_IAC_V_ELEC_HI.SetEventStatus
        OpEventSetEventStatus_SetEventStatus_Event_VCEvEcmPropFr04Tioutd: start-on-event=SetEventStatus, operation=Event_VCEvEcmPropFr04Tioutd.SetEventStatus
        OpEventSetEventStatus_SetEventStatus_Event_VcEvMonTrqActPlaus: start-on-event=SetEventStatus, operation=Event_VcEvMonTrqActPlaus.SetEventStatus
        OpEventSetEventStatus_SetEventStatus_Event_VcEvMonTrqAct: start-on-event=SetEventStatus, operation=Event_VcEvMonTrqAct.SetEventStatus
        OpEventSetEventStatus_SetEventStatus_Event_INV_RSLVR_COS_ELEC_LO: start-on-event=SetEventStatus, operation=Event_INV_RSLVR_COS_ELEC_LO.SetEventStatus
        OpEventSetEventStatus_SetEventStatus_Event_INV_COOLT_INLET_TEMP_HWP: start-on-event=SetEventStatus, operation=Event_INV_COOLT_INLET_TEMP_HWP.SetEventStatus
        OpEventSetEventStatus_SetEventStatus_Event_VCEvEcmPropFr11Tioutd: start-on-event=SetEventStatus, operation=Event_VCEvEcmPropFr11Tioutd.SetEventStatus
        OpEventSetEventStatus_SetEventStatus_Event_PS_KL30_RNG_HI: start-on-event=SetEventStatus, operation=Event_PS_KL30_RNG_HI.SetEventStatus
        OpEventSetEventStatus_SetEventStatus_Event_INV_IAC_OC_HWP: start-on-event=SetEventStatus, operation=Event_INV_IAC_OC_HWP.SetEventStatus
        OpEventSetEventStatus_SetEventStatus_Event_INV_RSLVR_COS_RNG_HI: start-on-event=SetEventStatus, operation=Event_INV_RSLVR_COS_RNG_HI.SetEventStatus
        OpEventSetEventStatus_SetEventStatus_Event_INV_IAC_U_ELEC_HI: start-on-event=SetEventStatus, operation=Event_INV_IAC_U_ELEC_HI.SetEventStatus
        OpEventSetEventStatus_SetEventStatus_Event_INV_IAC_V_RNG_LO: start-on-event=SetEventStatus, operation=Event_INV_IAC_V_RNG_LO.SetEventStatus
        OpEventSetEventStatus_SetEventStatus_Event_INV_IAC_U_RNG_HI: start-on-event=SetEventStatus, operation=Event_INV_IAC_U_RNG_HI.SetEventStatus
        OpEventSetEventStatus_SetEventStatus_Event_VCEvEcmPropFr25Tioutd: start-on-event=SetEventStatus, operation=Event_VCEvEcmPropFr25Tioutd.SetEventStatus
        OpEventSetEventStatus_SetEventStatus_Event_INV_IGBT_TEMP_W_RNG_LO: start-on-event=SetEventStatus, operation=Event_INV_IGBT_TEMP_W_RNG_LO.SetEventStatus
        OpEventSetEventStatus_SetEventStatus_Event_PSnsr_RNG_NOK: start-on-event=SetEventStatus, operation=Event_PSnsr_RNG_NOK.SetEventStatus
        OpEventSetEventStatus_SetEventStatus_Event_INV_RSLVR_COS_RNG_NOK: start-on-event=SetEventStatus, operation=Event_INV_RSLVR_COS_RNG_NOK.SetEventStatus
        OpEventSetEventStatus_SetEventStatus_Event_PS_DRVB_Fault: start-on-event=SetEventStatus, operation=Event_PS_DRVB_Fault.SetEventStatus
        OpEventSetEventStatus_SetEventStatus_Event_INV_CU_TEMP1_RNG_NOK: start-on-event=SetEventStatus, operation=Event_INV_CU_TEMP1_RNG_NOK.SetEventStatus
        OpEventSetEventStatus_SetEventStatus_Event_VcEvCntr: start-on-event=SetEventStatus, operation=Event_VcEvCntr.SetEventStatus
        OpEventSetEventStatus_SetEventStatus_Event_INV_RSLVR_SIN_AMP: start-on-event=SetEventStatus, operation=Event_INV_RSLVR_SIN_AMP.SetEventStatus
        OpEventSetEventStatus_SetEventStatus_Event_INV_UHVDC_2_RNG_HI: start-on-event=SetEventStatus, operation=Event_INV_UHVDC_2_RNG_HI.SetEventStatus
        OpEventSetEventStatus_SetEventStatus_Event_INV_IGBT_TEMP_U_GRDT: start-on-event=SetEventStatus, operation=Event_INV_IGBT_TEMP_U_GRDT.SetEventStatus
        OpEventSetEventStatus_SetEventStatus_Event_MON_TQ_PLAUS_PWR_MDL: start-on-event=SetEventStatus, operation=Event_MON_TQ_PLAUS_PWR_MDL.SetEventStatus
        OpEventSetEventStatus_SetEventStatus_Event_INV_IGBT_TEMP_W_PLAUS: start-on-event=SetEventStatus, operation=Event_INV_IGBT_TEMP_W_PLAUS.SetEventStatus
        OpEventSetEventStatus_SetEventStatus_Event_PS_BLDC_UV_FLT: start-on-event=SetEventStatus, operation=Event_PS_BLDC_UV_FLT.SetEventStatus
        OpEventSetEventStatus_SetEventStatus_Event_INV_IAC_V_OFFS: start-on-event=SetEventStatus, operation=Event_INV_IAC_V_OFFS.SetEventStatus
        OpEventSetEventStatus_SetEventStatus_Event_INV_RSLVR_EXCT_FREQ_RNG_NOK: start-on-event=SetEventStatus, operation=Event_INV_RSLVR_EXCT_FREQ_RNG_NOK.SetEventStatus
        OpEventSetEventStatus_SetEventStatus_Event_PS_KL30_RNG_LO: start-on-event=SetEventStatus, operation=Event_PS_KL30_RNG_LO.SetEventStatus
        OpEventSetEventStatus_SetEventStatus_Event_INV_RSLVR_COS_RNG_LO: start-on-event=SetEventStatus, operation=Event_INV_RSLVR_COS_RNG_LO.SetEventStatus
        OpEventSetEventStatus_SetEventStatus_Event_PSnsr_ELE_FLT: start-on-event=SetEventStatus, operation=Event_PSnsr_ELE_FLT.SetEventStatus
        OpEventSetEventStatus_SetEventStatus_Event_INV_RSLVR_SIN_COS_PLAUS_AMP: start-on-event=SetEventStatus, operation=Event_INV_RSLVR_SIN_COS_PLAUS_AMP.SetEventStatus
        OpEventSetEventStatus_SetEventStatus_Event_INV_IAC_U_ELEC_LO: start-on-event=SetEventStatus, operation=Event_INV_IAC_U_ELEC_LO.SetEventStatus
        OpEventSetEventStatus_SetEventStatus_Event_INV_RSLVR_EXCT_ELEC_HI: start-on-event=SetEventStatus, operation=Event_INV_RSLVR_EXCT_ELEC_HI.SetEventStatus
        OpEventSetEventStatus_SetEventStatus_Event_INV_IAC_U_RNG_LO: start-on-event=SetEventStatus, operation=Event_INV_IAC_U_RNG_LO.SetEventStatus
        OpEventSetEventStatus_SetEventStatus_Event_INV_IAC_V_RNG_HI: start-on-event=SetEventStatus, operation=Event_INV_IAC_V_RNG_HI.SetEventStatus
        OpEventSetEventStatus_SetEventStatus_Event_INV_IGBT_TEMP_U_PLAUS: start-on-event=SetEventStatus, operation=Event_INV_IGBT_TEMP_U_PLAUS.SetEventStatus
        OpEventSetEventStatus_SetEventStatus_Event_INV_RSLVR_OFFS_DFT: start-on-event=SetEventStatus, operation=Event_INV_RSLVR_OFFS_DFT.SetEventStatus
        OpEventSetEventStatus_SetEventStatus_Event_Ga_MoveOverThd: start-on-event=SetEventStatus, operation=Event_Ga_MoveOverThd.SetEventStatus
        OpEventSetEventStatus_SetEventStatus_Event_VcEvMonIPH: start-on-event=SetEventStatus, operation=Event_VcEvMonIPH.SetEventStatus
        OpEventSetEventStatus_SetEventStatus_Event_INV_RSLVR_HW_FLT: start-on-event=SetEventStatus, operation=Event_INV_RSLVR_HW_FLT.SetEventStatus
        OpEventSetEventStatus_SetEventStatus_Event_INV_RSLVR_SIN_ELEC_LO: start-on-event=SetEventStatus, operation=Event_INV_RSLVR_SIN_ELEC_LO.SetEventStatus
        OpEventSetEventStatus_SetEventStatus_Event_INV_IAC_W_AMP: start-on-event=SetEventStatus, operation=Event_INV_IAC_W_AMP.SetEventStatus
        OpEventSetEventStatus_SetEventStatus_Event_VCC_OverVoltage: start-on-event=SetEventStatus, operation=Event_VCC_OverVoltage.SetEventStatus
        OpEventSetEventStatus_SetEventStatus_Event_PS_BLDC_OV_FLT: start-on-event=SetEventStatus, operation=Event_PS_BLDC_OV_FLT.SetEventStatus
        OpEventSetEventStatus_SetEventStatus_Event_AURIX_EEPROM_FLT: start-on-event=SetEventStatus, operation=Event_AURIX_EEPROM_FLT.SetEventStatus
        OpEventSetEventStatus_SetEventStatus_Event_FS_MONITIOR_ASC_FW_FLT: start-on-event=SetEventStatus, operation=Event_FS_MONITIOR_ASC_FW_FLT.SetEventStatus
        OpEventSetEventStatus_SetEventStatus_Event_VCEvSrsPropFr02Tioutd: start-on-event=SetEventStatus, operation=Event_VCEvSrsPropFr02Tioutd.SetEventStatus
        OpEventSetEventStatus_SetEventStatus_Event_VcEvMonErrMode: start-on-event=SetEventStatus, operation=Event_VcEvMonErrMode.SetEventStatus
        OpEventSetEventStatus_SetEventStatus_Event_AURIX_RST_MPL: start-on-event=SetEventStatus, operation=Event_AURIX_RST_MPL.SetEventStatus
        OpEventSetEventStatus_SetEventStatus_Event_VcEvNodeMisECM: start-on-event=SetEventStatus, operation=Event_VcEvNodeMisECM.SetEventStatus
        OpEventSetEventStatus_SetEventStatus_Event_PS_KL30_PLAUS: start-on-event=SetEventStatus, operation=Event_PS_KL30_PLAUS.SetEventStatus
        OpEventSetEventStatus_SetEventStatus_Event_INV_IAC_W_ELEC_HI: start-on-event=SetEventStatus, operation=Event_INV_IAC_W_ELEC_HI.SetEventStatus
        OpEventSetEventStatus_SetEventStatus_Event_VCEvVddmPropFr19Tioutd: start-on-event=SetEventStatus, operation=Event_VCEvVddmPropFr19Tioutd.SetEventStatus
        OpEventSetEventStatus_SetEventStatus_Event_INV_TEMP_DCHA_HW: start-on-event=SetEventStatus, operation=Event_INV_TEMP_DCHA_HW.SetEventStatus
        OpEventSetEventStatus_SetEventStatus_Event_VcEvPropCANGlbTiOutd: start-on-event=SetEventStatus, operation=Event_VcEvPropCANGlbTiOutd.SetEventStatus
        OpEventSetEventStatus_SetEventStatus_Event_INV_EM_STATOR_TEMP2_RNG_NOK: start-on-event=SetEventStatus, operation=Event_INV_EM_STATOR_TEMP2_RNG_NOK.SetEventStatus
        OpEventSetEventStatus_SetEventStatus_Event_INV_UHVDC_OV_HWP: start-on-event=SetEventStatus, operation=Event_INV_UHVDC_OV_HWP.SetEventStatus
        OpEventSetEventStatus_SetEventStatus_Event_Ga_FindEngleAngleFailed: start-on-event=SetEventStatus, operation=Event_Ga_FindEngleAngleFailed.SetEventStatus
        OpEventSetEventStatus_SetEventStatus_Event_VcEvMonTrqCmp: start-on-event=SetEventStatus, operation=Event_VcEvMonTrqCmp.SetEventStatus
        OpEventSetEventStatus_SetEventStatus_Event_INV_IGBT_TEMP_V_RNG_LO: start-on-event=SetEventStatus, operation=Event_INV_IGBT_TEMP_V_RNG_LO.SetEventStatus
        OpEventSetEventStatus_SetEventStatus_Event_INV_CONTROL_LIMIT: start-on-event=SetEventStatus, operation=Event_INV_CONTROL_LIMIT.SetEventStatus
        OpEventSetEventStatus_SetEventStatus_Event_COM_CarConfigErr: start-on-event=SetEventStatus, operation=Event_COM_CarConfigErr.SetEventStatus
        OpEventSetEventStatus_SetEventStatus_Event_VCEvEcmPropFr08Tioutd: start-on-event=SetEventStatus, operation=Event_VCEvEcmPropFr08Tioutd.SetEventStatus
        OpEventSetEventStatus_SetEventStatus_Event_CU_TEMP1_RNG_LO: start-on-event=SetEventStatus, operation=Event_CU_TEMP1_RNG_LO.SetEventStatus
        OpEventSetEventStatus_SetEventStatus_Event_INV_EM_STATOR_TEMP2_RNG_SWT: start-on-event=SetEventStatus, operation=Event_INV_EM_STATOR_TEMP2_RNG_SWT.SetEventStatus
        OpEventSetEventStatus_SetEventStatus_Event_GA_BLDC_POS_FLT: start-on-event=SetEventStatus, operation=Event_GA_BLDC_POS_FLT.SetEventStatus
        OpEventSetEventStatus_SetEventStatus_Event_PS_WhlSnsr_FLT: start-on-event=SetEventStatus, operation=Event_PS_WhlSnsr_FLT.SetEventStatus
        OpEventSetEventStatus_SetEventStatus_Event_INV_EM_STATOR_TEMP_RNG_LO: start-on-event=SetEventStatus, operation=Event_INV_EM_STATOR_TEMP_RNG_LO.SetEventStatus
        OpEventSetEventStatus_SetEventStatus_Event_INV_RSLVR_SIN_ELEC_HI: start-on-event=SetEventStatus, operation=Event_INV_RSLVR_SIN_ELEC_HI.SetEventStatus
        OpEventSetEventStatus_SetEventStatus_Event_INV_RSLVR_SIN_COS_PLAUS: start-on-event=SetEventStatus, operation=Event_INV_RSLVR_SIN_COS_PLAUS.SetEventStatus
        OpEventSetEventStatus_SetEventStatus_Event_INV_RSLVR_COS_AMP: start-on-event=SetEventStatus, operation=Event_INV_RSLVR_COS_AMP.SetEventStatus
        OpEventSetEventStatus_SetEventStatus_Event_INV_GATE_DRVR_BOT_HWP: start-on-event=SetEventStatus, operation=Event_INV_GATE_DRVR_BOT_HWP.SetEventStatus
        OpEventSetEventStatus_SetEventStatus_Event_Eg_HallVolWrong: start-on-event=SetEventStatus, operation=Event_Eg_HallVolWrong.SetEventStatus
        OpEventSetEventStatus_SetEventStatus_Event_INV_RSLVR_EXCT_RNG_NOK: start-on-event=SetEventStatus, operation=Event_INV_RSLVR_EXCT_RNG_NOK.SetEventStatus
        OpEventSetEventStatus_SetEventStatus_Event_PA_OpenCirc: start-on-event=SetEventStatus, operation=Event_PA_OpenCirc.SetEventStatus
        OpEventSetEventStatus_SetEventStatus_Event_INV_RSLVR_COS_ELEC_HI: start-on-event=SetEventStatus, operation=Event_INV_RSLVR_COS_ELEC_HI.SetEventStatus
        OpEventSetEventStatus_SetEventStatus_Event_VcEvCntrHvSysRlySts: start-on-event=SetEventStatus, operation=Event_VcEvCntrHvSysRlySts.SetEventStatus
        OpEventSetEventStatus_SetEventStatus_Event_CRASH_DTC: start-on-event=SetEventStatus, operation=Event_CRASH_DTC.SetEventStatus
        OpEventSetEventStatus_SetEventStatus_Event_INV_IGBT_TEMP_W_RNG_HI: start-on-event=SetEventStatus, operation=Event_INV_IGBT_TEMP_W_RNG_HI.SetEventStatus
        OpEventSetEventStatus_SetEventStatus_Event_VCEvBecmPropFr02Tioutd: start-on-event=SetEventStatus, operation=Event_VCEvBecmPropFr02Tioutd.SetEventStatus
        OpEventSetEventStatus_SetEventStatus_Event_INV_IGBT_TEMP_W_GRDT: start-on-event=SetEventStatus, operation=Event_INV_IGBT_TEMP_W_GRDT.SetEventStatus
        OpEventSetEventStatus_SetEventStatus_Event_EXT_UC_SPI_FLT: start-on-event=SetEventStatus, operation=Event_EXT_UC_SPI_FLT.SetEventStatus
        OpEventSetEventStatus_SetEventStatus_Event_INV_IAC_V_ELEC_HWP_001: start-on-event=SetEventStatus, operation=Event_INV_IAC_V_ELEC_HWP_001.SetEventStatus
        OpEventSetEventStatus_SetEventStatus_Event_VcEvChkSumWhlMotSysTqAllwd: start-on-event=SetEventStatus, operation=Event_VcEvChkSumWhlMotSysTqAllwd.SetEventStatus
        OpEventSetEventStatus_SetEventStatus_Event_FS_MONITIOR_ASC_FLT: start-on-event=SetEventStatus, operation=Event_FS_MONITIOR_ASC_FLT.SetEventStatus
        OpEventSetEventStatus_SetEventStatus_Event_INV_IAC_V_AMP: start-on-event=SetEventStatus, operation=Event_INV_IAC_V_AMP.SetEventStatus
        OpEventSetEventStatus_SetEventStatus_Event_INV_IAC_W_ELEC_LO: start-on-event=SetEventStatus, operation=Event_INV_IAC_W_ELEC_LO.SetEventStatus
        OpEventSetEventStatus_SetEventStatus_Event_VCEvVddmPropFr08Tioutd_001: start-on-event=SetEventStatus, operation=Event_VCEvVddmPropFr08Tioutd_001.SetEventStatus
        OpEventSetEventStatus_SetEventStatus_Event_PS_P12_RES_FLT: start-on-event=SetEventStatus, operation=Event_PS_P12_RES_FLT.SetEventStatus
        OpEventSetEventStatus_SetEventStatus_Event_INV_RSLVR_SIN_RNG_LO: start-on-event=SetEventStatus, operation=Event_INV_RSLVR_SIN_RNG_LO.SetEventStatus
        OpEventSetEventStatus_SetEventStatus_Event_CU_TEMP_HW_FLT: start-on-event=SetEventStatus, operation=Event_CU_TEMP_HW_FLT.SetEventStatus
        OpEventSetEventStatus_SetEventStatus_Event_VCEvEcmPropFr02MgmFr00Tioutd: start-on-event=SetEventStatus, operation=Event_VCEvEcmPropFr02MgmFr00Tioutd.SetEventStatus
        OpEventSetEventStatus_SetEventStatus_Event_PS_KL15_RNG_HI: start-on-event=SetEventStatus, operation=Event_PS_KL15_RNG_HI.SetEventStatus
        OpEventSetEventStatus_SetEventStatus_Event_VCEvVddmPropFr17Tioutd: start-on-event=SetEventStatus, operation=Event_VCEvVddmPropFr17Tioutd.SetEventStatus
        OpEventSetEventStatus_SetEventStatus_Event_VcEvChkSumCrashStsSafe: start-on-event=SetEventStatus, operation=Event_VcEvChkSumCrashStsSafe.SetEventStatus
        OpEventSetEventStatus_SetEventStatus_Event_DiagC_ClutchService: start-on-event=SetEventStatus, operation=Event_DiagC_ClutchService.SetEventStatus
        OpEventSetEventStatus_SetEventStatus_Event_INV_EM_STATOR_TEMP_RNG_HI: start-on-event=SetEventStatus, operation=Event_INV_EM_STATOR_TEMP_RNG_HI.SetEventStatus
        OpEventSetEventStatus_SetEventStatus_Event_INV_RSLVR_OFFS_OUT_RANG: start-on-event=SetEventStatus, operation=Event_INV_RSLVR_OFFS_OUT_RANG.SetEventStatus
        OpEventSetEventStatus_SetEventStatus_Event_INV_EM_STATOR_TEMP2_RNG_LO: start-on-event=SetEventStatus, operation=Event_INV_EM_STATOR_TEMP2_RNG_LO.SetEventStatus
        OpEventSetEventStatus_SetEventStatus_Event_VcEvMonISAR: start-on-event=SetEventStatus, operation=Event_VcEvMonISAR.SetEventStatus
        OpEventSetEventStatus_SetEventStatus_Event_GA_BLDC_FLT: start-on-event=SetEventStatus, operation=Event_GA_BLDC_FLT.SetEventStatus
        OpEventSetEventStatus_SetEventStatus_Event_INV_RSLVR_EXCT_ELEC_OPEN: start-on-event=SetEventStatus, operation=Event_INV_RSLVR_EXCT_ELEC_OPEN.SetEventStatus
        OpEventSetEventStatus_SetEventStatus_Event_INV_RSLVR_EXCT_PLAUS: start-on-event=SetEventStatus, operation=Event_INV_RSLVR_EXCT_PLAUS.SetEventStatus
        OpEventSetEventStatus_SetEventStatus_Event_PS_P15_U_FLT: start-on-event=SetEventStatus, operation=Event_PS_P15_U_FLT.SetEventStatus
        OpEventSetEventStatus_SetEventStatus_Event_INV_EM_STATOR_TEMP_RNG_SWT: start-on-event=SetEventStatus, operation=Event_INV_EM_STATOR_TEMP_RNG_SWT.SetEventStatus
        OpEventSetEventStatus_SetEventStatus_Event_INV_UHVDC_OV_SWP: start-on-event=SetEventStatus, operation=Event_INV_UHVDC_OV_SWP.SetEventStatus
        OpEventSetEventStatus_SetEventStatus_Event_AURIX_HW_FLT: start-on-event=SetEventStatus, operation=Event_AURIX_HW_FLT.SetEventStatus
        OpEventSetEventStatus_SetEventStatus_Event_INV_GATE_DRVR_TOP_HWP: start-on-event=SetEventStatus, operation=Event_INV_GATE_DRVR_TOP_HWP.SetEventStatus
        OpEventSetEventStatus_SetEventStatus_Event_INV_ACTV_DCHA_HW: start-on-event=SetEventStatus, operation=Event_INV_ACTV_DCHA_HW.SetEventStatus
        OpEventSetEventStatus_SetEventStatus_Event_INV_IGBT_TEMP_HWP: start-on-event=SetEventStatus, operation=Event_INV_IGBT_TEMP_HWP.SetEventStatus
        OpEventSetEventStatus_SetEventStatus_Event_INV_RSLVR_SIN_ELEC_FLT: start-on-event=SetEventStatus, operation=Event_INV_RSLVR_SIN_ELEC_FLT.SetEventStatus
        OpEventSetEventStatus_SetEventStatus_Event_CU_TEMP2_RNG_HI: start-on-event=SetEventStatus, operation=Event_CU_TEMP2_RNG_HI.SetEventStatus
        OpEventSetEventStatus_SetEventStatus_Event_INV_IAC_PHA_LOSS_MPL: start-on-event=SetEventStatus, operation=Event_INV_IAC_PHA_LOSS_MPL.SetEventStatus
        OpEventSetEventStatus_SetEventStatus_Event_INV_IAC_U_AMP: start-on-event=SetEventStatus, operation=Event_INV_IAC_U_AMP.SetEventStatus
        OpEventSetEventStatus_SetEventStatus_Event_PSnsr_GRADT_Flt: start-on-event=SetEventStatus, operation=Event_PSnsr_GRADT_Flt.SetEventStatus
        OpEventSetEventStatus_SetEventStatus_Event_AURIX_WATHDOG_FLT: start-on-event=SetEventStatus, operation=Event_AURIX_WATHDOG_FLT.SetEventStatus
        OpEventSetEventStatus_SetEventStatus_Event_VcEvNodeMisBECM: start-on-event=SetEventStatus, operation=Event_VcEvNodeMisBECM.SetEventStatus
        OpEventSetEventStatus_SetEventStatus_Event_INV_UHVDC_UV_HWP: start-on-event=SetEventStatus, operation=Event_INV_UHVDC_UV_HWP.SetEventStatus
        OpEventSetEventStatus_SetEventStatus_Event_VcEvMonESpd: start-on-event=SetEventStatus, operation=Event_VcEvMonESpd.SetEventStatus
        OpEventSetEventStatus_SetEventStatus_Event_COM_NotConfig: start-on-event=SetEventStatus, operation=Event_COM_NotConfig.SetEventStatus
        OpEventSetEventStatus_SetEventStatus_Event_INV_RSLVR_SIN_RNG_HI: start-on-event=SetEventStatus, operation=Event_INV_RSLVR_SIN_RNG_HI.SetEventStatus
        OpEventSetEventStatus_SetEventStatus_Event_INV_IGBT_TEMP_U_RNG_HI: start-on-event=SetEventStatus, operation=Event_INV_IGBT_TEMP_U_RNG_HI.SetEventStatus
        OpEventSetEventStatus_SetEventStatus_Event_VcEvMonMode_001: start-on-event=SetEventStatus, operation=Event_VcEvMonMode_001.SetEventStatus
        OpEventSetEventStatus_SetEventStatus_Event_PA_ACTION_FLT: start-on-event=SetEventStatus, operation=Event_PA_ACTION_FLT.SetEventStatus
        OpEventSetEventStatus_SetEventStatus_Event_INV_IAC_V_ELEC_HWP: start-on-event=SetEventStatus, operation=Event_INV_IAC_V_ELEC_HWP.SetEventStatus
        OpEventSetEventStatus_SetEventStatus_Event_CU_TEMP_HW_FLT_001: start-on-event=SetEventStatus, operation=Event_CU_TEMP_HW_FLT_001.SetEventStatus
        OpEventSetEventStatus_SetEventStatus_Event_VCC_UnderVoltage: start-on-event=SetEventStatus, operation=Event_VCC_UnderVoltage.SetEventStatus
        OpEventSetEventStatus_SetEventStatus_Event_VcEvTsttrPlaus: start-on-event=SetEventStatus, operation=Event_VcEvTsttrPlaus.SetEventStatus
        OpEventSetEventStatus_SetEventStatus_Event_INV_RSLVR_EXCT_ELEC_FLT: start-on-event=SetEventStatus, operation=Event_INV_RSLVR_EXCT_ELEC_FLT.SetEventStatus
        OpEventSetEventStatus_SetEventStatus_Event_INV_RSLVR_EXCT_RNG_LO: start-on-event=SetEventStatus, operation=Event_INV_RSLVR_EXCT_RNG_LO.SetEventStatus
        OpEventSetEventStatus_SetEventStatus_Event_INV_EM_STATOR_TEMP2_RNG_HI: start-on-event=SetEventStatus, operation=Event_INV_EM_STATOR_TEMP2_RNG_HI.SetEventStatus
        OpEventSetEventStatus_SetEventStatus_Event_INV_SHUT_OFF_PAH_START_UP: start-on-event=SetEventStatus, operation=Event_INV_SHUT_OFF_PAH_START_UP.SetEventStatus
        OpEventSetEventStatus_SetEventStatus_Event_VCEvVddmPropFr08Tioutd: start-on-event=SetEventStatus, operation=Event_VCEvVddmPropFr08Tioutd.SetEventStatus
        OpEventSetEventStatus_SetEventStatus_Event_INV_RSLVR_EXCT_OC_HWP_001: start-on-event=SetEventStatus, operation=Event_INV_RSLVR_EXCT_OC_HWP_001.SetEventStatus
        OpEventSetEventStatus_SetEventStatus_Event_INV_RSLVR_EXCT_OC_HWP_002: start-on-event=SetEventStatus, operation=Event_INV_RSLVR_EXCT_OC_HWP_002.SetEventStatus
        OpEventSetEventStatus_SetEventStatus_Event_INV_EM_STATOR_TEMP_ELE_FLT: start-on-event=SetEventStatus, operation=Event_INV_EM_STATOR_TEMP_ELE_FLT.SetEventStatus
        OpEventSetEventStatus_SetEventStatus_Event_INV_INTERLOCK_FLT: start-on-event=SetEventStatus, operation=Event_INV_INTERLOCK_FLT.SetEventStatus
        OpEventSetEventStatus_SetEventStatus_Event_Ga_ZeroFindDistanFailure: start-on-event=SetEventStatus, operation=Event_Ga_ZeroFindDistanFailure.SetEventStatus
        OpEventSetEventStatus_SetEventStatus_Event_PLOCK_Current_RNG_OUT: start-on-event=SetEventStatus, operation=Event_PLOCK_Current_RNG_OUT.SetEventStatus
        OpEventSetEventStatus_SetEventStatus_Event_VCEvVddmPropFr05Tioutd: start-on-event=SetEventStatus, operation=Event_VCEvVddmPropFr05Tioutd.SetEventStatus
        OpEventSetEventStatus_SetEventStatus_Event_INV_IGBT_TEMP_V_GRDT: start-on-event=SetEventStatus, operation=Event_INV_IGBT_TEMP_V_GRDT.SetEventStatus
        OpEventSetEventStatus_SetEventStatus_Event_PS_5V_Fault: start-on-event=SetEventStatus, operation=Event_PS_5V_Fault.SetEventStatus
        OpEventSetEventStatus_SetEventStatus_Event_VcEvCntrCrashStsSafe: start-on-event=SetEventStatus, operation=Event_VcEvCntrCrashStsSafe.SetEventStatus
        OpEventSetEventStatus_SetEventStatus_Event_INV_EM_STATOR_TEMP_GRDT: start-on-event=SetEventStatus, operation=Event_INV_EM_STATOR_TEMP_GRDT.SetEventStatus
        OpEventSetEventStatus_SetEventStatus_Event_PS_P15_V_FLT: start-on-event=SetEventStatus, operation=Event_PS_P15_V_FLT.SetEventStatus
        OpEventSetEventStatus_SetEventStatus_Event_INV_EM_STATOR_TEMP_RNG_NOK: start-on-event=SetEventStatus, operation=Event_INV_EM_STATOR_TEMP_RNG_NOK.SetEventStatus
        OpEventSetEventStatus_SetEventStatus_Event_INV_RSLVR_SIN_RNG_NOK: start-on-event=SetEventStatus, operation=Event_INV_RSLVR_SIN_RNG_NOK.SetEventStatus
        OpEventSetEventStatus_SetEventStatus_Event_INV_IAC_U_OFFS: start-on-event=SetEventStatus, operation=Event_INV_IAC_U_OFFS.SetEventStatus
        OpEventSetEventStatus_SetEventStatus_Event_PS_KL30_BACKUP_FLT: start-on-event=SetEventStatus, operation=Event_PS_KL30_BACKUP_FLT.SetEventStatus
        OpEventSetEventStatus_SetEventStatus_Event_INV_IGBT_TEMP_U_RNG_LO: start-on-event=SetEventStatus, operation=Event_INV_IGBT_TEMP_U_RNG_LO.SetEventStatus
        OpEventSetEventStatus_SetEventStatus_Event_INV_EM_STATOR_TEMP_HWP: start-on-event=SetEventStatus, operation=Event_INV_EM_STATOR_TEMP_HWP.SetEventStatus
        OpEventSetEventStatus_SetEventStatus_Event_CU_TEMP1_RNG_HI: start-on-event=SetEventStatus, operation=Event_CU_TEMP1_RNG_HI.SetEventStatus
        OpEventSetEventStatus_SetEventStatus_Event_INV_IGBT_TEMP_V_RNG_HI: start-on-event=SetEventStatus, operation=Event_INV_IGBT_TEMP_V_RNG_HI.SetEventStatus
        OpEventSetEventStatus_SetEventStatus_Event_VcEvNodeMisVDDM: start-on-event=SetEventStatus, operation=Event_VcEvNodeMisVDDM.SetEventStatus
        OpEventSetEventStatus_SetEventStatus_Event_INV_UHVDC_PLAUS: start-on-event=SetEventStatus, operation=Event_INV_UHVDC_PLAUS.SetEventStatus
        OpEventSetEventStatus_SetEventStatus_Event_INV_QUIESCENT_FLT: start-on-event=SetEventStatus, operation=Event_INV_QUIESCENT_FLT.SetEventStatus
        OpEventSetEventStatus_SetEventStatus_Event_INV_RSLVR_EXCT_RNG_HI: start-on-event=SetEventStatus, operation=Event_INV_RSLVR_EXCT_RNG_HI.SetEventStatus
        OpEventResetEventStatus_ResetEventStatus_Event_VCEvBecmPropFr01Tioutd: start-on-event=ResetEventStatus, operation=Event_VCEvBecmPropFr01Tioutd.ResetEventStatus
        OpEventResetEventStatus_ResetEventStatus_Event_INV_CU_TEMP2_RNG_NOK: start-on-event=ResetEventStatus, operation=Event_INV_CU_TEMP2_RNG_NOK.ResetEventStatus
        OpEventResetEventStatus_ResetEventStatus_Event_COM_Busoff: start-on-event=ResetEventStatus, operation=Event_COM_Busoff.ResetEventStatus
        OpEventResetEventStatus_ResetEventStatus_Event_INV_IMMO_NOKEY: start-on-event=ResetEventStatus, operation=Event_INV_IMMO_NOKEY.ResetEventStatus
        OpEventResetEventStatus_ResetEventStatus_Event_INV_RSLVR_EXCT_OC_HWP: start-on-event=ResetEventStatus, operation=Event_INV_RSLVR_EXCT_OC_HWP.ResetEventStatus
        OpEventResetEventStatus_ResetEventStatus_Event_PS_P15_W_FLT: start-on-event=ResetEventStatus, operation=Event_PS_P15_W_FLT.ResetEventStatus
        OpEventResetEventStatus_ResetEventStatus_Event_INV_IAC_PLAUS_SUM: start-on-event=ResetEventStatus, operation=Event_INV_IAC_PLAUS_SUM.ResetEventStatus
        OpEventResetEventStatus_ResetEventStatus_Event_PA_ELE_FLT: start-on-event=ResetEventStatus, operation=Event_PA_ELE_FLT.ResetEventStatus
        OpEventResetEventStatus_ResetEventStatus_Event_CU_TEMP_GRDT: start-on-event=ResetEventStatus, operation=Event_CU_TEMP_GRDT.ResetEventStatus
        OpEventResetEventStatus_ResetEventStatus_Event_INV_IGBT_TEMP_V_PLAUS: start-on-event=ResetEventStatus, operation=Event_INV_IGBT_TEMP_V_PLAUS.ResetEventStatus
        OpEventResetEventStatus_ResetEventStatus_Event_Ga_GAEngageFailure: start-on-event=ResetEventStatus, operation=Event_Ga_GAEngageFailure.ResetEventStatus
        OpEventResetEventStatus_ResetEventStatus_Event_INV_IAC_W_RNG_LO: start-on-event=ResetEventStatus, operation=Event_INV_IAC_W_RNG_LO.ResetEventStatus
        OpEventResetEventStatus_ResetEventStatus_Event_PS_WhlSnsr_Vltg_FLT: start-on-event=ResetEventStatus, operation=Event_PS_WhlSnsr_Vltg_FLT.ResetEventStatus
        OpEventResetEventStatus_ResetEventStatus_Event_VCEvEcmPropFr02Tioutd: start-on-event=ResetEventStatus, operation=Event_VCEvEcmPropFr02Tioutd.ResetEventStatus
        OpEventResetEventStatus_ResetEventStatus_Event_Ga_TmSpdSyncFailed: start-on-event=ResetEventStatus, operation=Event_Ga_TmSpdSyncFailed.ResetEventStatus
        OpEventResetEventStatus_ResetEventStatus_Event_INV_RSLVR_EXCT_ELEC_LO: start-on-event=ResetEventStatus, operation=Event_INV_RSLVR_EXCT_ELEC_LO.ResetEventStatus
        OpEventResetEventStatus_ResetEventStatus_Event_VCEvEcmPropXevFr06Tioutd: start-on-event=ResetEventStatus, operation=Event_VCEvEcmPropXevFr06Tioutd.ResetEventStatus
        OpEventResetEventStatus_ResetEventStatus_Event_VcEvCntrWhlMotSysTqAllwd: start-on-event=ResetEventStatus, operation=Event_VcEvCntrWhlMotSysTqAllwd.ResetEventStatus
        OpEventResetEventStatus_ResetEventStatus_Event_INV_UHVDC_1_ELEC_HI: start-on-event=ResetEventStatus, operation=Event_INV_UHVDC_1_ELEC_HI.ResetEventStatus
        OpEventResetEventStatus_ResetEventStatus_Event_INV_EM_STATOR_TEMP2_ELE_FLT: start-on-event=ResetEventStatus, operation=Event_INV_EM_STATOR_TEMP2_ELE_FLT.ResetEventStatus
        OpEventResetEventStatus_ResetEventStatus_Event_AURIX_RST_SNG: start-on-event=ResetEventStatus, operation=Event_AURIX_RST_SNG.ResetEventStatus
        OpEventResetEventStatus_ResetEventStatus_Event_VCEvEcmPropFr24MgmFr01Tioutd: start-on-event=ResetEventStatus, operation=Event_VCEvEcmPropFr24MgmFr01Tioutd.ResetEventStatus
        OpEventResetEventStatus_ResetEventStatus_Event_INV_RSLVR_COS_ELEC_OPEN: start-on-event=ResetEventStatus, operation=Event_INV_RSLVR_COS_ELEC_OPEN.ResetEventStatus
        OpEventResetEventStatus_ResetEventStatus_Event_INV_IAC_V_ELEC_LO: start-on-event=ResetEventStatus, operation=Event_INV_IAC_V_ELEC_LO.ResetEventStatus
        OpEventResetEventStatus_ResetEventStatus_Event_INV_IAC_W_OFFS: start-on-event=ResetEventStatus, operation=Event_INV_IAC_W_OFFS.ResetEventStatus
        OpEventResetEventStatus_ResetEventStatus_Event_INV_EM_STATOR_TEMP2_GRDT: start-on-event=ResetEventStatus, operation=Event_INV_EM_STATOR_TEMP2_GRDT.ResetEventStatus
        OpEventResetEventStatus_ResetEventStatus_Event_INV_EM_OVRSPD_HWP: start-on-event=ResetEventStatus, operation=Event_INV_EM_OVRSPD_HWP.ResetEventStatus
        OpEventResetEventStatus_ResetEventStatus_Event_CU_TEMP_HWP: start-on-event=ResetEventStatus, operation=Event_CU_TEMP_HWP.ResetEventStatus
        OpEventResetEventStatus_ResetEventStatus_Event_INV_UHVDC_1_RNG_HI: start-on-event=ResetEventStatus, operation=Event_INV_UHVDC_1_RNG_HI.ResetEventStatus
        OpEventResetEventStatus_ResetEventStatus_Event_VcEvEMPerfPlaus: start-on-event=ResetEventStatus, operation=Event_VcEvEMPerfPlaus.ResetEventStatus
        OpEventResetEventStatus_ResetEventStatus_Event_VCEvVddmPropFr18Tioutd: start-on-event=ResetEventStatus, operation=Event_VCEvVddmPropFr18Tioutd.ResetEventStatus
        OpEventResetEventStatus_ResetEventStatus_Event_INV_IAC_U_ELEC_HWP: start-on-event=ResetEventStatus, operation=Event_INV_IAC_U_ELEC_HWP.ResetEventStatus
        OpEventResetEventStatus_ResetEventStatus_Event_VCEvVddmPropFr15Tioutd: start-on-event=ResetEventStatus, operation=Event_VCEvVddmPropFr15Tioutd.ResetEventStatus
        OpEventResetEventStatus_ResetEventStatus_Event_Ga_GADisengageFailure: start-on-event=ResetEventStatus, operation=Event_Ga_GADisengageFailure.ResetEventStatus
        OpEventResetEventStatus_ResetEventStatus_Event_CU_TEMP2_RNG_LO: start-on-event=ResetEventStatus, operation=Event_CU_TEMP2_RNG_LO.ResetEventStatus
        OpEventResetEventStatus_ResetEventStatus_Event_INV_RSLVR_SIN_ELEC_OPEN: start-on-event=ResetEventStatus, operation=Event_INV_RSLVR_SIN_ELEC_OPEN.ResetEventStatus
        OpEventResetEventStatus_ResetEventStatus_Event_VcEvChkSum: start-on-event=ResetEventStatus, operation=Event_VcEvChkSum.ResetEventStatus
        OpEventResetEventStatus_ResetEventStatus_Event_PS_P5_UC_FLT: start-on-event=ResetEventStatus, operation=Event_PS_P5_UC_FLT.ResetEventStatus
        OpEventResetEventStatus_ResetEventStatus_Event_INV_RSLVR_COS_ELEC_FLT: start-on-event=ResetEventStatus, operation=Event_INV_RSLVR_COS_ELEC_FLT.ResetEventStatus
        OpEventResetEventStatus_ResetEventStatus_Event_INV_IAC_W_RNG_HI: start-on-event=ResetEventStatus, operation=Event_INV_IAC_W_RNG_HI.ResetEventStatus
        OpEventResetEventStatus_ResetEventStatus_Event_PS_ECUSUPPLY_HIGH: start-on-event=ResetEventStatus, operation=Event_PS_ECUSUPPLY_HIGH.ResetEventStatus
        OpEventResetEventStatus_ResetEventStatus_Event_VCEvEcmPropFr05Tioutd: start-on-event=ResetEventStatus, operation=Event_VCEvEcmPropFr05Tioutd.ResetEventStatus
        OpEventResetEventStatus_ResetEventStatus_Event_PS_ECUSUPPLY_LOW: start-on-event=ResetEventStatus, operation=Event_PS_ECUSUPPLY_LOW.ResetEventStatus
        OpEventResetEventStatus_ResetEventStatus_Event_VcEvChkSumHvSysRlySts: start-on-event=ResetEventStatus, operation=Event_VcEvChkSumHvSysRlySts.ResetEventStatus
        OpEventResetEventStatus_ResetEventStatus_Event_VcEvMonMode: start-on-event=ResetEventStatus, operation=Event_VcEvMonMode.ResetEventStatus
        OpEventResetEventStatus_ResetEventStatus_Event_INV_IAC_OC_SWP: start-on-event=ResetEventStatus, operation=Event_INV_IAC_OC_SWP.ResetEventStatus
        OpEventResetEventStatus_ResetEventStatus_Event_INV_IMMO_AUTHFAIL: start-on-event=ResetEventStatus, operation=Event_INV_IMMO_AUTHFAIL.ResetEventStatus
        OpEventResetEventStatus_ResetEventStatus_Event_PA_OpenCirc_FLT: start-on-event=ResetEventStatus, operation=Event_PA_OpenCirc_FLT.ResetEventStatus
        OpEventResetEventStatus_ResetEventStatus_Event_INV_IAC_V_ELEC_HI: start-on-event=ResetEventStatus, operation=Event_INV_IAC_V_ELEC_HI.ResetEventStatus
        OpEventResetEventStatus_ResetEventStatus_Event_VCEvEcmPropFr04Tioutd: start-on-event=ResetEventStatus, operation=Event_VCEvEcmPropFr04Tioutd.ResetEventStatus
        OpEventResetEventStatus_ResetEventStatus_Event_VcEvMonTrqActPlaus: start-on-event=ResetEventStatus, operation=Event_VcEvMonTrqActPlaus.ResetEventStatus
        OpEventResetEventStatus_ResetEventStatus_Event_VcEvMonTrqAct: start-on-event=ResetEventStatus, operation=Event_VcEvMonTrqAct.ResetEventStatus
        OpEventResetEventStatus_ResetEventStatus_Event_INV_RSLVR_COS_ELEC_LO: start-on-event=ResetEventStatus, operation=Event_INV_RSLVR_COS_ELEC_LO.ResetEventStatus
        OpEventResetEventStatus_ResetEventStatus_Event_INV_COOLT_INLET_TEMP_HWP: start-on-event=ResetEventStatus, operation=Event_INV_COOLT_INLET_TEMP_HWP.ResetEventStatus
        OpEventResetEventStatus_ResetEventStatus_Event_VCEvEcmPropFr11Tioutd: start-on-event=ResetEventStatus, operation=Event_VCEvEcmPropFr11Tioutd.ResetEventStatus
        OpEventResetEventStatus_ResetEventStatus_Event_PS_KL30_RNG_HI: start-on-event=ResetEventStatus, operation=Event_PS_KL30_RNG_HI.ResetEventStatus
        OpEventResetEventStatus_ResetEventStatus_Event_INV_IAC_OC_HWP: start-on-event=ResetEventStatus, operation=Event_INV_IAC_OC_HWP.ResetEventStatus
        OpEventResetEventStatus_ResetEventStatus_Event_INV_RSLVR_COS_RNG_HI: start-on-event=ResetEventStatus, operation=Event_INV_RSLVR_COS_RNG_HI.ResetEventStatus
        OpEventResetEventStatus_ResetEventStatus_Event_INV_IAC_U_ELEC_HI: start-on-event=ResetEventStatus, operation=Event_INV_IAC_U_ELEC_HI.ResetEventStatus
        OpEventResetEventStatus_ResetEventStatus_Event_INV_IAC_V_RNG_LO: start-on-event=ResetEventStatus, operation=Event_INV_IAC_V_RNG_LO.ResetEventStatus
        OpEventResetEventStatus_ResetEventStatus_Event_INV_IAC_U_RNG_HI: start-on-event=ResetEventStatus, operation=Event_INV_IAC_U_RNG_HI.ResetEventStatus
        OpEventResetEventStatus_ResetEventStatus_Event_VCEvEcmPropFr25Tioutd: start-on-event=ResetEventStatus, operation=Event_VCEvEcmPropFr25Tioutd.ResetEventStatus
        OpEventResetEventStatus_ResetEventStatus_Event_INV_IGBT_TEMP_W_RNG_LO: start-on-event=ResetEventStatus, operation=Event_INV_IGBT_TEMP_W_RNG_LO.ResetEventStatus
        OpEventResetEventStatus_ResetEventStatus_Event_PSnsr_RNG_NOK: start-on-event=ResetEventStatus, operation=Event_PSnsr_RNG_NOK.ResetEventStatus
        OpEventResetEventStatus_ResetEventStatus_Event_INV_RSLVR_COS_RNG_NOK: start-on-event=ResetEventStatus, operation=Event_INV_RSLVR_COS_RNG_NOK.ResetEventStatus
        OpEventResetEventStatus_ResetEventStatus_Event_PS_DRVB_Fault: start-on-event=ResetEventStatus, operation=Event_PS_DRVB_Fault.ResetEventStatus
        OpEventResetEventStatus_ResetEventStatus_Event_INV_CU_TEMP1_RNG_NOK: start-on-event=ResetEventStatus, operation=Event_INV_CU_TEMP1_RNG_NOK.ResetEventStatus
        OpEventResetEventStatus_ResetEventStatus_Event_VcEvCntr: start-on-event=ResetEventStatus, operation=Event_VcEvCntr.ResetEventStatus
        OpEventResetEventStatus_ResetEventStatus_Event_INV_RSLVR_SIN_AMP: start-on-event=ResetEventStatus, operation=Event_INV_RSLVR_SIN_AMP.ResetEventStatus
        OpEventResetEventStatus_ResetEventStatus_Event_INV_UHVDC_2_RNG_HI: start-on-event=ResetEventStatus, operation=Event_INV_UHVDC_2_RNG_HI.ResetEventStatus
        OpEventResetEventStatus_ResetEventStatus_Event_INV_IGBT_TEMP_U_GRDT: start-on-event=ResetEventStatus, operation=Event_INV_IGBT_TEMP_U_GRDT.ResetEventStatus
        OpEventResetEventStatus_ResetEventStatus_Event_MON_TQ_PLAUS_PWR_MDL: start-on-event=ResetEventStatus, operation=Event_MON_TQ_PLAUS_PWR_MDL.ResetEventStatus
        OpEventResetEventStatus_ResetEventStatus_Event_INV_IGBT_TEMP_W_PLAUS: start-on-event=ResetEventStatus, operation=Event_INV_IGBT_TEMP_W_PLAUS.ResetEventStatus
        OpEventResetEventStatus_ResetEventStatus_Event_PS_BLDC_UV_FLT: start-on-event=ResetEventStatus, operation=Event_PS_BLDC_UV_FLT.ResetEventStatus
        OpEventResetEventStatus_ResetEventStatus_Event_INV_IAC_V_OFFS: start-on-event=ResetEventStatus, operation=Event_INV_IAC_V_OFFS.ResetEventStatus
        OpEventResetEventStatus_ResetEventStatus_Event_INV_RSLVR_EXCT_FREQ_RNG_NOK: start-on-event=ResetEventStatus, operation=Event_INV_RSLVR_EXCT_FREQ_RNG_NOK.ResetEventStatus
        OpEventResetEventStatus_ResetEventStatus_Event_PS_KL30_RNG_LO: start-on-event=ResetEventStatus, operation=Event_PS_KL30_RNG_LO.ResetEventStatus
        OpEventResetEventStatus_ResetEventStatus_Event_INV_RSLVR_COS_RNG_LO: start-on-event=ResetEventStatus, operation=Event_INV_RSLVR_COS_RNG_LO.ResetEventStatus
        OpEventResetEventStatus_ResetEventStatus_Event_PSnsr_ELE_FLT: start-on-event=ResetEventStatus, operation=Event_PSnsr_ELE_FLT.ResetEventStatus
        OpEventResetEventStatus_ResetEventStatus_Event_INV_RSLVR_SIN_COS_PLAUS_AMP: start-on-event=ResetEventStatus, operation=Event_INV_RSLVR_SIN_COS_PLAUS_AMP.ResetEventStatus
        OpEventResetEventStatus_ResetEventStatus_Event_INV_IAC_U_ELEC_LO: start-on-event=ResetEventStatus, operation=Event_INV_IAC_U_ELEC_LO.ResetEventStatus
        OpEventResetEventStatus_ResetEventStatus_Event_INV_RSLVR_EXCT_ELEC_HI: start-on-event=ResetEventStatus, operation=Event_INV_RSLVR_EXCT_ELEC_HI.ResetEventStatus
        OpEventResetEventStatus_ResetEventStatus_Event_INV_IAC_U_RNG_LO: start-on-event=ResetEventStatus, operation=Event_INV_IAC_U_RNG_LO.ResetEventStatus
        OpEventResetEventStatus_ResetEventStatus_Event_INV_IAC_V_RNG_HI: start-on-event=ResetEventStatus, operation=Event_INV_IAC_V_RNG_HI.ResetEventStatus
        OpEventResetEventStatus_ResetEventStatus_Event_INV_IGBT_TEMP_U_PLAUS: start-on-event=ResetEventStatus, operation=Event_INV_IGBT_TEMP_U_PLAUS.ResetEventStatus
        OpEventResetEventStatus_ResetEventStatus_Event_INV_RSLVR_OFFS_DFT: start-on-event=ResetEventStatus, operation=Event_INV_RSLVR_OFFS_DFT.ResetEventStatus
        OpEventResetEventStatus_ResetEventStatus_Event_Ga_MoveOverThd: start-on-event=ResetEventStatus, operation=Event_Ga_MoveOverThd.ResetEventStatus
        OpEventResetEventStatus_ResetEventStatus_Event_VcEvMonIPH: start-on-event=ResetEventStatus, operation=Event_VcEvMonIPH.ResetEventStatus
        OpEventResetEventStatus_ResetEventStatus_Event_INV_RSLVR_HW_FLT: start-on-event=ResetEventStatus, operation=Event_INV_RSLVR_HW_FLT.ResetEventStatus
        OpEventResetEventStatus_ResetEventStatus_Event_INV_RSLVR_SIN_ELEC_LO: start-on-event=ResetEventStatus, operation=Event_INV_RSLVR_SIN_ELEC_LO.ResetEventStatus
        OpEventResetEventStatus_ResetEventStatus_Event_INV_IAC_W_AMP: start-on-event=ResetEventStatus, operation=Event_INV_IAC_W_AMP.ResetEventStatus
        OpEventResetEventStatus_ResetEventStatus_Event_VCC_OverVoltage: start-on-event=ResetEventStatus, operation=Event_VCC_OverVoltage.ResetEventStatus
        OpEventResetEventStatus_ResetEventStatus_Event_PS_BLDC_OV_FLT: start-on-event=ResetEventStatus, operation=Event_PS_BLDC_OV_FLT.ResetEventStatus
        OpEventResetEventStatus_ResetEventStatus_Event_AURIX_EEPROM_FLT: start-on-event=ResetEventStatus, operation=Event_AURIX_EEPROM_FLT.ResetEventStatus
        OpEventResetEventStatus_ResetEventStatus_Event_FS_MONITIOR_ASC_FW_FLT: start-on-event=ResetEventStatus, operation=Event_FS_MONITIOR_ASC_FW_FLT.ResetEventStatus
        OpEventResetEventStatus_ResetEventStatus_Event_VCEvSrsPropFr02Tioutd: start-on-event=ResetEventStatus, operation=Event_VCEvSrsPropFr02Tioutd.ResetEventStatus
        OpEventResetEventStatus_ResetEventStatus_Event_VcEvMonErrMode: start-on-event=ResetEventStatus, operation=Event_VcEvMonErrMode.ResetEventStatus
        OpEventResetEventStatus_ResetEventStatus_Event_AURIX_RST_MPL: start-on-event=ResetEventStatus, operation=Event_AURIX_RST_MPL.ResetEventStatus
        OpEventResetEventStatus_ResetEventStatus_Event_VcEvNodeMisECM: start-on-event=ResetEventStatus, operation=Event_VcEvNodeMisECM.ResetEventStatus
        OpEventResetEventStatus_ResetEventStatus_Event_PS_KL30_PLAUS: start-on-event=ResetEventStatus, operation=Event_PS_KL30_PLAUS.ResetEventStatus
        OpEventResetEventStatus_ResetEventStatus_Event_INV_IAC_W_ELEC_HI: start-on-event=ResetEventStatus, operation=Event_INV_IAC_W_ELEC_HI.ResetEventStatus
        OpEventResetEventStatus_ResetEventStatus_Event_VCEvVddmPropFr19Tioutd: start-on-event=ResetEventStatus, operation=Event_VCEvVddmPropFr19Tioutd.ResetEventStatus
        OpEventResetEventStatus_ResetEventStatus_Event_INV_TEMP_DCHA_HW: start-on-event=ResetEventStatus, operation=Event_INV_TEMP_DCHA_HW.ResetEventStatus
        OpEventResetEventStatus_ResetEventStatus_Event_VcEvPropCANGlbTiOutd: start-on-event=ResetEventStatus, operation=Event_VcEvPropCANGlbTiOutd.ResetEventStatus
        OpEventResetEventStatus_ResetEventStatus_Event_INV_EM_STATOR_TEMP2_RNG_NOK: start-on-event=ResetEventStatus, operation=Event_INV_EM_STATOR_TEMP2_RNG_NOK.ResetEventStatus
        OpEventResetEventStatus_ResetEventStatus_Event_INV_UHVDC_OV_HWP: start-on-event=ResetEventStatus, operation=Event_INV_UHVDC_OV_HWP.ResetEventStatus
        OpEventResetEventStatus_ResetEventStatus_Event_Ga_FindEngleAngleFailed: start-on-event=ResetEventStatus, operation=Event_Ga_FindEngleAngleFailed.ResetEventStatus
        OpEventResetEventStatus_ResetEventStatus_Event_VcEvMonTrqCmp: start-on-event=ResetEventStatus, operation=Event_VcEvMonTrqCmp.ResetEventStatus
        OpEventResetEventStatus_ResetEventStatus_Event_INV_IGBT_TEMP_V_RNG_LO: start-on-event=ResetEventStatus, operation=Event_INV_IGBT_TEMP_V_RNG_LO.ResetEventStatus
        OpEventResetEventStatus_ResetEventStatus_Event_INV_CONTROL_LIMIT: start-on-event=ResetEventStatus, operation=Event_INV_CONTROL_LIMIT.ResetEventStatus
        OpEventResetEventStatus_ResetEventStatus_Event_COM_CarConfigErr: start-on-event=ResetEventStatus, operation=Event_COM_CarConfigErr.ResetEventStatus
        OpEventResetEventStatus_ResetEventStatus_Event_VCEvEcmPropFr08Tioutd: start-on-event=ResetEventStatus, operation=Event_VCEvEcmPropFr08Tioutd.ResetEventStatus
        OpEventResetEventStatus_ResetEventStatus_Event_CU_TEMP1_RNG_LO: start-on-event=ResetEventStatus, operation=Event_CU_TEMP1_RNG_LO.ResetEventStatus
        OpEventResetEventStatus_ResetEventStatus_Event_INV_EM_STATOR_TEMP2_RNG_SWT: start-on-event=ResetEventStatus, operation=Event_INV_EM_STATOR_TEMP2_RNG_SWT.ResetEventStatus
        OpEventResetEventStatus_ResetEventStatus_Event_GA_BLDC_POS_FLT: start-on-event=ResetEventStatus, operation=Event_GA_BLDC_POS_FLT.ResetEventStatus
        OpEventResetEventStatus_ResetEventStatus_Event_PS_WhlSnsr_FLT: start-on-event=ResetEventStatus, operation=Event_PS_WhlSnsr_FLT.ResetEventStatus
        OpEventResetEventStatus_ResetEventStatus_Event_INV_EM_STATOR_TEMP_RNG_LO: start-on-event=ResetEventStatus, operation=Event_INV_EM_STATOR_TEMP_RNG_LO.ResetEventStatus
        OpEventResetEventStatus_ResetEventStatus_Event_INV_RSLVR_SIN_ELEC_HI: start-on-event=ResetEventStatus, operation=Event_INV_RSLVR_SIN_ELEC_HI.ResetEventStatus
        OpEventResetEventStatus_ResetEventStatus_Event_INV_RSLVR_SIN_COS_PLAUS: start-on-event=ResetEventStatus, operation=Event_INV_RSLVR_SIN_COS_PLAUS.ResetEventStatus
        OpEventResetEventStatus_ResetEventStatus_Event_INV_RSLVR_COS_AMP: start-on-event=ResetEventStatus, operation=Event_INV_RSLVR_COS_AMP.ResetEventStatus
        OpEventResetEventStatus_ResetEventStatus_Event_INV_GATE_DRVR_BOT_HWP: start-on-event=ResetEventStatus, operation=Event_INV_GATE_DRVR_BOT_HWP.ResetEventStatus
        OpEventResetEventStatus_ResetEventStatus_Event_Eg_HallVolWrong: start-on-event=ResetEventStatus, operation=Event_Eg_HallVolWrong.ResetEventStatus
        OpEventResetEventStatus_ResetEventStatus_Event_INV_RSLVR_EXCT_RNG_NOK: start-on-event=ResetEventStatus, operation=Event_INV_RSLVR_EXCT_RNG_NOK.ResetEventStatus
        OpEventResetEventStatus_ResetEventStatus_Event_PA_OpenCirc: start-on-event=ResetEventStatus, operation=Event_PA_OpenCirc.ResetEventStatus
        OpEventResetEventStatus_ResetEventStatus_Event_INV_RSLVR_COS_ELEC_HI: start-on-event=ResetEventStatus, operation=Event_INV_RSLVR_COS_ELEC_HI.ResetEventStatus
        OpEventResetEventStatus_ResetEventStatus_Event_VcEvCntrHvSysRlySts: start-on-event=ResetEventStatus, operation=Event_VcEvCntrHvSysRlySts.ResetEventStatus
        OpEventResetEventStatus_ResetEventStatus_Event_CRASH_DTC: start-on-event=ResetEventStatus, operation=Event_CRASH_DTC.ResetEventStatus
        OpEventResetEventStatus_ResetEventStatus_Event_INV_IGBT_TEMP_W_RNG_HI: start-on-event=ResetEventStatus, operation=Event_INV_IGBT_TEMP_W_RNG_HI.ResetEventStatus
        OpEventResetEventStatus_ResetEventStatus_Event_VCEvBecmPropFr02Tioutd: start-on-event=ResetEventStatus, operation=Event_VCEvBecmPropFr02Tioutd.ResetEventStatus
        OpEventResetEventStatus_ResetEventStatus_Event_INV_IGBT_TEMP_W_GRDT: start-on-event=ResetEventStatus, operation=Event_INV_IGBT_TEMP_W_GRDT.ResetEventStatus
        OpEventResetEventStatus_ResetEventStatus_Event_EXT_UC_SPI_FLT: start-on-event=ResetEventStatus, operation=Event_EXT_UC_SPI_FLT.ResetEventStatus
        OpEventResetEventStatus_ResetEventStatus_Event_INV_IAC_V_ELEC_HWP_001: start-on-event=ResetEventStatus, operation=Event_INV_IAC_V_ELEC_HWP_001.ResetEventStatus
        OpEventResetEventStatus_ResetEventStatus_Event_VcEvChkSumWhlMotSysTqAllwd: start-on-event=ResetEventStatus, operation=Event_VcEvChkSumWhlMotSysTqAllwd.ResetEventStatus
        OpEventResetEventStatus_ResetEventStatus_Event_FS_MONITIOR_ASC_FLT: start-on-event=ResetEventStatus, operation=Event_FS_MONITIOR_ASC_FLT.ResetEventStatus
        OpEventResetEventStatus_ResetEventStatus_Event_INV_IAC_V_AMP: start-on-event=ResetEventStatus, operation=Event_INV_IAC_V_AMP.ResetEventStatus
        OpEventResetEventStatus_ResetEventStatus_Event_INV_IAC_W_ELEC_LO: start-on-event=ResetEventStatus, operation=Event_INV_IAC_W_ELEC_LO.ResetEventStatus
        OpEventResetEventStatus_ResetEventStatus_Event_VCEvVddmPropFr08Tioutd_001: start-on-event=ResetEventStatus, operation=Event_VCEvVddmPropFr08Tioutd_001.ResetEventStatus
        OpEventResetEventStatus_ResetEventStatus_Event_PS_P12_RES_FLT: start-on-event=ResetEventStatus, operation=Event_PS_P12_RES_FLT.ResetEventStatus
        OpEventResetEventStatus_ResetEventStatus_Event_INV_RSLVR_SIN_RNG_LO: start-on-event=ResetEventStatus, operation=Event_INV_RSLVR_SIN_RNG_LO.ResetEventStatus
        OpEventResetEventStatus_ResetEventStatus_Event_CU_TEMP_HW_FLT: start-on-event=ResetEventStatus, operation=Event_CU_TEMP_HW_FLT.ResetEventStatus
        OpEventResetEventStatus_ResetEventStatus_Event_VCEvEcmPropFr02MgmFr00Tioutd: start-on-event=ResetEventStatus, operation=Event_VCEvEcmPropFr02MgmFr00Tioutd.ResetEventStatus
        OpEventResetEventStatus_ResetEventStatus_Event_PS_KL15_RNG_HI: start-on-event=ResetEventStatus, operation=Event_PS_KL15_RNG_HI.ResetEventStatus
        OpEventResetEventStatus_ResetEventStatus_Event_VCEvVddmPropFr17Tioutd: start-on-event=ResetEventStatus, operation=Event_VCEvVddmPropFr17Tioutd.ResetEventStatus
        OpEventResetEventStatus_ResetEventStatus_Event_VcEvChkSumCrashStsSafe: start-on-event=ResetEventStatus, operation=Event_VcEvChkSumCrashStsSafe.ResetEventStatus
        OpEventResetEventStatus_ResetEventStatus_Event_DiagC_ClutchService: start-on-event=ResetEventStatus, operation=Event_DiagC_ClutchService.ResetEventStatus
        OpEventResetEventStatus_ResetEventStatus_Event_INV_EM_STATOR_TEMP_RNG_HI: start-on-event=ResetEventStatus, operation=Event_INV_EM_STATOR_TEMP_RNG_HI.ResetEventStatus
        OpEventResetEventStatus_ResetEventStatus_Event_INV_RSLVR_OFFS_OUT_RANG: start-on-event=ResetEventStatus, operation=Event_INV_RSLVR_OFFS_OUT_RANG.ResetEventStatus
        OpEventResetEventStatus_ResetEventStatus_Event_INV_EM_STATOR_TEMP2_RNG_LO: start-on-event=ResetEventStatus, operation=Event_INV_EM_STATOR_TEMP2_RNG_LO.ResetEventStatus
        OpEventResetEventStatus_ResetEventStatus_Event_VcEvMonISAR: start-on-event=ResetEventStatus, operation=Event_VcEvMonISAR.ResetEventStatus
        OpEventResetEventStatus_ResetEventStatus_Event_GA_BLDC_FLT: start-on-event=ResetEventStatus, operation=Event_GA_BLDC_FLT.ResetEventStatus
        OpEventResetEventStatus_ResetEventStatus_Event_INV_RSLVR_EXCT_ELEC_OPEN: start-on-event=ResetEventStatus, operation=Event_INV_RSLVR_EXCT_ELEC_OPEN.ResetEventStatus
        OpEventResetEventStatus_ResetEventStatus_Event_INV_RSLVR_EXCT_PLAUS: start-on-event=ResetEventStatus, operation=Event_INV_RSLVR_EXCT_PLAUS.ResetEventStatus
        OpEventResetEventStatus_ResetEventStatus_Event_PS_P15_U_FLT: start-on-event=ResetEventStatus, operation=Event_PS_P15_U_FLT.ResetEventStatus
        OpEventResetEventStatus_ResetEventStatus_Event_INV_EM_STATOR_TEMP_RNG_SWT: start-on-event=ResetEventStatus, operation=Event_INV_EM_STATOR_TEMP_RNG_SWT.ResetEventStatus
        OpEventResetEventStatus_ResetEventStatus_Event_INV_UHVDC_OV_SWP: start-on-event=ResetEventStatus, operation=Event_INV_UHVDC_OV_SWP.ResetEventStatus
        OpEventResetEventStatus_ResetEventStatus_Event_AURIX_HW_FLT: start-on-event=ResetEventStatus, operation=Event_AURIX_HW_FLT.ResetEventStatus
        OpEventResetEventStatus_ResetEventStatus_Event_INV_GATE_DRVR_TOP_HWP: start-on-event=ResetEventStatus, operation=Event_INV_GATE_DRVR_TOP_HWP.ResetEventStatus
        OpEventResetEventStatus_ResetEventStatus_Event_INV_ACTV_DCHA_HW: start-on-event=ResetEventStatus, operation=Event_INV_ACTV_DCHA_HW.ResetEventStatus
        OpEventResetEventStatus_ResetEventStatus_Event_INV_IGBT_TEMP_HWP: start-on-event=ResetEventStatus, operation=Event_INV_IGBT_TEMP_HWP.ResetEventStatus
        OpEventResetEventStatus_ResetEventStatus_Event_INV_RSLVR_SIN_ELEC_FLT: start-on-event=ResetEventStatus, operation=Event_INV_RSLVR_SIN_ELEC_FLT.ResetEventStatus
        OpEventResetEventStatus_ResetEventStatus_Event_CU_TEMP2_RNG_HI: start-on-event=ResetEventStatus, operation=Event_CU_TEMP2_RNG_HI.ResetEventStatus
        OpEventResetEventStatus_ResetEventStatus_Event_INV_IAC_PHA_LOSS_MPL: start-on-event=ResetEventStatus, operation=Event_INV_IAC_PHA_LOSS_MPL.ResetEventStatus
        OpEventResetEventStatus_ResetEventStatus_Event_INV_IAC_U_AMP: start-on-event=ResetEventStatus, operation=Event_INV_IAC_U_AMP.ResetEventStatus
        OpEventResetEventStatus_ResetEventStatus_Event_PSnsr_GRADT_Flt: start-on-event=ResetEventStatus, operation=Event_PSnsr_GRADT_Flt.ResetEventStatus
        OpEventResetEventStatus_ResetEventStatus_Event_AURIX_WATHDOG_FLT: start-on-event=ResetEventStatus, operation=Event_AURIX_WATHDOG_FLT.ResetEventStatus
        OpEventResetEventStatus_ResetEventStatus_Event_VcEvNodeMisBECM: start-on-event=ResetEventStatus, operation=Event_VcEvNodeMisBECM.ResetEventStatus
        OpEventResetEventStatus_ResetEventStatus_Event_INV_UHVDC_UV_HWP: start-on-event=ResetEventStatus, operation=Event_INV_UHVDC_UV_HWP.ResetEventStatus
        OpEventResetEventStatus_ResetEventStatus_Event_VcEvMonESpd: start-on-event=ResetEventStatus, operation=Event_VcEvMonESpd.ResetEventStatus
        OpEventResetEventStatus_ResetEventStatus_Event_COM_NotConfig: start-on-event=ResetEventStatus, operation=Event_COM_NotConfig.ResetEventStatus
        OpEventResetEventStatus_ResetEventStatus_Event_INV_RSLVR_SIN_RNG_HI: start-on-event=ResetEventStatus, operation=Event_INV_RSLVR_SIN_RNG_HI.ResetEventStatus
        OpEventResetEventStatus_ResetEventStatus_Event_INV_IGBT_TEMP_U_RNG_HI: start-on-event=ResetEventStatus, operation=Event_INV_IGBT_TEMP_U_RNG_HI.ResetEventStatus
        OpEventResetEventStatus_ResetEventStatus_Event_VcEvMonMode_001: start-on-event=ResetEventStatus, operation=Event_VcEvMonMode_001.ResetEventStatus
        OpEventResetEventStatus_ResetEventStatus_Event_PA_ACTION_FLT: start-on-event=ResetEventStatus, operation=Event_PA_ACTION_FLT.ResetEventStatus
        OpEventResetEventStatus_ResetEventStatus_Event_INV_IAC_V_ELEC_HWP: start-on-event=ResetEventStatus, operation=Event_INV_IAC_V_ELEC_HWP.ResetEventStatus
        OpEventResetEventStatus_ResetEventStatus_Event_CU_TEMP_HW_FLT_001: start-on-event=ResetEventStatus, operation=Event_CU_TEMP_HW_FLT_001.ResetEventStatus
        OpEventResetEventStatus_ResetEventStatus_Event_VCC_UnderVoltage: start-on-event=ResetEventStatus, operation=Event_VCC_UnderVoltage.ResetEventStatus
        OpEventResetEventStatus_ResetEventStatus_Event_VcEvTsttrPlaus: start-on-event=ResetEventStatus, operation=Event_VcEvTsttrPlaus.ResetEventStatus
        OpEventResetEventStatus_ResetEventStatus_Event_INV_RSLVR_EXCT_ELEC_FLT: start-on-event=ResetEventStatus, operation=Event_INV_RSLVR_EXCT_ELEC_FLT.ResetEventStatus
        OpEventResetEventStatus_ResetEventStatus_Event_INV_RSLVR_EXCT_RNG_LO: start-on-event=ResetEventStatus, operation=Event_INV_RSLVR_EXCT_RNG_LO.ResetEventStatus
        OpEventResetEventStatus_ResetEventStatus_Event_INV_EM_STATOR_TEMP2_RNG_HI: start-on-event=ResetEventStatus, operation=Event_INV_EM_STATOR_TEMP2_RNG_HI.ResetEventStatus
        OpEventResetEventStatus_ResetEventStatus_Event_INV_SHUT_OFF_PAH_START_UP: start-on-event=ResetEventStatus, operation=Event_INV_SHUT_OFF_PAH_START_UP.ResetEventStatus
        OpEventResetEventStatus_ResetEventStatus_Event_VCEvVddmPropFr08Tioutd: start-on-event=ResetEventStatus, operation=Event_VCEvVddmPropFr08Tioutd.ResetEventStatus
        OpEventResetEventStatus_ResetEventStatus_Event_INV_RSLVR_EXCT_OC_HWP_001: start-on-event=ResetEventStatus, operation=Event_INV_RSLVR_EXCT_OC_HWP_001.ResetEventStatus
        OpEventResetEventStatus_ResetEventStatus_Event_INV_RSLVR_EXCT_OC_HWP_002: start-on-event=ResetEventStatus, operation=Event_INV_RSLVR_EXCT_OC_HWP_002.ResetEventStatus
        OpEventResetEventStatus_ResetEventStatus_Event_INV_EM_STATOR_TEMP_ELE_FLT: start-on-event=ResetEventStatus, operation=Event_INV_EM_STATOR_TEMP_ELE_FLT.ResetEventStatus
        OpEventResetEventStatus_ResetEventStatus_Event_INV_INTERLOCK_FLT: start-on-event=ResetEventStatus, operation=Event_INV_INTERLOCK_FLT.ResetEventStatus
        OpEventResetEventStatus_ResetEventStatus_Event_Ga_ZeroFindDistanFailure: start-on-event=ResetEventStatus, operation=Event_Ga_ZeroFindDistanFailure.ResetEventStatus
        OpEventResetEventStatus_ResetEventStatus_Event_PLOCK_Current_RNG_OUT: start-on-event=ResetEventStatus, operation=Event_PLOCK_Current_RNG_OUT.ResetEventStatus
        OpEventResetEventStatus_ResetEventStatus_Event_VCEvVddmPropFr05Tioutd: start-on-event=ResetEventStatus, operation=Event_VCEvVddmPropFr05Tioutd.ResetEventStatus
        OpEventResetEventStatus_ResetEventStatus_Event_INV_IGBT_TEMP_V_GRDT: start-on-event=ResetEventStatus, operation=Event_INV_IGBT_TEMP_V_GRDT.ResetEventStatus
        OpEventResetEventStatus_ResetEventStatus_Event_PS_5V_Fault: start-on-event=ResetEventStatus, operation=Event_PS_5V_Fault.ResetEventStatus
        OpEventResetEventStatus_ResetEventStatus_Event_VcEvCntrCrashStsSafe: start-on-event=ResetEventStatus, operation=Event_VcEvCntrCrashStsSafe.ResetEventStatus
        OpEventResetEventStatus_ResetEventStatus_Event_INV_EM_STATOR_TEMP_GRDT: start-on-event=ResetEventStatus, operation=Event_INV_EM_STATOR_TEMP_GRDT.ResetEventStatus
        OpEventResetEventStatus_ResetEventStatus_Event_PS_P15_V_FLT: start-on-event=ResetEventStatus, operation=Event_PS_P15_V_FLT.ResetEventStatus
        OpEventResetEventStatus_ResetEventStatus_Event_INV_EM_STATOR_TEMP_RNG_NOK: start-on-event=ResetEventStatus, operation=Event_INV_EM_STATOR_TEMP_RNG_NOK.ResetEventStatus
        OpEventResetEventStatus_ResetEventStatus_Event_INV_RSLVR_SIN_RNG_NOK: start-on-event=ResetEventStatus, operation=Event_INV_RSLVR_SIN_RNG_NOK.ResetEventStatus
        OpEventResetEventStatus_ResetEventStatus_Event_INV_IAC_U_OFFS: start-on-event=ResetEventStatus, operation=Event_INV_IAC_U_OFFS.ResetEventStatus
        OpEventResetEventStatus_ResetEventStatus_Event_PS_KL30_BACKUP_FLT: start-on-event=ResetEventStatus, operation=Event_PS_KL30_BACKUP_FLT.ResetEventStatus
        OpEventResetEventStatus_ResetEventStatus_Event_INV_IGBT_TEMP_U_RNG_LO: start-on-event=ResetEventStatus, operation=Event_INV_IGBT_TEMP_U_RNG_LO.ResetEventStatus
        OpEventResetEventStatus_ResetEventStatus_Event_INV_EM_STATOR_TEMP_HWP: start-on-event=ResetEventStatus, operation=Event_INV_EM_STATOR_TEMP_HWP.ResetEventStatus
        OpEventResetEventStatus_ResetEventStatus_Event_CU_TEMP1_RNG_HI: start-on-event=ResetEventStatus, operation=Event_CU_TEMP1_RNG_HI.ResetEventStatus
        OpEventResetEventStatus_ResetEventStatus_Event_INV_IGBT_TEMP_V_RNG_HI: start-on-event=ResetEventStatus, operation=Event_INV_IGBT_TEMP_V_RNG_HI.ResetEventStatus
        OpEventResetEventStatus_ResetEventStatus_Event_VcEvNodeMisVDDM: start-on-event=ResetEventStatus, operation=Event_VcEvNodeMisVDDM.ResetEventStatus
        OpEventResetEventStatus_ResetEventStatus_Event_INV_UHVDC_PLAUS: start-on-event=ResetEventStatus, operation=Event_INV_UHVDC_PLAUS.ResetEventStatus
        OpEventResetEventStatus_ResetEventStatus_Event_INV_QUIESCENT_FLT: start-on-event=ResetEventStatus, operation=Event_INV_QUIESCENT_FLT.ResetEventStatus
        OpEventResetEventStatus_ResetEventStatus_Event_INV_RSLVR_EXCT_RNG_HI: start-on-event=ResetEventStatus, operation=Event_INV_RSLVR_EXCT_RNG_HI.ResetEventStatus
        OpEventResetEventDebounceStatus_ResetEventDebounceStatus_Event_VCEvBecmPropFr01Tioutd: start-on-event=ResetEventDebounceStatus, operation=Event_VCEvBecmPropFr01Tioutd.ResetEventDebounceStatus
        OpEventResetEventDebounceStatus_ResetEventDebounceStatus_Event_INV_CU_TEMP2_RNG_NOK: start-on-event=ResetEventDebounceStatus, operation=Event_INV_CU_TEMP2_RNG_NOK.ResetEventDebounceStatus
        OpEventResetEventDebounceStatus_ResetEventDebounceStatus_Event_COM_Busoff: start-on-event=ResetEventDebounceStatus, operation=Event_COM_Busoff.ResetEventDebounceStatus
        OpEventResetEventDebounceStatus_ResetEventDebounceStatus_Event_INV_IMMO_NOKEY: start-on-event=ResetEventDebounceStatus, operation=Event_INV_IMMO_NOKEY.ResetEventDebounceStatus
        OpEventResetEventDebounceStatus_ResetEventDebounceStatus_Event_INV_RSLVR_EXCT_OC_HWP: start-on-event=ResetEventDebounceStatus, operation=Event_INV_RSLVR_EXCT_OC_HWP.ResetEventDebounceStatus
        OpEventResetEventDebounceStatus_ResetEventDebounceStatus_Event_PS_P15_W_FLT: start-on-event=ResetEventDebounceStatus, operation=Event_PS_P15_W_FLT.ResetEventDebounceStatus
        OpEventResetEventDebounceStatus_ResetEventDebounceStatus_Event_INV_IAC_PLAUS_SUM: start-on-event=ResetEventDebounceStatus, operation=Event_INV_IAC_PLAUS_SUM.ResetEventDebounceStatus
        OpEventResetEventDebounceStatus_ResetEventDebounceStatus_Event_PA_ELE_FLT: start-on-event=ResetEventDebounceStatus, operation=Event_PA_ELE_FLT.ResetEventDebounceStatus
        OpEventResetEventDebounceStatus_ResetEventDebounceStatus_Event_CU_TEMP_GRDT: start-on-event=ResetEventDebounceStatus, operation=Event_CU_TEMP_GRDT.ResetEventDebounceStatus
        OpEventResetEventDebounceStatus_ResetEventDebounceStatus_Event_INV_IGBT_TEMP_V_PLAUS: start-on-event=ResetEventDebounceStatus, operation=Event_INV_IGBT_TEMP_V_PLAUS.ResetEventDebounceStatus
        OpEventResetEventDebounceStatus_ResetEventDebounceStatus_Event_Ga_GAEngageFailure: start-on-event=ResetEventDebounceStatus, operation=Event_Ga_GAEngageFailure.ResetEventDebounceStatus
        OpEventResetEventDebounceStatus_ResetEventDebounceStatus_Event_INV_IAC_W_RNG_LO: start-on-event=ResetEventDebounceStatus, operation=Event_INV_IAC_W_RNG_LO.ResetEventDebounceStatus
        OpEventResetEventDebounceStatus_ResetEventDebounceStatus_Event_PS_WhlSnsr_Vltg_FLT: start-on-event=ResetEventDebounceStatus, operation=Event_PS_WhlSnsr_Vltg_FLT.ResetEventDebounceStatus
        OpEventResetEventDebounceStatus_ResetEventDebounceStatus_Event_VCEvEcmPropFr02Tioutd: start-on-event=ResetEventDebounceStatus, operation=Event_VCEvEcmPropFr02Tioutd.ResetEventDebounceStatus
        OpEventResetEventDebounceStatus_ResetEventDebounceStatus_Event_Ga_TmSpdSyncFailed: start-on-event=ResetEventDebounceStatus, operation=Event_Ga_TmSpdSyncFailed.ResetEventDebounceStatus
        OpEventResetEventDebounceStatus_ResetEventDebounceStatus_Event_INV_RSLVR_EXCT_ELEC_LO: start-on-event=ResetEventDebounceStatus, operation=Event_INV_RSLVR_EXCT_ELEC_LO.ResetEventDebounceStatus
        OpEventResetEventDebounceStatus_ResetEventDebounceStatus_Event_VCEvEcmPropXevFr06Tioutd: start-on-event=ResetEventDebounceStatus, operation=Event_VCEvEcmPropXevFr06Tioutd.ResetEventDebounceStatus
        OpEventResetEventDebounceStatus_ResetEventDebounceStatus_Event_VcEvCntrWhlMotSysTqAllwd: start-on-event=ResetEventDebounceStatus, operation=Event_VcEvCntrWhlMotSysTqAllwd.ResetEventDebounceStatus
        OpEventResetEventDebounceStatus_ResetEventDebounceStatus_Event_INV_UHVDC_1_ELEC_HI: start-on-event=ResetEventDebounceStatus, operation=Event_INV_UHVDC_1_ELEC_HI.ResetEventDebounceStatus
        OpEventResetEventDebounceStatus_ResetEventDebounceStatus_Event_INV_EM_STATOR_TEMP2_ELE_FLT: start-on-event=ResetEventDebounceStatus, operation=Event_INV_EM_STATOR_TEMP2_ELE_FLT.ResetEventDebounceStatus
        OpEventResetEventDebounceStatus_ResetEventDebounceStatus_Event_AURIX_RST_SNG: start-on-event=ResetEventDebounceStatus, operation=Event_AURIX_RST_SNG.ResetEventDebounceStatus
        OpEventResetEventDebounceStatus_ResetEventDebounceStatus_Event_VCEvEcmPropFr24MgmFr01Tioutd: start-on-event=ResetEventDebounceStatus, operation=Event_VCEvEcmPropFr24MgmFr01Tioutd.ResetEventDebounceStatus
        OpEventResetEventDebounceStatus_ResetEventDebounceStatus_Event_INV_RSLVR_COS_ELEC_OPEN: start-on-event=ResetEventDebounceStatus, operation=Event_INV_RSLVR_COS_ELEC_OPEN.ResetEventDebounceStatus
        OpEventResetEventDebounceStatus_ResetEventDebounceStatus_Event_INV_IAC_V_ELEC_LO: start-on-event=ResetEventDebounceStatus, operation=Event_INV_IAC_V_ELEC_LO.ResetEventDebounceStatus
        OpEventResetEventDebounceStatus_ResetEventDebounceStatus_Event_INV_IAC_W_OFFS: start-on-event=ResetEventDebounceStatus, operation=Event_INV_IAC_W_OFFS.ResetEventDebounceStatus
        OpEventResetEventDebounceStatus_ResetEventDebounceStatus_Event_INV_EM_STATOR_TEMP2_GRDT: start-on-event=ResetEventDebounceStatus, operation=Event_INV_EM_STATOR_TEMP2_GRDT.ResetEventDebounceStatus
        OpEventResetEventDebounceStatus_ResetEventDebounceStatus_Event_INV_EM_OVRSPD_HWP: start-on-event=ResetEventDebounceStatus, operation=Event_INV_EM_OVRSPD_HWP.ResetEventDebounceStatus
        OpEventResetEventDebounceStatus_ResetEventDebounceStatus_Event_CU_TEMP_HWP: start-on-event=ResetEventDebounceStatus, operation=Event_CU_TEMP_HWP.ResetEventDebounceStatus
        OpEventResetEventDebounceStatus_ResetEventDebounceStatus_Event_INV_UHVDC_1_RNG_HI: start-on-event=ResetEventDebounceStatus, operation=Event_INV_UHVDC_1_RNG_HI.ResetEventDebounceStatus
        OpEventResetEventDebounceStatus_ResetEventDebounceStatus_Event_VcEvEMPerfPlaus: start-on-event=ResetEventDebounceStatus, operation=Event_VcEvEMPerfPlaus.ResetEventDebounceStatus
        OpEventResetEventDebounceStatus_ResetEventDebounceStatus_Event_VCEvVddmPropFr18Tioutd: start-on-event=ResetEventDebounceStatus, operation=Event_VCEvVddmPropFr18Tioutd.ResetEventDebounceStatus
        OpEventResetEventDebounceStatus_ResetEventDebounceStatus_Event_INV_IAC_U_ELEC_HWP: start-on-event=ResetEventDebounceStatus, operation=Event_INV_IAC_U_ELEC_HWP.ResetEventDebounceStatus
        OpEventResetEventDebounceStatus_ResetEventDebounceStatus_Event_VCEvVddmPropFr15Tioutd: start-on-event=ResetEventDebounceStatus, operation=Event_VCEvVddmPropFr15Tioutd.ResetEventDebounceStatus
        OpEventResetEventDebounceStatus_ResetEventDebounceStatus_Event_Ga_GADisengageFailure: start-on-event=ResetEventDebounceStatus, operation=Event_Ga_GADisengageFailure.ResetEventDebounceStatus
        OpEventResetEventDebounceStatus_ResetEventDebounceStatus_Event_CU_TEMP2_RNG_LO: start-on-event=ResetEventDebounceStatus, operation=Event_CU_TEMP2_RNG_LO.ResetEventDebounceStatus
        OpEventResetEventDebounceStatus_ResetEventDebounceStatus_Event_INV_RSLVR_SIN_ELEC_OPEN: start-on-event=ResetEventDebounceStatus, operation=Event_INV_RSLVR_SIN_ELEC_OPEN.ResetEventDebounceStatus
        OpEventResetEventDebounceStatus_ResetEventDebounceStatus_Event_VcEvChkSum: start-on-event=ResetEventDebounceStatus, operation=Event_VcEvChkSum.ResetEventDebounceStatus
        OpEventResetEventDebounceStatus_ResetEventDebounceStatus_Event_PS_P5_UC_FLT: start-on-event=ResetEventDebounceStatus, operation=Event_PS_P5_UC_FLT.ResetEventDebounceStatus
        OpEventResetEventDebounceStatus_ResetEventDebounceStatus_Event_INV_RSLVR_COS_ELEC_FLT: start-on-event=ResetEventDebounceStatus, operation=Event_INV_RSLVR_COS_ELEC_FLT.ResetEventDebounceStatus
        OpEventResetEventDebounceStatus_ResetEventDebounceStatus_Event_INV_IAC_W_RNG_HI: start-on-event=ResetEventDebounceStatus, operation=Event_INV_IAC_W_RNG_HI.ResetEventDebounceStatus
        OpEventResetEventDebounceStatus_ResetEventDebounceStatus_Event_PS_ECUSUPPLY_HIGH: start-on-event=ResetEventDebounceStatus, operation=Event_PS_ECUSUPPLY_HIGH.ResetEventDebounceStatus
        OpEventResetEventDebounceStatus_ResetEventDebounceStatus_Event_VCEvEcmPropFr05Tioutd: start-on-event=ResetEventDebounceStatus, operation=Event_VCEvEcmPropFr05Tioutd.ResetEventDebounceStatus
        OpEventResetEventDebounceStatus_ResetEventDebounceStatus_Event_PS_ECUSUPPLY_LOW: start-on-event=ResetEventDebounceStatus, operation=Event_PS_ECUSUPPLY_LOW.ResetEventDebounceStatus
        OpEventResetEventDebounceStatus_ResetEventDebounceStatus_Event_VcEvChkSumHvSysRlySts: start-on-event=ResetEventDebounceStatus, operation=Event_VcEvChkSumHvSysRlySts.ResetEventDebounceStatus
        OpEventResetEventDebounceStatus_ResetEventDebounceStatus_Event_VcEvMonMode: start-on-event=ResetEventDebounceStatus, operation=Event_VcEvMonMode.ResetEventDebounceStatus
        OpEventResetEventDebounceStatus_ResetEventDebounceStatus_Event_INV_IAC_OC_SWP: start-on-event=ResetEventDebounceStatus, operation=Event_INV_IAC_OC_SWP.ResetEventDebounceStatus
        OpEventResetEventDebounceStatus_ResetEventDebounceStatus_Event_INV_IMMO_AUTHFAIL: start-on-event=ResetEventDebounceStatus, operation=Event_INV_IMMO_AUTHFAIL.ResetEventDebounceStatus
        OpEventResetEventDebounceStatus_ResetEventDebounceStatus_Event_PA_OpenCirc_FLT: start-on-event=ResetEventDebounceStatus, operation=Event_PA_OpenCirc_FLT.ResetEventDebounceStatus
        OpEventResetEventDebounceStatus_ResetEventDebounceStatus_Event_INV_IAC_V_ELEC_HI: start-on-event=ResetEventDebounceStatus, operation=Event_INV_IAC_V_ELEC_HI.ResetEventDebounceStatus
        OpEventResetEventDebounceStatus_ResetEventDebounceStatus_Event_VCEvEcmPropFr04Tioutd: start-on-event=ResetEventDebounceStatus, operation=Event_VCEvEcmPropFr04Tioutd.ResetEventDebounceStatus
        OpEventResetEventDebounceStatus_ResetEventDebounceStatus_Event_VcEvMonTrqActPlaus: start-on-event=ResetEventDebounceStatus, operation=Event_VcEvMonTrqActPlaus.ResetEventDebounceStatus
        OpEventResetEventDebounceStatus_ResetEventDebounceStatus_Event_VcEvMonTrqAct: start-on-event=ResetEventDebounceStatus, operation=Event_VcEvMonTrqAct.ResetEventDebounceStatus
        OpEventResetEventDebounceStatus_ResetEventDebounceStatus_Event_INV_RSLVR_COS_ELEC_LO: start-on-event=ResetEventDebounceStatus, operation=Event_INV_RSLVR_COS_ELEC_LO.ResetEventDebounceStatus
        OpEventResetEventDebounceStatus_ResetEventDebounceStatus_Event_INV_COOLT_INLET_TEMP_HWP: start-on-event=ResetEventDebounceStatus, operation=Event_INV_COOLT_INLET_TEMP_HWP.ResetEventDebounceStatus
        OpEventResetEventDebounceStatus_ResetEventDebounceStatus_Event_VCEvEcmPropFr11Tioutd: start-on-event=ResetEventDebounceStatus, operation=Event_VCEvEcmPropFr11Tioutd.ResetEventDebounceStatus
        OpEventResetEventDebounceStatus_ResetEventDebounceStatus_Event_PS_KL30_RNG_HI: start-on-event=ResetEventDebounceStatus, operation=Event_PS_KL30_RNG_HI.ResetEventDebounceStatus
        OpEventResetEventDebounceStatus_ResetEventDebounceStatus_Event_INV_IAC_OC_HWP: start-on-event=ResetEventDebounceStatus, operation=Event_INV_IAC_OC_HWP.ResetEventDebounceStatus
        OpEventResetEventDebounceStatus_ResetEventDebounceStatus_Event_INV_RSLVR_COS_RNG_HI: start-on-event=ResetEventDebounceStatus, operation=Event_INV_RSLVR_COS_RNG_HI.ResetEventDebounceStatus
        OpEventResetEventDebounceStatus_ResetEventDebounceStatus_Event_INV_IAC_U_ELEC_HI: start-on-event=ResetEventDebounceStatus, operation=Event_INV_IAC_U_ELEC_HI.ResetEventDebounceStatus
        OpEventResetEventDebounceStatus_ResetEventDebounceStatus_Event_INV_IAC_V_RNG_LO: start-on-event=ResetEventDebounceStatus, operation=Event_INV_IAC_V_RNG_LO.ResetEventDebounceStatus
        OpEventResetEventDebounceStatus_ResetEventDebounceStatus_Event_INV_IAC_U_RNG_HI: start-on-event=ResetEventDebounceStatus, operation=Event_INV_IAC_U_RNG_HI.ResetEventDebounceStatus
        OpEventResetEventDebounceStatus_ResetEventDebounceStatus_Event_VCEvEcmPropFr25Tioutd: start-on-event=ResetEventDebounceStatus, operation=Event_VCEvEcmPropFr25Tioutd.ResetEventDebounceStatus
        OpEventResetEventDebounceStatus_ResetEventDebounceStatus_Event_INV_IGBT_TEMP_W_RNG_LO: start-on-event=ResetEventDebounceStatus, operation=Event_INV_IGBT_TEMP_W_RNG_LO.ResetEventDebounceStatus
        OpEventResetEventDebounceStatus_ResetEventDebounceStatus_Event_PSnsr_RNG_NOK: start-on-event=ResetEventDebounceStatus, operation=Event_PSnsr_RNG_NOK.ResetEventDebounceStatus
        OpEventResetEventDebounceStatus_ResetEventDebounceStatus_Event_INV_RSLVR_COS_RNG_NOK: start-on-event=ResetEventDebounceStatus, operation=Event_INV_RSLVR_COS_RNG_NOK.ResetEventDebounceStatus
        OpEventResetEventDebounceStatus_ResetEventDebounceStatus_Event_PS_DRVB_Fault: start-on-event=ResetEventDebounceStatus, operation=Event_PS_DRVB_Fault.ResetEventDebounceStatus
        OpEventResetEventDebounceStatus_ResetEventDebounceStatus_Event_INV_CU_TEMP1_RNG_NOK: start-on-event=ResetEventDebounceStatus, operation=Event_INV_CU_TEMP1_RNG_NOK.ResetEventDebounceStatus
        OpEventResetEventDebounceStatus_ResetEventDebounceStatus_Event_VcEvCntr: start-on-event=ResetEventDebounceStatus, operation=Event_VcEvCntr.ResetEventDebounceStatus
        OpEventResetEventDebounceStatus_ResetEventDebounceStatus_Event_INV_RSLVR_SIN_AMP: start-on-event=ResetEventDebounceStatus, operation=Event_INV_RSLVR_SIN_AMP.ResetEventDebounceStatus
        OpEventResetEventDebounceStatus_ResetEventDebounceStatus_Event_INV_UHVDC_2_RNG_HI: start-on-event=ResetEventDebounceStatus, operation=Event_INV_UHVDC_2_RNG_HI.ResetEventDebounceStatus
        OpEventResetEventDebounceStatus_ResetEventDebounceStatus_Event_INV_IGBT_TEMP_U_GRDT: start-on-event=ResetEventDebounceStatus, operation=Event_INV_IGBT_TEMP_U_GRDT.ResetEventDebounceStatus
        OpEventResetEventDebounceStatus_ResetEventDebounceStatus_Event_MON_TQ_PLAUS_PWR_MDL: start-on-event=ResetEventDebounceStatus, operation=Event_MON_TQ_PLAUS_PWR_MDL.ResetEventDebounceStatus
        OpEventResetEventDebounceStatus_ResetEventDebounceStatus_Event_INV_IGBT_TEMP_W_PLAUS: start-on-event=ResetEventDebounceStatus, operation=Event_INV_IGBT_TEMP_W_PLAUS.ResetEventDebounceStatus
        OpEventResetEventDebounceStatus_ResetEventDebounceStatus_Event_PS_BLDC_UV_FLT: start-on-event=ResetEventDebounceStatus, operation=Event_PS_BLDC_UV_FLT.ResetEventDebounceStatus
        OpEventResetEventDebounceStatus_ResetEventDebounceStatus_Event_INV_IAC_V_OFFS: start-on-event=ResetEventDebounceStatus, operation=Event_INV_IAC_V_OFFS.ResetEventDebounceStatus
        OpEventResetEventDebounceStatus_ResetEventDebounceStatus_Event_INV_RSLVR_EXCT_FREQ_RNG_NOK: start-on-event=ResetEventDebounceStatus, operation=Event_INV_RSLVR_EXCT_FREQ_RNG_NOK.ResetEventDebounceStatus
        OpEventResetEventDebounceStatus_ResetEventDebounceStatus_Event_PS_KL30_RNG_LO: start-on-event=ResetEventDebounceStatus, operation=Event_PS_KL30_RNG_LO.ResetEventDebounceStatus
        OpEventResetEventDebounceStatus_ResetEventDebounceStatus_Event_INV_RSLVR_COS_RNG_LO: start-on-event=ResetEventDebounceStatus, operation=Event_INV_RSLVR_COS_RNG_LO.ResetEventDebounceStatus
        OpEventResetEventDebounceStatus_ResetEventDebounceStatus_Event_PSnsr_ELE_FLT: start-on-event=ResetEventDebounceStatus, operation=Event_PSnsr_ELE_FLT.ResetEventDebounceStatus
        OpEventResetEventDebounceStatus_ResetEventDebounceStatus_Event_INV_RSLVR_SIN_COS_PLAUS_AMP: start-on-event=ResetEventDebounceStatus, operation=Event_INV_RSLVR_SIN_COS_PLAUS_AMP.ResetEventDebounceStatus
        OpEventResetEventDebounceStatus_ResetEventDebounceStatus_Event_INV_IAC_U_ELEC_LO: start-on-event=ResetEventDebounceStatus, operation=Event_INV_IAC_U_ELEC_LO.ResetEventDebounceStatus
        OpEventResetEventDebounceStatus_ResetEventDebounceStatus_Event_INV_RSLVR_EXCT_ELEC_HI: start-on-event=ResetEventDebounceStatus, operation=Event_INV_RSLVR_EXCT_ELEC_HI.ResetEventDebounceStatus
        OpEventResetEventDebounceStatus_ResetEventDebounceStatus_Event_INV_IAC_U_RNG_LO: start-on-event=ResetEventDebounceStatus, operation=Event_INV_IAC_U_RNG_LO.ResetEventDebounceStatus
        OpEventResetEventDebounceStatus_ResetEventDebounceStatus_Event_INV_IAC_V_RNG_HI: start-on-event=ResetEventDebounceStatus, operation=Event_INV_IAC_V_RNG_HI.ResetEventDebounceStatus
        OpEventResetEventDebounceStatus_ResetEventDebounceStatus_Event_INV_IGBT_TEMP_U_PLAUS: start-on-event=ResetEventDebounceStatus, operation=Event_INV_IGBT_TEMP_U_PLAUS.ResetEventDebounceStatus
        OpEventResetEventDebounceStatus_ResetEventDebounceStatus_Event_INV_RSLVR_OFFS_DFT: start-on-event=ResetEventDebounceStatus, operation=Event_INV_RSLVR_OFFS_DFT.ResetEventDebounceStatus
        OpEventResetEventDebounceStatus_ResetEventDebounceStatus_Event_Ga_MoveOverThd: start-on-event=ResetEventDebounceStatus, operation=Event_Ga_MoveOverThd.ResetEventDebounceStatus
        OpEventResetEventDebounceStatus_ResetEventDebounceStatus_Event_VcEvMonIPH: start-on-event=ResetEventDebounceStatus, operation=Event_VcEvMonIPH.ResetEventDebounceStatus
        OpEventResetEventDebounceStatus_ResetEventDebounceStatus_Event_INV_RSLVR_HW_FLT: start-on-event=ResetEventDebounceStatus, operation=Event_INV_RSLVR_HW_FLT.ResetEventDebounceStatus
        OpEventResetEventDebounceStatus_ResetEventDebounceStatus_Event_INV_RSLVR_SIN_ELEC_LO: start-on-event=ResetEventDebounceStatus, operation=Event_INV_RSLVR_SIN_ELEC_LO.ResetEventDebounceStatus
        OpEventResetEventDebounceStatus_ResetEventDebounceStatus_Event_INV_IAC_W_AMP: start-on-event=ResetEventDebounceStatus, operation=Event_INV_IAC_W_AMP.ResetEventDebounceStatus
        OpEventResetEventDebounceStatus_ResetEventDebounceStatus_Event_VCC_OverVoltage: start-on-event=ResetEventDebounceStatus, operation=Event_VCC_OverVoltage.ResetEventDebounceStatus
        OpEventResetEventDebounceStatus_ResetEventDebounceStatus_Event_PS_BLDC_OV_FLT: start-on-event=ResetEventDebounceStatus, operation=Event_PS_BLDC_OV_FLT.ResetEventDebounceStatus
        OpEventResetEventDebounceStatus_ResetEventDebounceStatus_Event_AURIX_EEPROM_FLT: start-on-event=ResetEventDebounceStatus, operation=Event_AURIX_EEPROM_FLT.ResetEventDebounceStatus
        OpEventResetEventDebounceStatus_ResetEventDebounceStatus_Event_FS_MONITIOR_ASC_FW_FLT: start-on-event=ResetEventDebounceStatus, operation=Event_FS_MONITIOR_ASC_FW_FLT.ResetEventDebounceStatus
        OpEventResetEventDebounceStatus_ResetEventDebounceStatus_Event_VCEvSrsPropFr02Tioutd: start-on-event=ResetEventDebounceStatus, operation=Event_VCEvSrsPropFr02Tioutd.ResetEventDebounceStatus
        OpEventResetEventDebounceStatus_ResetEventDebounceStatus_Event_VcEvMonErrMode: start-on-event=ResetEventDebounceStatus, operation=Event_VcEvMonErrMode.ResetEventDebounceStatus
        OpEventResetEventDebounceStatus_ResetEventDebounceStatus_Event_AURIX_RST_MPL: start-on-event=ResetEventDebounceStatus, operation=Event_AURIX_RST_MPL.ResetEventDebounceStatus
        OpEventResetEventDebounceStatus_ResetEventDebounceStatus_Event_VcEvNodeMisECM: start-on-event=ResetEventDebounceStatus, operation=Event_VcEvNodeMisECM.ResetEventDebounceStatus
        OpEventResetEventDebounceStatus_ResetEventDebounceStatus_Event_PS_KL30_PLAUS: start-on-event=ResetEventDebounceStatus, operation=Event_PS_KL30_PLAUS.ResetEventDebounceStatus
        OpEventResetEventDebounceStatus_ResetEventDebounceStatus_Event_INV_IAC_W_ELEC_HI: start-on-event=ResetEventDebounceStatus, operation=Event_INV_IAC_W_ELEC_HI.ResetEventDebounceStatus
        OpEventResetEventDebounceStatus_ResetEventDebounceStatus_Event_VCEvVddmPropFr19Tioutd: start-on-event=ResetEventDebounceStatus, operation=Event_VCEvVddmPropFr19Tioutd.ResetEventDebounceStatus
        OpEventResetEventDebounceStatus_ResetEventDebounceStatus_Event_INV_TEMP_DCHA_HW: start-on-event=ResetEventDebounceStatus, operation=Event_INV_TEMP_DCHA_HW.ResetEventDebounceStatus
        OpEventResetEventDebounceStatus_ResetEventDebounceStatus_Event_VcEvPropCANGlbTiOutd: start-on-event=ResetEventDebounceStatus, operation=Event_VcEvPropCANGlbTiOutd.ResetEventDebounceStatus
        OpEventResetEventDebounceStatus_ResetEventDebounceStatus_Event_INV_EM_STATOR_TEMP2_RNG_NOK: start-on-event=ResetEventDebounceStatus, operation=Event_INV_EM_STATOR_TEMP2_RNG_NOK.ResetEventDebounceStatus
        OpEventResetEventDebounceStatus_ResetEventDebounceStatus_Event_INV_UHVDC_OV_HWP: start-on-event=ResetEventDebounceStatus, operation=Event_INV_UHVDC_OV_HWP.ResetEventDebounceStatus
        OpEventResetEventDebounceStatus_ResetEventDebounceStatus_Event_Ga_FindEngleAngleFailed: start-on-event=ResetEventDebounceStatus, operation=Event_Ga_FindEngleAngleFailed.ResetEventDebounceStatus
        OpEventResetEventDebounceStatus_ResetEventDebounceStatus_Event_VcEvMonTrqCmp: start-on-event=ResetEventDebounceStatus, operation=Event_VcEvMonTrqCmp.ResetEventDebounceStatus
        OpEventResetEventDebounceStatus_ResetEventDebounceStatus_Event_INV_IGBT_TEMP_V_RNG_LO: start-on-event=ResetEventDebounceStatus, operation=Event_INV_IGBT_TEMP_V_RNG_LO.ResetEventDebounceStatus
        OpEventResetEventDebounceStatus_ResetEventDebounceStatus_Event_INV_CONTROL_LIMIT: start-on-event=ResetEventDebounceStatus, operation=Event_INV_CONTROL_LIMIT.ResetEventDebounceStatus
        OpEventResetEventDebounceStatus_ResetEventDebounceStatus_Event_COM_CarConfigErr: start-on-event=ResetEventDebounceStatus, operation=Event_COM_CarConfigErr.ResetEventDebounceStatus
        OpEventResetEventDebounceStatus_ResetEventDebounceStatus_Event_VCEvEcmPropFr08Tioutd: start-on-event=ResetEventDebounceStatus, operation=Event_VCEvEcmPropFr08Tioutd.ResetEventDebounceStatus
        OpEventResetEventDebounceStatus_ResetEventDebounceStatus_Event_CU_TEMP1_RNG_LO: start-on-event=ResetEventDebounceStatus, operation=Event_CU_TEMP1_RNG_LO.ResetEventDebounceStatus
        OpEventResetEventDebounceStatus_ResetEventDebounceStatus_Event_INV_EM_STATOR_TEMP2_RNG_SWT: start-on-event=ResetEventDebounceStatus, operation=Event_INV_EM_STATOR_TEMP2_RNG_SWT.ResetEventDebounceStatus
        OpEventResetEventDebounceStatus_ResetEventDebounceStatus_Event_GA_BLDC_POS_FLT: start-on-event=ResetEventDebounceStatus, operation=Event_GA_BLDC_POS_FLT.ResetEventDebounceStatus
        OpEventResetEventDebounceStatus_ResetEventDebounceStatus_Event_PS_WhlSnsr_FLT: start-on-event=ResetEventDebounceStatus, operation=Event_PS_WhlSnsr_FLT.ResetEventDebounceStatus
        OpEventResetEventDebounceStatus_ResetEventDebounceStatus_Event_INV_EM_STATOR_TEMP_RNG_LO: start-on-event=ResetEventDebounceStatus, operation=Event_INV_EM_STATOR_TEMP_RNG_LO.ResetEventDebounceStatus
        OpEventResetEventDebounceStatus_ResetEventDebounceStatus_Event_INV_RSLVR_SIN_ELEC_HI: start-on-event=ResetEventDebounceStatus, operation=Event_INV_RSLVR_SIN_ELEC_HI.ResetEventDebounceStatus
        OpEventResetEventDebounceStatus_ResetEventDebounceStatus_Event_INV_RSLVR_SIN_COS_PLAUS: start-on-event=ResetEventDebounceStatus, operation=Event_INV_RSLVR_SIN_COS_PLAUS.ResetEventDebounceStatus
        OpEventResetEventDebounceStatus_ResetEventDebounceStatus_Event_INV_RSLVR_COS_AMP: start-on-event=ResetEventDebounceStatus, operation=Event_INV_RSLVR_COS_AMP.ResetEventDebounceStatus
        OpEventResetEventDebounceStatus_ResetEventDebounceStatus_Event_INV_GATE_DRVR_BOT_HWP: start-on-event=ResetEventDebounceStatus, operation=Event_INV_GATE_DRVR_BOT_HWP.ResetEventDebounceStatus
        OpEventResetEventDebounceStatus_ResetEventDebounceStatus_Event_Eg_HallVolWrong: start-on-event=ResetEventDebounceStatus, operation=Event_Eg_HallVolWrong.ResetEventDebounceStatus
        OpEventResetEventDebounceStatus_ResetEventDebounceStatus_Event_INV_RSLVR_EXCT_RNG_NOK: start-on-event=ResetEventDebounceStatus, operation=Event_INV_RSLVR_EXCT_RNG_NOK.ResetEventDebounceStatus
        OpEventResetEventDebounceStatus_ResetEventDebounceStatus_Event_PA_OpenCirc: start-on-event=ResetEventDebounceStatus, operation=Event_PA_OpenCirc.ResetEventDebounceStatus
        OpEventResetEventDebounceStatus_ResetEventDebounceStatus_Event_INV_RSLVR_COS_ELEC_HI: start-on-event=ResetEventDebounceStatus, operation=Event_INV_RSLVR_COS_ELEC_HI.ResetEventDebounceStatus
        OpEventResetEventDebounceStatus_ResetEventDebounceStatus_Event_VcEvCntrHvSysRlySts: start-on-event=ResetEventDebounceStatus, operation=Event_VcEvCntrHvSysRlySts.ResetEventDebounceStatus
        OpEventResetEventDebounceStatus_ResetEventDebounceStatus_Event_CRASH_DTC: start-on-event=ResetEventDebounceStatus, operation=Event_CRASH_DTC.ResetEventDebounceStatus
        OpEventResetEventDebounceStatus_ResetEventDebounceStatus_Event_INV_IGBT_TEMP_W_RNG_HI: start-on-event=ResetEventDebounceStatus, operation=Event_INV_IGBT_TEMP_W_RNG_HI.ResetEventDebounceStatus
        OpEventResetEventDebounceStatus_ResetEventDebounceStatus_Event_VCEvBecmPropFr02Tioutd: start-on-event=ResetEventDebounceStatus, operation=Event_VCEvBecmPropFr02Tioutd.ResetEventDebounceStatus
        OpEventResetEventDebounceStatus_ResetEventDebounceStatus_Event_INV_IGBT_TEMP_W_GRDT: start-on-event=ResetEventDebounceStatus, operation=Event_INV_IGBT_TEMP_W_GRDT.ResetEventDebounceStatus
        OpEventResetEventDebounceStatus_ResetEventDebounceStatus_Event_EXT_UC_SPI_FLT: start-on-event=ResetEventDebounceStatus, operation=Event_EXT_UC_SPI_FLT.ResetEventDebounceStatus
        OpEventResetEventDebounceStatus_ResetEventDebounceStatus_Event_INV_IAC_V_ELEC_HWP_001: start-on-event=ResetEventDebounceStatus, operation=Event_INV_IAC_V_ELEC_HWP_001.ResetEventDebounceStatus
        OpEventResetEventDebounceStatus_ResetEventDebounceStatus_Event_VcEvChkSumWhlMotSysTqAllwd: start-on-event=ResetEventDebounceStatus, operation=Event_VcEvChkSumWhlMotSysTqAllwd.ResetEventDebounceStatus
        OpEventResetEventDebounceStatus_ResetEventDebounceStatus_Event_FS_MONITIOR_ASC_FLT: start-on-event=ResetEventDebounceStatus, operation=Event_FS_MONITIOR_ASC_FLT.ResetEventDebounceStatus
        OpEventResetEventDebounceStatus_ResetEventDebounceStatus_Event_INV_IAC_V_AMP: start-on-event=ResetEventDebounceStatus, operation=Event_INV_IAC_V_AMP.ResetEventDebounceStatus
        OpEventResetEventDebounceStatus_ResetEventDebounceStatus_Event_INV_IAC_W_ELEC_LO: start-on-event=ResetEventDebounceStatus, operation=Event_INV_IAC_W_ELEC_LO.ResetEventDebounceStatus
        OpEventResetEventDebounceStatus_ResetEventDebounceStatus_Event_VCEvVddmPropFr08Tioutd_001: start-on-event=ResetEventDebounceStatus, operation=Event_VCEvVddmPropFr08Tioutd_001.ResetEventDebounceStatus
        OpEventResetEventDebounceStatus_ResetEventDebounceStatus_Event_PS_P12_RES_FLT: start-on-event=ResetEventDebounceStatus, operation=Event_PS_P12_RES_FLT.ResetEventDebounceStatus
        OpEventResetEventDebounceStatus_ResetEventDebounceStatus_Event_INV_RSLVR_SIN_RNG_LO: start-on-event=ResetEventDebounceStatus, operation=Event_INV_RSLVR_SIN_RNG_LO.ResetEventDebounceStatus
        OpEventResetEventDebounceStatus_ResetEventDebounceStatus_Event_CU_TEMP_HW_FLT: start-on-event=ResetEventDebounceStatus, operation=Event_CU_TEMP_HW_FLT.ResetEventDebounceStatus
        OpEventResetEventDebounceStatus_ResetEventDebounceStatus_Event_VCEvEcmPropFr02MgmFr00Tioutd: start-on-event=ResetEventDebounceStatus, operation=Event_VCEvEcmPropFr02MgmFr00Tioutd.ResetEventDebounceStatus
        OpEventResetEventDebounceStatus_ResetEventDebounceStatus_Event_PS_KL15_RNG_HI: start-on-event=ResetEventDebounceStatus, operation=Event_PS_KL15_RNG_HI.ResetEventDebounceStatus
        OpEventResetEventDebounceStatus_ResetEventDebounceStatus_Event_VCEvVddmPropFr17Tioutd: start-on-event=ResetEventDebounceStatus, operation=Event_VCEvVddmPropFr17Tioutd.ResetEventDebounceStatus
        OpEventResetEventDebounceStatus_ResetEventDebounceStatus_Event_VcEvChkSumCrashStsSafe: start-on-event=ResetEventDebounceStatus, operation=Event_VcEvChkSumCrashStsSafe.ResetEventDebounceStatus
        OpEventResetEventDebounceStatus_ResetEventDebounceStatus_Event_DiagC_ClutchService: start-on-event=ResetEventDebounceStatus, operation=Event_DiagC_ClutchService.ResetEventDebounceStatus
        OpEventResetEventDebounceStatus_ResetEventDebounceStatus_Event_INV_EM_STATOR_TEMP_RNG_HI: start-on-event=ResetEventDebounceStatus, operation=Event_INV_EM_STATOR_TEMP_RNG_HI.ResetEventDebounceStatus
        OpEventResetEventDebounceStatus_ResetEventDebounceStatus_Event_INV_RSLVR_OFFS_OUT_RANG: start-on-event=ResetEventDebounceStatus, operation=Event_INV_RSLVR_OFFS_OUT_RANG.ResetEventDebounceStatus
        OpEventResetEventDebounceStatus_ResetEventDebounceStatus_Event_INV_EM_STATOR_TEMP2_RNG_LO: start-on-event=ResetEventDebounceStatus, operation=Event_INV_EM_STATOR_TEMP2_RNG_LO.ResetEventDebounceStatus
        OpEventResetEventDebounceStatus_ResetEventDebounceStatus_Event_VcEvMonISAR: start-on-event=ResetEventDebounceStatus, operation=Event_VcEvMonISAR.ResetEventDebounceStatus
        OpEventResetEventDebounceStatus_ResetEventDebounceStatus_Event_GA_BLDC_FLT: start-on-event=ResetEventDebounceStatus, operation=Event_GA_BLDC_FLT.ResetEventDebounceStatus
        OpEventResetEventDebounceStatus_ResetEventDebounceStatus_Event_INV_RSLVR_EXCT_ELEC_OPEN: start-on-event=ResetEventDebounceStatus, operation=Event_INV_RSLVR_EXCT_ELEC_OPEN.ResetEventDebounceStatus
        OpEventResetEventDebounceStatus_ResetEventDebounceStatus_Event_INV_RSLVR_EXCT_PLAUS: start-on-event=ResetEventDebounceStatus, operation=Event_INV_RSLVR_EXCT_PLAUS.ResetEventDebounceStatus
        OpEventResetEventDebounceStatus_ResetEventDebounceStatus_Event_PS_P15_U_FLT: start-on-event=ResetEventDebounceStatus, operation=Event_PS_P15_U_FLT.ResetEventDebounceStatus
        OpEventResetEventDebounceStatus_ResetEventDebounceStatus_Event_INV_EM_STATOR_TEMP_RNG_SWT: start-on-event=ResetEventDebounceStatus, operation=Event_INV_EM_STATOR_TEMP_RNG_SWT.ResetEventDebounceStatus
        OpEventResetEventDebounceStatus_ResetEventDebounceStatus_Event_INV_UHVDC_OV_SWP: start-on-event=ResetEventDebounceStatus, operation=Event_INV_UHVDC_OV_SWP.ResetEventDebounceStatus
        OpEventResetEventDebounceStatus_ResetEventDebounceStatus_Event_AURIX_HW_FLT: start-on-event=ResetEventDebounceStatus, operation=Event_AURIX_HW_FLT.ResetEventDebounceStatus
        OpEventResetEventDebounceStatus_ResetEventDebounceStatus_Event_INV_GATE_DRVR_TOP_HWP: start-on-event=ResetEventDebounceStatus, operation=Event_INV_GATE_DRVR_TOP_HWP.ResetEventDebounceStatus
        OpEventResetEventDebounceStatus_ResetEventDebounceStatus_Event_INV_ACTV_DCHA_HW: start-on-event=ResetEventDebounceStatus, operation=Event_INV_ACTV_DCHA_HW.ResetEventDebounceStatus
        OpEventResetEventDebounceStatus_ResetEventDebounceStatus_Event_INV_IGBT_TEMP_HWP: start-on-event=ResetEventDebounceStatus, operation=Event_INV_IGBT_TEMP_HWP.ResetEventDebounceStatus
        OpEventResetEventDebounceStatus_ResetEventDebounceStatus_Event_INV_RSLVR_SIN_ELEC_FLT: start-on-event=ResetEventDebounceStatus, operation=Event_INV_RSLVR_SIN_ELEC_FLT.ResetEventDebounceStatus
        OpEventResetEventDebounceStatus_ResetEventDebounceStatus_Event_CU_TEMP2_RNG_HI: start-on-event=ResetEventDebounceStatus, operation=Event_CU_TEMP2_RNG_HI.ResetEventDebounceStatus
        OpEventResetEventDebounceStatus_ResetEventDebounceStatus_Event_INV_IAC_PHA_LOSS_MPL: start-on-event=ResetEventDebounceStatus, operation=Event_INV_IAC_PHA_LOSS_MPL.ResetEventDebounceStatus
        OpEventResetEventDebounceStatus_ResetEventDebounceStatus_Event_INV_IAC_U_AMP: start-on-event=ResetEventDebounceStatus, operation=Event_INV_IAC_U_AMP.ResetEventDebounceStatus
        OpEventResetEventDebounceStatus_ResetEventDebounceStatus_Event_PSnsr_GRADT_Flt: start-on-event=ResetEventDebounceStatus, operation=Event_PSnsr_GRADT_Flt.ResetEventDebounceStatus
        OpEventResetEventDebounceStatus_ResetEventDebounceStatus_Event_AURIX_WATHDOG_FLT: start-on-event=ResetEventDebounceStatus, operation=Event_AURIX_WATHDOG_FLT.ResetEventDebounceStatus
        OpEventResetEventDebounceStatus_ResetEventDebounceStatus_Event_VcEvNodeMisBECM: start-on-event=ResetEventDebounceStatus, operation=Event_VcEvNodeMisBECM.ResetEventDebounceStatus
        OpEventResetEventDebounceStatus_ResetEventDebounceStatus_Event_INV_UHVDC_UV_HWP: start-on-event=ResetEventDebounceStatus, operation=Event_INV_UHVDC_UV_HWP.ResetEventDebounceStatus
        OpEventResetEventDebounceStatus_ResetEventDebounceStatus_Event_VcEvMonESpd: start-on-event=ResetEventDebounceStatus, operation=Event_VcEvMonESpd.ResetEventDebounceStatus
        OpEventResetEventDebounceStatus_ResetEventDebounceStatus_Event_COM_NotConfig: start-on-event=ResetEventDebounceStatus, operation=Event_COM_NotConfig.ResetEventDebounceStatus
        OpEventResetEventDebounceStatus_ResetEventDebounceStatus_Event_INV_RSLVR_SIN_RNG_HI: start-on-event=ResetEventDebounceStatus, operation=Event_INV_RSLVR_SIN_RNG_HI.ResetEventDebounceStatus
        OpEventResetEventDebounceStatus_ResetEventDebounceStatus_Event_INV_IGBT_TEMP_U_RNG_HI: start-on-event=ResetEventDebounceStatus, operation=Event_INV_IGBT_TEMP_U_RNG_HI.ResetEventDebounceStatus
        OpEventResetEventDebounceStatus_ResetEventDebounceStatus_Event_VcEvMonMode_001: start-on-event=ResetEventDebounceStatus, operation=Event_VcEvMonMode_001.ResetEventDebounceStatus
        OpEventResetEventDebounceStatus_ResetEventDebounceStatus_Event_PA_ACTION_FLT: start-on-event=ResetEventDebounceStatus, operation=Event_PA_ACTION_FLT.ResetEventDebounceStatus
        OpEventResetEventDebounceStatus_ResetEventDebounceStatus_Event_INV_IAC_V_ELEC_HWP: start-on-event=ResetEventDebounceStatus, operation=Event_INV_IAC_V_ELEC_HWP.ResetEventDebounceStatus
        OpEventResetEventDebounceStatus_ResetEventDebounceStatus_Event_CU_TEMP_HW_FLT_001: start-on-event=ResetEventDebounceStatus, operation=Event_CU_TEMP_HW_FLT_001.ResetEventDebounceStatus
        OpEventResetEventDebounceStatus_ResetEventDebounceStatus_Event_VCC_UnderVoltage: start-on-event=ResetEventDebounceStatus, operation=Event_VCC_UnderVoltage.ResetEventDebounceStatus
        OpEventResetEventDebounceStatus_ResetEventDebounceStatus_Event_VcEvTsttrPlaus: start-on-event=ResetEventDebounceStatus, operation=Event_VcEvTsttrPlaus.ResetEventDebounceStatus
        OpEventResetEventDebounceStatus_ResetEventDebounceStatus_Event_INV_RSLVR_EXCT_ELEC_FLT: start-on-event=ResetEventDebounceStatus, operation=Event_INV_RSLVR_EXCT_ELEC_FLT.ResetEventDebounceStatus
        OpEventResetEventDebounceStatus_ResetEventDebounceStatus_Event_INV_RSLVR_EXCT_RNG_LO: start-on-event=ResetEventDebounceStatus, operation=Event_INV_RSLVR_EXCT_RNG_LO.ResetEventDebounceStatus
        OpEventResetEventDebounceStatus_ResetEventDebounceStatus_Event_INV_EM_STATOR_TEMP2_RNG_HI: start-on-event=ResetEventDebounceStatus, operation=Event_INV_EM_STATOR_TEMP2_RNG_HI.ResetEventDebounceStatus
        OpEventResetEventDebounceStatus_ResetEventDebounceStatus_Event_INV_SHUT_OFF_PAH_START_UP: start-on-event=ResetEventDebounceStatus, operation=Event_INV_SHUT_OFF_PAH_START_UP.ResetEventDebounceStatus
        OpEventResetEventDebounceStatus_ResetEventDebounceStatus_Event_VCEvVddmPropFr08Tioutd: start-on-event=ResetEventDebounceStatus, operation=Event_VCEvVddmPropFr08Tioutd.ResetEventDebounceStatus
        OpEventResetEventDebounceStatus_ResetEventDebounceStatus_Event_INV_RSLVR_EXCT_OC_HWP_001: start-on-event=ResetEventDebounceStatus, operation=Event_INV_RSLVR_EXCT_OC_HWP_001.ResetEventDebounceStatus
        OpEventResetEventDebounceStatus_ResetEventDebounceStatus_Event_INV_RSLVR_EXCT_OC_HWP_002: start-on-event=ResetEventDebounceStatus, operation=Event_INV_RSLVR_EXCT_OC_HWP_002.ResetEventDebounceStatus
        OpEventResetEventDebounceStatus_ResetEventDebounceStatus_Event_INV_EM_STATOR_TEMP_ELE_FLT: start-on-event=ResetEventDebounceStatus, operation=Event_INV_EM_STATOR_TEMP_ELE_FLT.ResetEventDebounceStatus
        OpEventResetEventDebounceStatus_ResetEventDebounceStatus_Event_INV_INTERLOCK_FLT: start-on-event=ResetEventDebounceStatus, operation=Event_INV_INTERLOCK_FLT.ResetEventDebounceStatus
        OpEventResetEventDebounceStatus_ResetEventDebounceStatus_Event_Ga_ZeroFindDistanFailure: start-on-event=ResetEventDebounceStatus, operation=Event_Ga_ZeroFindDistanFailure.ResetEventDebounceStatus
        OpEventResetEventDebounceStatus_ResetEventDebounceStatus_Event_PLOCK_Current_RNG_OUT: start-on-event=ResetEventDebounceStatus, operation=Event_PLOCK_Current_RNG_OUT.ResetEventDebounceStatus
        OpEventResetEventDebounceStatus_ResetEventDebounceStatus_Event_VCEvVddmPropFr05Tioutd: start-on-event=ResetEventDebounceStatus, operation=Event_VCEvVddmPropFr05Tioutd.ResetEventDebounceStatus
        OpEventResetEventDebounceStatus_ResetEventDebounceStatus_Event_INV_IGBT_TEMP_V_GRDT: start-on-event=ResetEventDebounceStatus, operation=Event_INV_IGBT_TEMP_V_GRDT.ResetEventDebounceStatus
        OpEventResetEventDebounceStatus_ResetEventDebounceStatus_Event_PS_5V_Fault: start-on-event=ResetEventDebounceStatus, operation=Event_PS_5V_Fault.ResetEventDebounceStatus
        OpEventResetEventDebounceStatus_ResetEventDebounceStatus_Event_VcEvCntrCrashStsSafe: start-on-event=ResetEventDebounceStatus, operation=Event_VcEvCntrCrashStsSafe.ResetEventDebounceStatus
        OpEventResetEventDebounceStatus_ResetEventDebounceStatus_Event_INV_EM_STATOR_TEMP_GRDT: start-on-event=ResetEventDebounceStatus, operation=Event_INV_EM_STATOR_TEMP_GRDT.ResetEventDebounceStatus
        OpEventResetEventDebounceStatus_ResetEventDebounceStatus_Event_PS_P15_V_FLT: start-on-event=ResetEventDebounceStatus, operation=Event_PS_P15_V_FLT.ResetEventDebounceStatus
        OpEventResetEventDebounceStatus_ResetEventDebounceStatus_Event_INV_EM_STATOR_TEMP_RNG_NOK: start-on-event=ResetEventDebounceStatus, operation=Event_INV_EM_STATOR_TEMP_RNG_NOK.ResetEventDebounceStatus
        OpEventResetEventDebounceStatus_ResetEventDebounceStatus_Event_INV_RSLVR_SIN_RNG_NOK: start-on-event=ResetEventDebounceStatus, operation=Event_INV_RSLVR_SIN_RNG_NOK.ResetEventDebounceStatus
        OpEventResetEventDebounceStatus_ResetEventDebounceStatus_Event_INV_IAC_U_OFFS: start-on-event=ResetEventDebounceStatus, operation=Event_INV_IAC_U_OFFS.ResetEventDebounceStatus
        OpEventResetEventDebounceStatus_ResetEventDebounceStatus_Event_PS_KL30_BACKUP_FLT: start-on-event=ResetEventDebounceStatus, operation=Event_PS_KL30_BACKUP_FLT.ResetEventDebounceStatus
        OpEventResetEventDebounceStatus_ResetEventDebounceStatus_Event_INV_IGBT_TEMP_U_RNG_LO: start-on-event=ResetEventDebounceStatus, operation=Event_INV_IGBT_TEMP_U_RNG_LO.ResetEventDebounceStatus
        OpEventResetEventDebounceStatus_ResetEventDebounceStatus_Event_INV_EM_STATOR_TEMP_HWP: start-on-event=ResetEventDebounceStatus, operation=Event_INV_EM_STATOR_TEMP_HWP.ResetEventDebounceStatus
        OpEventResetEventDebounceStatus_ResetEventDebounceStatus_Event_CU_TEMP1_RNG_HI: start-on-event=ResetEventDebounceStatus, operation=Event_CU_TEMP1_RNG_HI.ResetEventDebounceStatus
        OpEventResetEventDebounceStatus_ResetEventDebounceStatus_Event_INV_IGBT_TEMP_V_RNG_HI: start-on-event=ResetEventDebounceStatus, operation=Event_INV_IGBT_TEMP_V_RNG_HI.ResetEventDebounceStatus
        OpEventResetEventDebounceStatus_ResetEventDebounceStatus_Event_VcEvNodeMisVDDM: start-on-event=ResetEventDebounceStatus, operation=Event_VcEvNodeMisVDDM.ResetEventDebounceStatus
        OpEventResetEventDebounceStatus_ResetEventDebounceStatus_Event_INV_UHVDC_PLAUS: start-on-event=ResetEventDebounceStatus, operation=Event_INV_UHVDC_PLAUS.ResetEventDebounceStatus
        OpEventResetEventDebounceStatus_ResetEventDebounceStatus_Event_INV_QUIESCENT_FLT: start-on-event=ResetEventDebounceStatus, operation=Event_INV_QUIESCENT_FLT.ResetEventDebounceStatus
        OpEventResetEventDebounceStatus_ResetEventDebounceStatus_Event_INV_RSLVR_EXCT_RNG_HI: start-on-event=ResetEventDebounceStatus, operation=Event_INV_RSLVR_EXCT_RNG_HI.ResetEventDebounceStatus
      port-api-options:
        enable-take-address=true, indirect-api=false, port=DemSatellite_0/GeneralEvtInfo
        {enable-take-address=true, indirect-api=false, port-defined-argument-value{value=165, value-type=Dem_EventIdType}, port=EvtInfo_VCEvBecmPropFr01Tioutd}
        {enable-take-address=true, indirect-api=false, port-defined-argument-value{value=165, value-type=Dem_EventIdType}, port=Event_VCEvBecmPropFr01Tioutd}
        {enable-take-address=true, indirect-api=false, port-defined-argument-value{value=35, value-type=Dem_EventIdType}, port=EvtInfo_INV_CU_TEMP2_RNG_NOK}
        {enable-take-address=true, indirect-api=false, port-defined-argument-value{value=35, value-type=Dem_EventIdType}, port=Event_INV_CU_TEMP2_RNG_NOK}
        {enable-take-address=true, indirect-api=false, port-defined-argument-value{value=6, value-type=Dem_EventIdType}, port=EvtInfo_COM_Busoff}
        {enable-take-address=true, indirect-api=false, port-defined-argument-value{value=6, value-type=Dem_EventIdType}, port=Event_COM_Busoff}
        {enable-take-address=true, indirect-api=false, port-defined-argument-value{value=91, value-type=Dem_EventIdType}, port=EvtInfo_INV_IMMO_NOKEY}
        {enable-take-address=true, indirect-api=false, port-defined-argument-value{value=91, value-type=Dem_EventIdType}, port=Event_INV_IMMO_NOKEY}
        {enable-take-address=true, indirect-api=false, port-defined-argument-value{value=107, value-type=Dem_EventIdType}, port=EvtInfo_INV_RSLVR_EXCT_OC_HWP}
        {enable-take-address=true, indirect-api=false, port-defined-argument-value{value=107, value-type=Dem_EventIdType}, port=Event_INV_RSLVR_EXCT_OC_HWP}
        {enable-take-address=true, indirect-api=false, port-defined-argument-value{value=157, value-type=Dem_EventIdType}, port=EvtInfo_PS_P15_W_FLT}
        {enable-take-address=true, indirect-api=false, port-defined-argument-value{value=157, value-type=Dem_EventIdType}, port=Event_PS_P15_W_FLT}
        {enable-take-address=true, indirect-api=false, port-defined-argument-value{value=55, value-type=Dem_EventIdType}, port=EvtInfo_INV_IAC_PLAUS_SUM}
        {enable-take-address=true, indirect-api=false, port-defined-argument-value{value=55, value-type=Dem_EventIdType}, port=Event_INV_IAC_PLAUS_SUM}
        {enable-take-address=true, indirect-api=false, port-defined-argument-value{value=138, value-type=Dem_EventIdType}, port=EvtInfo_PA_ELE_FLT}
        {enable-take-address=true, indirect-api=false, port-defined-argument-value{value=138, value-type=Dem_EventIdType}, port=Event_PA_ELE_FLT}
        {enable-take-address=true, indirect-api=false, port-defined-argument-value{value=14, value-type=Dem_EventIdType}, port=EvtInfo_CU_TEMP_GRDT}
        {enable-take-address=true, indirect-api=false, port-defined-argument-value{value=14, value-type=Dem_EventIdType}, port=Event_CU_TEMP_GRDT}
        {enable-take-address=true, indirect-api=false, port-defined-argument-value{value=83, value-type=Dem_EventIdType}, port=EvtInfo_INV_IGBT_TEMP_V_PLAUS}
        {enable-take-address=true, indirect-api=false, port-defined-argument-value{value=83, value-type=Dem_EventIdType}, port=Event_INV_IGBT_TEMP_V_PLAUS}
        {enable-take-address=true, indirect-api=false, port-defined-argument-value{value=27, value-type=Dem_EventIdType}, port=EvtInfo_Ga_GAEngageFailure}
        {enable-take-address=true, indirect-api=false, port-defined-argument-value{value=27, value-type=Dem_EventIdType}, port=Event_Ga_GAEngageFailure}
        {enable-take-address=true, indirect-api=false, port-defined-argument-value{value=76, value-type=Dem_EventIdType}, port=EvtInfo_INV_IAC_W_RNG_LO}
        {enable-take-address=true, indirect-api=false, port-defined-argument-value{value=76, value-type=Dem_EventIdType}, port=Event_INV_IAC_W_RNG_LO}
        {enable-take-address=true, indirect-api=false, port-defined-argument-value{value=159, value-type=Dem_EventIdType}, port=EvtInfo_PS_WhlSnsr_Vltg_FLT}
        {enable-take-address=true, indirect-api=false, port-defined-argument-value{value=159, value-type=Dem_EventIdType}, port=Event_PS_WhlSnsr_Vltg_FLT}
        {enable-take-address=true, indirect-api=false, port-defined-argument-value{value=168, value-type=Dem_EventIdType}, port=EvtInfo_VCEvEcmPropFr02Tioutd}
        {enable-take-address=true, indirect-api=false, port-defined-argument-value{value=168, value-type=Dem_EventIdType}, port=Event_VCEvEcmPropFr02Tioutd}
        {enable-take-address=true, indirect-api=false, port-defined-argument-value{value=29, value-type=Dem_EventIdType}, port=EvtInfo_Ga_TmSpdSyncFailed}
        {enable-take-address=true, indirect-api=false, port-defined-argument-value{value=29, value-type=Dem_EventIdType}, port=Event_Ga_TmSpdSyncFailed}
        {enable-take-address=true, indirect-api=false, port-defined-argument-value{value=104, value-type=Dem_EventIdType}, port=EvtInfo_INV_RSLVR_EXCT_ELEC_LO}
        {enable-take-address=true, indirect-api=false, port-defined-argument-value{value=104, value-type=Dem_EventIdType}, port=Event_INV_RSLVR_EXCT_ELEC_LO}
        {enable-take-address=true, indirect-api=false, port-defined-argument-value{value=175, value-type=Dem_EventIdType}, port=EvtInfo_VCEvEcmPropXevFr06Tioutd}
        {enable-take-address=true, indirect-api=false, port-defined-argument-value{value=175, value-type=Dem_EventIdType}, port=Event_VCEvEcmPropXevFr06Tioutd}
        {enable-take-address=true, indirect-api=false, port-defined-argument-value{value=191, value-type=Dem_EventIdType}, port=EvtInfo_VcEvCntrWhlMotSysTqAllwd}
        {enable-take-address=true, indirect-api=false, port-defined-argument-value{value=191, value-type=Dem_EventIdType}, port=Event_VcEvCntrWhlMotSysTqAllwd}
        {enable-take-address=true, indirect-api=false, port-defined-argument-value{value=129, value-type=Dem_EventIdType}, port=EvtInfo_INV_UHVDC_1_ELEC_HI}
        {enable-take-address=true, indirect-api=false, port-defined-argument-value{value=129, value-type=Dem_EventIdType}, port=Event_INV_UHVDC_1_ELEC_HI}
        {enable-take-address=true, indirect-api=false, port-defined-argument-value{value=37, value-type=Dem_EventIdType}, port=EvtInfo_INV_EM_STATOR_TEMP2_ELE_FLT}
        {enable-take-address=true, indirect-api=false, port-defined-argument-value{value=37, value-type=Dem_EventIdType}, port=Event_INV_EM_STATOR_TEMP2_ELE_FLT}
        {enable-take-address=true, indirect-api=false, port-defined-argument-value{value=4, value-type=Dem_EventIdType}, port=EvtInfo_AURIX_RST_SNG}
        {enable-take-address=true, indirect-api=false, port-defined-argument-value{value=4, value-type=Dem_EventIdType}, port=Event_AURIX_RST_SNG}
        {enable-take-address=true, indirect-api=false, port-defined-argument-value{value=173, value-type=Dem_EventIdType}, port=EvtInfo_VCEvEcmPropFr24MgmFr01Tioutd}
        {enable-take-address=true, indirect-api=false, port-defined-argument-value{value=173, value-type=Dem_EventIdType}, port=Event_VCEvEcmPropFr24MgmFr01Tioutd}
        {enable-take-address=true, indirect-api=false, port-defined-argument-value{value=98, value-type=Dem_EventIdType}, port=EvtInfo_INV_RSLVR_COS_ELEC_OPEN}
        {enable-take-address=true, indirect-api=false, port-defined-argument-value{value=98, value-type=Dem_EventIdType}, port=Event_INV_RSLVR_COS_ELEC_OPEN}
        {enable-take-address=true, indirect-api=false, port-defined-argument-value{value=67, value-type=Dem_EventIdType}, port=EvtInfo_INV_IAC_V_ELEC_LO}
        {enable-take-address=true, indirect-api=false, port-defined-argument-value{value=67, value-type=Dem_EventIdType}, port=Event_INV_IAC_V_ELEC_LO}
        {enable-take-address=true, indirect-api=false, port-defined-argument-value{value=74, value-type=Dem_EventIdType}, port=EvtInfo_INV_IAC_W_OFFS}
        {enable-take-address=true, indirect-api=false, port-defined-argument-value{value=74, value-type=Dem_EventIdType}, port=Event_INV_IAC_W_OFFS}
        {enable-take-address=true, indirect-api=false, port-defined-argument-value{value=38, value-type=Dem_EventIdType}, port=EvtInfo_INV_EM_STATOR_TEMP2_GRDT}
        {enable-take-address=true, indirect-api=false, port-defined-argument-value{value=38, value-type=Dem_EventIdType}, port=Event_INV_EM_STATOR_TEMP2_GRDT}
        {enable-take-address=true, indirect-api=false, port-defined-argument-value{value=36, value-type=Dem_EventIdType}, port=EvtInfo_INV_EM_OVRSPD_HWP}
        {enable-take-address=true, indirect-api=false, port-defined-argument-value{value=36, value-type=Dem_EventIdType}, port=Event_INV_EM_OVRSPD_HWP}
        {enable-take-address=true, indirect-api=false, port-defined-argument-value{value=15, value-type=Dem_EventIdType}, port=EvtInfo_CU_TEMP_HWP}
        {enable-take-address=true, indirect-api=false, port-defined-argument-value{value=15, value-type=Dem_EventIdType}, port=Event_CU_TEMP_HWP}
        {enable-take-address=true, indirect-api=false, port-defined-argument-value{value=130, value-type=Dem_EventIdType}, port=EvtInfo_INV_UHVDC_1_RNG_HI}
        {enable-take-address=true, indirect-api=false, port-defined-argument-value{value=130, value-type=Dem_EventIdType}, port=Event_INV_UHVDC_1_RNG_HI}
        {enable-take-address=true, indirect-api=false, port-defined-argument-value{value=192, value-type=Dem_EventIdType}, port=EvtInfo_VcEvEMPerfPlaus}
        {enable-take-address=true, indirect-api=false, port-defined-argument-value{value=192, value-type=Dem_EventIdType}, port=Event_VcEvEMPerfPlaus}
        {enable-take-address=true, indirect-api=false, port-defined-argument-value{value=182, value-type=Dem_EventIdType}, port=EvtInfo_VCEvVddmPropFr18Tioutd}
        {enable-take-address=true, indirect-api=false, port-defined-argument-value{value=182, value-type=Dem_EventIdType}, port=Event_VCEvVddmPropFr18Tioutd}
        {enable-take-address=true, indirect-api=false, port-defined-argument-value{value=58, value-type=Dem_EventIdType}, port=EvtInfo_INV_IAC_U_ELEC_HWP}
        {enable-take-address=true, indirect-api=false, port-defined-argument-value{value=58, value-type=Dem_EventIdType}, port=Event_INV_IAC_U_ELEC_HWP}
        {enable-take-address=true, indirect-api=false, port-defined-argument-value{value=180, value-type=Dem_EventIdType}, port=EvtInfo_VCEvVddmPropFr15Tioutd}
        {enable-take-address=true, indirect-api=false, port-defined-argument-value{value=180, value-type=Dem_EventIdType}, port=Event_VCEvVddmPropFr15Tioutd}
        {enable-take-address=true, indirect-api=false, port-defined-argument-value{value=26, value-type=Dem_EventIdType}, port=EvtInfo_Ga_GADisengageFailure}
        {enable-take-address=true, indirect-api=false, port-defined-argument-value{value=26, value-type=Dem_EventIdType}, port=Event_Ga_GADisengageFailure}
        {enable-take-address=true, indirect-api=false, port-defined-argument-value{value=13, value-type=Dem_EventIdType}, port=EvtInfo_CU_TEMP2_RNG_LO}
        {enable-take-address=true, indirect-api=false, port-defined-argument-value{value=13, value-type=Dem_EventIdType}, port=Event_CU_TEMP2_RNG_LO}
        {enable-take-address=true, indirect-api=false, port-defined-argument-value{value=123, value-type=Dem_EventIdType}, port=EvtInfo_INV_RSLVR_SIN_ELEC_OPEN}
        {enable-take-address=true, indirect-api=false, port-defined-argument-value{value=123, value-type=Dem_EventIdType}, port=Event_INV_RSLVR_SIN_ELEC_OPEN}
        {enable-take-address=true, indirect-api=false, port-defined-argument-value{value=184, value-type=Dem_EventIdType}, port=EvtInfo_VcEvChkSum}
        {enable-take-address=true, indirect-api=false, port-defined-argument-value{value=184, value-type=Dem_EventIdType}, port=Event_VcEvChkSum}
        {enable-take-address=true, indirect-api=false, port-defined-argument-value{value=153, value-type=Dem_EventIdType}, port=EvtInfo_PS_P5_UC_FLT}
        {enable-take-address=true, indirect-api=false, port-defined-argument-value{value=153, value-type=Dem_EventIdType}, port=Event_PS_P5_UC_FLT}
        {enable-take-address=true, indirect-api=false, port-defined-argument-value{value=95, value-type=Dem_EventIdType}, port=EvtInfo_INV_RSLVR_COS_ELEC_FLT}
        {enable-take-address=true, indirect-api=false, port-defined-argument-value{value=95, value-type=Dem_EventIdType}, port=Event_INV_RSLVR_COS_ELEC_FLT}
        {enable-take-address=true, indirect-api=false, port-defined-argument-value{value=75, value-type=Dem_EventIdType}, port=EvtInfo_INV_IAC_W_RNG_HI}
        {enable-take-address=true, indirect-api=false, port-defined-argument-value{value=75, value-type=Dem_EventIdType}, port=Event_INV_IAC_W_RNG_HI}
        {enable-take-address=true, indirect-api=false, port-defined-argument-value{value=146, value-type=Dem_EventIdType}, port=EvtInfo_PS_ECUSUPPLY_HIGH}
        {enable-take-address=true, indirect-api=false, port-defined-argument-value{value=146, value-type=Dem_EventIdType}, port=Event_PS_ECUSUPPLY_HIGH}
        {enable-take-address=true, indirect-api=false, port-defined-argument-value{value=170, value-type=Dem_EventIdType}, port=EvtInfo_VCEvEcmPropFr05Tioutd}
        {enable-take-address=true, indirect-api=false, port-defined-argument-value{value=170, value-type=Dem_EventIdType}, port=Event_VCEvEcmPropFr05Tioutd}
        {enable-take-address=true, indirect-api=false, port-defined-argument-value{value=147, value-type=Dem_EventIdType}, port=EvtInfo_PS_ECUSUPPLY_LOW}
        {enable-take-address=true, indirect-api=false, port-defined-argument-value{value=147, value-type=Dem_EventIdType}, port=Event_PS_ECUSUPPLY_LOW}
        {enable-take-address=true, indirect-api=false, port-defined-argument-value{value=186, value-type=Dem_EventIdType}, port=EvtInfo_VcEvChkSumHvSysRlySts}
        {enable-take-address=true, indirect-api=false, port-defined-argument-value{value=186, value-type=Dem_EventIdType}, port=Event_VcEvChkSumHvSysRlySts}
        {enable-take-address=true, indirect-api=false, port-defined-argument-value{value=197, value-type=Dem_EventIdType}, port=EvtInfo_VcEvMonMode}
        {enable-take-address=true, indirect-api=false, port-defined-argument-value{value=197, value-type=Dem_EventIdType}, port=Event_VcEvMonMode}
        {enable-take-address=true, indirect-api=false, port-defined-argument-value{value=53, value-type=Dem_EventIdType}, port=EvtInfo_INV_IAC_OC_SWP}
        {enable-take-address=true, indirect-api=false, port-defined-argument-value{value=53, value-type=Dem_EventIdType}, port=Event_INV_IAC_OC_SWP}
        {enable-take-address=true, indirect-api=false, port-defined-argument-value{value=90, value-type=Dem_EventIdType}, port=EvtInfo_INV_IMMO_AUTHFAIL}
        {enable-take-address=true, indirect-api=false, port-defined-argument-value{value=90, value-type=Dem_EventIdType}, port=Event_INV_IMMO_AUTHFAIL}
        {enable-take-address=true, indirect-api=false, port-defined-argument-value{value=140, value-type=Dem_EventIdType}, port=EvtInfo_PA_OpenCirc_FLT}
        {enable-take-address=true, indirect-api=false, port-defined-argument-value{value=140, value-type=Dem_EventIdType}, port=Event_PA_OpenCirc_FLT}
        {enable-take-address=true, indirect-api=false, port-defined-argument-value{value=64, value-type=Dem_EventIdType}, port=EvtInfo_INV_IAC_V_ELEC_HI}
        {enable-take-address=true, indirect-api=false, port-defined-argument-value{value=64, value-type=Dem_EventIdType}, port=Event_INV_IAC_V_ELEC_HI}
        {enable-take-address=true, indirect-api=false, port-defined-argument-value{value=169, value-type=Dem_EventIdType}, port=EvtInfo_VCEvEcmPropFr04Tioutd}
        {enable-take-address=true, indirect-api=false, port-defined-argument-value{value=169, value-type=Dem_EventIdType}, port=Event_VCEvEcmPropFr04Tioutd}
        {enable-take-address=true, indirect-api=false, port-defined-argument-value{value=200, value-type=Dem_EventIdType}, port=EvtInfo_VcEvMonTrqActPlaus}
        {enable-take-address=true, indirect-api=false, port-defined-argument-value{value=200, value-type=Dem_EventIdType}, port=Event_VcEvMonTrqActPlaus}
        {enable-take-address=true, indirect-api=false, port-defined-argument-value{value=199, value-type=Dem_EventIdType}, port=EvtInfo_VcEvMonTrqAct}
        {enable-take-address=true, indirect-api=false, port-defined-argument-value{value=199, value-type=Dem_EventIdType}, port=Event_VcEvMonTrqAct}
        {enable-take-address=true, indirect-api=false, port-defined-argument-value{value=97, value-type=Dem_EventIdType}, port=EvtInfo_INV_RSLVR_COS_ELEC_LO}
        {enable-take-address=true, indirect-api=false, port-defined-argument-value{value=97, value-type=Dem_EventIdType}, port=Event_INV_RSLVR_COS_ELEC_LO}
        {enable-take-address=true, indirect-api=false, port-defined-argument-value{value=33, value-type=Dem_EventIdType}, port=EvtInfo_INV_COOLT_INLET_TEMP_HWP}
        {enable-take-address=true, indirect-api=false, port-defined-argument-value{value=33, value-type=Dem_EventIdType}, port=Event_INV_COOLT_INLET_TEMP_HWP}
        {enable-take-address=true, indirect-api=false, port-defined-argument-value{value=172, value-type=Dem_EventIdType}, port=EvtInfo_VCEvEcmPropFr11Tioutd}
        {enable-take-address=true, indirect-api=false, port-defined-argument-value{value=172, value-type=Dem_EventIdType}, port=Event_VCEvEcmPropFr11Tioutd}
        {enable-take-address=true, indirect-api=false, port-defined-argument-value{value=151, value-type=Dem_EventIdType}, port=EvtInfo_PS_KL30_RNG_HI}
        {enable-take-address=true, indirect-api=false, port-defined-argument-value{value=151, value-type=Dem_EventIdType}, port=Event_PS_KL30_RNG_HI}
        {enable-take-address=true, indirect-api=false, port-defined-argument-value{value=52, value-type=Dem_EventIdType}, port=EvtInfo_INV_IAC_OC_HWP}
        {enable-take-address=true, indirect-api=false, port-defined-argument-value{value=52, value-type=Dem_EventIdType}, port=Event_INV_IAC_OC_HWP}
        {enable-take-address=true, indirect-api=false, port-defined-argument-value{value=99, value-type=Dem_EventIdType}, port=EvtInfo_INV_RSLVR_COS_RNG_HI}
        {enable-take-address=true, indirect-api=false, port-defined-argument-value{value=99, value-type=Dem_EventIdType}, port=Event_INV_RSLVR_COS_RNG_HI}
        {enable-take-address=true, indirect-api=false, port-defined-argument-value{value=57, value-type=Dem_EventIdType}, port=EvtInfo_INV_IAC_U_ELEC_HI}
        {enable-take-address=true, indirect-api=false, port-defined-argument-value{value=57, value-type=Dem_EventIdType}, port=Event_INV_IAC_U_ELEC_HI}
        {enable-take-address=true, indirect-api=false, port-defined-argument-value{value=70, value-type=Dem_EventIdType}, port=EvtInfo_INV_IAC_V_RNG_LO}
        {enable-take-address=true, indirect-api=false, port-defined-argument-value{value=70, value-type=Dem_EventIdType}, port=Event_INV_IAC_V_RNG_LO}
        {enable-take-address=true, indirect-api=false, port-defined-argument-value{value=61, value-type=Dem_EventIdType}, port=EvtInfo_INV_IAC_U_RNG_HI}
        {enable-take-address=true, indirect-api=false, port-defined-argument-value{value=61, value-type=Dem_EventIdType}, port=Event_INV_IAC_U_RNG_HI}
        {enable-take-address=true, indirect-api=false, port-defined-argument-value{value=174, value-type=Dem_EventIdType}, port=EvtInfo_VCEvEcmPropFr25Tioutd}
        {enable-take-address=true, indirect-api=false, port-defined-argument-value{value=174, value-type=Dem_EventIdType}, port=Event_VCEvEcmPropFr25Tioutd}
        {enable-take-address=true, indirect-api=false, port-defined-argument-value{value=89, value-type=Dem_EventIdType}, port=EvtInfo_INV_IGBT_TEMP_W_RNG_LO}
        {enable-take-address=true, indirect-api=false, port-defined-argument-value{value=89, value-type=Dem_EventIdType}, port=Event_INV_IGBT_TEMP_W_RNG_LO}
        {enable-take-address=true, indirect-api=false, port-defined-argument-value{value=162, value-type=Dem_EventIdType}, port=EvtInfo_PSnsr_RNG_NOK}
        {enable-take-address=true, indirect-api=false, port-defined-argument-value{value=162, value-type=Dem_EventIdType}, port=Event_PSnsr_RNG_NOK}
        {enable-take-address=true, indirect-api=false, port-defined-argument-value{value=101, value-type=Dem_EventIdType}, port=EvtInfo_INV_RSLVR_COS_RNG_NOK}
        {enable-take-address=true, indirect-api=false, port-defined-argument-value{value=101, value-type=Dem_EventIdType}, port=Event_INV_RSLVR_COS_RNG_NOK}
        {enable-take-address=true, indirect-api=false, port-defined-argument-value{value=145, value-type=Dem_EventIdType}, port=EvtInfo_PS_DRVB_Fault}
        {enable-take-address=true, indirect-api=false, port-defined-argument-value{value=145, value-type=Dem_EventIdType}, port=Event_PS_DRVB_Fault}
        {enable-take-address=true, indirect-api=false, port-defined-argument-value{value=34, value-type=Dem_EventIdType}, port=EvtInfo_INV_CU_TEMP1_RNG_NOK}
        {enable-take-address=true, indirect-api=false, port-defined-argument-value{value=34, value-type=Dem_EventIdType}, port=Event_INV_CU_TEMP1_RNG_NOK}
        {enable-take-address=true, indirect-api=false, port-defined-argument-value{value=188, value-type=Dem_EventIdType}, port=EvtInfo_VcEvCntr}
        {enable-take-address=true, indirect-api=false, port-defined-argument-value{value=188, value-type=Dem_EventIdType}, port=Event_VcEvCntr}
        {enable-take-address=true, indirect-api=false, port-defined-argument-value{value=117, value-type=Dem_EventIdType}, port=EvtInfo_INV_RSLVR_SIN_AMP}
        {enable-take-address=true, indirect-api=false, port-defined-argument-value{value=117, value-type=Dem_EventIdType}, port=Event_INV_RSLVR_SIN_AMP}
        {enable-take-address=true, indirect-api=false, port-defined-argument-value{value=131, value-type=Dem_EventIdType}, port=EvtInfo_INV_UHVDC_2_RNG_HI}
        {enable-take-address=true, indirect-api=false, port-defined-argument-value{value=131, value-type=Dem_EventIdType}, port=Event_INV_UHVDC_2_RNG_HI}
        {enable-take-address=true, indirect-api=false, port-defined-argument-value{value=78, value-type=Dem_EventIdType}, port=EvtInfo_INV_IGBT_TEMP_U_GRDT}
        {enable-take-address=true, indirect-api=false, port-defined-argument-value{value=78, value-type=Dem_EventIdType}, port=Event_INV_IGBT_TEMP_U_GRDT}
        {enable-take-address=true, indirect-api=false, port-defined-argument-value{value=136, value-type=Dem_EventIdType}, port=EvtInfo_MON_TQ_PLAUS_PWR_MDL}
        {enable-take-address=true, indirect-api=false, port-defined-argument-value{value=136, value-type=Dem_EventIdType}, port=Event_MON_TQ_PLAUS_PWR_MDL}
        {enable-take-address=true, indirect-api=false, port-defined-argument-value{value=87, value-type=Dem_EventIdType}, port=EvtInfo_INV_IGBT_TEMP_W_PLAUS}
        {enable-take-address=true, indirect-api=false, port-defined-argument-value{value=87, value-type=Dem_EventIdType}, port=Event_INV_IGBT_TEMP_W_PLAUS}
        {enable-take-address=true, indirect-api=false, port-defined-argument-value{value=144, value-type=Dem_EventIdType}, port=EvtInfo_PS_BLDC_UV_FLT}
        {enable-take-address=true, indirect-api=false, port-defined-argument-value{value=144, value-type=Dem_EventIdType}, port=Event_PS_BLDC_UV_FLT}
        {enable-take-address=true, indirect-api=false, port-defined-argument-value{value=68, value-type=Dem_EventIdType}, port=EvtInfo_INV_IAC_V_OFFS}
        {enable-take-address=true, indirect-api=false, port-defined-argument-value{value=68, value-type=Dem_EventIdType}, port=Event_INV_IAC_V_OFFS}
        {enable-take-address=true, indirect-api=false, port-defined-argument-value{value=106, value-type=Dem_EventIdType}, port=EvtInfo_INV_RSLVR_EXCT_FREQ_RNG_NOK}
        {enable-take-address=true, indirect-api=false, port-defined-argument-value{value=106, value-type=Dem_EventIdType}, port=Event_INV_RSLVR_EXCT_FREQ_RNG_NOK}
        {enable-take-address=true, indirect-api=false, port-defined-argument-value{value=152, value-type=Dem_EventIdType}, port=EvtInfo_PS_KL30_RNG_LO}
        {enable-take-address=true, indirect-api=false, port-defined-argument-value{value=152, value-type=Dem_EventIdType}, port=Event_PS_KL30_RNG_LO}
        {enable-take-address=true, indirect-api=false, port-defined-argument-value{value=100, value-type=Dem_EventIdType}, port=EvtInfo_INV_RSLVR_COS_RNG_LO}
        {enable-take-address=true, indirect-api=false, port-defined-argument-value{value=100, value-type=Dem_EventIdType}, port=Event_INV_RSLVR_COS_RNG_LO}
        {enable-take-address=true, indirect-api=false, port-defined-argument-value{value=160, value-type=Dem_EventIdType}, port=EvtInfo_PSnsr_ELE_FLT}
        {enable-take-address=true, indirect-api=false, port-defined-argument-value{value=160, value-type=Dem_EventIdType}, port=Event_PSnsr_ELE_FLT}
        {enable-take-address=true, indirect-api=false, port-defined-argument-value{value=119, value-type=Dem_EventIdType}, port=EvtInfo_INV_RSLVR_SIN_COS_PLAUS_AMP}
        {enable-take-address=true, indirect-api=false, port-defined-argument-value{value=119, value-type=Dem_EventIdType}, port=Event_INV_RSLVR_SIN_COS_PLAUS_AMP}
        {enable-take-address=true, indirect-api=false, port-defined-argument-value{value=59, value-type=Dem_EventIdType}, port=EvtInfo_INV_IAC_U_ELEC_LO}
        {enable-take-address=true, indirect-api=false, port-defined-argument-value{value=59, value-type=Dem_EventIdType}, port=Event_INV_IAC_U_ELEC_LO}
        {enable-take-address=true, indirect-api=false, port-defined-argument-value{value=103, value-type=Dem_EventIdType}, port=EvtInfo_INV_RSLVR_EXCT_ELEC_HI}
        {enable-take-address=true, indirect-api=false, port-defined-argument-value{value=103, value-type=Dem_EventIdType}, port=Event_INV_RSLVR_EXCT_ELEC_HI}
        {enable-take-address=true, indirect-api=false, port-defined-argument-value{value=62, value-type=Dem_EventIdType}, port=EvtInfo_INV_IAC_U_RNG_LO}
        {enable-take-address=true, indirect-api=false, port-defined-argument-value{value=62, value-type=Dem_EventIdType}, port=Event_INV_IAC_U_RNG_LO}
        {enable-take-address=true, indirect-api=false, port-defined-argument-value{value=69, value-type=Dem_EventIdType}, port=EvtInfo_INV_IAC_V_RNG_HI}
        {enable-take-address=true, indirect-api=false, port-defined-argument-value{value=69, value-type=Dem_EventIdType}, port=Event_INV_IAC_V_RNG_HI}
        {enable-take-address=true, indirect-api=false, port-defined-argument-value{value=79, value-type=Dem_EventIdType}, port=EvtInfo_INV_IGBT_TEMP_U_PLAUS}
        {enable-take-address=true, indirect-api=false, port-defined-argument-value{value=79, value-type=Dem_EventIdType}, port=Event_INV_IGBT_TEMP_U_PLAUS}
        {enable-take-address=true, indirect-api=false, port-defined-argument-value{value=115, value-type=Dem_EventIdType}, port=EvtInfo_INV_RSLVR_OFFS_DFT}
        {enable-take-address=true, indirect-api=false, port-defined-argument-value{value=115, value-type=Dem_EventIdType}, port=Event_INV_RSLVR_OFFS_DFT}
        {enable-take-address=true, indirect-api=false, port-defined-argument-value{value=28, value-type=Dem_EventIdType}, port=EvtInfo_Ga_MoveOverThd}
        {enable-take-address=true, indirect-api=false, port-defined-argument-value{value=28, value-type=Dem_EventIdType}, port=Event_Ga_MoveOverThd}
        {enable-take-address=true, indirect-api=false, port-defined-argument-value{value=195, value-type=Dem_EventIdType}, port=EvtInfo_VcEvMonIPH}
        {enable-take-address=true, indirect-api=false, port-defined-argument-value{value=195, value-type=Dem_EventIdType}, port=Event_VcEvMonIPH}
        {enable-take-address=true, indirect-api=false, port-defined-argument-value{value=114, value-type=Dem_EventIdType}, port=EvtInfo_INV_RSLVR_HW_FLT}
        {enable-take-address=true, indirect-api=false, port-defined-argument-value{value=114, value-type=Dem_EventIdType}, port=Event_INV_RSLVR_HW_FLT}
        {enable-take-address=true, indirect-api=false, port-defined-argument-value{value=122, value-type=Dem_EventIdType}, port=EvtInfo_INV_RSLVR_SIN_ELEC_LO}
        {enable-take-address=true, indirect-api=false, port-defined-argument-value{value=122, value-type=Dem_EventIdType}, port=Event_INV_RSLVR_SIN_ELEC_LO}
        {enable-take-address=true, indirect-api=false, port-defined-argument-value{value=71, value-type=Dem_EventIdType}, port=EvtInfo_INV_IAC_W_AMP}
        {enable-take-address=true, indirect-api=false, port-defined-argument-value{value=71, value-type=Dem_EventIdType}, port=Event_INV_IAC_W_AMP}
        {enable-take-address=true, indirect-api=false, port-defined-argument-value{value=163, value-type=Dem_EventIdType}, port=EvtInfo_VCC_OverVoltage}
        {enable-take-address=true, indirect-api=false, port-defined-argument-value{value=163, value-type=Dem_EventIdType}, port=Event_VCC_OverVoltage}
        {enable-take-address=true, indirect-api=false, port-defined-argument-value{value=143, value-type=Dem_EventIdType}, port=EvtInfo_PS_BLDC_OV_FLT}
        {enable-take-address=true, indirect-api=false, port-defined-argument-value{value=143, value-type=Dem_EventIdType}, port=Event_PS_BLDC_OV_FLT}
        {enable-take-address=true, indirect-api=false, port-defined-argument-value{value=1, value-type=Dem_EventIdType}, port=EvtInfo_AURIX_EEPROM_FLT}
        {enable-take-address=true, indirect-api=false, port-defined-argument-value{value=1, value-type=Dem_EventIdType}, port=Event_AURIX_EEPROM_FLT}
        {enable-take-address=true, indirect-api=false, port-defined-argument-value{value=22, value-type=Dem_EventIdType}, port=EvtInfo_FS_MONITIOR_ASC_FW_FLT}
        {enable-take-address=true, indirect-api=false, port-defined-argument-value{value=22, value-type=Dem_EventIdType}, port=Event_FS_MONITIOR_ASC_FW_FLT}
        {enable-take-address=true, indirect-api=false, port-defined-argument-value{value=176, value-type=Dem_EventIdType}, port=EvtInfo_VCEvSrsPropFr02Tioutd}
        {enable-take-address=true, indirect-api=false, port-defined-argument-value{value=176, value-type=Dem_EventIdType}, port=Event_VCEvSrsPropFr02Tioutd}
        {enable-take-address=true, indirect-api=false, port-defined-argument-value{value=194, value-type=Dem_EventIdType}, port=EvtInfo_VcEvMonErrMode}
        {enable-take-address=true, indirect-api=false, port-defined-argument-value{value=194, value-type=Dem_EventIdType}, port=Event_VcEvMonErrMode}
        {enable-take-address=true, indirect-api=false, port-defined-argument-value{value=3, value-type=Dem_EventIdType}, port=EvtInfo_AURIX_RST_MPL}
        {enable-take-address=true, indirect-api=false, port-defined-argument-value{value=3, value-type=Dem_EventIdType}, port=Event_AURIX_RST_MPL}
        {enable-take-address=true, indirect-api=false, port-defined-argument-value{value=203, value-type=Dem_EventIdType}, port=EvtInfo_VcEvNodeMisECM}
        {enable-take-address=true, indirect-api=false, port-defined-argument-value{value=203, value-type=Dem_EventIdType}, port=Event_VcEvNodeMisECM}
        {enable-take-address=true, indirect-api=false, port-defined-argument-value{value=150, value-type=Dem_EventIdType}, port=EvtInfo_PS_KL30_PLAUS}
        {enable-take-address=true, indirect-api=false, port-defined-argument-value{value=150, value-type=Dem_EventIdType}, port=Event_PS_KL30_PLAUS}
        {enable-take-address=true, indirect-api=false, port-defined-argument-value{value=72, value-type=Dem_EventIdType}, port=EvtInfo_INV_IAC_W_ELEC_HI}
        {enable-take-address=true, indirect-api=false, port-defined-argument-value{value=72, value-type=Dem_EventIdType}, port=Event_INV_IAC_W_ELEC_HI}
        {enable-take-address=true, indirect-api=false, port-defined-argument-value{value=183, value-type=Dem_EventIdType}, port=EvtInfo_VCEvVddmPropFr19Tioutd}
        {enable-take-address=true, indirect-api=false, port-defined-argument-value{value=183, value-type=Dem_EventIdType}, port=Event_VCEvVddmPropFr19Tioutd}
        {enable-take-address=true, indirect-api=false, port-defined-argument-value{value=128, value-type=Dem_EventIdType}, port=EvtInfo_INV_TEMP_DCHA_HW}
        {enable-take-address=true, indirect-api=false, port-defined-argument-value{value=128, value-type=Dem_EventIdType}, port=Event_INV_TEMP_DCHA_HW}
        {enable-take-address=true, indirect-api=false, port-defined-argument-value{value=205, value-type=Dem_EventIdType}, port=EvtInfo_VcEvPropCANGlbTiOutd}
        {enable-take-address=true, indirect-api=false, port-defined-argument-value{value=205, value-type=Dem_EventIdType}, port=Event_VcEvPropCANGlbTiOutd}
        {enable-take-address=true, indirect-api=false, port-defined-argument-value{value=41, value-type=Dem_EventIdType}, port=EvtInfo_INV_EM_STATOR_TEMP2_RNG_NOK}
        {enable-take-address=true, indirect-api=false, port-defined-argument-value{value=41, value-type=Dem_EventIdType}, port=Event_INV_EM_STATOR_TEMP2_RNG_NOK}
        {enable-take-address=true, indirect-api=false, port-defined-argument-value{value=132, value-type=Dem_EventIdType}, port=EvtInfo_INV_UHVDC_OV_HWP}
        {enable-take-address=true, indirect-api=false, port-defined-argument-value{value=132, value-type=Dem_EventIdType}, port=Event_INV_UHVDC_OV_HWP}
        {enable-take-address=true, indirect-api=false, port-defined-argument-value{value=25, value-type=Dem_EventIdType}, port=EvtInfo_Ga_FindEngleAngleFailed}
        {enable-take-address=true, indirect-api=false, port-defined-argument-value{value=25, value-type=Dem_EventIdType}, port=Event_Ga_FindEngleAngleFailed}
        {enable-take-address=true, indirect-api=false, port-defined-argument-value{value=201, value-type=Dem_EventIdType}, port=EvtInfo_VcEvMonTrqCmp}
        {enable-take-address=true, indirect-api=false, port-defined-argument-value{value=201, value-type=Dem_EventIdType}, port=Event_VcEvMonTrqCmp}
        {enable-take-address=true, indirect-api=false, port-defined-argument-value{value=85, value-type=Dem_EventIdType}, port=EvtInfo_INV_IGBT_TEMP_V_RNG_LO}
        {enable-take-address=true, indirect-api=false, port-defined-argument-value{value=85, value-type=Dem_EventIdType}, port=Event_INV_IGBT_TEMP_V_RNG_LO}
        {enable-take-address=true, indirect-api=false, port-defined-argument-value{value=32, value-type=Dem_EventIdType}, port=EvtInfo_INV_CONTROL_LIMIT}
        {enable-take-address=true, indirect-api=false, port-defined-argument-value{value=32, value-type=Dem_EventIdType}, port=Event_INV_CONTROL_LIMIT}
        {enable-take-address=true, indirect-api=false, port-defined-argument-value{value=7, value-type=Dem_EventIdType}, port=EvtInfo_COM_CarConfigErr}
        {enable-take-address=true, indirect-api=false, port-defined-argument-value{value=7, value-type=Dem_EventIdType}, port=Event_COM_CarConfigErr}
        {enable-take-address=true, indirect-api=false, port-defined-argument-value{value=171, value-type=Dem_EventIdType}, port=EvtInfo_VCEvEcmPropFr08Tioutd}
        {enable-take-address=true, indirect-api=false, port-defined-argument-value{value=171, value-type=Dem_EventIdType}, port=Event_VCEvEcmPropFr08Tioutd}
        {enable-take-address=true, indirect-api=false, port-defined-argument-value{value=11, value-type=Dem_EventIdType}, port=EvtInfo_CU_TEMP1_RNG_LO}
        {enable-take-address=true, indirect-api=false, port-defined-argument-value{value=11, value-type=Dem_EventIdType}, port=Event_CU_TEMP1_RNG_LO}
        {enable-take-address=true, indirect-api=false, port-defined-argument-value{value=42, value-type=Dem_EventIdType}, port=EvtInfo_INV_EM_STATOR_TEMP2_RNG_SWT}
        {enable-take-address=true, indirect-api=false, port-defined-argument-value{value=42, value-type=Dem_EventIdType}, port=Event_INV_EM_STATOR_TEMP2_RNG_SWT}
        {enable-take-address=true, indirect-api=false, port-defined-argument-value{value=24, value-type=Dem_EventIdType}, port=EvtInfo_GA_BLDC_POS_FLT}
        {enable-take-address=true, indirect-api=false, port-defined-argument-value{value=24, value-type=Dem_EventIdType}, port=Event_GA_BLDC_POS_FLT}
        {enable-take-address=true, indirect-api=false, port-defined-argument-value{value=158, value-type=Dem_EventIdType}, port=EvtInfo_PS_WhlSnsr_FLT}
        {enable-take-address=true, indirect-api=false, port-defined-argument-value{value=158, value-type=Dem_EventIdType}, port=Event_PS_WhlSnsr_FLT}
        {enable-take-address=true, indirect-api=false, port-defined-argument-value{value=47, value-type=Dem_EventIdType}, port=EvtInfo_INV_EM_STATOR_TEMP_RNG_LO}
        {enable-take-address=true, indirect-api=false, port-defined-argument-value{value=47, value-type=Dem_EventIdType}, port=Event_INV_EM_STATOR_TEMP_RNG_LO}
        {enable-take-address=true, indirect-api=false, port-defined-argument-value{value=121, value-type=Dem_EventIdType}, port=EvtInfo_INV_RSLVR_SIN_ELEC_HI}
        {enable-take-address=true, indirect-api=false, port-defined-argument-value{value=121, value-type=Dem_EventIdType}, port=Event_INV_RSLVR_SIN_ELEC_HI}
        {enable-take-address=true, indirect-api=false, port-defined-argument-value{value=118, value-type=Dem_EventIdType}, port=EvtInfo_INV_RSLVR_SIN_COS_PLAUS}
        {enable-take-address=true, indirect-api=false, port-defined-argument-value{value=118, value-type=Dem_EventIdType}, port=Event_INV_RSLVR_SIN_COS_PLAUS}
        {enable-take-address=true, indirect-api=false, port-defined-argument-value{value=94, value-type=Dem_EventIdType}, port=EvtInfo_INV_RSLVR_COS_AMP}
        {enable-take-address=true, indirect-api=false, port-defined-argument-value{value=94, value-type=Dem_EventIdType}, port=Event_INV_RSLVR_COS_AMP}
        {enable-take-address=true, indirect-api=false, port-defined-argument-value{value=50, value-type=Dem_EventIdType}, port=EvtInfo_INV_GATE_DRVR_BOT_HWP}
        {enable-take-address=true, indirect-api=false, port-defined-argument-value{value=50, value-type=Dem_EventIdType}, port=Event_INV_GATE_DRVR_BOT_HWP}
        {enable-take-address=true, indirect-api=false, port-defined-argument-value{value=20, value-type=Dem_EventIdType}, port=EvtInfo_Eg_HallVolWrong}
        {enable-take-address=true, indirect-api=false, port-defined-argument-value{value=20, value-type=Dem_EventIdType}, port=Event_Eg_HallVolWrong}
        {enable-take-address=true, indirect-api=false, port-defined-argument-value{value=113, value-type=Dem_EventIdType}, port=EvtInfo_INV_RSLVR_EXCT_RNG_NOK}
        {enable-take-address=true, indirect-api=false, port-defined-argument-value{value=113, value-type=Dem_EventIdType}, port=Event_INV_RSLVR_EXCT_RNG_NOK}
        {enable-take-address=true, indirect-api=false, port-defined-argument-value{value=139, value-type=Dem_EventIdType}, port=EvtInfo_PA_OpenCirc}
        {enable-take-address=true, indirect-api=false, port-defined-argument-value{value=139, value-type=Dem_EventIdType}, port=Event_PA_OpenCirc}
        {enable-take-address=true, indirect-api=false, port-defined-argument-value{value=96, value-type=Dem_EventIdType}, port=EvtInfo_INV_RSLVR_COS_ELEC_HI}
        {enable-take-address=true, indirect-api=false, port-defined-argument-value{value=96, value-type=Dem_EventIdType}, port=Event_INV_RSLVR_COS_ELEC_HI}
        {enable-take-address=true, indirect-api=false, port-defined-argument-value{value=190, value-type=Dem_EventIdType}, port=EvtInfo_VcEvCntrHvSysRlySts}
        {enable-take-address=true, indirect-api=false, port-defined-argument-value{value=190, value-type=Dem_EventIdType}, port=Event_VcEvCntrHvSysRlySts}
        {enable-take-address=true, indirect-api=false, port-defined-argument-value{value=9, value-type=Dem_EventIdType}, port=EvtInfo_CRASH_DTC}
        {enable-take-address=true, indirect-api=false, port-defined-argument-value{value=9, value-type=Dem_EventIdType}, port=Event_CRASH_DTC}
        {enable-take-address=true, indirect-api=false, port-defined-argument-value{value=88, value-type=Dem_EventIdType}, port=EvtInfo_INV_IGBT_TEMP_W_RNG_HI}
        {enable-take-address=true, indirect-api=false, port-defined-argument-value{value=88, value-type=Dem_EventIdType}, port=Event_INV_IGBT_TEMP_W_RNG_HI}
        {enable-take-address=true, indirect-api=false, port-defined-argument-value{value=166, value-type=Dem_EventIdType}, port=EvtInfo_VCEvBecmPropFr02Tioutd}
        {enable-take-address=true, indirect-api=false, port-defined-argument-value{value=166, value-type=Dem_EventIdType}, port=Event_VCEvBecmPropFr02Tioutd}
        {enable-take-address=true, indirect-api=false, port-defined-argument-value{value=86, value-type=Dem_EventIdType}, port=EvtInfo_INV_IGBT_TEMP_W_GRDT}
        {enable-take-address=true, indirect-api=false, port-defined-argument-value{value=86, value-type=Dem_EventIdType}, port=Event_INV_IGBT_TEMP_W_GRDT}
        {enable-take-address=true, indirect-api=false, port-defined-argument-value{value=19, value-type=Dem_EventIdType}, port=EvtInfo_EXT_UC_SPI_FLT}
        {enable-take-address=true, indirect-api=false, port-defined-argument-value{value=19, value-type=Dem_EventIdType}, port=Event_EXT_UC_SPI_FLT}
        {enable-take-address=true, indirect-api=false, port-defined-argument-value{value=66, value-type=Dem_EventIdType}, port=EvtInfo_INV_IAC_V_ELEC_HWP_001}
        {enable-take-address=true, indirect-api=false, port-defined-argument-value{value=66, value-type=Dem_EventIdType}, port=Event_INV_IAC_V_ELEC_HWP_001}
        {enable-take-address=true, indirect-api=false, port-defined-argument-value{value=187, value-type=Dem_EventIdType}, port=EvtInfo_VcEvChkSumWhlMotSysTqAllwd}
        {enable-take-address=true, indirect-api=false, port-defined-argument-value{value=187, value-type=Dem_EventIdType}, port=Event_VcEvChkSumWhlMotSysTqAllwd}
        {enable-take-address=true, indirect-api=false, port-defined-argument-value{value=21, value-type=Dem_EventIdType}, port=EvtInfo_FS_MONITIOR_ASC_FLT}
        {enable-take-address=true, indirect-api=false, port-defined-argument-value{value=21, value-type=Dem_EventIdType}, port=Event_FS_MONITIOR_ASC_FLT}
        {enable-take-address=true, indirect-api=false, port-defined-argument-value{value=63, value-type=Dem_EventIdType}, port=EvtInfo_INV_IAC_V_AMP}
        {enable-take-address=true, indirect-api=false, port-defined-argument-value{value=63, value-type=Dem_EventIdType}, port=Event_INV_IAC_V_AMP}
        {enable-take-address=true, indirect-api=false, port-defined-argument-value{value=73, value-type=Dem_EventIdType}, port=EvtInfo_INV_IAC_W_ELEC_LO}
        {enable-take-address=true, indirect-api=false, port-defined-argument-value{value=73, value-type=Dem_EventIdType}, port=Event_INV_IAC_W_ELEC_LO}
        {enable-take-address=true, indirect-api=false, port-defined-argument-value{value=179, value-type=Dem_EventIdType}, port=EvtInfo_VCEvVddmPropFr08Tioutd_001}
        {enable-take-address=true, indirect-api=false, port-defined-argument-value{value=179, value-type=Dem_EventIdType}, port=Event_VCEvVddmPropFr08Tioutd_001}
        {enable-take-address=true, indirect-api=false, port-defined-argument-value{value=154, value-type=Dem_EventIdType}, port=EvtInfo_PS_P12_RES_FLT}
        {enable-take-address=true, indirect-api=false, port-defined-argument-value{value=154, value-type=Dem_EventIdType}, port=Event_PS_P12_RES_FLT}
        {enable-take-address=true, indirect-api=false, port-defined-argument-value{value=125, value-type=Dem_EventIdType}, port=EvtInfo_INV_RSLVR_SIN_RNG_LO}
        {enable-take-address=true, indirect-api=false, port-defined-argument-value{value=125, value-type=Dem_EventIdType}, port=Event_INV_RSLVR_SIN_RNG_LO}
        {enable-take-address=true, indirect-api=false, port-defined-argument-value{value=16, value-type=Dem_EventIdType}, port=EvtInfo_CU_TEMP_HW_FLT}
        {enable-take-address=true, indirect-api=false, port-defined-argument-value{value=16, value-type=Dem_EventIdType}, port=Event_CU_TEMP_HW_FLT}
        {enable-take-address=true, indirect-api=false, port-defined-argument-value{value=167, value-type=Dem_EventIdType}, port=EvtInfo_VCEvEcmPropFr02MgmFr00Tioutd}
        {enable-take-address=true, indirect-api=false, port-defined-argument-value{value=167, value-type=Dem_EventIdType}, port=Event_VCEvEcmPropFr02MgmFr00Tioutd}
        {enable-take-address=true, indirect-api=false, port-defined-argument-value{value=148, value-type=Dem_EventIdType}, port=EvtInfo_PS_KL15_RNG_HI}
        {enable-take-address=true, indirect-api=false, port-defined-argument-value{value=148, value-type=Dem_EventIdType}, port=Event_PS_KL15_RNG_HI}
        {enable-take-address=true, indirect-api=false, port-defined-argument-value{value=181, value-type=Dem_EventIdType}, port=EvtInfo_VCEvVddmPropFr17Tioutd}
        {enable-take-address=true, indirect-api=false, port-defined-argument-value{value=181, value-type=Dem_EventIdType}, port=Event_VCEvVddmPropFr17Tioutd}
        {enable-take-address=true, indirect-api=false, port-defined-argument-value{value=185, value-type=Dem_EventIdType}, port=EvtInfo_VcEvChkSumCrashStsSafe}
        {enable-take-address=true, indirect-api=false, port-defined-argument-value{value=185, value-type=Dem_EventIdType}, port=Event_VcEvChkSumCrashStsSafe}
        {enable-take-address=true, indirect-api=false, port-defined-argument-value{value=18, value-type=Dem_EventIdType}, port=EvtInfo_DiagC_ClutchService}
        {enable-take-address=true, indirect-api=false, port-defined-argument-value{value=18, value-type=Dem_EventIdType}, port=Event_DiagC_ClutchService}
        {enable-take-address=true, indirect-api=false, port-defined-argument-value{value=46, value-type=Dem_EventIdType}, port=EvtInfo_INV_EM_STATOR_TEMP_RNG_HI}
        {enable-take-address=true, indirect-api=false, port-defined-argument-value{value=46, value-type=Dem_EventIdType}, port=Event_INV_EM_STATOR_TEMP_RNG_HI}
        {enable-take-address=true, indirect-api=false, port-defined-argument-value{value=116, value-type=Dem_EventIdType}, port=EvtInfo_INV_RSLVR_OFFS_OUT_RANG}
        {enable-take-address=true, indirect-api=false, port-defined-argument-value{value=116, value-type=Dem_EventIdType}, port=Event_INV_RSLVR_OFFS_OUT_RANG}
        {enable-take-address=true, indirect-api=false, port-defined-argument-value{value=40, value-type=Dem_EventIdType}, port=EvtInfo_INV_EM_STATOR_TEMP2_RNG_LO}
        {enable-take-address=true, indirect-api=false, port-defined-argument-value{value=40, value-type=Dem_EventIdType}, port=Event_INV_EM_STATOR_TEMP2_RNG_LO}
        {enable-take-address=true, indirect-api=false, port-defined-argument-value{value=196, value-type=Dem_EventIdType}, port=EvtInfo_VcEvMonISAR}
        {enable-take-address=true, indirect-api=false, port-defined-argument-value{value=196, value-type=Dem_EventIdType}, port=Event_VcEvMonISAR}
        {enable-take-address=true, indirect-api=false, port-defined-argument-value{value=23, value-type=Dem_EventIdType}, port=EvtInfo_GA_BLDC_FLT}
        {enable-take-address=true, indirect-api=false, port-defined-argument-value{value=23, value-type=Dem_EventIdType}, port=Event_GA_BLDC_FLT}
        {enable-take-address=true, indirect-api=false, port-defined-argument-value{value=105, value-type=Dem_EventIdType}, port=EvtInfo_INV_RSLVR_EXCT_ELEC_OPEN}
        {enable-take-address=true, indirect-api=false, port-defined-argument-value{value=105, value-type=Dem_EventIdType}, port=Event_INV_RSLVR_EXCT_ELEC_OPEN}
        {enable-take-address=true, indirect-api=false, port-defined-argument-value{value=110, value-type=Dem_EventIdType}, port=EvtInfo_INV_RSLVR_EXCT_PLAUS}
        {enable-take-address=true, indirect-api=false, port-defined-argument-value{value=110, value-type=Dem_EventIdType}, port=Event_INV_RSLVR_EXCT_PLAUS}
        {enable-take-address=true, indirect-api=false, port-defined-argument-value{value=155, value-type=Dem_EventIdType}, port=EvtInfo_PS_P15_U_FLT}
        {enable-take-address=true, indirect-api=false, port-defined-argument-value{value=155, value-type=Dem_EventIdType}, port=Event_PS_P15_U_FLT}
        {enable-take-address=true, indirect-api=false, port-defined-argument-value{value=49, value-type=Dem_EventIdType}, port=EvtInfo_INV_EM_STATOR_TEMP_RNG_SWT}
        {enable-take-address=true, indirect-api=false, port-defined-argument-value{value=49, value-type=Dem_EventIdType}, port=Event_INV_EM_STATOR_TEMP_RNG_SWT}
        {enable-take-address=true, indirect-api=false, port-defined-argument-value{value=133, value-type=Dem_EventIdType}, port=EvtInfo_INV_UHVDC_OV_SWP}
        {enable-take-address=true, indirect-api=false, port-defined-argument-value{value=133, value-type=Dem_EventIdType}, port=Event_INV_UHVDC_OV_SWP}
        {enable-take-address=true, indirect-api=false, port-defined-argument-value{value=2, value-type=Dem_EventIdType}, port=EvtInfo_AURIX_HW_FLT}
        {enable-take-address=true, indirect-api=false, port-defined-argument-value{value=2, value-type=Dem_EventIdType}, port=Event_AURIX_HW_FLT}
        {enable-take-address=true, indirect-api=false, port-defined-argument-value{value=51, value-type=Dem_EventIdType}, port=EvtInfo_INV_GATE_DRVR_TOP_HWP}
        {enable-take-address=true, indirect-api=false, port-defined-argument-value{value=51, value-type=Dem_EventIdType}, port=Event_INV_GATE_DRVR_TOP_HWP}
        {enable-take-address=true, indirect-api=false, port-defined-argument-value{value=31, value-type=Dem_EventIdType}, port=EvtInfo_INV_ACTV_DCHA_HW}
        {enable-take-address=true, indirect-api=false, port-defined-argument-value{value=31, value-type=Dem_EventIdType}, port=Event_INV_ACTV_DCHA_HW}
        {enable-take-address=true, indirect-api=false, port-defined-argument-value{value=77, value-type=Dem_EventIdType}, port=EvtInfo_INV_IGBT_TEMP_HWP}
        {enable-take-address=true, indirect-api=false, port-defined-argument-value{value=77, value-type=Dem_EventIdType}, port=Event_INV_IGBT_TEMP_HWP}
        {enable-take-address=true, indirect-api=false, port-defined-argument-value{value=120, value-type=Dem_EventIdType}, port=EvtInfo_INV_RSLVR_SIN_ELEC_FLT}
        {enable-take-address=true, indirect-api=false, port-defined-argument-value{value=120, value-type=Dem_EventIdType}, port=Event_INV_RSLVR_SIN_ELEC_FLT}
        {enable-take-address=true, indirect-api=false, port-defined-argument-value{value=12, value-type=Dem_EventIdType}, port=EvtInfo_CU_TEMP2_RNG_HI}
        {enable-take-address=true, indirect-api=false, port-defined-argument-value{value=12, value-type=Dem_EventIdType}, port=Event_CU_TEMP2_RNG_HI}
        {enable-take-address=true, indirect-api=false, port-defined-argument-value{value=54, value-type=Dem_EventIdType}, port=EvtInfo_INV_IAC_PHA_LOSS_MPL}
        {enable-take-address=true, indirect-api=false, port-defined-argument-value{value=54, value-type=Dem_EventIdType}, port=Event_INV_IAC_PHA_LOSS_MPL}
        {enable-take-address=true, indirect-api=false, port-defined-argument-value{value=56, value-type=Dem_EventIdType}, port=EvtInfo_INV_IAC_U_AMP}
        {enable-take-address=true, indirect-api=false, port-defined-argument-value{value=56, value-type=Dem_EventIdType}, port=Event_INV_IAC_U_AMP}
        {enable-take-address=true, indirect-api=false, port-defined-argument-value{value=161, value-type=Dem_EventIdType}, port=EvtInfo_PSnsr_GRADT_Flt}
        {enable-take-address=true, indirect-api=false, port-defined-argument-value{value=161, value-type=Dem_EventIdType}, port=Event_PSnsr_GRADT_Flt}
        {enable-take-address=true, indirect-api=false, port-defined-argument-value{value=5, value-type=Dem_EventIdType}, port=EvtInfo_AURIX_WATHDOG_FLT}
        {enable-take-address=true, indirect-api=false, port-defined-argument-value{value=5, value-type=Dem_EventIdType}, port=Event_AURIX_WATHDOG_FLT}
        {enable-take-address=true, indirect-api=false, port-defined-argument-value{value=202, value-type=Dem_EventIdType}, port=EvtInfo_VcEvNodeMisBECM}
        {enable-take-address=true, indirect-api=false, port-defined-argument-value{value=202, value-type=Dem_EventIdType}, port=Event_VcEvNodeMisBECM}
        {enable-take-address=true, indirect-api=false, port-defined-argument-value{value=135, value-type=Dem_EventIdType}, port=EvtInfo_INV_UHVDC_UV_HWP}
        {enable-take-address=true, indirect-api=false, port-defined-argument-value{value=135, value-type=Dem_EventIdType}, port=Event_INV_UHVDC_UV_HWP}
        {enable-take-address=true, indirect-api=false, port-defined-argument-value{value=193, value-type=Dem_EventIdType}, port=EvtInfo_VcEvMonESpd}
        {enable-take-address=true, indirect-api=false, port-defined-argument-value{value=193, value-type=Dem_EventIdType}, port=Event_VcEvMonESpd}
        {enable-take-address=true, indirect-api=false, port-defined-argument-value{value=8, value-type=Dem_EventIdType}, port=EvtInfo_COM_NotConfig}
        {enable-take-address=true, indirect-api=false, port-defined-argument-value{value=8, value-type=Dem_EventIdType}, port=Event_COM_NotConfig}
        {enable-take-address=true, indirect-api=false, port-defined-argument-value{value=124, value-type=Dem_EventIdType}, port=EvtInfo_INV_RSLVR_SIN_RNG_HI}
        {enable-take-address=true, indirect-api=false, port-defined-argument-value{value=124, value-type=Dem_EventIdType}, port=Event_INV_RSLVR_SIN_RNG_HI}
        {enable-take-address=true, indirect-api=false, port-defined-argument-value{value=80, value-type=Dem_EventIdType}, port=EvtInfo_INV_IGBT_TEMP_U_RNG_HI}
        {enable-take-address=true, indirect-api=false, port-defined-argument-value{value=80, value-type=Dem_EventIdType}, port=Event_INV_IGBT_TEMP_U_RNG_HI}
        {enable-take-address=true, indirect-api=false, port-defined-argument-value{value=198, value-type=Dem_EventIdType}, port=EvtInfo_VcEvMonMode_001}
        {enable-take-address=true, indirect-api=false, port-defined-argument-value{value=198, value-type=Dem_EventIdType}, port=Event_VcEvMonMode_001}
        {enable-take-address=true, indirect-api=false, port-defined-argument-value{value=137, value-type=Dem_EventIdType}, port=EvtInfo_PA_ACTION_FLT}
        {enable-take-address=true, indirect-api=false, port-defined-argument-value{value=137, value-type=Dem_EventIdType}, port=Event_PA_ACTION_FLT}
        {enable-take-address=true, indirect-api=false, port-defined-argument-value{value=65, value-type=Dem_EventIdType}, port=EvtInfo_INV_IAC_V_ELEC_HWP}
        {enable-take-address=true, indirect-api=false, port-defined-argument-value{value=65, value-type=Dem_EventIdType}, port=Event_INV_IAC_V_ELEC_HWP}
        {enable-take-address=true, indirect-api=false, port-defined-argument-value{value=17, value-type=Dem_EventIdType}, port=EvtInfo_CU_TEMP_HW_FLT_001}
        {enable-take-address=true, indirect-api=false, port-defined-argument-value{value=17, value-type=Dem_EventIdType}, port=Event_CU_TEMP_HW_FLT_001}
        {enable-take-address=true, indirect-api=false, port-defined-argument-value{value=164, value-type=Dem_EventIdType}, port=EvtInfo_VCC_UnderVoltage}
        {enable-take-address=true, indirect-api=false, port-defined-argument-value{value=164, value-type=Dem_EventIdType}, port=Event_VCC_UnderVoltage}
        {enable-take-address=true, indirect-api=false, port-defined-argument-value{value=206, value-type=Dem_EventIdType}, port=EvtInfo_VcEvTsttrPlaus}
        {enable-take-address=true, indirect-api=false, port-defined-argument-value{value=206, value-type=Dem_EventIdType}, port=Event_VcEvTsttrPlaus}
        {enable-take-address=true, indirect-api=false, port-defined-argument-value{value=102, value-type=Dem_EventIdType}, port=EvtInfo_INV_RSLVR_EXCT_ELEC_FLT}
        {enable-take-address=true, indirect-api=false, port-defined-argument-value{value=102, value-type=Dem_EventIdType}, port=Event_INV_RSLVR_EXCT_ELEC_FLT}
        {enable-take-address=true, indirect-api=false, port-defined-argument-value{value=112, value-type=Dem_EventIdType}, port=EvtInfo_INV_RSLVR_EXCT_RNG_LO}
        {enable-take-address=true, indirect-api=false, port-defined-argument-value{value=112, value-type=Dem_EventIdType}, port=Event_INV_RSLVR_EXCT_RNG_LO}
        {enable-take-address=true, indirect-api=false, port-defined-argument-value{value=39, value-type=Dem_EventIdType}, port=EvtInfo_INV_EM_STATOR_TEMP2_RNG_HI}
        {enable-take-address=true, indirect-api=false, port-defined-argument-value{value=39, value-type=Dem_EventIdType}, port=Event_INV_EM_STATOR_TEMP2_RNG_HI}
        {enable-take-address=true, indirect-api=false, port-defined-argument-value{value=127, value-type=Dem_EventIdType}, port=EvtInfo_INV_SHUT_OFF_PAH_START_UP}
        {enable-take-address=true, indirect-api=false, port-defined-argument-value{value=127, value-type=Dem_EventIdType}, port=Event_INV_SHUT_OFF_PAH_START_UP}
        {enable-take-address=true, indirect-api=false, port-defined-argument-value{value=178, value-type=Dem_EventIdType}, port=EvtInfo_VCEvVddmPropFr08Tioutd}
        {enable-take-address=true, indirect-api=false, port-defined-argument-value{value=178, value-type=Dem_EventIdType}, port=Event_VCEvVddmPropFr08Tioutd}
        {enable-take-address=true, indirect-api=false, port-defined-argument-value{value=108, value-type=Dem_EventIdType}, port=EvtInfo_INV_RSLVR_EXCT_OC_HWP_001}
        {enable-take-address=true, indirect-api=false, port-defined-argument-value{value=108, value-type=Dem_EventIdType}, port=Event_INV_RSLVR_EXCT_OC_HWP_001}
        {enable-take-address=true, indirect-api=false, port-defined-argument-value{value=109, value-type=Dem_EventIdType}, port=EvtInfo_INV_RSLVR_EXCT_OC_HWP_002}
        {enable-take-address=true, indirect-api=false, port-defined-argument-value{value=109, value-type=Dem_EventIdType}, port=Event_INV_RSLVR_EXCT_OC_HWP_002}
        {enable-take-address=true, indirect-api=false, port-defined-argument-value{value=43, value-type=Dem_EventIdType}, port=EvtInfo_INV_EM_STATOR_TEMP_ELE_FLT}
        {enable-take-address=true, indirect-api=false, port-defined-argument-value{value=43, value-type=Dem_EventIdType}, port=Event_INV_EM_STATOR_TEMP_ELE_FLT}
        {enable-take-address=true, indirect-api=false, port-defined-argument-value{value=92, value-type=Dem_EventIdType}, port=EvtInfo_INV_INTERLOCK_FLT}
        {enable-take-address=true, indirect-api=false, port-defined-argument-value{value=92, value-type=Dem_EventIdType}, port=Event_INV_INTERLOCK_FLT}
        {enable-take-address=true, indirect-api=false, port-defined-argument-value{value=30, value-type=Dem_EventIdType}, port=EvtInfo_Ga_ZeroFindDistanFailure}
        {enable-take-address=true, indirect-api=false, port-defined-argument-value{value=30, value-type=Dem_EventIdType}, port=Event_Ga_ZeroFindDistanFailure}
        {enable-take-address=true, indirect-api=false, port-defined-argument-value{value=141, value-type=Dem_EventIdType}, port=EvtInfo_PLOCK_Current_RNG_OUT}
        {enable-take-address=true, indirect-api=false, port-defined-argument-value{value=141, value-type=Dem_EventIdType}, port=Event_PLOCK_Current_RNG_OUT}
        {enable-take-address=true, indirect-api=false, port-defined-argument-value{value=177, value-type=Dem_EventIdType}, port=EvtInfo_VCEvVddmPropFr05Tioutd}
        {enable-take-address=true, indirect-api=false, port-defined-argument-value{value=177, value-type=Dem_EventIdType}, port=Event_VCEvVddmPropFr05Tioutd}
        {enable-take-address=true, indirect-api=false, port-defined-argument-value{value=82, value-type=Dem_EventIdType}, port=EvtInfo_INV_IGBT_TEMP_V_GRDT}
        {enable-take-address=true, indirect-api=false, port-defined-argument-value{value=82, value-type=Dem_EventIdType}, port=Event_INV_IGBT_TEMP_V_GRDT}
        {enable-take-address=true, indirect-api=false, port-defined-argument-value{value=142, value-type=Dem_EventIdType}, port=EvtInfo_PS_5V_Fault}
        {enable-take-address=true, indirect-api=false, port-defined-argument-value{value=142, value-type=Dem_EventIdType}, port=Event_PS_5V_Fault}
        {enable-take-address=true, indirect-api=false, port-defined-argument-value{value=189, value-type=Dem_EventIdType}, port=EvtInfo_VcEvCntrCrashStsSafe}
        {enable-take-address=true, indirect-api=false, port-defined-argument-value{value=189, value-type=Dem_EventIdType}, port=Event_VcEvCntrCrashStsSafe}
        {enable-take-address=true, indirect-api=false, port-defined-argument-value{value=44, value-type=Dem_EventIdType}, port=EvtInfo_INV_EM_STATOR_TEMP_GRDT}
        {enable-take-address=true, indirect-api=false, port-defined-argument-value{value=44, value-type=Dem_EventIdType}, port=Event_INV_EM_STATOR_TEMP_GRDT}
        {enable-take-address=true, indirect-api=false, port-defined-argument-value{value=156, value-type=Dem_EventIdType}, port=EvtInfo_PS_P15_V_FLT}
        {enable-take-address=true, indirect-api=false, port-defined-argument-value{value=156, value-type=Dem_EventIdType}, port=Event_PS_P15_V_FLT}
        {enable-take-address=true, indirect-api=false, port-defined-argument-value{value=48, value-type=Dem_EventIdType}, port=EvtInfo_INV_EM_STATOR_TEMP_RNG_NOK}
        {enable-take-address=true, indirect-api=false, port-defined-argument-value{value=48, value-type=Dem_EventIdType}, port=Event_INV_EM_STATOR_TEMP_RNG_NOK}
        {enable-take-address=true, indirect-api=false, port-defined-argument-value{value=126, value-type=Dem_EventIdType}, port=EvtInfo_INV_RSLVR_SIN_RNG_NOK}
        {enable-take-address=true, indirect-api=false, port-defined-argument-value{value=126, value-type=Dem_EventIdType}, port=Event_INV_RSLVR_SIN_RNG_NOK}
        {enable-take-address=true, indirect-api=false, port-defined-argument-value{value=60, value-type=Dem_EventIdType}, port=EvtInfo_INV_IAC_U_OFFS}
        {enable-take-address=true, indirect-api=false, port-defined-argument-value{value=60, value-type=Dem_EventIdType}, port=Event_INV_IAC_U_OFFS}
        {enable-take-address=true, indirect-api=false, port-defined-argument-value{value=149, value-type=Dem_EventIdType}, port=EvtInfo_PS_KL30_BACKUP_FLT}
        {enable-take-address=true, indirect-api=false, port-defined-argument-value{value=149, value-type=Dem_EventIdType}, port=Event_PS_KL30_BACKUP_FLT}
        {enable-take-address=true, indirect-api=false, port-defined-argument-value{value=81, value-type=Dem_EventIdType}, port=EvtInfo_INV_IGBT_TEMP_U_RNG_LO}
        {enable-take-address=true, indirect-api=false, port-defined-argument-value{value=81, value-type=Dem_EventIdType}, port=Event_INV_IGBT_TEMP_U_RNG_LO}
        {enable-take-address=true, indirect-api=false, port-defined-argument-value{value=45, value-type=Dem_EventIdType}, port=EvtInfo_INV_EM_STATOR_TEMP_HWP}
        {enable-take-address=true, indirect-api=false, port-defined-argument-value{value=45, value-type=Dem_EventIdType}, port=Event_INV_EM_STATOR_TEMP_HWP}
        {enable-take-address=true, indirect-api=false, port-defined-argument-value{value=10, value-type=Dem_EventIdType}, port=EvtInfo_CU_TEMP1_RNG_HI}
        {enable-take-address=true, indirect-api=false, port-defined-argument-value{value=10, value-type=Dem_EventIdType}, port=Event_CU_TEMP1_RNG_HI}
        {enable-take-address=true, indirect-api=false, port-defined-argument-value{value=84, value-type=Dem_EventIdType}, port=EvtInfo_INV_IGBT_TEMP_V_RNG_HI}
        {enable-take-address=true, indirect-api=false, port-defined-argument-value{value=84, value-type=Dem_EventIdType}, port=Event_INV_IGBT_TEMP_V_RNG_HI}
        {enable-take-address=true, indirect-api=false, port-defined-argument-value{value=204, value-type=Dem_EventIdType}, port=EvtInfo_VcEvNodeMisVDDM}
        {enable-take-address=true, indirect-api=false, port-defined-argument-value{value=204, value-type=Dem_EventIdType}, port=Event_VcEvNodeMisVDDM}
        {enable-take-address=true, indirect-api=false, port-defined-argument-value{value=134, value-type=Dem_EventIdType}, port=EvtInfo_INV_UHVDC_PLAUS}
        {enable-take-address=true, indirect-api=false, port-defined-argument-value{value=134, value-type=Dem_EventIdType}, port=Event_INV_UHVDC_PLAUS}
        {enable-take-address=true, indirect-api=false, port-defined-argument-value{value=93, value-type=Dem_EventIdType}, port=EvtInfo_INV_QUIESCENT_FLT}
        {enable-take-address=true, indirect-api=false, port-defined-argument-value{value=93, value-type=Dem_EventIdType}, port=Event_INV_QUIESCENT_FLT}
        {enable-take-address=true, indirect-api=false, port-defined-argument-value{value=111, value-type=Dem_EventIdType}, port=EvtInfo_INV_RSLVR_EXCT_RNG_HI}
        {enable-take-address=true, indirect-api=false, port-defined-argument-value{value=111, value-type=Dem_EventIdType}, port=Event_INV_RSLVR_EXCT_RNG_HI}
        enable-take-address=true, indirect-api=false, port=DemSatellite_0/CBReadData_DTCStatusindicator30_DTCStatusindicator30
        enable-take-address=true, indirect-api=false, port=DemSatellite_0/CBReadData_DID_0xe310_DID_E310_IEMMGM_Derating_Status
        enable-take-address=true, indirect-api=false, port=DemSatellite_0/CBReadData_DID_0xe301_DID_E301_HVDC_Current_
        enable-take-address=true, indirect-api=false, port=DemSatellite_0/CBReadData_DID_0xe305_DID_E305_Inverter_IGBT_Junction_Temp
        enable-take-address=true, indirect-api=false, port=DemSatellite_0/CBReadData_DID_0xe339_DID_E339_d_axis_voltage
        enable-take-address=true, indirect-api=false, port=DemSatellite_0/CBReadData_DID_0xe307_DID_E307_System_Mode
        enable-take-address=true, indirect-api=false, port=DemSatellite_0/CBReadData_DID_0xe357_DID_E357_Resolve_compensated_angle
        enable-take-address=true, indirect-api=false, port=DemSatellite_0/CBReadData_DID_0xe308_DID_E308_ECM_Torque_Request
        enable-take-address=true, indirect-api=false, port=DemSatellite_0/CBReadData_DID_0xe335_DID_E335_d_axis_current_setpoint
        enable-take-address=true, indirect-api=false, port=DemSatellite_0/CBReadData_DID_0xe319_DID_E319_Torque_Direction
        enable-take-address=true, indirect-api=false, port=DemSatellite_0/CBReadData_DID_0xe309_DID_E309_ECM_Mode_Request
        enable-take-address=true, indirect-api=false, port=DemSatellite_0/CBReadData_DID_0xdd0a_DID_DD0A_Usage_Mode
        enable-take-address=true, indirect-api=false, port=DemSatellite_0/CBReadData_DID_0xeec3_DID_EEC3_ECU_power_supply_Voltage
        enable-take-address=true, indirect-api=false, port=DemSatellite_0/CBReadData_DID_0xdd00_DID_DD00_Global_Real_Time
        enable-take-address=true, indirect-api=false, port=DemSatellite_0/CBReadData_DID_0xee9e_DID_EE9E_Transient_Phase_Current_C
        enable-take-address=true, indirect-api=false, port=DemSatellite_0/CBReadData_DID_0xe333_2002_Hu
        enable-take-address=true, indirect-api=false, port=DemSatellite_0/CBReadData_DID_0xe333_2002_Hw
        enable-take-address=true, indirect-api=false, port=DemSatellite_0/CBReadData_DID_0xe333_2002_Hv
        enable-take-address=true, indirect-api=false, port=DemSatellite_0/CBReadData_DID_0xe314_DID_E314_Available_Torque_maximum
        enable-take-address=true, indirect-api=false, port=DemSatellite_0/CBReadData_DID_0xeed4_DID_EED4_Safty_Function_Mode
        enable-take-address=true, indirect-api=false, port=DemSatellite_0/CBReadData_DID_0xd003_DID_D003_Vehicle_Speed
        enable-take-address=true, indirect-api=false, port=DemSatellite_0/CBReadData_DID_0xe303_DID_E303_Motor_Speed_
        enable-take-address=true, indirect-api=false, port=DemSatellite_0/CBReadData_DID_0xe353_DID_E353_Flux_weakening_correction_factor
        enable-take-address=true, indirect-api=false, port=DemSatellite_0/CBReadData_DID_0xe306_DID_E306_Motor_Temperature
        enable-take-address=true, indirect-api=false, port=DemSatellite_0/CBReadData_DID_0xe363_DID_E363_Modulation_index
        enable-take-address=true, indirect-api=false, port=DemSatellite_0/CBReadData_DID_0xe349_DID_E349_Phase_V_PWM_duty
        enable-take-address=true, indirect-api=false, port=DemSatellite_0/CBReadData_DID_0xdd02_DID_DD02_Vehicle_Battery_Voltage
        enable-take-address=true, indirect-api=false, port=DemSatellite_0/CBReadData_DTCTimeStamp21_DTCTimeStamp21
        enable-take-address=true, indirect-api=false, port=DemSatellite_0/CBReadData_DID_0xe347_DID_E347_IGBT_Max_Temperature
        enable-take-address=true, indirect-api=false, port=DemSatellite_0/CBReadData_DID_0xeeb5_DID_EEB5_IEMMGM_current_torque
        enable-take-address=true, indirect-api=false, port=DemSatellite_0/CBReadData_DID_0xeebe_DID_EEBE_Offset_angle_status
        enable-take-address=true, indirect-api=false, port=DemSatellite_0/CBReadData_DID_0xe338_DID_E338_q_axis_current_feedback
        enable-take-address=true, indirect-api=false, port=DemSatellite_0/CBReadData_DID_0xee9d_DID_EE9D_Transient_Phase_Current_B
        enable-take-address=true, indirect-api=false, port=DemSatellite_0/CBReadData_DID_0xe336_DID_E336_d_axis_current_feedback
        enable-take-address=true, indirect-api=false, port=DemSatellite_0/CBReadData_DID_0xe348_DID_E348_Phase_U_PWM_duty
        enable-take-address=true, indirect-api=false, port=DemSatellite_0/CBReadData_DID_0xe350_DID_E350_Phase_W_PWM_duty
        enable-take-address=true, indirect-api=false, port=DemSatellite_0/CBReadData_DTCTimeStamp20_DTCTimeStamp20
        enable-take-address=true, indirect-api=false, port=DemSatellite_0/CBReadData_DID_0xe333_2002_H_Ser
        enable-take-address=true, indirect-api=false, port=DemSatellite_0/CBReadData_DID_0xeec4_DID_EEC4_Charging_Power_Sustain_RelayCPSR_Voltage
        enable-take-address=true, indirect-api=false, port=DemSatellite_0/CBReadData_DID_0xe346_DID_E346_ECM_Torque_Allowed_Status
        enable-take-address=true, indirect-api=false, port=DemSatellite_0/CBReadData_DID_0xe313_DID_E313_Active_discharge_status
        enable-take-address=true, indirect-api=false, port=DemSatellite_0/CBReadData_DID_0xe311_DID_E311_Crash_Status
        enable-take-address=true, indirect-api=false, port=DemSatellite_0/CBReadData_DID_0xe300_DID_E300_HVDC_Voltage
        enable-take-address=true, indirect-api=false, port=DemSatellite_0/CBReadData_DID_0xe324_DID_E324_Motor_Derating_reason_of_IEMMGM
        enable-take-address=true, indirect-api=false, port=DemSatellite_0/CBReadData_DID_0xee9f_DID_EE9F_Gate_Status
        enable-take-address=true, indirect-api=false, port=DemSatellite_0/CBReadData_DID_0xe304_DID_E304_Actual_Torque
        enable-take-address=true, indirect-api=false, port=DemSatellite_0/CBReadData_DID_0xe315_DID_E315_Available_Torque_minimum
        enable-take-address=true, indirect-api=false, port=DemSatellite_0/CBReadData_DID_0xeeb8_DID_EEB8_HV_voltage_received_from_BECM
        enable-take-address=true, indirect-api=false, port=DemSatellite_0/CBReadData_DID_0xeed5_EED5_Safety_Torque_Quality_factor
        enable-take-address=true, indirect-api=false, port=DemSatellite_0/CBReadData_DID_0xe320_DID_E320_System_Mode_Mismatch
        enable-take-address=true, indirect-api=false, port=DemSatellite_0/CBReadData_DID_0xeeb7_DID_EEB7_ECM_Power_Limitation_minimum
        enable-take-address=true, indirect-api=false, port=DemSatellite_0/CBReadData_DID_0xe364_DID_E364_AURIX_Fault_Indication
        enable-take-address=true, indirect-api=false, port=DemSatellite_0/CBReadData_DID_0xeed1_EED1_1
        enable-take-address=true, indirect-api=false, port=DemSatellite_0/CBReadData_DID_0xeed1_EED1_0
        enable-take-address=true, indirect-api=false, port=DemSatellite_0/CBReadData_DID_0xeed1_EED1_3
        enable-take-address=true, indirect-api=false, port=DemSatellite_0/CBReadData_DID_0xeed1_EED1_2
        enable-take-address=true, indirect-api=false, port=DemSatellite_0/CBReadData_DID_0xe312_DID_E312_Wheel_Speed
        enable-take-address=true, indirect-api=false, port=DemSatellite_0/CBReadData_DID_0xe341_DID_E341_q_axis_voltage
        enable-take-address=true, indirect-api=false, port=DemSatellite_0/CBReadData_DID_0xeed3_DID_EED3_Safety_speed
        enable-take-address=true, indirect-api=false, port=DemSatellite_0/CBReadData_DID_0xee9c_DID_EE9C_Transient_Phase_Current_A
        enable-take-address=true, indirect-api=false, port=DemSatellite_0/CBReadData_DID_0xeed2_DID_EED2_SaftyTorque
        enable-take-address=true, indirect-api=false, port=DemSatellite_0/CBReadData_DID_0xdd01_DID_DD01_Total_Distance
        enable-take-address=true, indirect-api=false, port=DemSatellite_0/CBReadData_DID_0xeebf_DID_EEBF_HV_Main_Relay_Status
        enable-take-address=true, indirect-api=false, port=DemSatellite_0/CBReadData_DID_0xe333_2002_L_Ser
        enable-take-address=true, indirect-api=false, port=DemSatellite_0/CBReadData_DID_0xeeb2_DID_EEB2_Three_Phase_Motor_Current_RMS_Current
        enable-take-address=true, indirect-api=false, port=DemSatellite_0/CBReadData_DID_0xe333_2002_Lw
        enable-take-address=true, indirect-api=false, port=DemSatellite_0/CBReadData_DID_0xe333_2002_Lv
        enable-take-address=true, indirect-api=false, port=DemSatellite_0/CBReadData_DID_0xee9a_DID_EE9A_Inverter_Coolant_Temperature
        enable-take-address=true, indirect-api=false, port=DemSatellite_0/CBReadData_DID_0xdd0c_DID_DD0C_Electric_Power_Level
        enable-take-address=true, indirect-api=false, port=DemSatellite_0/CBReadData_DID_0xe337_DID_E337_q_axis_current_setpoint
        enable-take-address=true, indirect-api=false, port=DemSatellite_0/CBReadData_DID_0xeeb6_DID_EEB6_ECM_Power_Limitation_maximum
        enable-take-address=true, indirect-api=false, port=DemSatellite_0/CBReadData_DID_0xe358_DID_E358_Resolve_angle
        enable-take-address=true, indirect-api=false, port=DemSatellite_0/CBReadData_DID_0xe333_2002_Lu
      15 x runnable:
        Dem_SatelliteMainFunction
          73 x sync call, all with timeout=0:
            OpServerCallDem_SatelliteMainFunction_ReadData_CBReadData_DTCStatusindicator30_DTCStatusindicator30: operation=CBReadData_DTCStatusindicator30_DTCStatusindicator30.ReadData
            OpServerCallDem_SatelliteMainFunction_ReadData_CBReadData_DID_0xe310_DID_E310_IEMMGM_Derating_Status: operation=CBReadData_DID_0xe310_DID_E310_IEMMGM_Derating_Status.ReadData
            OpServerCallDem_SatelliteMainFunction_ReadData_CBReadData_DID_0xe301_DID_E301_HVDC_Current_: operation=CBReadData_DID_0xe301_DID_E301_HVDC_Current_.ReadData
            OpServerCallDem_SatelliteMainFunction_ReadData_CBReadData_DID_0xe305_DID_E305_Inverter_IGBT_Junction_Temp: operation=CBReadData_DID_0xe305_DID_E305_Inverter_IGBT_Junction_Temp.ReadData
            OpServerCallDem_SatelliteMainFunction_ReadData_CBReadData_DID_0xe339_DID_E339_d_axis_voltage: operation=CBReadData_DID_0xe339_DID_E339_d_axis_voltage.ReadData
            OpServerCallDem_SatelliteMainFunction_ReadData_CBReadData_DID_0xe307_DID_E307_System_Mode: operation=CBReadData_DID_0xe307_DID_E307_System_Mode.ReadData
            OpServerCallDem_SatelliteMainFunction_ReadData_CBReadData_DID_0xe357_DID_E357_Resolve_compensated_angle: operation=CBReadData_DID_0xe357_DID_E357_Resolve_compensated_angle.ReadData
            OpServerCallDem_SatelliteMainFunction_ReadData_CBReadData_DID_0xe308_DID_E308_ECM_Torque_Request: operation=CBReadData_DID_0xe308_DID_E308_ECM_Torque_Request.ReadData
            OpServerCallDem_SatelliteMainFunction_ReadData_CBReadData_DID_0xe335_DID_E335_d_axis_current_setpoint: operation=CBReadData_DID_0xe335_DID_E335_d_axis_current_setpoint.ReadData
            OpServerCallDem_SatelliteMainFunction_ReadData_CBReadData_DID_0xe319_DID_E319_Torque_Direction: operation=CBReadData_DID_0xe319_DID_E319_Torque_Direction.ReadData
            OpServerCallDem_SatelliteMainFunction_ReadData_CBReadData_DID_0xe309_DID_E309_ECM_Mode_Request: operation=CBReadData_DID_0xe309_DID_E309_ECM_Mode_Request.ReadData
            OpServerCallDem_SatelliteMainFunction_ReadData_CBReadData_DID_0xdd0a_DID_DD0A_Usage_Mode: operation=CBReadData_DID_0xdd0a_DID_DD0A_Usage_Mode.ReadData
            OpServerCallDem_SatelliteMainFunction_ReadData_CBReadData_DID_0xeec3_DID_EEC3_ECU_power_supply_Voltage: operation=CBReadData_DID_0xeec3_DID_EEC3_ECU_power_supply_Voltage.ReadData
            OpServerCallDem_SatelliteMainFunction_ReadData_CBReadData_DID_0xdd00_DID_DD00_Global_Real_Time: operation=CBReadData_DID_0xdd00_DID_DD00_Global_Real_Time.ReadData
            OpServerCallDem_SatelliteMainFunction_ReadData_CBReadData_DID_0xee9e_DID_EE9E_Transient_Phase_Current_C: operation=CBReadData_DID_0xee9e_DID_EE9E_Transient_Phase_Current_C.ReadData
            OpServerCallDem_SatelliteMainFunction_ReadData_CBReadData_DID_0xe333_2002_Hu: operation=CBReadData_DID_0xe333_2002_Hu.ReadData
            OpServerCallDem_SatelliteMainFunction_ReadData_CBReadData_DID_0xe333_2002_Hw: operation=CBReadData_DID_0xe333_2002_Hw.ReadData
            OpServerCallDem_SatelliteMainFunction_ReadData_CBReadData_DID_0xe333_2002_Hv: operation=CBReadData_DID_0xe333_2002_Hv.ReadData
            OpServerCallDem_SatelliteMainFunction_ReadData_CBReadData_DID_0xe314_DID_E314_Available_Torque_maximum: operation=CBReadData_DID_0xe314_DID_E314_Available_Torque_maximum.ReadData
            OpServerCallDem_SatelliteMainFunction_ReadData_CBReadData_DID_0xeed4_DID_EED4_Safty_Function_Mode: operation=CBReadData_DID_0xeed4_DID_EED4_Safty_Function_Mode.ReadData
            OpServerCallDem_SatelliteMainFunction_ReadData_CBReadData_DID_0xd003_DID_D003_Vehicle_Speed: operation=CBReadData_DID_0xd003_DID_D003_Vehicle_Speed.ReadData
            OpServerCallDem_SatelliteMainFunction_ReadData_CBReadData_DID_0xe303_DID_E303_Motor_Speed_: operation=CBReadData_DID_0xe303_DID_E303_Motor_Speed_.ReadData
            OpServerCallDem_SatelliteMainFunction_ReadData_CBReadData_DID_0xe353_DID_E353_Flux_weakening_correction_factor: operation=CBReadData_DID_0xe353_DID_E353_Flux_weakening_correction_factor.ReadData
            OpServerCallDem_SatelliteMainFunction_ReadData_CBReadData_DID_0xe306_DID_E306_Motor_Temperature: operation=CBReadData_DID_0xe306_DID_E306_Motor_Temperature.ReadData
            OpServerCallDem_SatelliteMainFunction_ReadData_CBReadData_DID_0xe363_DID_E363_Modulation_index: operation=CBReadData_DID_0xe363_DID_E363_Modulation_index.ReadData
            OpServerCallDem_SatelliteMainFunction_ReadData_CBReadData_DID_0xe349_DID_E349_Phase_V_PWM_duty: operation=CBReadData_DID_0xe349_DID_E349_Phase_V_PWM_duty.ReadData
            OpServerCallDem_SatelliteMainFunction_ReadData_CBReadData_DID_0xdd02_DID_DD02_Vehicle_Battery_Voltage: operation=CBReadData_DID_0xdd02_DID_DD02_Vehicle_Battery_Voltage.ReadData
            OpServerCallDem_SatelliteMainFunction_ReadData_CBReadData_DTCTimeStamp21_DTCTimeStamp21: operation=CBReadData_DTCTimeStamp21_DTCTimeStamp21.ReadData
            OpServerCallDem_SatelliteMainFunction_ReadData_CBReadData_DID_0xe347_DID_E347_IGBT_Max_Temperature: operation=CBReadData_DID_0xe347_DID_E347_IGBT_Max_Temperature.ReadData
            OpServerCallDem_SatelliteMainFunction_ReadData_CBReadData_DID_0xeeb5_DID_EEB5_IEMMGM_current_torque: operation=CBReadData_DID_0xeeb5_DID_EEB5_IEMMGM_current_torque.ReadData
            OpServerCallDem_SatelliteMainFunction_ReadData_CBReadData_DID_0xeebe_DID_EEBE_Offset_angle_status: operation=CBReadData_DID_0xeebe_DID_EEBE_Offset_angle_status.ReadData
            OpServerCallDem_SatelliteMainFunction_ReadData_CBReadData_DID_0xe338_DID_E338_q_axis_current_feedback: operation=CBReadData_DID_0xe338_DID_E338_q_axis_current_feedback.ReadData
            OpServerCallDem_SatelliteMainFunction_ReadData_CBReadData_DID_0xee9d_DID_EE9D_Transient_Phase_Current_B: operation=CBReadData_DID_0xee9d_DID_EE9D_Transient_Phase_Current_B.ReadData
            OpServerCallDem_SatelliteMainFunction_ReadData_CBReadData_DID_0xe336_DID_E336_d_axis_current_feedback: operation=CBReadData_DID_0xe336_DID_E336_d_axis_current_feedback.ReadData
            OpServerCallDem_SatelliteMainFunction_ReadData_CBReadData_DID_0xe348_DID_E348_Phase_U_PWM_duty: operation=CBReadData_DID_0xe348_DID_E348_Phase_U_PWM_duty.ReadData
            OpServerCallDem_SatelliteMainFunction_ReadData_CBReadData_DID_0xe350_DID_E350_Phase_W_PWM_duty: operation=CBReadData_DID_0xe350_DID_E350_Phase_W_PWM_duty.ReadData
            OpServerCallDem_SatelliteMainFunction_ReadData_CBReadData_DTCTimeStamp20_DTCTimeStamp20: operation=CBReadData_DTCTimeStamp20_DTCTimeStamp20.ReadData
            OpServerCallDem_SatelliteMainFunction_ReadData_CBReadData_DID_0xe333_2002_H_Ser: operation=CBReadData_DID_0xe333_2002_H_Ser.ReadData
            OpServerCallDem_SatelliteMainFunction_ReadData_CBReadData_DID_0xeec4_DID_EEC4_Charging_Power_Sustain_RelayCPSR_Voltage: operation=CBReadData_DID_0xeec4_DID_EEC4_Charging_Power_Sustain_RelayCPSR_Voltage.ReadData
            OpServerCallDem_SatelliteMainFunction_ReadData_CBReadData_DID_0xe346_DID_E346_ECM_Torque_Allowed_Status: operation=CBReadData_DID_0xe346_DID_E346_ECM_Torque_Allowed_Status.ReadData
            OpServerCallDem_SatelliteMainFunction_ReadData_CBReadData_DID_0xe313_DID_E313_Active_discharge_status: operation=CBReadData_DID_0xe313_DID_E313_Active_discharge_status.ReadData
            OpServerCallDem_SatelliteMainFunction_ReadData_CBReadData_DID_0xe311_DID_E311_Crash_Status: operation=CBReadData_DID_0xe311_DID_E311_Crash_Status.ReadData
            OpServerCallDem_SatelliteMainFunction_ReadData_CBReadData_DID_0xe300_DID_E300_HVDC_Voltage: operation=CBReadData_DID_0xe300_DID_E300_HVDC_Voltage.ReadData
            OpServerCallDem_SatelliteMainFunction_ReadData_CBReadData_DID_0xe324_DID_E324_Motor_Derating_reason_of_IEMMGM: operation=CBReadData_DID_0xe324_DID_E324_Motor_Derating_reason_of_IEMMGM.ReadData
            OpServerCallDem_SatelliteMainFunction_ReadData_CBReadData_DID_0xee9f_DID_EE9F_Gate_Status: operation=CBReadData_DID_0xee9f_DID_EE9F_Gate_Status.ReadData
            OpServerCallDem_SatelliteMainFunction_ReadData_CBReadData_DID_0xe304_DID_E304_Actual_Torque: operation=CBReadData_DID_0xe304_DID_E304_Actual_Torque.ReadData
            OpServerCallDem_SatelliteMainFunction_ReadData_CBReadData_DID_0xe315_DID_E315_Available_Torque_minimum: operation=CBReadData_DID_0xe315_DID_E315_Available_Torque_minimum.ReadData
            OpServerCallDem_SatelliteMainFunction_ReadData_CBReadData_DID_0xeeb8_DID_EEB8_HV_voltage_received_from_BECM: operation=CBReadData_DID_0xeeb8_DID_EEB8_HV_voltage_received_from_BECM.ReadData
            OpServerCallDem_SatelliteMainFunction_ReadData_CBReadData_DID_0xeed5_EED5_Safety_Torque_Quality_factor: operation=CBReadData_DID_0xeed5_EED5_Safety_Torque_Quality_factor.ReadData
            OpServerCallDem_SatelliteMainFunction_ReadData_CBReadData_DID_0xe320_DID_E320_System_Mode_Mismatch: operation=CBReadData_DID_0xe320_DID_E320_System_Mode_Mismatch.ReadData
            OpServerCallDem_SatelliteMainFunction_ReadData_CBReadData_DID_0xeeb7_DID_EEB7_ECM_Power_Limitation_minimum: operation=CBReadData_DID_0xeeb7_DID_EEB7_ECM_Power_Limitation_minimum.ReadData
            OpServerCallDem_SatelliteMainFunction_ReadData_CBReadData_DID_0xe364_DID_E364_AURIX_Fault_Indication: operation=CBReadData_DID_0xe364_DID_E364_AURIX_Fault_Indication.ReadData
            OpServerCallDem_SatelliteMainFunction_ReadData_CBReadData_DID_0xeed1_EED1_1: operation=CBReadData_DID_0xeed1_EED1_1.ReadData
            OpServerCallDem_SatelliteMainFunction_ReadData_CBReadData_DID_0xeed1_EED1_0: operation=CBReadData_DID_0xeed1_EED1_0.ReadData
            OpServerCallDem_SatelliteMainFunction_ReadData_CBReadData_DID_0xeed1_EED1_3: operation=CBReadData_DID_0xeed1_EED1_3.ReadData
            OpServerCallDem_SatelliteMainFunction_ReadData_CBReadData_DID_0xeed1_EED1_2: operation=CBReadData_DID_0xeed1_EED1_2.ReadData
            OpServerCallDem_SatelliteMainFunction_ReadData_CBReadData_DID_0xe312_DID_E312_Wheel_Speed: operation=CBReadData_DID_0xe312_DID_E312_Wheel_Speed.ReadData
            OpServerCallDem_SatelliteMainFunction_ReadData_CBReadData_DID_0xe341_DID_E341_q_axis_voltage: operation=CBReadData_DID_0xe341_DID_E341_q_axis_voltage.ReadData
            OpServerCallDem_SatelliteMainFunction_ReadData_CBReadData_DID_0xeed3_DID_EED3_Safety_speed: operation=CBReadData_DID_0xeed3_DID_EED3_Safety_speed.ReadData
            OpServerCallDem_SatelliteMainFunction_ReadData_CBReadData_DID_0xee9c_DID_EE9C_Transient_Phase_Current_A: operation=CBReadData_DID_0xee9c_DID_EE9C_Transient_Phase_Current_A.ReadData
            OpServerCallDem_SatelliteMainFunction_ReadData_CBReadData_DID_0xeed2_DID_EED2_SaftyTorque: operation=CBReadData_DID_0xeed2_DID_EED2_SaftyTorque.ReadData
            OpServerCallDem_SatelliteMainFunction_ReadData_CBReadData_DID_0xdd01_DID_DD01_Total_Distance: operation=CBReadData_DID_0xdd01_DID_DD01_Total_Distance.ReadData
            OpServerCallDem_SatelliteMainFunction_ReadData_CBReadData_DID_0xeebf_DID_EEBF_HV_Main_Relay_Status: operation=CBReadData_DID_0xeebf_DID_EEBF_HV_Main_Relay_Status.ReadData
            OpServerCallDem_SatelliteMainFunction_ReadData_CBReadData_DID_0xe333_2002_L_Ser: operation=CBReadData_DID_0xe333_2002_L_Ser.ReadData
            OpServerCallDem_SatelliteMainFunction_ReadData_CBReadData_DID_0xeeb2_DID_EEB2_Three_Phase_Motor_Current_RMS_Current: operation=CBReadData_DID_0xeeb2_DID_EEB2_Three_Phase_Motor_Current_RMS_Current.ReadData
            OpServerCallDem_SatelliteMainFunction_ReadData_CBReadData_DID_0xe333_2002_Lw: operation=CBReadData_DID_0xe333_2002_Lw.ReadData
            OpServerCallDem_SatelliteMainFunction_ReadData_CBReadData_DID_0xe333_2002_Lv: operation=CBReadData_DID_0xe333_2002_Lv.ReadData
            OpServerCallDem_SatelliteMainFunction_ReadData_CBReadData_DID_0xee9a_DID_EE9A_Inverter_Coolant_Temperature: operation=CBReadData_DID_0xee9a_DID_EE9A_Inverter_Coolant_Temperature.ReadData
            OpServerCallDem_SatelliteMainFunction_ReadData_CBReadData_DID_0xdd0c_DID_DD0C_Electric_Power_Level: operation=CBReadData_DID_0xdd0c_DID_DD0C_Electric_Power_Level.ReadData
            OpServerCallDem_SatelliteMainFunction_ReadData_CBReadData_DID_0xe337_DID_E337_q_axis_current_setpoint: operation=CBReadData_DID_0xe337_DID_E337_q_axis_current_setpoint.ReadData
            OpServerCallDem_SatelliteMainFunction_ReadData_CBReadData_DID_0xeeb6_DID_EEB6_ECM_Power_Limitation_maximum: operation=CBReadData_DID_0xeeb6_DID_EEB6_ECM_Power_Limitation_maximum.ReadData
            OpServerCallDem_SatelliteMainFunction_ReadData_CBReadData_DID_0xe358_DID_E358_Resolve_angle: operation=CBReadData_DID_0xe358_DID_E358_Resolve_angle.ReadData
            OpServerCallDem_SatelliteMainFunction_ReadData_CBReadData_DID_0xe333_2002_Lu: operation=CBReadData_DID_0xe333_2002_Lu.ReadData
        GetEventUdsStatus: can-be-invoked-concurrently=true, symbol=Dem_GetEventUdsStatus
        GetEventStatus: can-be-invoked-concurrently=true, symbol=Dem_GetEventUdsStatus
        GetEventFailed: can-be-invoked-concurrently=true, symbol=Dem_GetEventFailed
        GetEventTested: can-be-invoked-concurrently=true, symbol=Dem_GetEventTested
        GetDTCOfEvent: can-be-invoked-concurrently=true, symbol=Dem_GetDTCOfEvent
        GetFaultDetectionCounter: can-be-invoked-concurrently=true, symbol=Dem_GetFaultDetectionCounter
        GetEventFreezeFrameDataEx: can-be-invoked-concurrently=true, symbol=Dem_GetEventFreezeFrameDataEx
        GetEventExtendedDataRecordEx: can-be-invoked-concurrently=true, symbol=Dem_GetEventExtendedDataRecordEx
        GetEventEnableCondition: can-be-invoked-concurrently=true, symbol=Dem_GetEventEnableCondition
        GetDebouncingOfEvent: can-be-invoked-concurrently=true, symbol=Dem_GetDebouncingOfEvent
        GetMonitorStatus: can-be-invoked-concurrently=true, symbol=Dem_GetMonitorStatus
        SetEventStatus: can-be-invoked-concurrently=true, symbol=Dem_SetEventStatus
        ResetEventStatus: can-be-invoked-concurrently=true, symbol=Dem_ResetEventStatus
        ResetEventDebounceStatus: can-be-invoked-concurrently=true, symbol=Dem_ResetEventDebounceStatus
  swc implementation DemSatellite_0Implementation: programming-language=C, behavior=DemSatellite_0InternalBehavior

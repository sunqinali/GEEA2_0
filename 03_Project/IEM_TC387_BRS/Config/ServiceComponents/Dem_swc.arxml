[part 3 of 6: package /MICROSAR/Dem_swc/ComponentTypes]
AUTOSAR XML (schema 4-2-2)
package /MICROSAR/Dem_swc/ComponentTypes  (continued)
  service sw component type DemSatellite_0: category=SERVICE_COMPONENT  (continued)
    behavior DemSatellite_0InternalBehavior: handle-termination-and-restart=NO-SUPPORT, included-data-type-set=data-type=[Dem_EventIdType, Dem_RatioIdType, Dem_EventStatusType, Dem_UdsStatusByteType, Dem_DTCFormatType, Dem_InitMonitorReasonType, Dem_OperationCycleStateType, Dem_DTCStatusMaskType, Dem_IndicatorStatusType, Dem_MaxDataValueType, Dem_DTCKindType, Dem_DTCGroupType, Dem_IumprDenomCondIdType, Dem_IumprDenomCondStatusType, Dem_DebounceResetStatusType, Dem_DebouncingStateType, Dem_IumprReadinessGroupType, Dem_DTRControlType, Dem_DTCSeverityType, Dem_MonitorStatusType]  (continued)
      4543 x operation invoked event:  (continued)
        OpEventGetEventFailed_GetEventFailed_EvtInfo_INV_IGBT_TEMP_HWP: start-on-event=DemSatellite_0InternalBehavior/GetEventFailed, operation=EvtInfo_INV_IGBT_TEMP_HWP.GetEventFailed
        OpEventGetEventFailed_GetEventFailed_Event_INV_IGBT_TEMP_HWP: start-on-event=DemSatellite_0InternalBehavior/GetEventFailed, operation=Event_INV_IGBT_TEMP_HWP.GetEventFailed
        OpEventGetEventFailed_GetEventFailed_EvtInfo_INV_RSLVR_SIN_ELEC_FLT: start-on-event=DemSatellite_0InternalBehavior/GetEventFailed, operation=EvtInfo_INV_RSLVR_SIN_ELEC_FLT.GetEventFailed
        OpEventGetEventFailed_GetEventFailed_Event_INV_RSLVR_SIN_ELEC_FLT: start-on-event=DemSatellite_0InternalBehavior/GetEventFailed, operation=Event_INV_RSLVR_SIN_ELEC_FLT.GetEventFailed
        OpEventGetEventFailed_GetEventFailed_EvtInfo_CU_TEMP2_RNG_HI: start-on-event=DemSatellite_0InternalBehavior/GetEventFailed, operation=EvtInfo_CU_TEMP2_RNG_HI.GetEventFailed
        OpEventGetEventFailed_GetEventFailed_Event_CU_TEMP2_RNG_HI: start-on-event=DemSatellite_0InternalBehavior/GetEventFailed, operation=Event_CU_TEMP2_RNG_HI.GetEventFailed
        OpEventGetEventFailed_GetEventFailed_EvtInfo_INV_IAC_PHA_LOSS_MPL: start-on-event=DemSatellite_0InternalBehavior/GetEventFailed, operation=EvtInfo_INV_IAC_PHA_LOSS_MPL.GetEventFailed
        OpEventGetEventFailed_GetEventFailed_Event_INV_IAC_PHA_LOSS_MPL: start-on-event=DemSatellite_0InternalBehavior/GetEventFailed, operation=Event_INV_IAC_PHA_LOSS_MPL.GetEventFailed
        OpEventGetEventFailed_GetEventFailed_EvtInfo_INV_IAC_U_AMP: start-on-event=DemSatellite_0InternalBehavior/GetEventFailed, operation=EvtInfo_INV_IAC_U_AMP.GetEventFailed
        OpEventGetEventFailed_GetEventFailed_Event_INV_IAC_U_AMP: start-on-event=DemSatellite_0InternalBehavior/GetEventFailed, operation=Event_INV_IAC_U_AMP.GetEventFailed
        OpEventGetEventFailed_GetEventFailed_EvtInfo_PSnsr_GRADT_Flt: start-on-event=DemSatellite_0InternalBehavior/GetEventFailed, operation=EvtInfo_PSnsr_GRADT_Flt.GetEventFailed
        OpEventGetEventFailed_GetEventFailed_Event_PSnsr_GRADT_Flt: start-on-event=DemSatellite_0InternalBehavior/GetEventFailed, operation=Event_PSnsr_GRADT_Flt.GetEventFailed
        OpEventGetEventFailed_GetEventFailed_EvtInfo_AURIX_WATHDOG_FLT: start-on-event=DemSatellite_0InternalBehavior/GetEventFailed, operation=EvtInfo_AURIX_WATHDOG_FLT.GetEventFailed
        OpEventGetEventFailed_GetEventFailed_Event_AURIX_WATHDOG_FLT: start-on-event=DemSatellite_0InternalBehavior/GetEventFailed, operation=Event_AURIX_WATHDOG_FLT.GetEventFailed
        OpEventGetEventFailed_GetEventFailed_EvtInfo_VcEvNodeMisBECM: start-on-event=DemSatellite_0InternalBehavior/GetEventFailed, operation=EvtInfo_VcEvNodeMisBECM.GetEventFailed
        OpEventGetEventFailed_GetEventFailed_Event_VcEvNodeMisBECM: start-on-event=DemSatellite_0InternalBehavior/GetEventFailed, operation=Event_VcEvNodeMisBECM.GetEventFailed
        OpEventGetEventFailed_GetEventFailed_EvtInfo_INV_UHVDC_UV_HWP: start-on-event=DemSatellite_0InternalBehavior/GetEventFailed, operation=EvtInfo_INV_UHVDC_UV_HWP.GetEventFailed
        OpEventGetEventFailed_GetEventFailed_Event_INV_UHVDC_UV_HWP: start-on-event=DemSatellite_0InternalBehavior/GetEventFailed, operation=Event_INV_UHVDC_UV_HWP.GetEventFailed
        OpEventGetEventFailed_GetEventFailed_EvtInfo_VcEvMonESpd: start-on-event=DemSatellite_0InternalBehavior/GetEventFailed, operation=EvtInfo_VcEvMonESpd.GetEventFailed
        OpEventGetEventFailed_GetEventFailed_Event_VcEvMonESpd: start-on-event=DemSatellite_0InternalBehavior/GetEventFailed, operation=Event_VcEvMonESpd.GetEventFailed
        OpEventGetEventFailed_GetEventFailed_EvtInfo_COM_NotConfig: start-on-event=DemSatellite_0InternalBehavior/GetEventFailed, operation=EvtInfo_COM_NotConfig.GetEventFailed
        OpEventGetEventFailed_GetEventFailed_Event_COM_NotConfig: start-on-event=DemSatellite_0InternalBehavior/GetEventFailed, operation=Event_COM_NotConfig.GetEventFailed
        OpEventGetEventFailed_GetEventFailed_EvtInfo_INV_RSLVR_SIN_RNG_HI: start-on-event=DemSatellite_0InternalBehavior/GetEventFailed, operation=EvtInfo_INV_RSLVR_SIN_RNG_HI.GetEventFailed
        OpEventGetEventFailed_GetEventFailed_Event_INV_RSLVR_SIN_RNG_HI: start-on-event=DemSatellite_0InternalBehavior/GetEventFailed, operation=Event_INV_RSLVR_SIN_RNG_HI.GetEventFailed
        OpEventGetEventFailed_GetEventFailed_EvtInfo_INV_IGBT_TEMP_U_RNG_HI: start-on-event=DemSatellite_0InternalBehavior/GetEventFailed, operation=EvtInfo_INV_IGBT_TEMP_U_RNG_HI.GetEventFailed
        OpEventGetEventFailed_GetEventFailed_Event_INV_IGBT_TEMP_U_RNG_HI: start-on-event=DemSatellite_0InternalBehavior/GetEventFailed, operation=Event_INV_IGBT_TEMP_U_RNG_HI.GetEventFailed
        OpEventGetEventFailed_GetEventFailed_EvtInfo_VcEvMonMode_001: start-on-event=DemSatellite_0InternalBehavior/GetEventFailed, operation=EvtInfo_VcEvMonMode_001.GetEventFailed
        OpEventGetEventFailed_GetEventFailed_Event_VcEvMonMode_001: start-on-event=DemSatellite_0InternalBehavior/GetEventFailed, operation=Event_VcEvMonMode_001.GetEventFailed
        OpEventGetEventFailed_GetEventFailed_EvtInfo_PA_ACTION_FLT: start-on-event=DemSatellite_0InternalBehavior/GetEventFailed, operation=EvtInfo_PA_ACTION_FLT.GetEventFailed
        OpEventGetEventFailed_GetEventFailed_Event_PA_ACTION_FLT: start-on-event=DemSatellite_0InternalBehavior/GetEventFailed, operation=Event_PA_ACTION_FLT.GetEventFailed
        OpEventGetEventFailed_GetEventFailed_EvtInfo_INV_IAC_V_ELEC_HWP: start-on-event=DemSatellite_0InternalBehavior/GetEventFailed, operation=EvtInfo_INV_IAC_V_ELEC_HWP.GetEventFailed
        OpEventGetEventFailed_GetEventFailed_Event_INV_IAC_V_ELEC_HWP: start-on-event=DemSatellite_0InternalBehavior/GetEventFailed, operation=Event_INV_IAC_V_ELEC_HWP.GetEventFailed
        OpEventGetEventFailed_GetEventFailed_EvtInfo_CU_TEMP_HW_FLT_001: start-on-event=DemSatellite_0InternalBehavior/GetEventFailed, operation=EvtInfo_CU_TEMP_HW_FLT_001.GetEventFailed
        OpEventGetEventFailed_GetEventFailed_Event_CU_TEMP_HW_FLT_001: start-on-event=DemSatellite_0InternalBehavior/GetEventFailed, operation=Event_CU_TEMP_HW_FLT_001.GetEventFailed
        OpEventGetEventFailed_GetEventFailed_EvtInfo_VCC_UnderVoltage: start-on-event=DemSatellite_0InternalBehavior/GetEventFailed, operation=EvtInfo_VCC_UnderVoltage.GetEventFailed
        OpEventGetEventFailed_GetEventFailed_Event_VCC_UnderVoltage: start-on-event=DemSatellite_0InternalBehavior/GetEventFailed, operation=Event_VCC_UnderVoltage.GetEventFailed
        OpEventGetEventFailed_GetEventFailed_EvtInfo_VcEvTsttrPlaus: start-on-event=DemSatellite_0InternalBehavior/GetEventFailed, operation=EvtInfo_VcEvTsttrPlaus.GetEventFailed
        OpEventGetEventFailed_GetEventFailed_Event_VcEvTsttrPlaus: start-on-event=DemSatellite_0InternalBehavior/GetEventFailed, operation=Event_VcEvTsttrPlaus.GetEventFailed
        OpEventGetEventFailed_GetEventFailed_EvtInfo_INV_RSLVR_EXCT_ELEC_FLT: start-on-event=DemSatellite_0InternalBehavior/GetEventFailed, operation=EvtInfo_INV_RSLVR_EXCT_ELEC_FLT.GetEventFailed
        OpEventGetEventFailed_GetEventFailed_Event_INV_RSLVR_EXCT_ELEC_FLT: start-on-event=DemSatellite_0InternalBehavior/GetEventFailed, operation=Event_INV_RSLVR_EXCT_ELEC_FLT.GetEventFailed
        OpEventGetEventFailed_GetEventFailed_EvtInfo_INV_RSLVR_EXCT_RNG_LO: start-on-event=DemSatellite_0InternalBehavior/GetEventFailed, operation=EvtInfo_INV_RSLVR_EXCT_RNG_LO.GetEventFailed
        OpEventGetEventFailed_GetEventFailed_Event_INV_RSLVR_EXCT_RNG_LO: start-on-event=DemSatellite_0InternalBehavior/GetEventFailed, operation=Event_INV_RSLVR_EXCT_RNG_LO.GetEventFailed
        OpEventGetEventFailed_GetEventFailed_EvtInfo_INV_EM_STATOR_TEMP2_RNG_HI: start-on-event=DemSatellite_0InternalBehavior/GetEventFailed, operation=EvtInfo_INV_EM_STATOR_TEMP2_RNG_HI.GetEventFailed
        OpEventGetEventFailed_GetEventFailed_Event_INV_EM_STATOR_TEMP2_RNG_HI: start-on-event=DemSatellite_0InternalBehavior/GetEventFailed, operation=Event_INV_EM_STATOR_TEMP2_RNG_HI.GetEventFailed
        OpEventGetEventFailed_GetEventFailed_EvtInfo_INV_SHUT_OFF_PAH_START_UP: start-on-event=DemSatellite_0InternalBehavior/GetEventFailed, operation=EvtInfo_INV_SHUT_OFF_PAH_START_UP.GetEventFailed
        OpEventGetEventFailed_GetEventFailed_Event_INV_SHUT_OFF_PAH_START_UP: start-on-event=DemSatellite_0InternalBehavior/GetEventFailed, operation=Event_INV_SHUT_OFF_PAH_START_UP.GetEventFailed
        OpEventGetEventFailed_GetEventFailed_EvtInfo_VCEvVddmPropFr08Tioutd: start-on-event=DemSatellite_0InternalBehavior/GetEventFailed, operation=EvtInfo_VCEvVddmPropFr08Tioutd.GetEventFailed
        OpEventGetEventFailed_GetEventFailed_Event_VCEvVddmPropFr08Tioutd: start-on-event=DemSatellite_0InternalBehavior/GetEventFailed, operation=Event_VCEvVddmPropFr08Tioutd.GetEventFailed
        OpEventGetEventFailed_GetEventFailed_EvtInfo_INV_RSLVR_EXCT_OC_HWP_001: start-on-event=DemSatellite_0InternalBehavior/GetEventFailed, operation=EvtInfo_INV_RSLVR_EXCT_OC_HWP_001.GetEventFailed
        OpEventGetEventFailed_GetEventFailed_Event_INV_RSLVR_EXCT_OC_HWP_001: start-on-event=DemSatellite_0InternalBehavior/GetEventFailed, operation=Event_INV_RSLVR_EXCT_OC_HWP_001.GetEventFailed
        OpEventGetEventFailed_GetEventFailed_EvtInfo_INV_RSLVR_EXCT_OC_HWP_002: start-on-event=DemSatellite_0InternalBehavior/GetEventFailed, operation=EvtInfo_INV_RSLVR_EXCT_OC_HWP_002.GetEventFailed
        OpEventGetEventFailed_GetEventFailed_Event_INV_RSLVR_EXCT_OC_HWP_002: start-on-event=DemSatellite_0InternalBehavior/GetEventFailed, operation=Event_INV_RSLVR_EXCT_OC_HWP_002.GetEventFailed
        OpEventGetEventFailed_GetEventFailed_EvtInfo_INV_EM_STATOR_TEMP_ELE_FLT: start-on-event=DemSatellite_0InternalBehavior/GetEventFailed, operation=EvtInfo_INV_EM_STATOR_TEMP_ELE_FLT.GetEventFailed
        OpEventGetEventFailed_GetEventFailed_Event_INV_EM_STATOR_TEMP_ELE_FLT: start-on-event=DemSatellite_0InternalBehavior/GetEventFailed, operation=Event_INV_EM_STATOR_TEMP_ELE_FLT.GetEventFailed
        OpEventGetEventFailed_GetEventFailed_EvtInfo_INV_INTERLOCK_FLT: start-on-event=DemSatellite_0InternalBehavior/GetEventFailed, operation=EvtInfo_INV_INTERLOCK_FLT.GetEventFailed
        OpEventGetEventFailed_GetEventFailed_Event_INV_INTERLOCK_FLT: start-on-event=DemSatellite_0InternalBehavior/GetEventFailed, operation=Event_INV_INTERLOCK_FLT.GetEventFailed
        OpEventGetEventFailed_GetEventFailed_EvtInfo_Ga_ZeroFindDistanFailure: start-on-event=DemSatellite_0InternalBehavior/GetEventFailed, operation=EvtInfo_Ga_ZeroFindDistanFailure.GetEventFailed
        OpEventGetEventFailed_GetEventFailed_Event_Ga_ZeroFindDistanFailure: start-on-event=DemSatellite_0InternalBehavior/GetEventFailed, operation=Event_Ga_ZeroFindDistanFailure.GetEventFailed
        OpEventGetEventFailed_GetEventFailed_EvtInfo_PLOCK_Current_RNG_OUT: start-on-event=DemSatellite_0InternalBehavior/GetEventFailed, operation=EvtInfo_PLOCK_Current_RNG_OUT.GetEventFailed
        OpEventGetEventFailed_GetEventFailed_Event_PLOCK_Current_RNG_OUT: start-on-event=DemSatellite_0InternalBehavior/GetEventFailed, operation=Event_PLOCK_Current_RNG_OUT.GetEventFailed
        OpEventGetEventFailed_GetEventFailed_EvtInfo_VCEvVddmPropFr05Tioutd: start-on-event=DemSatellite_0InternalBehavior/GetEventFailed, operation=EvtInfo_VCEvVddmPropFr05Tioutd.GetEventFailed
        OpEventGetEventFailed_GetEventFailed_Event_VCEvVddmPropFr05Tioutd: start-on-event=DemSatellite_0InternalBehavior/GetEventFailed, operation=Event_VCEvVddmPropFr05Tioutd.GetEventFailed
        OpEventGetEventFailed_GetEventFailed_EvtInfo_INV_IGBT_TEMP_V_GRDT: start-on-event=DemSatellite_0InternalBehavior/GetEventFailed, operation=EvtInfo_INV_IGBT_TEMP_V_GRDT.GetEventFailed
        OpEventGetEventFailed_GetEventFailed_Event_INV_IGBT_TEMP_V_GRDT: start-on-event=DemSatellite_0InternalBehavior/GetEventFailed, operation=Event_INV_IGBT_TEMP_V_GRDT.GetEventFailed
        OpEventGetEventFailed_GetEventFailed_EvtInfo_PS_5V_Fault: start-on-event=DemSatellite_0InternalBehavior/GetEventFailed, operation=EvtInfo_PS_5V_Fault.GetEventFailed
        OpEventGetEventFailed_GetEventFailed_Event_PS_5V_Fault: start-on-event=DemSatellite_0InternalBehavior/GetEventFailed, operation=Event_PS_5V_Fault.GetEventFailed
        OpEventGetEventFailed_GetEventFailed_EvtInfo_VcEvCntrCrashStsSafe: start-on-event=DemSatellite_0InternalBehavior/GetEventFailed, operation=EvtInfo_VcEvCntrCrashStsSafe.GetEventFailed
        OpEventGetEventFailed_GetEventFailed_Event_VcEvCntrCrashStsSafe: start-on-event=DemSatellite_0InternalBehavior/GetEventFailed, operation=Event_VcEvCntrCrashStsSafe.GetEventFailed
        OpEventGetEventFailed_GetEventFailed_EvtInfo_INV_EM_STATOR_TEMP_GRDT: start-on-event=DemSatellite_0InternalBehavior/GetEventFailed, operation=EvtInfo_INV_EM_STATOR_TEMP_GRDT.GetEventFailed
        OpEventGetEventFailed_GetEventFailed_Event_INV_EM_STATOR_TEMP_GRDT: start-on-event=DemSatellite_0InternalBehavior/GetEventFailed, operation=Event_INV_EM_STATOR_TEMP_GRDT.GetEventFailed
        OpEventGetEventFailed_GetEventFailed_EvtInfo_PS_P15_V_FLT: start-on-event=DemSatellite_0InternalBehavior/GetEventFailed, operation=EvtInfo_PS_P15_V_FLT.GetEventFailed
        OpEventGetEventFailed_GetEventFailed_Event_PS_P15_V_FLT: start-on-event=DemSatellite_0InternalBehavior/GetEventFailed, operation=Event_PS_P15_V_FLT.GetEventFailed
        OpEventGetEventFailed_GetEventFailed_EvtInfo_INV_EM_STATOR_TEMP_RNG_NOK: start-on-event=DemSatellite_0InternalBehavior/GetEventFailed, operation=EvtInfo_INV_EM_STATOR_TEMP_RNG_NOK.GetEventFailed
        OpEventGetEventFailed_GetEventFailed_Event_INV_EM_STATOR_TEMP_RNG_NOK: start-on-event=DemSatellite_0InternalBehavior/GetEventFailed, operation=Event_INV_EM_STATOR_TEMP_RNG_NOK.GetEventFailed
        OpEventGetEventFailed_GetEventFailed_EvtInfo_INV_RSLVR_SIN_RNG_NOK: start-on-event=DemSatellite_0InternalBehavior/GetEventFailed, operation=EvtInfo_INV_RSLVR_SIN_RNG_NOK.GetEventFailed
        OpEventGetEventFailed_GetEventFailed_Event_INV_RSLVR_SIN_RNG_NOK: start-on-event=DemSatellite_0InternalBehavior/GetEventFailed, operation=Event_INV_RSLVR_SIN_RNG_NOK.GetEventFailed
        OpEventGetEventFailed_GetEventFailed_EvtInfo_INV_IAC_U_OFFS: start-on-event=DemSatellite_0InternalBehavior/GetEventFailed, operation=EvtInfo_INV_IAC_U_OFFS.GetEventFailed
        OpEventGetEventFailed_GetEventFailed_Event_INV_IAC_U_OFFS: start-on-event=DemSatellite_0InternalBehavior/GetEventFailed, operation=Event_INV_IAC_U_OFFS.GetEventFailed
        OpEventGetEventFailed_GetEventFailed_EvtInfo_PS_KL30_BACKUP_FLT: start-on-event=DemSatellite_0InternalBehavior/GetEventFailed, operation=EvtInfo_PS_KL30_BACKUP_FLT.GetEventFailed
        OpEventGetEventFailed_GetEventFailed_Event_PS_KL30_BACKUP_FLT: start-on-event=DemSatellite_0InternalBehavior/GetEventFailed, operation=Event_PS_KL30_BACKUP_FLT.GetEventFailed
        OpEventGetEventFailed_GetEventFailed_EvtInfo_INV_IGBT_TEMP_U_RNG_LO: start-on-event=DemSatellite_0InternalBehavior/GetEventFailed, operation=EvtInfo_INV_IGBT_TEMP_U_RNG_LO.GetEventFailed
        OpEventGetEventFailed_GetEventFailed_Event_INV_IGBT_TEMP_U_RNG_LO: start-on-event=DemSatellite_0InternalBehavior/GetEventFailed, operation=Event_INV_IGBT_TEMP_U_RNG_LO.GetEventFailed
        OpEventGetEventFailed_GetEventFailed_EvtInfo_INV_EM_STATOR_TEMP_HWP: start-on-event=DemSatellite_0InternalBehavior/GetEventFailed, operation=EvtInfo_INV_EM_STATOR_TEMP_HWP.GetEventFailed
        OpEventGetEventFailed_GetEventFailed_Event_INV_EM_STATOR_TEMP_HWP: start-on-event=DemSatellite_0InternalBehavior/GetEventFailed, operation=Event_INV_EM_STATOR_TEMP_HWP.GetEventFailed
        OpEventGetEventFailed_GetEventFailed_EvtInfo_CU_TEMP1_RNG_HI: start-on-event=DemSatellite_0InternalBehavior/GetEventFailed, operation=EvtInfo_CU_TEMP1_RNG_HI.GetEventFailed
        OpEventGetEventFailed_GetEventFailed_Event_CU_TEMP1_RNG_HI: start-on-event=DemSatellite_0InternalBehavior/GetEventFailed, operation=Event_CU_TEMP1_RNG_HI.GetEventFailed
        OpEventGetEventFailed_GetEventFailed_EvtInfo_INV_IGBT_TEMP_V_RNG_HI: start-on-event=DemSatellite_0InternalBehavior/GetEventFailed, operation=EvtInfo_INV_IGBT_TEMP_V_RNG_HI.GetEventFailed
        OpEventGetEventFailed_GetEventFailed_Event_INV_IGBT_TEMP_V_RNG_HI: start-on-event=DemSatellite_0InternalBehavior/GetEventFailed, operation=Event_INV_IGBT_TEMP_V_RNG_HI.GetEventFailed
        OpEventGetEventFailed_GetEventFailed_EvtInfo_VcEvNodeMisVDDM: start-on-event=DemSatellite_0InternalBehavior/GetEventFailed, operation=EvtInfo_VcEvNodeMisVDDM.GetEventFailed
        OpEventGetEventFailed_GetEventFailed_Event_VcEvNodeMisVDDM: start-on-event=DemSatellite_0InternalBehavior/GetEventFailed, operation=Event_VcEvNodeMisVDDM.GetEventFailed
        OpEventGetEventFailed_GetEventFailed_EvtInfo_INV_UHVDC_PLAUS: start-on-event=DemSatellite_0InternalBehavior/GetEventFailed, operation=EvtInfo_INV_UHVDC_PLAUS.GetEventFailed
        OpEventGetEventFailed_GetEventFailed_Event_INV_UHVDC_PLAUS: start-on-event=DemSatellite_0InternalBehavior/GetEventFailed, operation=Event_INV_UHVDC_PLAUS.GetEventFailed
        OpEventGetEventFailed_GetEventFailed_EvtInfo_INV_QUIESCENT_FLT: start-on-event=DemSatellite_0InternalBehavior/GetEventFailed, operation=EvtInfo_INV_QUIESCENT_FLT.GetEventFailed
        OpEventGetEventFailed_GetEventFailed_Event_INV_QUIESCENT_FLT: start-on-event=DemSatellite_0InternalBehavior/GetEventFailed, operation=Event_INV_QUIESCENT_FLT.GetEventFailed
        OpEventGetEventFailed_GetEventFailed_EvtInfo_INV_RSLVR_EXCT_RNG_HI: start-on-event=DemSatellite_0InternalBehavior/GetEventFailed, operation=EvtInfo_INV_RSLVR_EXCT_RNG_HI.GetEventFailed
        OpEventGetEventFailed_GetEventFailed_Event_INV_RSLVR_EXCT_RNG_HI: start-on-event=DemSatellite_0InternalBehavior/GetEventFailed, operation=Event_INV_RSLVR_EXCT_RNG_HI.GetEventFailed
        OpEventGetEventFailed_GetEventFailed_GeneralEvtInfo: start-on-event=DemSatellite_0InternalBehavior/GetEventFailed, operation=GeneralEvtInfo.GetEventFailed
        OpEventGetEventTested_GetEventTested_EvtInfo_VCEvBecmPropFr01Tioutd: start-on-event=DemSatellite_0InternalBehavior/GetEventTested, operation=EvtInfo_VCEvBecmPropFr01Tioutd.GetEventTested
        OpEventGetEventTested_GetEventTested_Event_VCEvBecmPropFr01Tioutd: start-on-event=DemSatellite_0InternalBehavior/GetEventTested, operation=Event_VCEvBecmPropFr01Tioutd.GetEventTested
        OpEventGetEventTested_GetEventTested_EvtInfo_INV_CU_TEMP2_RNG_NOK: start-on-event=DemSatellite_0InternalBehavior/GetEventTested, operation=EvtInfo_INV_CU_TEMP2_RNG_NOK.GetEventTested
        OpEventGetEventTested_GetEventTested_Event_INV_CU_TEMP2_RNG_NOK: start-on-event=DemSatellite_0InternalBehavior/GetEventTested, operation=Event_INV_CU_TEMP2_RNG_NOK.GetEventTested
        OpEventGetEventTested_GetEventTested_EvtInfo_COM_Busoff: start-on-event=DemSatellite_0InternalBehavior/GetEventTested, operation=EvtInfo_COM_Busoff.GetEventTested
        OpEventGetEventTested_GetEventTested_Event_COM_Busoff: start-on-event=DemSatellite_0InternalBehavior/GetEventTested, operation=Event_COM_Busoff.GetEventTested
        OpEventGetEventTested_GetEventTested_EvtInfo_INV_IMMO_NOKEY: start-on-event=DemSatellite_0InternalBehavior/GetEventTested, operation=EvtInfo_INV_IMMO_NOKEY.GetEventTested
        OpEventGetEventTested_GetEventTested_Event_INV_IMMO_NOKEY: start-on-event=DemSatellite_0InternalBehavior/GetEventTested, operation=Event_INV_IMMO_NOKEY.GetEventTested
        OpEventGetEventTested_GetEventTested_EvtInfo_INV_RSLVR_EXCT_OC_HWP: start-on-event=DemSatellite_0InternalBehavior/GetEventTested, operation=EvtInfo_INV_RSLVR_EXCT_OC_HWP.GetEventTested
        OpEventGetEventTested_GetEventTested_Event_INV_RSLVR_EXCT_OC_HWP: start-on-event=DemSatellite_0InternalBehavior/GetEventTested, operation=Event_INV_RSLVR_EXCT_OC_HWP.GetEventTested
        OpEventGetEventTested_GetEventTested_EvtInfo_PS_P15_W_FLT: start-on-event=DemSatellite_0InternalBehavior/GetEventTested, operation=EvtInfo_PS_P15_W_FLT.GetEventTested
        OpEventGetEventTested_GetEventTested_Event_PS_P15_W_FLT: start-on-event=DemSatellite_0InternalBehavior/GetEventTested, operation=Event_PS_P15_W_FLT.GetEventTested
        OpEventGetEventTested_GetEventTested_EvtInfo_INV_IAC_PLAUS_SUM: start-on-event=DemSatellite_0InternalBehavior/GetEventTested, operation=EvtInfo_INV_IAC_PLAUS_SUM.GetEventTested
        OpEventGetEventTested_GetEventTested_Event_INV_IAC_PLAUS_SUM: start-on-event=DemSatellite_0InternalBehavior/GetEventTested, operation=Event_INV_IAC_PLAUS_SUM.GetEventTested
        OpEventGetEventTested_GetEventTested_EvtInfo_PA_ELE_FLT: start-on-event=DemSatellite_0InternalBehavior/GetEventTested, operation=EvtInfo_PA_ELE_FLT.GetEventTested
        OpEventGetEventTested_GetEventTested_Event_PA_ELE_FLT: start-on-event=DemSatellite_0InternalBehavior/GetEventTested, operation=Event_PA_ELE_FLT.GetEventTested
        OpEventGetEventTested_GetEventTested_EvtInfo_CU_TEMP_GRDT: start-on-event=DemSatellite_0InternalBehavior/GetEventTested, operation=EvtInfo_CU_TEMP_GRDT.GetEventTested
        OpEventGetEventTested_GetEventTested_Event_CU_TEMP_GRDT: start-on-event=DemSatellite_0InternalBehavior/GetEventTested, operation=Event_CU_TEMP_GRDT.GetEventTested
        OpEventGetEventTested_GetEventTested_EvtInfo_INV_IGBT_TEMP_V_PLAUS: start-on-event=DemSatellite_0InternalBehavior/GetEventTested, operation=EvtInfo_INV_IGBT_TEMP_V_PLAUS.GetEventTested
        OpEventGetEventTested_GetEventTested_Event_INV_IGBT_TEMP_V_PLAUS: start-on-event=DemSatellite_0InternalBehavior/GetEventTested, operation=Event_INV_IGBT_TEMP_V_PLAUS.GetEventTested
        OpEventGetEventTested_GetEventTested_EvtInfo_Ga_GAEngageFailure: start-on-event=DemSatellite_0InternalBehavior/GetEventTested, operation=EvtInfo_Ga_GAEngageFailure.GetEventTested
        OpEventGetEventTested_GetEventTested_Event_Ga_GAEngageFailure: start-on-event=DemSatellite_0InternalBehavior/GetEventTested, operation=Event_Ga_GAEngageFailure.GetEventTested
        OpEventGetEventTested_GetEventTested_EvtInfo_INV_IAC_W_RNG_LO: start-on-event=DemSatellite_0InternalBehavior/GetEventTested, operation=EvtInfo_INV_IAC_W_RNG_LO.GetEventTested
        OpEventGetEventTested_GetEventTested_Event_INV_IAC_W_RNG_LO: start-on-event=DemSatellite_0InternalBehavior/GetEventTested, operation=Event_INV_IAC_W_RNG_LO.GetEventTested
        OpEventGetEventTested_GetEventTested_EvtInfo_PS_WhlSnsr_Vltg_FLT: start-on-event=DemSatellite_0InternalBehavior/GetEventTested, operation=EvtInfo_PS_WhlSnsr_Vltg_FLT.GetEventTested
        OpEventGetEventTested_GetEventTested_Event_PS_WhlSnsr_Vltg_FLT: start-on-event=DemSatellite_0InternalBehavior/GetEventTested, operation=Event_PS_WhlSnsr_Vltg_FLT.GetEventTested
        OpEventGetEventTested_GetEventTested_EvtInfo_VCEvEcmPropFr02Tioutd: start-on-event=DemSatellite_0InternalBehavior/GetEventTested, operation=EvtInfo_VCEvEcmPropFr02Tioutd.GetEventTested
        OpEventGetEventTested_GetEventTested_Event_VCEvEcmPropFr02Tioutd: start-on-event=DemSatellite_0InternalBehavior/GetEventTested, operation=Event_VCEvEcmPropFr02Tioutd.GetEventTested
        OpEventGetEventTested_GetEventTested_EvtInfo_Ga_TmSpdSyncFailed: start-on-event=DemSatellite_0InternalBehavior/GetEventTested, operation=EvtInfo_Ga_TmSpdSyncFailed.GetEventTested
        OpEventGetEventTested_GetEventTested_Event_Ga_TmSpdSyncFailed: start-on-event=DemSatellite_0InternalBehavior/GetEventTested, operation=Event_Ga_TmSpdSyncFailed.GetEventTested
        OpEventGetEventTested_GetEventTested_EvtInfo_INV_RSLVR_EXCT_ELEC_LO: start-on-event=DemSatellite_0InternalBehavior/GetEventTested, operation=EvtInfo_INV_RSLVR_EXCT_ELEC_LO.GetEventTested
        OpEventGetEventTested_GetEventTested_Event_INV_RSLVR_EXCT_ELEC_LO: start-on-event=DemSatellite_0InternalBehavior/GetEventTested, operation=Event_INV_RSLVR_EXCT_ELEC_LO.GetEventTested
        OpEventGetEventTested_GetEventTested_EvtInfo_VCEvEcmPropXevFr06Tioutd: start-on-event=DemSatellite_0InternalBehavior/GetEventTested, operation=EvtInfo_VCEvEcmPropXevFr06Tioutd.GetEventTested
        OpEventGetEventTested_GetEventTested_Event_VCEvEcmPropXevFr06Tioutd: start-on-event=DemSatellite_0InternalBehavior/GetEventTested, operation=Event_VCEvEcmPropXevFr06Tioutd.GetEventTested
        OpEventGetEventTested_GetEventTested_EvtInfo_VcEvCntrWhlMotSysTqAllwd: start-on-event=DemSatellite_0InternalBehavior/GetEventTested, operation=EvtInfo_VcEvCntrWhlMotSysTqAllwd.GetEventTested
        OpEventGetEventTested_GetEventTested_Event_VcEvCntrWhlMotSysTqAllwd: start-on-event=DemSatellite_0InternalBehavior/GetEventTested, operation=Event_VcEvCntrWhlMotSysTqAllwd.GetEventTested
        OpEventGetEventTested_GetEventTested_EvtInfo_INV_UHVDC_1_ELEC_HI: start-on-event=DemSatellite_0InternalBehavior/GetEventTested, operation=EvtInfo_INV_UHVDC_1_ELEC_HI.GetEventTested
        OpEventGetEventTested_GetEventTested_Event_INV_UHVDC_1_ELEC_HI: start-on-event=DemSatellite_0InternalBehavior/GetEventTested, operation=Event_INV_UHVDC_1_ELEC_HI.GetEventTested
        OpEventGetEventTested_GetEventTested_EvtInfo_INV_EM_STATOR_TEMP2_ELE_FLT: start-on-event=DemSatellite_0InternalBehavior/GetEventTested, operation=EvtInfo_INV_EM_STATOR_TEMP2_ELE_FLT.GetEventTested
        OpEventGetEventTested_GetEventTested_Event_INV_EM_STATOR_TEMP2_ELE_FLT: start-on-event=DemSatellite_0InternalBehavior/GetEventTested, operation=Event_INV_EM_STATOR_TEMP2_ELE_FLT.GetEventTested
        OpEventGetEventTested_GetEventTested_EvtInfo_AURIX_RST_SNG: start-on-event=DemSatellite_0InternalBehavior/GetEventTested, operation=EvtInfo_AURIX_RST_SNG.GetEventTested
        OpEventGetEventTested_GetEventTested_Event_AURIX_RST_SNG: start-on-event=DemSatellite_0InternalBehavior/GetEventTested, operation=Event_AURIX_RST_SNG.GetEventTested
        OpEventGetEventTested_GetEventTested_EvtInfo_VCEvEcmPropFr24MgmFr01Tioutd: start-on-event=DemSatellite_0InternalBehavior/GetEventTested, operation=EvtInfo_VCEvEcmPropFr24MgmFr01Tioutd.GetEventTested
        OpEventGetEventTested_GetEventTested_Event_VCEvEcmPropFr24MgmFr01Tioutd: start-on-event=DemSatellite_0InternalBehavior/GetEventTested, operation=Event_VCEvEcmPropFr24MgmFr01Tioutd.GetEventTested
        OpEventGetEventTested_GetEventTested_EvtInfo_INV_RSLVR_COS_ELEC_OPEN: start-on-event=DemSatellite_0InternalBehavior/GetEventTested, operation=EvtInfo_INV_RSLVR_COS_ELEC_OPEN.GetEventTested
        OpEventGetEventTested_GetEventTested_Event_INV_RSLVR_COS_ELEC_OPEN: start-on-event=DemSatellite_0InternalBehavior/GetEventTested, operation=Event_INV_RSLVR_COS_ELEC_OPEN.GetEventTested
        OpEventGetEventTested_GetEventTested_EvtInfo_INV_IAC_V_ELEC_LO: start-on-event=DemSatellite_0InternalBehavior/GetEventTested, operation=EvtInfo_INV_IAC_V_ELEC_LO.GetEventTested
        OpEventGetEventTested_GetEventTested_Event_INV_IAC_V_ELEC_LO: start-on-event=DemSatellite_0InternalBehavior/GetEventTested, operation=Event_INV_IAC_V_ELEC_LO.GetEventTested
        OpEventGetEventTested_GetEventTested_EvtInfo_INV_IAC_W_OFFS: start-on-event=DemSatellite_0InternalBehavior/GetEventTested, operation=EvtInfo_INV_IAC_W_OFFS.GetEventTested
        OpEventGetEventTested_GetEventTested_Event_INV_IAC_W_OFFS: start-on-event=DemSatellite_0InternalBehavior/GetEventTested, operation=Event_INV_IAC_W_OFFS.GetEventTested
        OpEventGetEventTested_GetEventTested_EvtInfo_INV_EM_STATOR_TEMP2_GRDT: start-on-event=DemSatellite_0InternalBehavior/GetEventTested, operation=EvtInfo_INV_EM_STATOR_TEMP2_GRDT.GetEventTested
        OpEventGetEventTested_GetEventTested_Event_INV_EM_STATOR_TEMP2_GRDT: start-on-event=DemSatellite_0InternalBehavior/GetEventTested, operation=Event_INV_EM_STATOR_TEMP2_GRDT.GetEventTested
        OpEventGetEventTested_GetEventTested_EvtInfo_INV_EM_OVRSPD_HWP: start-on-event=DemSatellite_0InternalBehavior/GetEventTested, operation=EvtInfo_INV_EM_OVRSPD_HWP.GetEventTested
        OpEventGetEventTested_GetEventTested_Event_INV_EM_OVRSPD_HWP: start-on-event=DemSatellite_0InternalBehavior/GetEventTested, operation=Event_INV_EM_OVRSPD_HWP.GetEventTested
        OpEventGetEventTested_GetEventTested_EvtInfo_CU_TEMP_HWP: start-on-event=DemSatellite_0InternalBehavior/GetEventTested, operation=EvtInfo_CU_TEMP_HWP.GetEventTested
        OpEventGetEventTested_GetEventTested_Event_CU_TEMP_HWP: start-on-event=DemSatellite_0InternalBehavior/GetEventTested, operation=Event_CU_TEMP_HWP.GetEventTested
        OpEventGetEventTested_GetEventTested_EvtInfo_INV_UHVDC_1_RNG_HI: start-on-event=DemSatellite_0InternalBehavior/GetEventTested, operation=EvtInfo_INV_UHVDC_1_RNG_HI.GetEventTested
        OpEventGetEventTested_GetEventTested_Event_INV_UHVDC_1_RNG_HI: start-on-event=DemSatellite_0InternalBehavior/GetEventTested, operation=Event_INV_UHVDC_1_RNG_HI.GetEventTested
        OpEventGetEventTested_GetEventTested_EvtInfo_VcEvEMPerfPlaus: start-on-event=DemSatellite_0InternalBehavior/GetEventTested, operation=EvtInfo_VcEvEMPerfPlaus.GetEventTested
        OpEventGetEventTested_GetEventTested_Event_VcEvEMPerfPlaus: start-on-event=DemSatellite_0InternalBehavior/GetEventTested, operation=Event_VcEvEMPerfPlaus.GetEventTested
        OpEventGetEventTested_GetEventTested_EvtInfo_VCEvVddmPropFr18Tioutd: start-on-event=DemSatellite_0InternalBehavior/GetEventTested, operation=EvtInfo_VCEvVddmPropFr18Tioutd.GetEventTested
        OpEventGetEventTested_GetEventTested_Event_VCEvVddmPropFr18Tioutd: start-on-event=DemSatellite_0InternalBehavior/GetEventTested, operation=Event_VCEvVddmPropFr18Tioutd.GetEventTested
        OpEventGetEventTested_GetEventTested_EvtInfo_INV_IAC_U_ELEC_HWP: start-on-event=DemSatellite_0InternalBehavior/GetEventTested, operation=EvtInfo_INV_IAC_U_ELEC_HWP.GetEventTested
        OpEventGetEventTested_GetEventTested_Event_INV_IAC_U_ELEC_HWP: start-on-event=DemSatellite_0InternalBehavior/GetEventTested, operation=Event_INV_IAC_U_ELEC_HWP.GetEventTested
        OpEventGetEventTested_GetEventTested_EvtInfo_VCEvVddmPropFr15Tioutd: start-on-event=DemSatellite_0InternalBehavior/GetEventTested, operation=EvtInfo_VCEvVddmPropFr15Tioutd.GetEventTested
        OpEventGetEventTested_GetEventTested_Event_VCEvVddmPropFr15Tioutd: start-on-event=DemSatellite_0InternalBehavior/GetEventTested, operation=Event_VCEvVddmPropFr15Tioutd.GetEventTested
        OpEventGetEventTested_GetEventTested_EvtInfo_Ga_GADisengageFailure: start-on-event=DemSatellite_0InternalBehavior/GetEventTested, operation=EvtInfo_Ga_GADisengageFailure.GetEventTested
        OpEventGetEventTested_GetEventTested_Event_Ga_GADisengageFailure: start-on-event=DemSatellite_0InternalBehavior/GetEventTested, operation=Event_Ga_GADisengageFailure.GetEventTested
        OpEventGetEventTested_GetEventTested_EvtInfo_CU_TEMP2_RNG_LO: start-on-event=DemSatellite_0InternalBehavior/GetEventTested, operation=EvtInfo_CU_TEMP2_RNG_LO.GetEventTested
        OpEventGetEventTested_GetEventTested_Event_CU_TEMP2_RNG_LO: start-on-event=DemSatellite_0InternalBehavior/GetEventTested, operation=Event_CU_TEMP2_RNG_LO.GetEventTested
        OpEventGetEventTested_GetEventTested_EvtInfo_INV_RSLVR_SIN_ELEC_OPEN: start-on-event=DemSatellite_0InternalBehavior/GetEventTested, operation=EvtInfo_INV_RSLVR_SIN_ELEC_OPEN.GetEventTested
        OpEventGetEventTested_GetEventTested_Event_INV_RSLVR_SIN_ELEC_OPEN: start-on-event=DemSatellite_0InternalBehavior/GetEventTested, operation=Event_INV_RSLVR_SIN_ELEC_OPEN.GetEventTested
        OpEventGetEventTested_GetEventTested_EvtInfo_VcEvChkSum: start-on-event=DemSatellite_0InternalBehavior/GetEventTested, operation=EvtInfo_VcEvChkSum.GetEventTested
        OpEventGetEventTested_GetEventTested_Event_VcEvChkSum: start-on-event=DemSatellite_0InternalBehavior/GetEventTested, operation=Event_VcEvChkSum.GetEventTested
        OpEventGetEventTested_GetEventTested_EvtInfo_PS_P5_UC_FLT: start-on-event=DemSatellite_0InternalBehavior/GetEventTested, operation=EvtInfo_PS_P5_UC_FLT.GetEventTested
        OpEventGetEventTested_GetEventTested_Event_PS_P5_UC_FLT: start-on-event=DemSatellite_0InternalBehavior/GetEventTested, operation=Event_PS_P5_UC_FLT.GetEventTested
        OpEventGetEventTested_GetEventTested_EvtInfo_INV_RSLVR_COS_ELEC_FLT: start-on-event=DemSatellite_0InternalBehavior/GetEventTested, operation=EvtInfo_INV_RSLVR_COS_ELEC_FLT.GetEventTested
        OpEventGetEventTested_GetEventTested_Event_INV_RSLVR_COS_ELEC_FLT: start-on-event=DemSatellite_0InternalBehavior/GetEventTested, operation=Event_INV_RSLVR_COS_ELEC_FLT.GetEventTested
        OpEventGetEventTested_GetEventTested_EvtInfo_INV_IAC_W_RNG_HI: start-on-event=DemSatellite_0InternalBehavior/GetEventTested, operation=EvtInfo_INV_IAC_W_RNG_HI.GetEventTested
        OpEventGetEventTested_GetEventTested_Event_INV_IAC_W_RNG_HI: start-on-event=DemSatellite_0InternalBehavior/GetEventTested, operation=Event_INV_IAC_W_RNG_HI.GetEventTested
        OpEventGetEventTested_GetEventTested_EvtInfo_PS_ECUSUPPLY_HIGH: start-on-event=DemSatellite_0InternalBehavior/GetEventTested, operation=EvtInfo_PS_ECUSUPPLY_HIGH.GetEventTested
        OpEventGetEventTested_GetEventTested_Event_PS_ECUSUPPLY_HIGH: start-on-event=DemSatellite_0InternalBehavior/GetEventTested, operation=Event_PS_ECUSUPPLY_HIGH.GetEventTested
        OpEventGetEventTested_GetEventTested_EvtInfo_VCEvEcmPropFr05Tioutd: start-on-event=DemSatellite_0InternalBehavior/GetEventTested, operation=EvtInfo_VCEvEcmPropFr05Tioutd.GetEventTested
        OpEventGetEventTested_GetEventTested_Event_VCEvEcmPropFr05Tioutd: start-on-event=DemSatellite_0InternalBehavior/GetEventTested, operation=Event_VCEvEcmPropFr05Tioutd.GetEventTested
        OpEventGetEventTested_GetEventTested_EvtInfo_PS_ECUSUPPLY_LOW: start-on-event=DemSatellite_0InternalBehavior/GetEventTested, operation=EvtInfo_PS_ECUSUPPLY_LOW.GetEventTested
        OpEventGetEventTested_GetEventTested_Event_PS_ECUSUPPLY_LOW: start-on-event=DemSatellite_0InternalBehavior/GetEventTested, operation=Event_PS_ECUSUPPLY_LOW.GetEventTested
        OpEventGetEventTested_GetEventTested_EvtInfo_VcEvChkSumHvSysRlySts: start-on-event=DemSatellite_0InternalBehavior/GetEventTested, operation=EvtInfo_VcEvChkSumHvSysRlySts.GetEventTested
        OpEventGetEventTested_GetEventTested_Event_VcEvChkSumHvSysRlySts: start-on-event=DemSatellite_0InternalBehavior/GetEventTested, operation=Event_VcEvChkSumHvSysRlySts.GetEventTested
        OpEventGetEventTested_GetEventTested_EvtInfo_VcEvMonMode: start-on-event=DemSatellite_0InternalBehavior/GetEventTested, operation=EvtInfo_VcEvMonMode.GetEventTested
        OpEventGetEventTested_GetEventTested_Event_VcEvMonMode: start-on-event=DemSatellite_0InternalBehavior/GetEventTested, operation=Event_VcEvMonMode.GetEventTested
        OpEventGetEventTested_GetEventTested_EvtInfo_INV_IAC_OC_SWP: start-on-event=DemSatellite_0InternalBehavior/GetEventTested, operation=EvtInfo_INV_IAC_OC_SWP.GetEventTested
        OpEventGetEventTested_GetEventTested_Event_INV_IAC_OC_SWP: start-on-event=DemSatellite_0InternalBehavior/GetEventTested, operation=Event_INV_IAC_OC_SWP.GetEventTested
        OpEventGetEventTested_GetEventTested_EvtInfo_INV_IMMO_AUTHFAIL: start-on-event=DemSatellite_0InternalBehavior/GetEventTested, operation=EvtInfo_INV_IMMO_AUTHFAIL.GetEventTested
        OpEventGetEventTested_GetEventTested_Event_INV_IMMO_AUTHFAIL: start-on-event=DemSatellite_0InternalBehavior/GetEventTested, operation=Event_INV_IMMO_AUTHFAIL.GetEventTested
        OpEventGetEventTested_GetEventTested_EvtInfo_PA_OpenCirc_FLT: start-on-event=DemSatellite_0InternalBehavior/GetEventTested, operation=EvtInfo_PA_OpenCirc_FLT.GetEventTested
        OpEventGetEventTested_GetEventTested_Event_PA_OpenCirc_FLT: start-on-event=DemSatellite_0InternalBehavior/GetEventTested, operation=Event_PA_OpenCirc_FLT.GetEventTested
        OpEventGetEventTested_GetEventTested_EvtInfo_INV_IAC_V_ELEC_HI: start-on-event=DemSatellite_0InternalBehavior/GetEventTested, operation=EvtInfo_INV_IAC_V_ELEC_HI.GetEventTested
        OpEventGetEventTested_GetEventTested_Event_INV_IAC_V_ELEC_HI: start-on-event=DemSatellite_0InternalBehavior/GetEventTested, operation=Event_INV_IAC_V_ELEC_HI.GetEventTested
        OpEventGetEventTested_GetEventTested_EvtInfo_VCEvEcmPropFr04Tioutd: start-on-event=DemSatellite_0InternalBehavior/GetEventTested, operation=EvtInfo_VCEvEcmPropFr04Tioutd.GetEventTested
        OpEventGetEventTested_GetEventTested_Event_VCEvEcmPropFr04Tioutd: start-on-event=DemSatellite_0InternalBehavior/GetEventTested, operation=Event_VCEvEcmPropFr04Tioutd.GetEventTested
        OpEventGetEventTested_GetEventTested_EvtInfo_VcEvMonTrqActPlaus: start-on-event=DemSatellite_0InternalBehavior/GetEventTested, operation=EvtInfo_VcEvMonTrqActPlaus.GetEventTested
        OpEventGetEventTested_GetEventTested_Event_VcEvMonTrqActPlaus: start-on-event=DemSatellite_0InternalBehavior/GetEventTested, operation=Event_VcEvMonTrqActPlaus.GetEventTested
        OpEventGetEventTested_GetEventTested_EvtInfo_VcEvMonTrqAct: start-on-event=DemSatellite_0InternalBehavior/GetEventTested, operation=EvtInfo_VcEvMonTrqAct.GetEventTested
        OpEventGetEventTested_GetEventTested_Event_VcEvMonTrqAct: start-on-event=DemSatellite_0InternalBehavior/GetEventTested, operation=Event_VcEvMonTrqAct.GetEventTested
        OpEventGetEventTested_GetEventTested_EvtInfo_INV_RSLVR_COS_ELEC_LO: start-on-event=DemSatellite_0InternalBehavior/GetEventTested, operation=EvtInfo_INV_RSLVR_COS_ELEC_LO.GetEventTested
        OpEventGetEventTested_GetEventTested_Event_INV_RSLVR_COS_ELEC_LO: start-on-event=DemSatellite_0InternalBehavior/GetEventTested, operation=Event_INV_RSLVR_COS_ELEC_LO.GetEventTested
        OpEventGetEventTested_GetEventTested_EvtInfo_INV_COOLT_INLET_TEMP_HWP: start-on-event=DemSatellite_0InternalBehavior/GetEventTested, operation=EvtInfo_INV_COOLT_INLET_TEMP_HWP.GetEventTested
        OpEventGetEventTested_GetEventTested_Event_INV_COOLT_INLET_TEMP_HWP: start-on-event=DemSatellite_0InternalBehavior/GetEventTested, operation=Event_INV_COOLT_INLET_TEMP_HWP.GetEventTested
        OpEventGetEventTested_GetEventTested_EvtInfo_VCEvEcmPropFr11Tioutd: start-on-event=DemSatellite_0InternalBehavior/GetEventTested, operation=EvtInfo_VCEvEcmPropFr11Tioutd.GetEventTested
        OpEventGetEventTested_GetEventTested_Event_VCEvEcmPropFr11Tioutd: start-on-event=DemSatellite_0InternalBehavior/GetEventTested, operation=Event_VCEvEcmPropFr11Tioutd.GetEventTested
        OpEventGetEventTested_GetEventTested_EvtInfo_PS_KL30_RNG_HI: start-on-event=DemSatellite_0InternalBehavior/GetEventTested, operation=EvtInfo_PS_KL30_RNG_HI.GetEventTested
        OpEventGetEventTested_GetEventTested_Event_PS_KL30_RNG_HI: start-on-event=DemSatellite_0InternalBehavior/GetEventTested, operation=Event_PS_KL30_RNG_HI.GetEventTested
        OpEventGetEventTested_GetEventTested_EvtInfo_INV_IAC_OC_HWP: start-on-event=DemSatellite_0InternalBehavior/GetEventTested, operation=EvtInfo_INV_IAC_OC_HWP.GetEventTested
        OpEventGetEventTested_GetEventTested_Event_INV_IAC_OC_HWP: start-on-event=DemSatellite_0InternalBehavior/GetEventTested, operation=Event_INV_IAC_OC_HWP.GetEventTested
        OpEventGetEventTested_GetEventTested_EvtInfo_INV_RSLVR_COS_RNG_HI: start-on-event=DemSatellite_0InternalBehavior/GetEventTested, operation=EvtInfo_INV_RSLVR_COS_RNG_HI.GetEventTested
        OpEventGetEventTested_GetEventTested_Event_INV_RSLVR_COS_RNG_HI: start-on-event=DemSatellite_0InternalBehavior/GetEventTested, operation=Event_INV_RSLVR_COS_RNG_HI.GetEventTested
        OpEventGetEventTested_GetEventTested_EvtInfo_INV_IAC_U_ELEC_HI: start-on-event=DemSatellite_0InternalBehavior/GetEventTested, operation=EvtInfo_INV_IAC_U_ELEC_HI.GetEventTested
        OpEventGetEventTested_GetEventTested_Event_INV_IAC_U_ELEC_HI: start-on-event=DemSatellite_0InternalBehavior/GetEventTested, operation=Event_INV_IAC_U_ELEC_HI.GetEventTested
        OpEventGetEventTested_GetEventTested_EvtInfo_INV_IAC_V_RNG_LO: start-on-event=DemSatellite_0InternalBehavior/GetEventTested, operation=EvtInfo_INV_IAC_V_RNG_LO.GetEventTested
        OpEventGetEventTested_GetEventTested_Event_INV_IAC_V_RNG_LO: start-on-event=DemSatellite_0InternalBehavior/GetEventTested, operation=Event_INV_IAC_V_RNG_LO.GetEventTested
        OpEventGetEventTested_GetEventTested_EvtInfo_INV_IAC_U_RNG_HI: start-on-event=DemSatellite_0InternalBehavior/GetEventTested, operation=EvtInfo_INV_IAC_U_RNG_HI.GetEventTested
        OpEventGetEventTested_GetEventTested_Event_INV_IAC_U_RNG_HI: start-on-event=DemSatellite_0InternalBehavior/GetEventTested, operation=Event_INV_IAC_U_RNG_HI.GetEventTested
        OpEventGetEventTested_GetEventTested_EvtInfo_VCEvEcmPropFr25Tioutd: start-on-event=DemSatellite_0InternalBehavior/GetEventTested, operation=EvtInfo_VCEvEcmPropFr25Tioutd.GetEventTested
        OpEventGetEventTested_GetEventTested_Event_VCEvEcmPropFr25Tioutd: start-on-event=DemSatellite_0InternalBehavior/GetEventTested, operation=Event_VCEvEcmPropFr25Tioutd.GetEventTested
        OpEventGetEventTested_GetEventTested_EvtInfo_INV_IGBT_TEMP_W_RNG_LO: start-on-event=DemSatellite_0InternalBehavior/GetEventTested, operation=EvtInfo_INV_IGBT_TEMP_W_RNG_LO.GetEventTested
        OpEventGetEventTested_GetEventTested_Event_INV_IGBT_TEMP_W_RNG_LO: start-on-event=DemSatellite_0InternalBehavior/GetEventTested, operation=Event_INV_IGBT_TEMP_W_RNG_LO.GetEventTested
        OpEventGetEventTested_GetEventTested_EvtInfo_PSnsr_RNG_NOK: start-on-event=DemSatellite_0InternalBehavior/GetEventTested, operation=EvtInfo_PSnsr_RNG_NOK.GetEventTested
        OpEventGetEventTested_GetEventTested_Event_PSnsr_RNG_NOK: start-on-event=DemSatellite_0InternalBehavior/GetEventTested, operation=Event_PSnsr_RNG_NOK.GetEventTested
        OpEventGetEventTested_GetEventTested_EvtInfo_INV_RSLVR_COS_RNG_NOK: start-on-event=DemSatellite_0InternalBehavior/GetEventTested, operation=EvtInfo_INV_RSLVR_COS_RNG_NOK.GetEventTested
        OpEventGetEventTested_GetEventTested_Event_INV_RSLVR_COS_RNG_NOK: start-on-event=DemSatellite_0InternalBehavior/GetEventTested, operation=Event_INV_RSLVR_COS_RNG_NOK.GetEventTested
        OpEventGetEventTested_GetEventTested_EvtInfo_PS_DRVB_Fault: start-on-event=DemSatellite_0InternalBehavior/GetEventTested, operation=EvtInfo_PS_DRVB_Fault.GetEventTested
        OpEventGetEventTested_GetEventTested_Event_PS_DRVB_Fault: start-on-event=DemSatellite_0InternalBehavior/GetEventTested, operation=Event_PS_DRVB_Fault.GetEventTested
        OpEventGetEventTested_GetEventTested_EvtInfo_INV_CU_TEMP1_RNG_NOK: start-on-event=DemSatellite_0InternalBehavior/GetEventTested, operation=EvtInfo_INV_CU_TEMP1_RNG_NOK.GetEventTested
        OpEventGetEventTested_GetEventTested_Event_INV_CU_TEMP1_RNG_NOK: start-on-event=DemSatellite_0InternalBehavior/GetEventTested, operation=Event_INV_CU_TEMP1_RNG_NOK.GetEventTested
        OpEventGetEventTested_GetEventTested_EvtInfo_VcEvCntr: start-on-event=DemSatellite_0InternalBehavior/GetEventTested, operation=EvtInfo_VcEvCntr.GetEventTested
        OpEventGetEventTested_GetEventTested_Event_VcEvCntr: start-on-event=DemSatellite_0InternalBehavior/GetEventTested, operation=Event_VcEvCntr.GetEventTested
        OpEventGetEventTested_GetEventTested_EvtInfo_INV_RSLVR_SIN_AMP: start-on-event=DemSatellite_0InternalBehavior/GetEventTested, operation=EvtInfo_INV_RSLVR_SIN_AMP.GetEventTested
        OpEventGetEventTested_GetEventTested_Event_INV_RSLVR_SIN_AMP: start-on-event=DemSatellite_0InternalBehavior/GetEventTested, operation=Event_INV_RSLVR_SIN_AMP.GetEventTested
        OpEventGetEventTested_GetEventTested_EvtInfo_INV_UHVDC_2_RNG_HI: start-on-event=DemSatellite_0InternalBehavior/GetEventTested, operation=EvtInfo_INV_UHVDC_2_RNG_HI.GetEventTested
        OpEventGetEventTested_GetEventTested_Event_INV_UHVDC_2_RNG_HI: start-on-event=DemSatellite_0InternalBehavior/GetEventTested, operation=Event_INV_UHVDC_2_RNG_HI.GetEventTested
        OpEventGetEventTested_GetEventTested_EvtInfo_INV_IGBT_TEMP_U_GRDT: start-on-event=DemSatellite_0InternalBehavior/GetEventTested, operation=EvtInfo_INV_IGBT_TEMP_U_GRDT.GetEventTested
        OpEventGetEventTested_GetEventTested_Event_INV_IGBT_TEMP_U_GRDT: start-on-event=DemSatellite_0InternalBehavior/GetEventTested, operation=Event_INV_IGBT_TEMP_U_GRDT.GetEventTested
        OpEventGetEventTested_GetEventTested_EvtInfo_MON_TQ_PLAUS_PWR_MDL: start-on-event=DemSatellite_0InternalBehavior/GetEventTested, operation=EvtInfo_MON_TQ_PLAUS_PWR_MDL.GetEventTested
        OpEventGetEventTested_GetEventTested_Event_MON_TQ_PLAUS_PWR_MDL: start-on-event=DemSatellite_0InternalBehavior/GetEventTested, operation=Event_MON_TQ_PLAUS_PWR_MDL.GetEventTested
        OpEventGetEventTested_GetEventTested_EvtInfo_INV_IGBT_TEMP_W_PLAUS: start-on-event=DemSatellite_0InternalBehavior/GetEventTested, operation=EvtInfo_INV_IGBT_TEMP_W_PLAUS.GetEventTested
        OpEventGetEventTested_GetEventTested_Event_INV_IGBT_TEMP_W_PLAUS: start-on-event=DemSatellite_0InternalBehavior/GetEventTested, operation=Event_INV_IGBT_TEMP_W_PLAUS.GetEventTested
        OpEventGetEventTested_GetEventTested_EvtInfo_PS_BLDC_UV_FLT: start-on-event=DemSatellite_0InternalBehavior/GetEventTested, operation=EvtInfo_PS_BLDC_UV_FLT.GetEventTested
        OpEventGetEventTested_GetEventTested_Event_PS_BLDC_UV_FLT: start-on-event=DemSatellite_0InternalBehavior/GetEventTested, operation=Event_PS_BLDC_UV_FLT.GetEventTested
        OpEventGetEventTested_GetEventTested_EvtInfo_INV_IAC_V_OFFS: start-on-event=DemSatellite_0InternalBehavior/GetEventTested, operation=EvtInfo_INV_IAC_V_OFFS.GetEventTested
        OpEventGetEventTested_GetEventTested_Event_INV_IAC_V_OFFS: start-on-event=DemSatellite_0InternalBehavior/GetEventTested, operation=Event_INV_IAC_V_OFFS.GetEventTested
        OpEventGetEventTested_GetEventTested_EvtInfo_INV_RSLVR_EXCT_FREQ_RNG_NOK: start-on-event=DemSatellite_0InternalBehavior/GetEventTested, operation=EvtInfo_INV_RSLVR_EXCT_FREQ_RNG_NOK.GetEventTested
        OpEventGetEventTested_GetEventTested_Event_INV_RSLVR_EXCT_FREQ_RNG_NOK: start-on-event=DemSatellite_0InternalBehavior/GetEventTested, operation=Event_INV_RSLVR_EXCT_FREQ_RNG_NOK.GetEventTested
        OpEventGetEventTested_GetEventTested_EvtInfo_PS_KL30_RNG_LO: start-on-event=DemSatellite_0InternalBehavior/GetEventTested, operation=EvtInfo_PS_KL30_RNG_LO.GetEventTested
        OpEventGetEventTested_GetEventTested_Event_PS_KL30_RNG_LO: start-on-event=DemSatellite_0InternalBehavior/GetEventTested, operation=Event_PS_KL30_RNG_LO.GetEventTested
        OpEventGetEventTested_GetEventTested_EvtInfo_INV_RSLVR_COS_RNG_LO: start-on-event=DemSatellite_0InternalBehavior/GetEventTested, operation=EvtInfo_INV_RSLVR_COS_RNG_LO.GetEventTested
        OpEventGetEventTested_GetEventTested_Event_INV_RSLVR_COS_RNG_LO: start-on-event=DemSatellite_0InternalBehavior/GetEventTested, operation=Event_INV_RSLVR_COS_RNG_LO.GetEventTested
        OpEventGetEventTested_GetEventTested_EvtInfo_PSnsr_ELE_FLT: start-on-event=DemSatellite_0InternalBehavior/GetEventTested, operation=EvtInfo_PSnsr_ELE_FLT.GetEventTested
        OpEventGetEventTested_GetEventTested_Event_PSnsr_ELE_FLT: start-on-event=DemSatellite_0InternalBehavior/GetEventTested, operation=Event_PSnsr_ELE_FLT.GetEventTested
        OpEventGetEventTested_GetEventTested_EvtInfo_INV_RSLVR_SIN_COS_PLAUS_AMP: start-on-event=DemSatellite_0InternalBehavior/GetEventTested, operation=EvtInfo_INV_RSLVR_SIN_COS_PLAUS_AMP.GetEventTested
        OpEventGetEventTested_GetEventTested_Event_INV_RSLVR_SIN_COS_PLAUS_AMP: start-on-event=DemSatellite_0InternalBehavior/GetEventTested, operation=Event_INV_RSLVR_SIN_COS_PLAUS_AMP.GetEventTested
        OpEventGetEventTested_GetEventTested_EvtInfo_INV_IAC_U_ELEC_LO: start-on-event=DemSatellite_0InternalBehavior/GetEventTested, operation=EvtInfo_INV_IAC_U_ELEC_LO.GetEventTested
        OpEventGetEventTested_GetEventTested_Event_INV_IAC_U_ELEC_LO: start-on-event=DemSatellite_0InternalBehavior/GetEventTested, operation=Event_INV_IAC_U_ELEC_LO.GetEventTested
        OpEventGetEventTested_GetEventTested_EvtInfo_INV_RSLVR_EXCT_ELEC_HI: start-on-event=DemSatellite_0InternalBehavior/GetEventTested, operation=EvtInfo_INV_RSLVR_EXCT_ELEC_HI.GetEventTested
        OpEventGetEventTested_GetEventTested_Event_INV_RSLVR_EXCT_ELEC_HI: start-on-event=DemSatellite_0InternalBehavior/GetEventTested, operation=Event_INV_RSLVR_EXCT_ELEC_HI.GetEventTested
        OpEventGetEventTested_GetEventTested_EvtInfo_INV_IAC_U_RNG_LO: start-on-event=DemSatellite_0InternalBehavior/GetEventTested, operation=EvtInfo_INV_IAC_U_RNG_LO.GetEventTested
        OpEventGetEventTested_GetEventTested_Event_INV_IAC_U_RNG_LO: start-on-event=DemSatellite_0InternalBehavior/GetEventTested, operation=Event_INV_IAC_U_RNG_LO.GetEventTested
        OpEventGetEventTested_GetEventTested_EvtInfo_INV_IAC_V_RNG_HI: start-on-event=DemSatellite_0InternalBehavior/GetEventTested, operation=EvtInfo_INV_IAC_V_RNG_HI.GetEventTested
        OpEventGetEventTested_GetEventTested_Event_INV_IAC_V_RNG_HI: start-on-event=DemSatellite_0InternalBehavior/GetEventTested, operation=Event_INV_IAC_V_RNG_HI.GetEventTested
        OpEventGetEventTested_GetEventTested_EvtInfo_INV_IGBT_TEMP_U_PLAUS: start-on-event=DemSatellite_0InternalBehavior/GetEventTested, operation=EvtInfo_INV_IGBT_TEMP_U_PLAUS.GetEventTested
        OpEventGetEventTested_GetEventTested_Event_INV_IGBT_TEMP_U_PLAUS: start-on-event=DemSatellite_0InternalBehavior/GetEventTested, operation=Event_INV_IGBT_TEMP_U_PLAUS.GetEventTested
        OpEventGetEventTested_GetEventTested_EvtInfo_INV_RSLVR_OFFS_DFT: start-on-event=DemSatellite_0InternalBehavior/GetEventTested, operation=EvtInfo_INV_RSLVR_OFFS_DFT.GetEventTested
        OpEventGetEventTested_GetEventTested_Event_INV_RSLVR_OFFS_DFT: start-on-event=DemSatellite_0InternalBehavior/GetEventTested, operation=Event_INV_RSLVR_OFFS_DFT.GetEventTested
        OpEventGetEventTested_GetEventTested_EvtInfo_Ga_MoveOverThd: start-on-event=DemSatellite_0InternalBehavior/GetEventTested, operation=EvtInfo_Ga_MoveOverThd.GetEventTested
        OpEventGetEventTested_GetEventTested_Event_Ga_MoveOverThd: start-on-event=DemSatellite_0InternalBehavior/GetEventTested, operation=Event_Ga_MoveOverThd.GetEventTested
        OpEventGetEventTested_GetEventTested_EvtInfo_VcEvMonIPH: start-on-event=DemSatellite_0InternalBehavior/GetEventTested, operation=EvtInfo_VcEvMonIPH.GetEventTested
        OpEventGetEventTested_GetEventTested_Event_VcEvMonIPH: start-on-event=DemSatellite_0InternalBehavior/GetEventTested, operation=Event_VcEvMonIPH.GetEventTested
        OpEventGetEventTested_GetEventTested_EvtInfo_INV_RSLVR_HW_FLT: start-on-event=DemSatellite_0InternalBehavior/GetEventTested, operation=EvtInfo_INV_RSLVR_HW_FLT.GetEventTested
        OpEventGetEventTested_GetEventTested_Event_INV_RSLVR_HW_FLT: start-on-event=DemSatellite_0InternalBehavior/GetEventTested, operation=Event_INV_RSLVR_HW_FLT.GetEventTested
        OpEventGetEventTested_GetEventTested_EvtInfo_INV_RSLVR_SIN_ELEC_LO: start-on-event=DemSatellite_0InternalBehavior/GetEventTested, operation=EvtInfo_INV_RSLVR_SIN_ELEC_LO.GetEventTested
        OpEventGetEventTested_GetEventTested_Event_INV_RSLVR_SIN_ELEC_LO: start-on-event=DemSatellite_0InternalBehavior/GetEventTested, operation=Event_INV_RSLVR_SIN_ELEC_LO.GetEventTested
        OpEventGetEventTested_GetEventTested_EvtInfo_INV_IAC_W_AMP: start-on-event=DemSatellite_0InternalBehavior/GetEventTested, operation=EvtInfo_INV_IAC_W_AMP.GetEventTested
        OpEventGetEventTested_GetEventTested_Event_INV_IAC_W_AMP: start-on-event=DemSatellite_0InternalBehavior/GetEventTested, operation=Event_INV_IAC_W_AMP.GetEventTested
        OpEventGetEventTested_GetEventTested_EvtInfo_VCC_OverVoltage: start-on-event=DemSatellite_0InternalBehavior/GetEventTested, operation=EvtInfo_VCC_OverVoltage.GetEventTested
        OpEventGetEventTested_GetEventTested_Event_VCC_OverVoltage: start-on-event=DemSatellite_0InternalBehavior/GetEventTested, operation=Event_VCC_OverVoltage.GetEventTested
        OpEventGetEventTested_GetEventTested_EvtInfo_PS_BLDC_OV_FLT: start-on-event=DemSatellite_0InternalBehavior/GetEventTested, operation=EvtInfo_PS_BLDC_OV_FLT.GetEventTested
        OpEventGetEventTested_GetEventTested_Event_PS_BLDC_OV_FLT: start-on-event=DemSatellite_0InternalBehavior/GetEventTested, operation=Event_PS_BLDC_OV_FLT.GetEventTested
        OpEventGetEventTested_GetEventTested_EvtInfo_AURIX_EEPROM_FLT: start-on-event=DemSatellite_0InternalBehavior/GetEventTested, operation=EvtInfo_AURIX_EEPROM_FLT.GetEventTested
        OpEventGetEventTested_GetEventTested_Event_AURIX_EEPROM_FLT: start-on-event=DemSatellite_0InternalBehavior/GetEventTested, operation=Event_AURIX_EEPROM_FLT.GetEventTested
        OpEventGetEventTested_GetEventTested_EvtInfo_FS_MONITIOR_ASC_FW_FLT: start-on-event=DemSatellite_0InternalBehavior/GetEventTested, operation=EvtInfo_FS_MONITIOR_ASC_FW_FLT.GetEventTested
        OpEventGetEventTested_GetEventTested_Event_FS_MONITIOR_ASC_FW_FLT: start-on-event=DemSatellite_0InternalBehavior/GetEventTested, operation=Event_FS_MONITIOR_ASC_FW_FLT.GetEventTested
        OpEventGetEventTested_GetEventTested_EvtInfo_VCEvSrsPropFr02Tioutd: start-on-event=DemSatellite_0InternalBehavior/GetEventTested, operation=EvtInfo_VCEvSrsPropFr02Tioutd.GetEventTested
        OpEventGetEventTested_GetEventTested_Event_VCEvSrsPropFr02Tioutd: start-on-event=DemSatellite_0InternalBehavior/GetEventTested, operation=Event_VCEvSrsPropFr02Tioutd.GetEventTested
        OpEventGetEventTested_GetEventTested_EvtInfo_VcEvMonErrMode: start-on-event=DemSatellite_0InternalBehavior/GetEventTested, operation=EvtInfo_VcEvMonErrMode.GetEventTested
        OpEventGetEventTested_GetEventTested_Event_VcEvMonErrMode: start-on-event=DemSatellite_0InternalBehavior/GetEventTested, operation=Event_VcEvMonErrMode.GetEventTested
        OpEventGetEventTested_GetEventTested_EvtInfo_AURIX_RST_MPL: start-on-event=DemSatellite_0InternalBehavior/GetEventTested, operation=EvtInfo_AURIX_RST_MPL.GetEventTested
        OpEventGetEventTested_GetEventTested_Event_AURIX_RST_MPL: start-on-event=DemSatellite_0InternalBehavior/GetEventTested, operation=Event_AURIX_RST_MPL.GetEventTested
        OpEventGetEventTested_GetEventTested_EvtInfo_VcEvNodeMisECM: start-on-event=DemSatellite_0InternalBehavior/GetEventTested, operation=EvtInfo_VcEvNodeMisECM.GetEventTested
        OpEventGetEventTested_GetEventTested_Event_VcEvNodeMisECM: start-on-event=DemSatellite_0InternalBehavior/GetEventTested, operation=Event_VcEvNodeMisECM.GetEventTested
        OpEventGetEventTested_GetEventTested_EvtInfo_PS_KL30_PLAUS: start-on-event=DemSatellite_0InternalBehavior/GetEventTested, operation=EvtInfo_PS_KL30_PLAUS.GetEventTested
        OpEventGetEventTested_GetEventTested_Event_PS_KL30_PLAUS: start-on-event=DemSatellite_0InternalBehavior/GetEventTested, operation=Event_PS_KL30_PLAUS.GetEventTested
        OpEventGetEventTested_GetEventTested_EvtInfo_INV_IAC_W_ELEC_HI: start-on-event=DemSatellite_0InternalBehavior/GetEventTested, operation=EvtInfo_INV_IAC_W_ELEC_HI.GetEventTested
        OpEventGetEventTested_GetEventTested_Event_INV_IAC_W_ELEC_HI: start-on-event=DemSatellite_0InternalBehavior/GetEventTested, operation=Event_INV_IAC_W_ELEC_HI.GetEventTested
        OpEventGetEventTested_GetEventTested_EvtInfo_VCEvVddmPropFr19Tioutd: start-on-event=DemSatellite_0InternalBehavior/GetEventTested, operation=EvtInfo_VCEvVddmPropFr19Tioutd.GetEventTested
        OpEventGetEventTested_GetEventTested_Event_VCEvVddmPropFr19Tioutd: start-on-event=DemSatellite_0InternalBehavior/GetEventTested, operation=Event_VCEvVddmPropFr19Tioutd.GetEventTested
        OpEventGetEventTested_GetEventTested_EvtInfo_INV_TEMP_DCHA_HW: start-on-event=DemSatellite_0InternalBehavior/GetEventTested, operation=EvtInfo_INV_TEMP_DCHA_HW.GetEventTested
        OpEventGetEventTested_GetEventTested_Event_INV_TEMP_DCHA_HW: start-on-event=DemSatellite_0InternalBehavior/GetEventTested, operation=Event_INV_TEMP_DCHA_HW.GetEventTested
        OpEventGetEventTested_GetEventTested_EvtInfo_VcEvPropCANGlbTiOutd: start-on-event=DemSatellite_0InternalBehavior/GetEventTested, operation=EvtInfo_VcEvPropCANGlbTiOutd.GetEventTested
        OpEventGetEventTested_GetEventTested_Event_VcEvPropCANGlbTiOutd: start-on-event=DemSatellite_0InternalBehavior/GetEventTested, operation=Event_VcEvPropCANGlbTiOutd.GetEventTested
        OpEventGetEventTested_GetEventTested_EvtInfo_INV_EM_STATOR_TEMP2_RNG_NOK: start-on-event=DemSatellite_0InternalBehavior/GetEventTested, operation=EvtInfo_INV_EM_STATOR_TEMP2_RNG_NOK.GetEventTested
        OpEventGetEventTested_GetEventTested_Event_INV_EM_STATOR_TEMP2_RNG_NOK: start-on-event=DemSatellite_0InternalBehavior/GetEventTested, operation=Event_INV_EM_STATOR_TEMP2_RNG_NOK.GetEventTested
        OpEventGetEventTested_GetEventTested_EvtInfo_INV_UHVDC_OV_HWP: start-on-event=DemSatellite_0InternalBehavior/GetEventTested, operation=EvtInfo_INV_UHVDC_OV_HWP.GetEventTested
        OpEventGetEventTested_GetEventTested_Event_INV_UHVDC_OV_HWP: start-on-event=DemSatellite_0InternalBehavior/GetEventTested, operation=Event_INV_UHVDC_OV_HWP.GetEventTested
        OpEventGetEventTested_GetEventTested_EvtInfo_Ga_FindEngleAngleFailed: start-on-event=DemSatellite_0InternalBehavior/GetEventTested, operation=EvtInfo_Ga_FindEngleAngleFailed.GetEventTested
        OpEventGetEventTested_GetEventTested_Event_Ga_FindEngleAngleFailed: start-on-event=DemSatellite_0InternalBehavior/GetEventTested, operation=Event_Ga_FindEngleAngleFailed.GetEventTested
        OpEventGetEventTested_GetEventTested_EvtInfo_VcEvMonTrqCmp: start-on-event=DemSatellite_0InternalBehavior/GetEventTested, operation=EvtInfo_VcEvMonTrqCmp.GetEventTested
        OpEventGetEventTested_GetEventTested_Event_VcEvMonTrqCmp: start-on-event=DemSatellite_0InternalBehavior/GetEventTested, operation=Event_VcEvMonTrqCmp.GetEventTested
        OpEventGetEventTested_GetEventTested_EvtInfo_INV_IGBT_TEMP_V_RNG_LO: start-on-event=DemSatellite_0InternalBehavior/GetEventTested, operation=EvtInfo_INV_IGBT_TEMP_V_RNG_LO.GetEventTested
        OpEventGetEventTested_GetEventTested_Event_INV_IGBT_TEMP_V_RNG_LO: start-on-event=DemSatellite_0InternalBehavior/GetEventTested, operation=Event_INV_IGBT_TEMP_V_RNG_LO.GetEventTested
        OpEventGetEventTested_GetEventTested_EvtInfo_INV_CONTROL_LIMIT: start-on-event=DemSatellite_0InternalBehavior/GetEventTested, operation=EvtInfo_INV_CONTROL_LIMIT.GetEventTested
        OpEventGetEventTested_GetEventTested_Event_INV_CONTROL_LIMIT: start-on-event=DemSatellite_0InternalBehavior/GetEventTested, operation=Event_INV_CONTROL_LIMIT.GetEventTested
        OpEventGetEventTested_GetEventTested_EvtInfo_COM_CarConfigErr: start-on-event=DemSatellite_0InternalBehavior/GetEventTested, operation=EvtInfo_COM_CarConfigErr.GetEventTested
        OpEventGetEventTested_GetEventTested_Event_COM_CarConfigErr: start-on-event=DemSatellite_0InternalBehavior/GetEventTested, operation=Event_COM_CarConfigErr.GetEventTested
        OpEventGetEventTested_GetEventTested_EvtInfo_VCEvEcmPropFr08Tioutd: start-on-event=DemSatellite_0InternalBehavior/GetEventTested, operation=EvtInfo_VCEvEcmPropFr08Tioutd.GetEventTested
        OpEventGetEventTested_GetEventTested_Event_VCEvEcmPropFr08Tioutd: start-on-event=DemSatellite_0InternalBehavior/GetEventTested, operation=Event_VCEvEcmPropFr08Tioutd.GetEventTested
        OpEventGetEventTested_GetEventTested_EvtInfo_CU_TEMP1_RNG_LO: start-on-event=DemSatellite_0InternalBehavior/GetEventTested, operation=EvtInfo_CU_TEMP1_RNG_LO.GetEventTested
        OpEventGetEventTested_GetEventTested_Event_CU_TEMP1_RNG_LO: start-on-event=DemSatellite_0InternalBehavior/GetEventTested, operation=Event_CU_TEMP1_RNG_LO.GetEventTested
        OpEventGetEventTested_GetEventTested_EvtInfo_INV_EM_STATOR_TEMP2_RNG_SWT: start-on-event=DemSatellite_0InternalBehavior/GetEventTested, operation=EvtInfo_INV_EM_STATOR_TEMP2_RNG_SWT.GetEventTested
        OpEventGetEventTested_GetEventTested_Event_INV_EM_STATOR_TEMP2_RNG_SWT: start-on-event=DemSatellite_0InternalBehavior/GetEventTested, operation=Event_INV_EM_STATOR_TEMP2_RNG_SWT.GetEventTested
        OpEventGetEventTested_GetEventTested_EvtInfo_GA_BLDC_POS_FLT: start-on-event=DemSatellite_0InternalBehavior/GetEventTested, operation=EvtInfo_GA_BLDC_POS_FLT.GetEventTested
        OpEventGetEventTested_GetEventTested_Event_GA_BLDC_POS_FLT: start-on-event=DemSatellite_0InternalBehavior/GetEventTested, operation=Event_GA_BLDC_POS_FLT.GetEventTested
        OpEventGetEventTested_GetEventTested_EvtInfo_PS_WhlSnsr_FLT: start-on-event=DemSatellite_0InternalBehavior/GetEventTested, operation=EvtInfo_PS_WhlSnsr_FLT.GetEventTested
        OpEventGetEventTested_GetEventTested_Event_PS_WhlSnsr_FLT: start-on-event=DemSatellite_0InternalBehavior/GetEventTested, operation=Event_PS_WhlSnsr_FLT.GetEventTested
        OpEventGetEventTested_GetEventTested_EvtInfo_INV_EM_STATOR_TEMP_RNG_LO: start-on-event=DemSatellite_0InternalBehavior/GetEventTested, operation=EvtInfo_INV_EM_STATOR_TEMP_RNG_LO.GetEventTested
        OpEventGetEventTested_GetEventTested_Event_INV_EM_STATOR_TEMP_RNG_LO: start-on-event=DemSatellite_0InternalBehavior/GetEventTested, operation=Event_INV_EM_STATOR_TEMP_RNG_LO.GetEventTested
        OpEventGetEventTested_GetEventTested_EvtInfo_INV_RSLVR_SIN_ELEC_HI: start-on-event=DemSatellite_0InternalBehavior/GetEventTested, operation=EvtInfo_INV_RSLVR_SIN_ELEC_HI.GetEventTested
        OpEventGetEventTested_GetEventTested_Event_INV_RSLVR_SIN_ELEC_HI: start-on-event=DemSatellite_0InternalBehavior/GetEventTested, operation=Event_INV_RSLVR_SIN_ELEC_HI.GetEventTested
        OpEventGetEventTested_GetEventTested_EvtInfo_INV_RSLVR_SIN_COS_PLAUS: start-on-event=DemSatellite_0InternalBehavior/GetEventTested, operation=EvtInfo_INV_RSLVR_SIN_COS_PLAUS.GetEventTested
        OpEventGetEventTested_GetEventTested_Event_INV_RSLVR_SIN_COS_PLAUS: start-on-event=DemSatellite_0InternalBehavior/GetEventTested, operation=Event_INV_RSLVR_SIN_COS_PLAUS.GetEventTested
        OpEventGetEventTested_GetEventTested_EvtInfo_INV_RSLVR_COS_AMP: start-on-event=DemSatellite_0InternalBehavior/GetEventTested, operation=EvtInfo_INV_RSLVR_COS_AMP.GetEventTested
        OpEventGetEventTested_GetEventTested_Event_INV_RSLVR_COS_AMP: start-on-event=DemSatellite_0InternalBehavior/GetEventTested, operation=Event_INV_RSLVR_COS_AMP.GetEventTested
        OpEventGetEventTested_GetEventTested_EvtInfo_INV_GATE_DRVR_BOT_HWP: start-on-event=DemSatellite_0InternalBehavior/GetEventTested, operation=EvtInfo_INV_GATE_DRVR_BOT_HWP.GetEventTested
        OpEventGetEventTested_GetEventTested_Event_INV_GATE_DRVR_BOT_HWP: start-on-event=DemSatellite_0InternalBehavior/GetEventTested, operation=Event_INV_GATE_DRVR_BOT_HWP.GetEventTested
        OpEventGetEventTested_GetEventTested_EvtInfo_Eg_HallVolWrong: start-on-event=DemSatellite_0InternalBehavior/GetEventTested, operation=EvtInfo_Eg_HallVolWrong.GetEventTested
        OpEventGetEventTested_GetEventTested_Event_Eg_HallVolWrong: start-on-event=DemSatellite_0InternalBehavior/GetEventTested, operation=Event_Eg_HallVolWrong.GetEventTested
        OpEventGetEventTested_GetEventTested_EvtInfo_INV_RSLVR_EXCT_RNG_NOK: start-on-event=DemSatellite_0InternalBehavior/GetEventTested, operation=EvtInfo_INV_RSLVR_EXCT_RNG_NOK.GetEventTested
        OpEventGetEventTested_GetEventTested_Event_INV_RSLVR_EXCT_RNG_NOK: start-on-event=DemSatellite_0InternalBehavior/GetEventTested, operation=Event_INV_RSLVR_EXCT_RNG_NOK.GetEventTested
        OpEventGetEventTested_GetEventTested_EvtInfo_PA_OpenCirc: start-on-event=DemSatellite_0InternalBehavior/GetEventTested, operation=EvtInfo_PA_OpenCirc.GetEventTested
        OpEventGetEventTested_GetEventTested_Event_PA_OpenCirc: start-on-event=DemSatellite_0InternalBehavior/GetEventTested, operation=Event_PA_OpenCirc.GetEventTested
        OpEventGetEventTested_GetEventTested_EvtInfo_INV_RSLVR_COS_ELEC_HI: start-on-event=DemSatellite_0InternalBehavior/GetEventTested, operation=EvtInfo_INV_RSLVR_COS_ELEC_HI.GetEventTested
        OpEventGetEventTested_GetEventTested_Event_INV_RSLVR_COS_ELEC_HI: start-on-event=DemSatellite_0InternalBehavior/GetEventTested, operation=Event_INV_RSLVR_COS_ELEC_HI.GetEventTested
        OpEventGetEventTested_GetEventTested_EvtInfo_VcEvCntrHvSysRlySts: start-on-event=DemSatellite_0InternalBehavior/GetEventTested, operation=EvtInfo_VcEvCntrHvSysRlySts.GetEventTested
        OpEventGetEventTested_GetEventTested_Event_VcEvCntrHvSysRlySts: start-on-event=DemSatellite_0InternalBehavior/GetEventTested, operation=Event_VcEvCntrHvSysRlySts.GetEventTested
        OpEventGetEventTested_GetEventTested_EvtInfo_CRASH_DTC: start-on-event=DemSatellite_0InternalBehavior/GetEventTested, operation=EvtInfo_CRASH_DTC.GetEventTested
        OpEventGetEventTested_GetEventTested_Event_CRASH_DTC: start-on-event=DemSatellite_0InternalBehavior/GetEventTested, operation=Event_CRASH_DTC.GetEventTested
        OpEventGetEventTested_GetEventTested_EvtInfo_INV_IGBT_TEMP_W_RNG_HI: start-on-event=DemSatellite_0InternalBehavior/GetEventTested, operation=EvtInfo_INV_IGBT_TEMP_W_RNG_HI.GetEventTested
        OpEventGetEventTested_GetEventTested_Event_INV_IGBT_TEMP_W_RNG_HI: start-on-event=DemSatellite_0InternalBehavior/GetEventTested, operation=Event_INV_IGBT_TEMP_W_RNG_HI.GetEventTested
        OpEventGetEventTested_GetEventTested_EvtInfo_VCEvBecmPropFr02Tioutd: start-on-event=DemSatellite_0InternalBehavior/GetEventTested, operation=EvtInfo_VCEvBecmPropFr02Tioutd.GetEventTested
        OpEventGetEventTested_GetEventTested_Event_VCEvBecmPropFr02Tioutd: start-on-event=DemSatellite_0InternalBehavior/GetEventTested, operation=Event_VCEvBecmPropFr02Tioutd.GetEventTested
        OpEventGetEventTested_GetEventTested_EvtInfo_INV_IGBT_TEMP_W_GRDT: start-on-event=DemSatellite_0InternalBehavior/GetEventTested, operation=EvtInfo_INV_IGBT_TEMP_W_GRDT.GetEventTested
        OpEventGetEventTested_GetEventTested_Event_INV_IGBT_TEMP_W_GRDT: start-on-event=DemSatellite_0InternalBehavior/GetEventTested, operation=Event_INV_IGBT_TEMP_W_GRDT.GetEventTested
        OpEventGetEventTested_GetEventTested_EvtInfo_EXT_UC_SPI_FLT: start-on-event=DemSatellite_0InternalBehavior/GetEventTested, operation=EvtInfo_EXT_UC_SPI_FLT.GetEventTested
        OpEventGetEventTested_GetEventTested_Event_EXT_UC_SPI_FLT: start-on-event=DemSatellite_0InternalBehavior/GetEventTested, operation=Event_EXT_UC_SPI_FLT.GetEventTested
        OpEventGetEventTested_GetEventTested_EvtInfo_INV_IAC_V_ELEC_HWP_001: start-on-event=DemSatellite_0InternalBehavior/GetEventTested, operation=EvtInfo_INV_IAC_V_ELEC_HWP_001.GetEventTested
        OpEventGetEventTested_GetEventTested_Event_INV_IAC_V_ELEC_HWP_001: start-on-event=DemSatellite_0InternalBehavior/GetEventTested, operation=Event_INV_IAC_V_ELEC_HWP_001.GetEventTested
        OpEventGetEventTested_GetEventTested_EvtInfo_VcEvChkSumWhlMotSysTqAllwd: start-on-event=DemSatellite_0InternalBehavior/GetEventTested, operation=EvtInfo_VcEvChkSumWhlMotSysTqAllwd.GetEventTested
        OpEventGetEventTested_GetEventTested_Event_VcEvChkSumWhlMotSysTqAllwd: start-on-event=DemSatellite_0InternalBehavior/GetEventTested, operation=Event_VcEvChkSumWhlMotSysTqAllwd.GetEventTested
        OpEventGetEventTested_GetEventTested_EvtInfo_FS_MONITIOR_ASC_FLT: start-on-event=DemSatellite_0InternalBehavior/GetEventTested, operation=EvtInfo_FS_MONITIOR_ASC_FLT.GetEventTested
        OpEventGetEventTested_GetEventTested_Event_FS_MONITIOR_ASC_FLT: start-on-event=DemSatellite_0InternalBehavior/GetEventTested, operation=Event_FS_MONITIOR_ASC_FLT.GetEventTested
        OpEventGetEventTested_GetEventTested_EvtInfo_INV_IAC_V_AMP: start-on-event=DemSatellite_0InternalBehavior/GetEventTested, operation=EvtInfo_INV_IAC_V_AMP.GetEventTested
        OpEventGetEventTested_GetEventTested_Event_INV_IAC_V_AMP: start-on-event=DemSatellite_0InternalBehavior/GetEventTested, operation=Event_INV_IAC_V_AMP.GetEventTested
        OpEventGetEventTested_GetEventTested_EvtInfo_INV_IAC_W_ELEC_LO: start-on-event=DemSatellite_0InternalBehavior/GetEventTested, operation=EvtInfo_INV_IAC_W_ELEC_LO.GetEventTested
        OpEventGetEventTested_GetEventTested_Event_INV_IAC_W_ELEC_LO: start-on-event=DemSatellite_0InternalBehavior/GetEventTested, operation=Event_INV_IAC_W_ELEC_LO.GetEventTested
        OpEventGetEventTested_GetEventTested_EvtInfo_VCEvVddmPropFr08Tioutd_001: start-on-event=DemSatellite_0InternalBehavior/GetEventTested, operation=EvtInfo_VCEvVddmPropFr08Tioutd_001.GetEventTested
        OpEventGetEventTested_GetEventTested_Event_VCEvVddmPropFr08Tioutd_001: start-on-event=DemSatellite_0InternalBehavior/GetEventTested, operation=Event_VCEvVddmPropFr08Tioutd_001.GetEventTested
        OpEventGetEventTested_GetEventTested_EvtInfo_PS_P12_RES_FLT: start-on-event=DemSatellite_0InternalBehavior/GetEventTested, operation=EvtInfo_PS_P12_RES_FLT.GetEventTested
        OpEventGetEventTested_GetEventTested_Event_PS_P12_RES_FLT: start-on-event=DemSatellite_0InternalBehavior/GetEventTested, operation=Event_PS_P12_RES_FLT.GetEventTested
        OpEventGetEventTested_GetEventTested_EvtInfo_INV_RSLVR_SIN_RNG_LO: start-on-event=DemSatellite_0InternalBehavior/GetEventTested, operation=EvtInfo_INV_RSLVR_SIN_RNG_LO.GetEventTested
        OpEventGetEventTested_GetEventTested_Event_INV_RSLVR_SIN_RNG_LO: start-on-event=DemSatellite_0InternalBehavior/GetEventTested, operation=Event_INV_RSLVR_SIN_RNG_LO.GetEventTested
        OpEventGetEventTested_GetEventTested_EvtInfo_CU_TEMP_HW_FLT: start-on-event=DemSatellite_0InternalBehavior/GetEventTested, operation=EvtInfo_CU_TEMP_HW_FLT.GetEventTested
        OpEventGetEventTested_GetEventTested_Event_CU_TEMP_HW_FLT: start-on-event=DemSatellite_0InternalBehavior/GetEventTested, operation=Event_CU_TEMP_HW_FLT.GetEventTested
        OpEventGetEventTested_GetEventTested_EvtInfo_VCEvEcmPropFr02MgmFr00Tioutd: start-on-event=DemSatellite_0InternalBehavior/GetEventTested, operation=EvtInfo_VCEvEcmPropFr02MgmFr00Tioutd.GetEventTested
        OpEventGetEventTested_GetEventTested_Event_VCEvEcmPropFr02MgmFr00Tioutd: start-on-event=DemSatellite_0InternalBehavior/GetEventTested, operation=Event_VCEvEcmPropFr02MgmFr00Tioutd.GetEventTested
        OpEventGetEventTested_GetEventTested_EvtInfo_PS_KL15_RNG_HI: start-on-event=DemSatellite_0InternalBehavior/GetEventTested, operation=EvtInfo_PS_KL15_RNG_HI.GetEventTested
        OpEventGetEventTested_GetEventTested_Event_PS_KL15_RNG_HI: start-on-event=DemSatellite_0InternalBehavior/GetEventTested, operation=Event_PS_KL15_RNG_HI.GetEventTested
        OpEventGetEventTested_GetEventTested_EvtInfo_VCEvVddmPropFr17Tioutd: start-on-event=DemSatellite_0InternalBehavior/GetEventTested, operation=EvtInfo_VCEvVddmPropFr17Tioutd.GetEventTested
        OpEventGetEventTested_GetEventTested_Event_VCEvVddmPropFr17Tioutd: start-on-event=DemSatellite_0InternalBehavior/GetEventTested, operation=Event_VCEvVddmPropFr17Tioutd.GetEventTested
        OpEventGetEventTested_GetEventTested_EvtInfo_VcEvChkSumCrashStsSafe: start-on-event=DemSatellite_0InternalBehavior/GetEventTested, operation=EvtInfo_VcEvChkSumCrashStsSafe.GetEventTested
        OpEventGetEventTested_GetEventTested_Event_VcEvChkSumCrashStsSafe: start-on-event=DemSatellite_0InternalBehavior/GetEventTested, operation=Event_VcEvChkSumCrashStsSafe.GetEventTested
        OpEventGetEventTested_GetEventTested_EvtInfo_DiagC_ClutchService: start-on-event=DemSatellite_0InternalBehavior/GetEventTested, operation=EvtInfo_DiagC_ClutchService.GetEventTested
        OpEventGetEventTested_GetEventTested_Event_DiagC_ClutchService: start-on-event=DemSatellite_0InternalBehavior/GetEventTested, operation=Event_DiagC_ClutchService.GetEventTested
        OpEventGetEventTested_GetEventTested_EvtInfo_INV_EM_STATOR_TEMP_RNG_HI: start-on-event=DemSatellite_0InternalBehavior/GetEventTested, operation=EvtInfo_INV_EM_STATOR_TEMP_RNG_HI.GetEventTested
        OpEventGetEventTested_GetEventTested_Event_INV_EM_STATOR_TEMP_RNG_HI: start-on-event=DemSatellite_0InternalBehavior/GetEventTested, operation=Event_INV_EM_STATOR_TEMP_RNG_HI.GetEventTested
        OpEventGetEventTested_GetEventTested_EvtInfo_INV_RSLVR_OFFS_OUT_RANG: start-on-event=DemSatellite_0InternalBehavior/GetEventTested, operation=EvtInfo_INV_RSLVR_OFFS_OUT_RANG.GetEventTested
        OpEventGetEventTested_GetEventTested_Event_INV_RSLVR_OFFS_OUT_RANG: start-on-event=DemSatellite_0InternalBehavior/GetEventTested, operation=Event_INV_RSLVR_OFFS_OUT_RANG.GetEventTested
        OpEventGetEventTested_GetEventTested_EvtInfo_INV_EM_STATOR_TEMP2_RNG_LO: start-on-event=DemSatellite_0InternalBehavior/GetEventTested, operation=EvtInfo_INV_EM_STATOR_TEMP2_RNG_LO.GetEventTested
        OpEventGetEventTested_GetEventTested_Event_INV_EM_STATOR_TEMP2_RNG_LO: start-on-event=DemSatellite_0InternalBehavior/GetEventTested, operation=Event_INV_EM_STATOR_TEMP2_RNG_LO.GetEventTested
        OpEventGetEventTested_GetEventTested_EvtInfo_VcEvMonISAR: start-on-event=DemSatellite_0InternalBehavior/GetEventTested, operation=EvtInfo_VcEvMonISAR.GetEventTested
        OpEventGetEventTested_GetEventTested_Event_VcEvMonISAR: start-on-event=DemSatellite_0InternalBehavior/GetEventTested, operation=Event_VcEvMonISAR.GetEventTested
        OpEventGetEventTested_GetEventTested_EvtInfo_GA_BLDC_FLT: start-on-event=DemSatellite_0InternalBehavior/GetEventTested, operation=EvtInfo_GA_BLDC_FLT.GetEventTested
        OpEventGetEventTested_GetEventTested_Event_GA_BLDC_FLT: start-on-event=DemSatellite_0InternalBehavior/GetEventTested, operation=Event_GA_BLDC_FLT.GetEventTested
        OpEventGetEventTested_GetEventTested_EvtInfo_INV_RSLVR_EXCT_ELEC_OPEN: start-on-event=DemSatellite_0InternalBehavior/GetEventTested, operation=EvtInfo_INV_RSLVR_EXCT_ELEC_OPEN.GetEventTested
        OpEventGetEventTested_GetEventTested_Event_INV_RSLVR_EXCT_ELEC_OPEN: start-on-event=DemSatellite_0InternalBehavior/GetEventTested, operation=Event_INV_RSLVR_EXCT_ELEC_OPEN.GetEventTested
        OpEventGetEventTested_GetEventTested_EvtInfo_INV_RSLVR_EXCT_PLAUS: start-on-event=DemSatellite_0InternalBehavior/GetEventTested, operation=EvtInfo_INV_RSLVR_EXCT_PLAUS.GetEventTested
        OpEventGetEventTested_GetEventTested_Event_INV_RSLVR_EXCT_PLAUS: start-on-event=DemSatellite_0InternalBehavior/GetEventTested, operation=Event_INV_RSLVR_EXCT_PLAUS.GetEventTested
        OpEventGetEventTested_GetEventTested_EvtInfo_PS_P15_U_FLT: start-on-event=DemSatellite_0InternalBehavior/GetEventTested, operation=EvtInfo_PS_P15_U_FLT.GetEventTested
        OpEventGetEventTested_GetEventTested_Event_PS_P15_U_FLT: start-on-event=DemSatellite_0InternalBehavior/GetEventTested, operation=Event_PS_P15_U_FLT.GetEventTested
        OpEventGetEventTested_GetEventTested_EvtInfo_INV_EM_STATOR_TEMP_RNG_SWT: start-on-event=DemSatellite_0InternalBehavior/GetEventTested, operation=EvtInfo_INV_EM_STATOR_TEMP_RNG_SWT.GetEventTested
        OpEventGetEventTested_GetEventTested_Event_INV_EM_STATOR_TEMP_RNG_SWT: start-on-event=DemSatellite_0InternalBehavior/GetEventTested, operation=Event_INV_EM_STATOR_TEMP_RNG_SWT.GetEventTested
        OpEventGetEventTested_GetEventTested_EvtInfo_INV_UHVDC_OV_SWP: start-on-event=DemSatellite_0InternalBehavior/GetEventTested, operation=EvtInfo_INV_UHVDC_OV_SWP.GetEventTested
        OpEventGetEventTested_GetEventTested_Event_INV_UHVDC_OV_SWP: start-on-event=DemSatellite_0InternalBehavior/GetEventTested, operation=Event_INV_UHVDC_OV_SWP.GetEventTested
        OpEventGetEventTested_GetEventTested_EvtInfo_AURIX_HW_FLT: start-on-event=DemSatellite_0InternalBehavior/GetEventTested, operation=EvtInfo_AURIX_HW_FLT.GetEventTested
        OpEventGetEventTested_GetEventTested_Event_AURIX_HW_FLT: start-on-event=DemSatellite_0InternalBehavior/GetEventTested, operation=Event_AURIX_HW_FLT.GetEventTested
        OpEventGetEventTested_GetEventTested_EvtInfo_INV_GATE_DRVR_TOP_HWP: start-on-event=DemSatellite_0InternalBehavior/GetEventTested, operation=EvtInfo_INV_GATE_DRVR_TOP_HWP.GetEventTested
        OpEventGetEventTested_GetEventTested_Event_INV_GATE_DRVR_TOP_HWP: start-on-event=DemSatellite_0InternalBehavior/GetEventTested, operation=Event_INV_GATE_DRVR_TOP_HWP.GetEventTested
        OpEventGetEventTested_GetEventTested_EvtInfo_INV_ACTV_DCHA_HW: start-on-event=DemSatellite_0InternalBehavior/GetEventTested, operation=EvtInfo_INV_ACTV_DCHA_HW.GetEventTested
        OpEventGetEventTested_GetEventTested_Event_INV_ACTV_DCHA_HW: start-on-event=DemSatellite_0InternalBehavior/GetEventTested, operation=Event_INV_ACTV_DCHA_HW.GetEventTested
        OpEventGetEventTested_GetEventTested_EvtInfo_INV_IGBT_TEMP_HWP: start-on-event=DemSatellite_0InternalBehavior/GetEventTested, operation=EvtInfo_INV_IGBT_TEMP_HWP.GetEventTested
        OpEventGetEventTested_GetEventTested_Event_INV_IGBT_TEMP_HWP: start-on-event=DemSatellite_0InternalBehavior/GetEventTested, operation=Event_INV_IGBT_TEMP_HWP.GetEventTested
        OpEventGetEventTested_GetEventTested_EvtInfo_INV_RSLVR_SIN_ELEC_FLT: start-on-event=DemSatellite_0InternalBehavior/GetEventTested, operation=EvtInfo_INV_RSLVR_SIN_ELEC_FLT.GetEventTested
        OpEventGetEventTested_GetEventTested_Event_INV_RSLVR_SIN_ELEC_FLT: start-on-event=DemSatellite_0InternalBehavior/GetEventTested, operation=Event_INV_RSLVR_SIN_ELEC_FLT.GetEventTested
        OpEventGetEventTested_GetEventTested_EvtInfo_CU_TEMP2_RNG_HI: start-on-event=DemSatellite_0InternalBehavior/GetEventTested, operation=EvtInfo_CU_TEMP2_RNG_HI.GetEventTested
        OpEventGetEventTested_GetEventTested_Event_CU_TEMP2_RNG_HI: start-on-event=DemSatellite_0InternalBehavior/GetEventTested, operation=Event_CU_TEMP2_RNG_HI.GetEventTested
        OpEventGetEventTested_GetEventTested_EvtInfo_INV_IAC_PHA_LOSS_MPL: start-on-event=DemSatellite_0InternalBehavior/GetEventTested, operation=EvtInfo_INV_IAC_PHA_LOSS_MPL.GetEventTested
        OpEventGetEventTested_GetEventTested_Event_INV_IAC_PHA_LOSS_MPL: start-on-event=DemSatellite_0InternalBehavior/GetEventTested, operation=Event_INV_IAC_PHA_LOSS_MPL.GetEventTested
        OpEventGetEventTested_GetEventTested_EvtInfo_INV_IAC_U_AMP: start-on-event=DemSatellite_0InternalBehavior/GetEventTested, operation=EvtInfo_INV_IAC_U_AMP.GetEventTested
        OpEventGetEventTested_GetEventTested_Event_INV_IAC_U_AMP: start-on-event=DemSatellite_0InternalBehavior/GetEventTested, operation=Event_INV_IAC_U_AMP.GetEventTested
        OpEventGetEventTested_GetEventTested_EvtInfo_PSnsr_GRADT_Flt: start-on-event=DemSatellite_0InternalBehavior/GetEventTested, operation=EvtInfo_PSnsr_GRADT_Flt.GetEventTested
        OpEventGetEventTested_GetEventTested_Event_PSnsr_GRADT_Flt: start-on-event=DemSatellite_0InternalBehavior/GetEventTested, operation=Event_PSnsr_GRADT_Flt.GetEventTested
        OpEventGetEventTested_GetEventTested_EvtInfo_AURIX_WATHDOG_FLT: start-on-event=DemSatellite_0InternalBehavior/GetEventTested, operation=EvtInfo_AURIX_WATHDOG_FLT.GetEventTested
        OpEventGetEventTested_GetEventTested_Event_AURIX_WATHDOG_FLT: start-on-event=DemSatellite_0InternalBehavior/GetEventTested, operation=Event_AURIX_WATHDOG_FLT.GetEventTested
        OpEventGetEventTested_GetEventTested_EvtInfo_VcEvNodeMisBECM: start-on-event=DemSatellite_0InternalBehavior/GetEventTested, operation=EvtInfo_VcEvNodeMisBECM.GetEventTested
        OpEventGetEventTested_GetEventTested_Event_VcEvNodeMisBECM: start-on-event=DemSatellite_0InternalBehavior/GetEventTested, operation=Event_VcEvNodeMisBECM.GetEventTested
        OpEventGetEventTested_GetEventTested_EvtInfo_INV_UHVDC_UV_HWP: start-on-event=DemSatellite_0InternalBehavior/GetEventTested, operation=EvtInfo_INV_UHVDC_UV_HWP.GetEventTested
        OpEventGetEventTested_GetEventTested_Event_INV_UHVDC_UV_HWP: start-on-event=DemSatellite_0InternalBehavior/GetEventTested, operation=Event_INV_UHVDC_UV_HWP.GetEventTested
        OpEventGetEventTested_GetEventTested_EvtInfo_VcEvMonESpd: start-on-event=DemSatellite_0InternalBehavior/GetEventTested, operation=EvtInfo_VcEvMonESpd.GetEventTested
        OpEventGetEventTested_GetEventTested_Event_VcEvMonESpd: start-on-event=DemSatellite_0InternalBehavior/GetEventTested, operation=Event_VcEvMonESpd.GetEventTested
        OpEventGetEventTested_GetEventTested_EvtInfo_COM_NotConfig: start-on-event=DemSatellite_0InternalBehavior/GetEventTested, operation=EvtInfo_COM_NotConfig.GetEventTested
        OpEventGetEventTested_GetEventTested_Event_COM_NotConfig: start-on-event=DemSatellite_0InternalBehavior/GetEventTested, operation=Event_COM_NotConfig.GetEventTested
        OpEventGetEventTested_GetEventTested_EvtInfo_INV_RSLVR_SIN_RNG_HI: start-on-event=DemSatellite_0InternalBehavior/GetEventTested, operation=EvtInfo_INV_RSLVR_SIN_RNG_HI.GetEventTested
        OpEventGetEventTested_GetEventTested_Event_INV_RSLVR_SIN_RNG_HI: start-on-event=DemSatellite_0InternalBehavior/GetEventTested, operation=Event_INV_RSLVR_SIN_RNG_HI.GetEventTested
        OpEventGetEventTested_GetEventTested_EvtInfo_INV_IGBT_TEMP_U_RNG_HI: start-on-event=DemSatellite_0InternalBehavior/GetEventTested, operation=EvtInfo_INV_IGBT_TEMP_U_RNG_HI.GetEventTested
        OpEventGetEventTested_GetEventTested_Event_INV_IGBT_TEMP_U_RNG_HI: start-on-event=DemSatellite_0InternalBehavior/GetEventTested, operation=Event_INV_IGBT_TEMP_U_RNG_HI.GetEventTested
        OpEventGetEventTested_GetEventTested_EvtInfo_VcEvMonMode_001: start-on-event=DemSatellite_0InternalBehavior/GetEventTested, operation=EvtInfo_VcEvMonMode_001.GetEventTested
        OpEventGetEventTested_GetEventTested_Event_VcEvMonMode_001: start-on-event=DemSatellite_0InternalBehavior/GetEventTested, operation=Event_VcEvMonMode_001.GetEventTested
        OpEventGetEventTested_GetEventTested_EvtInfo_PA_ACTION_FLT: start-on-event=DemSatellite_0InternalBehavior/GetEventTested, operation=EvtInfo_PA_ACTION_FLT.GetEventTested
        OpEventGetEventTested_GetEventTested_Event_PA_ACTION_FLT: start-on-event=DemSatellite_0InternalBehavior/GetEventTested, operation=Event_PA_ACTION_FLT.GetEventTested
        OpEventGetEventTested_GetEventTested_EvtInfo_INV_IAC_V_ELEC_HWP: start-on-event=DemSatellite_0InternalBehavior/GetEventTested, operation=EvtInfo_INV_IAC_V_ELEC_HWP.GetEventTested
        OpEventGetEventTested_GetEventTested_Event_INV_IAC_V_ELEC_HWP: start-on-event=DemSatellite_0InternalBehavior/GetEventTested, operation=Event_INV_IAC_V_ELEC_HWP.GetEventTested
        OpEventGetEventTested_GetEventTested_EvtInfo_CU_TEMP_HW_FLT_001: start-on-event=DemSatellite_0InternalBehavior/GetEventTested, operation=EvtInfo_CU_TEMP_HW_FLT_001.GetEventTested
        OpEventGetEventTested_GetEventTested_Event_CU_TEMP_HW_FLT_001: start-on-event=DemSatellite_0InternalBehavior/GetEventTested, operation=Event_CU_TEMP_HW_FLT_001.GetEventTested
        OpEventGetEventTested_GetEventTested_EvtInfo_VCC_UnderVoltage: start-on-event=DemSatellite_0InternalBehavior/GetEventTested, operation=EvtInfo_VCC_UnderVoltage.GetEventTested
        OpEventGetEventTested_GetEventTested_Event_VCC_UnderVoltage: start-on-event=DemSatellite_0InternalBehavior/GetEventTested, operation=Event_VCC_UnderVoltage.GetEventTested
        OpEventGetEventTested_GetEventTested_EvtInfo_VcEvTsttrPlaus: start-on-event=DemSatellite_0InternalBehavior/GetEventTested, operation=EvtInfo_VcEvTsttrPlaus.GetEventTested
        OpEventGetEventTested_GetEventTested_Event_VcEvTsttrPlaus: start-on-event=DemSatellite_0InternalBehavior/GetEventTested, operation=Event_VcEvTsttrPlaus.GetEventTested
        OpEventGetEventTested_GetEventTested_EvtInfo_INV_RSLVR_EXCT_ELEC_FLT: start-on-event=DemSatellite_0InternalBehavior/GetEventTested, operation=EvtInfo_INV_RSLVR_EXCT_ELEC_FLT.GetEventTested
        OpEventGetEventTested_GetEventTested_Event_INV_RSLVR_EXCT_ELEC_FLT: start-on-event=DemSatellite_0InternalBehavior/GetEventTested, operation=Event_INV_RSLVR_EXCT_ELEC_FLT.GetEventTested
        OpEventGetEventTested_GetEventTested_EvtInfo_INV_RSLVR_EXCT_RNG_LO: start-on-event=DemSatellite_0InternalBehavior/GetEventTested, operation=EvtInfo_INV_RSLVR_EXCT_RNG_LO.GetEventTested
        OpEventGetEventTested_GetEventTested_Event_INV_RSLVR_EXCT_RNG_LO: start-on-event=DemSatellite_0InternalBehavior/GetEventTested, operation=Event_INV_RSLVR_EXCT_RNG_LO.GetEventTested
        OpEventGetEventTested_GetEventTested_EvtInfo_INV_EM_STATOR_TEMP2_RNG_HI: start-on-event=DemSatellite_0InternalBehavior/GetEventTested, operation=EvtInfo_INV_EM_STATOR_TEMP2_RNG_HI.GetEventTested
        OpEventGetEventTested_GetEventTested_Event_INV_EM_STATOR_TEMP2_RNG_HI: start-on-event=DemSatellite_0InternalBehavior/GetEventTested, operation=Event_INV_EM_STATOR_TEMP2_RNG_HI.GetEventTested
        OpEventGetEventTested_GetEventTested_EvtInfo_INV_SHUT_OFF_PAH_START_UP: start-on-event=DemSatellite_0InternalBehavior/GetEventTested, operation=EvtInfo_INV_SHUT_OFF_PAH_START_UP.GetEventTested
        OpEventGetEventTested_GetEventTested_Event_INV_SHUT_OFF_PAH_START_UP: start-on-event=DemSatellite_0InternalBehavior/GetEventTested, operation=Event_INV_SHUT_OFF_PAH_START_UP.GetEventTested
        OpEventGetEventTested_GetEventTested_EvtInfo_VCEvVddmPropFr08Tioutd: start-on-event=DemSatellite_0InternalBehavior/GetEventTested, operation=EvtInfo_VCEvVddmPropFr08Tioutd.GetEventTested
        OpEventGetEventTested_GetEventTested_Event_VCEvVddmPropFr08Tioutd: start-on-event=DemSatellite_0InternalBehavior/GetEventTested, operation=Event_VCEvVddmPropFr08Tioutd.GetEventTested
        OpEventGetEventTested_GetEventTested_EvtInfo_INV_RSLVR_EXCT_OC_HWP_001: start-on-event=DemSatellite_0InternalBehavior/GetEventTested, operation=EvtInfo_INV_RSLVR_EXCT_OC_HWP_001.GetEventTested
        OpEventGetEventTested_GetEventTested_Event_INV_RSLVR_EXCT_OC_HWP_001: start-on-event=DemSatellite_0InternalBehavior/GetEventTested, operation=Event_INV_RSLVR_EXCT_OC_HWP_001.GetEventTested
        OpEventGetEventTested_GetEventTested_EvtInfo_INV_RSLVR_EXCT_OC_HWP_002: start-on-event=DemSatellite_0InternalBehavior/GetEventTested, operation=EvtInfo_INV_RSLVR_EXCT_OC_HWP_002.GetEventTested
        OpEventGetEventTested_GetEventTested_Event_INV_RSLVR_EXCT_OC_HWP_002: start-on-event=DemSatellite_0InternalBehavior/GetEventTested, operation=Event_INV_RSLVR_EXCT_OC_HWP_002.GetEventTested
        OpEventGetEventTested_GetEventTested_EvtInfo_INV_EM_STATOR_TEMP_ELE_FLT: start-on-event=DemSatellite_0InternalBehavior/GetEventTested, operation=EvtInfo_INV_EM_STATOR_TEMP_ELE_FLT.GetEventTested
        OpEventGetEventTested_GetEventTested_Event_INV_EM_STATOR_TEMP_ELE_FLT: start-on-event=DemSatellite_0InternalBehavior/GetEventTested, operation=Event_INV_EM_STATOR_TEMP_ELE_FLT.GetEventTested
        OpEventGetEventTested_GetEventTested_EvtInfo_INV_INTERLOCK_FLT: start-on-event=DemSatellite_0InternalBehavior/GetEventTested, operation=EvtInfo_INV_INTERLOCK_FLT.GetEventTested
        OpEventGetEventTested_GetEventTested_Event_INV_INTERLOCK_FLT: start-on-event=DemSatellite_0InternalBehavior/GetEventTested, operation=Event_INV_INTERLOCK_FLT.GetEventTested
        OpEventGetEventTested_GetEventTested_EvtInfo_Ga_ZeroFindDistanFailure: start-on-event=DemSatellite_0InternalBehavior/GetEventTested, operation=EvtInfo_Ga_ZeroFindDistanFailure.GetEventTested
        OpEventGetEventTested_GetEventTested_Event_Ga_ZeroFindDistanFailure: start-on-event=DemSatellite_0InternalBehavior/GetEventTested, operation=Event_Ga_ZeroFindDistanFailure.GetEventTested
        OpEventGetEventTested_GetEventTested_EvtInfo_PLOCK_Current_RNG_OUT: start-on-event=DemSatellite_0InternalBehavior/GetEventTested, operation=EvtInfo_PLOCK_Current_RNG_OUT.GetEventTested
        OpEventGetEventTested_GetEventTested_Event_PLOCK_Current_RNG_OUT: start-on-event=DemSatellite_0InternalBehavior/GetEventTested, operation=Event_PLOCK_Current_RNG_OUT.GetEventTested
        OpEventGetEventTested_GetEventTested_EvtInfo_VCEvVddmPropFr05Tioutd: start-on-event=DemSatellite_0InternalBehavior/GetEventTested, operation=EvtInfo_VCEvVddmPropFr05Tioutd.GetEventTested
        OpEventGetEventTested_GetEventTested_Event_VCEvVddmPropFr05Tioutd: start-on-event=DemSatellite_0InternalBehavior/GetEventTested, operation=Event_VCEvVddmPropFr05Tioutd.GetEventTested
        OpEventGetEventTested_GetEventTested_EvtInfo_INV_IGBT_TEMP_V_GRDT: start-on-event=DemSatellite_0InternalBehavior/GetEventTested, operation=EvtInfo_INV_IGBT_TEMP_V_GRDT.GetEventTested
        OpEventGetEventTested_GetEventTested_Event_INV_IGBT_TEMP_V_GRDT: start-on-event=DemSatellite_0InternalBehavior/GetEventTested, operation=Event_INV_IGBT_TEMP_V_GRDT.GetEventTested
        OpEventGetEventTested_GetEventTested_EvtInfo_PS_5V_Fault: start-on-event=DemSatellite_0InternalBehavior/GetEventTested, operation=EvtInfo_PS_5V_Fault.GetEventTested
        OpEventGetEventTested_GetEventTested_Event_PS_5V_Fault: start-on-event=DemSatellite_0InternalBehavior/GetEventTested, operation=Event_PS_5V_Fault.GetEventTested
        OpEventGetEventTested_GetEventTested_EvtInfo_VcEvCntrCrashStsSafe: start-on-event=DemSatellite_0InternalBehavior/GetEventTested, operation=EvtInfo_VcEvCntrCrashStsSafe.GetEventTested
        OpEventGetEventTested_GetEventTested_Event_VcEvCntrCrashStsSafe: start-on-event=DemSatellite_0InternalBehavior/GetEventTested, operation=Event_VcEvCntrCrashStsSafe.GetEventTested
        OpEventGetEventTested_GetEventTested_EvtInfo_INV_EM_STATOR_TEMP_GRDT: start-on-event=DemSatellite_0InternalBehavior/GetEventTested, operation=EvtInfo_INV_EM_STATOR_TEMP_GRDT.GetEventTested
        OpEventGetEventTested_GetEventTested_Event_INV_EM_STATOR_TEMP_GRDT: start-on-event=DemSatellite_0InternalBehavior/GetEventTested, operation=Event_INV_EM_STATOR_TEMP_GRDT.GetEventTested
        OpEventGetEventTested_GetEventTested_EvtInfo_PS_P15_V_FLT: start-on-event=DemSatellite_0InternalBehavior/GetEventTested, operation=EvtInfo_PS_P15_V_FLT.GetEventTested
        OpEventGetEventTested_GetEventTested_Event_PS_P15_V_FLT: start-on-event=DemSatellite_0InternalBehavior/GetEventTested, operation=Event_PS_P15_V_FLT.GetEventTested
        OpEventGetEventTested_GetEventTested_EvtInfo_INV_EM_STATOR_TEMP_RNG_NOK: start-on-event=DemSatellite_0InternalBehavior/GetEventTested, operation=EvtInfo_INV_EM_STATOR_TEMP_RNG_NOK.GetEventTested
        OpEventGetEventTested_GetEventTested_Event_INV_EM_STATOR_TEMP_RNG_NOK: start-on-event=DemSatellite_0InternalBehavior/GetEventTested, operation=Event_INV_EM_STATOR_TEMP_RNG_NOK.GetEventTested
        OpEventGetEventTested_GetEventTested_EvtInfo_INV_RSLVR_SIN_RNG_NOK: start-on-event=DemSatellite_0InternalBehavior/GetEventTested, operation=EvtInfo_INV_RSLVR_SIN_RNG_NOK.GetEventTested
        OpEventGetEventTested_GetEventTested_Event_INV_RSLVR_SIN_RNG_NOK: start-on-event=DemSatellite_0InternalBehavior/GetEventTested, operation=Event_INV_RSLVR_SIN_RNG_NOK.GetEventTested
        OpEventGetEventTested_GetEventTested_EvtInfo_INV_IAC_U_OFFS: start-on-event=DemSatellite_0InternalBehavior/GetEventTested, operation=EvtInfo_INV_IAC_U_OFFS.GetEventTested
        OpEventGetEventTested_GetEventTested_Event_INV_IAC_U_OFFS: start-on-event=DemSatellite_0InternalBehavior/GetEventTested, operation=Event_INV_IAC_U_OFFS.GetEventTested
        OpEventGetEventTested_GetEventTested_EvtInfo_PS_KL30_BACKUP_FLT: start-on-event=DemSatellite_0InternalBehavior/GetEventTested, operation=EvtInfo_PS_KL30_BACKUP_FLT.GetEventTested
        OpEventGetEventTested_GetEventTested_Event_PS_KL30_BACKUP_FLT: start-on-event=DemSatellite_0InternalBehavior/GetEventTested, operation=Event_PS_KL30_BACKUP_FLT.GetEventTested
        OpEventGetEventTested_GetEventTested_EvtInfo_INV_IGBT_TEMP_U_RNG_LO: start-on-event=DemSatellite_0InternalBehavior/GetEventTested, operation=EvtInfo_INV_IGBT_TEMP_U_RNG_LO.GetEventTested
        OpEventGetEventTested_GetEventTested_Event_INV_IGBT_TEMP_U_RNG_LO: start-on-event=DemSatellite_0InternalBehavior/GetEventTested, operation=Event_INV_IGBT_TEMP_U_RNG_LO.GetEventTested
        OpEventGetEventTested_GetEventTested_EvtInfo_INV_EM_STATOR_TEMP_HWP: start-on-event=DemSatellite_0InternalBehavior/GetEventTested, operation=EvtInfo_INV_EM_STATOR_TEMP_HWP.GetEventTested
        OpEventGetEventTested_GetEventTested_Event_INV_EM_STATOR_TEMP_HWP: start-on-event=DemSatellite_0InternalBehavior/GetEventTested, operation=Event_INV_EM_STATOR_TEMP_HWP.GetEventTested
        OpEventGetEventTested_GetEventTested_EvtInfo_CU_TEMP1_RNG_HI: start-on-event=DemSatellite_0InternalBehavior/GetEventTested, operation=EvtInfo_CU_TEMP1_RNG_HI.GetEventTested
        OpEventGetEventTested_GetEventTested_Event_CU_TEMP1_RNG_HI: start-on-event=DemSatellite_0InternalBehavior/GetEventTested, operation=Event_CU_TEMP1_RNG_HI.GetEventTested
        OpEventGetEventTested_GetEventTested_EvtInfo_INV_IGBT_TEMP_V_RNG_HI: start-on-event=DemSatellite_0InternalBehavior/GetEventTested, operation=EvtInfo_INV_IGBT_TEMP_V_RNG_HI.GetEventTested
        OpEventGetEventTested_GetEventTested_Event_INV_IGBT_TEMP_V_RNG_HI: start-on-event=DemSatellite_0InternalBehavior/GetEventTested, operation=Event_INV_IGBT_TEMP_V_RNG_HI.GetEventTested
        OpEventGetEventTested_GetEventTested_EvtInfo_VcEvNodeMisVDDM: start-on-event=DemSatellite_0InternalBehavior/GetEventTested, operation=EvtInfo_VcEvNodeMisVDDM.GetEventTested
        OpEventGetEventTested_GetEventTested_Event_VcEvNodeMisVDDM: start-on-event=DemSatellite_0InternalBehavior/GetEventTested, operation=Event_VcEvNodeMisVDDM.GetEventTested
        OpEventGetEventTested_GetEventTested_EvtInfo_INV_UHVDC_PLAUS: start-on-event=DemSatellite_0InternalBehavior/GetEventTested, operation=EvtInfo_INV_UHVDC_PLAUS.GetEventTested
        OpEventGetEventTested_GetEventTested_Event_INV_UHVDC_PLAUS: start-on-event=DemSatellite_0InternalBehavior/GetEventTested, operation=Event_INV_UHVDC_PLAUS.GetEventTested
        OpEventGetEventTested_GetEventTested_EvtInfo_INV_QUIESCENT_FLT: start-on-event=DemSatellite_0InternalBehavior/GetEventTested, operation=EvtInfo_INV_QUIESCENT_FLT.GetEventTested
        OpEventGetEventTested_GetEventTested_Event_INV_QUIESCENT_FLT: start-on-event=DemSatellite_0InternalBehavior/GetEventTested, operation=Event_INV_QUIESCENT_FLT.GetEventTested
        OpEventGetEventTested_GetEventTested_EvtInfo_INV_RSLVR_EXCT_RNG_HI: start-on-event=DemSatellite_0InternalBehavior/GetEventTested, operation=EvtInfo_INV_RSLVR_EXCT_RNG_HI.GetEventTested
        OpEventGetEventTested_GetEventTested_Event_INV_RSLVR_EXCT_RNG_HI: start-on-event=DemSatellite_0InternalBehavior/GetEventTested, operation=Event_INV_RSLVR_EXCT_RNG_HI.GetEventTested
        OpEventGetEventTested_GetEventTested_GeneralEvtInfo: start-on-event=DemSatellite_0InternalBehavior/GetEventTested, operation=GeneralEvtInfo.GetEventTested
        OpEventGetDTCOfEvent_GetDTCOfEvent_EvtInfo_VCEvBecmPropFr01Tioutd: start-on-event=DemSatellite_0InternalBehavior/GetDTCOfEvent, operation=EvtInfo_VCEvBecmPropFr01Tioutd.GetDTCOfEvent
        OpEventGetDTCOfEvent_GetDTCOfEvent_Event_VCEvBecmPropFr01Tioutd: start-on-event=DemSatellite_0InternalBehavior/GetDTCOfEvent, operation=Event_VCEvBecmPropFr01Tioutd.GetDTCOfEvent
        OpEventGetDTCOfEvent_GetDTCOfEvent_EvtInfo_INV_CU_TEMP2_RNG_NOK: start-on-event=DemSatellite_0InternalBehavior/GetDTCOfEvent, operation=EvtInfo_INV_CU_TEMP2_RNG_NOK.GetDTCOfEvent
        OpEventGetDTCOfEvent_GetDTCOfEvent_Event_INV_CU_TEMP2_RNG_NOK: start-on-event=DemSatellite_0InternalBehavior/GetDTCOfEvent, operation=Event_INV_CU_TEMP2_RNG_NOK.GetDTCOfEvent
        OpEventGetDTCOfEvent_GetDTCOfEvent_EvtInfo_COM_Busoff: start-on-event=DemSatellite_0InternalBehavior/GetDTCOfEvent, operation=EvtInfo_COM_Busoff.GetDTCOfEvent
        OpEventGetDTCOfEvent_GetDTCOfEvent_Event_COM_Busoff: start-on-event=DemSatellite_0InternalBehavior/GetDTCOfEvent, operation=Event_COM_Busoff.GetDTCOfEvent
        OpEventGetDTCOfEvent_GetDTCOfEvent_EvtInfo_INV_IMMO_NOKEY: start-on-event=DemSatellite_0InternalBehavior/GetDTCOfEvent, operation=EvtInfo_INV_IMMO_NOKEY.GetDTCOfEvent
        OpEventGetDTCOfEvent_GetDTCOfEvent_Event_INV_IMMO_NOKEY: start-on-event=DemSatellite_0InternalBehavior/GetDTCOfEvent, operation=Event_INV_IMMO_NOKEY.GetDTCOfEvent
        OpEventGetDTCOfEvent_GetDTCOfEvent_EvtInfo_INV_RSLVR_EXCT_OC_HWP: start-on-event=DemSatellite_0InternalBehavior/GetDTCOfEvent, operation=EvtInfo_INV_RSLVR_EXCT_OC_HWP.GetDTCOfEvent
        OpEventGetDTCOfEvent_GetDTCOfEvent_Event_INV_RSLVR_EXCT_OC_HWP: start-on-event=DemSatellite_0InternalBehavior/GetDTCOfEvent, operation=Event_INV_RSLVR_EXCT_OC_HWP.GetDTCOfEvent
        OpEventGetDTCOfEvent_GetDTCOfEvent_EvtInfo_PS_P15_W_FLT: start-on-event=DemSatellite_0InternalBehavior/GetDTCOfEvent, operation=EvtInfo_PS_P15_W_FLT.GetDTCOfEvent
        OpEventGetDTCOfEvent_GetDTCOfEvent_Event_PS_P15_W_FLT: start-on-event=DemSatellite_0InternalBehavior/GetDTCOfEvent, operation=Event_PS_P15_W_FLT.GetDTCOfEvent
        OpEventGetDTCOfEvent_GetDTCOfEvent_EvtInfo_INV_IAC_PLAUS_SUM: start-on-event=DemSatellite_0InternalBehavior/GetDTCOfEvent, operation=EvtInfo_INV_IAC_PLAUS_SUM.GetDTCOfEvent
        OpEventGetDTCOfEvent_GetDTCOfEvent_Event_INV_IAC_PLAUS_SUM: start-on-event=DemSatellite_0InternalBehavior/GetDTCOfEvent, operation=Event_INV_IAC_PLAUS_SUM.GetDTCOfEvent
        OpEventGetDTCOfEvent_GetDTCOfEvent_EvtInfo_PA_ELE_FLT: start-on-event=DemSatellite_0InternalBehavior/GetDTCOfEvent, operation=EvtInfo_PA_ELE_FLT.GetDTCOfEvent
        OpEventGetDTCOfEvent_GetDTCOfEvent_Event_PA_ELE_FLT: start-on-event=DemSatellite_0InternalBehavior/GetDTCOfEvent, operation=Event_PA_ELE_FLT.GetDTCOfEvent
        OpEventGetDTCOfEvent_GetDTCOfEvent_EvtInfo_CU_TEMP_GRDT: start-on-event=DemSatellite_0InternalBehavior/GetDTCOfEvent, operation=EvtInfo_CU_TEMP_GRDT.GetDTCOfEvent
        OpEventGetDTCOfEvent_GetDTCOfEvent_Event_CU_TEMP_GRDT: start-on-event=DemSatellite_0InternalBehavior/GetDTCOfEvent, operation=Event_CU_TEMP_GRDT.GetDTCOfEvent
        OpEventGetDTCOfEvent_GetDTCOfEvent_EvtInfo_INV_IGBT_TEMP_V_PLAUS: start-on-event=DemSatellite_0InternalBehavior/GetDTCOfEvent, operation=EvtInfo_INV_IGBT_TEMP_V_PLAUS.GetDTCOfEvent
        OpEventGetDTCOfEvent_GetDTCOfEvent_Event_INV_IGBT_TEMP_V_PLAUS: start-on-event=DemSatellite_0InternalBehavior/GetDTCOfEvent, operation=Event_INV_IGBT_TEMP_V_PLAUS.GetDTCOfEvent
        OpEventGetDTCOfEvent_GetDTCOfEvent_EvtInfo_Ga_GAEngageFailure: start-on-event=DemSatellite_0InternalBehavior/GetDTCOfEvent, operation=EvtInfo_Ga_GAEngageFailure.GetDTCOfEvent
        OpEventGetDTCOfEvent_GetDTCOfEvent_Event_Ga_GAEngageFailure: start-on-event=DemSatellite_0InternalBehavior/GetDTCOfEvent, operation=Event_Ga_GAEngageFailure.GetDTCOfEvent
        OpEventGetDTCOfEvent_GetDTCOfEvent_EvtInfo_INV_IAC_W_RNG_LO: start-on-event=DemSatellite_0InternalBehavior/GetDTCOfEvent, operation=EvtInfo_INV_IAC_W_RNG_LO.GetDTCOfEvent
        OpEventGetDTCOfEvent_GetDTCOfEvent_Event_INV_IAC_W_RNG_LO: start-on-event=DemSatellite_0InternalBehavior/GetDTCOfEvent, operation=Event_INV_IAC_W_RNG_LO.GetDTCOfEvent
        OpEventGetDTCOfEvent_GetDTCOfEvent_EvtInfo_PS_WhlSnsr_Vltg_FLT: start-on-event=DemSatellite_0InternalBehavior/GetDTCOfEvent, operation=EvtInfo_PS_WhlSnsr_Vltg_FLT.GetDTCOfEvent
        OpEventGetDTCOfEvent_GetDTCOfEvent_Event_PS_WhlSnsr_Vltg_FLT: start-on-event=DemSatellite_0InternalBehavior/GetDTCOfEvent, operation=Event_PS_WhlSnsr_Vltg_FLT.GetDTCOfEvent
        OpEventGetDTCOfEvent_GetDTCOfEvent_EvtInfo_VCEvEcmPropFr02Tioutd: start-on-event=DemSatellite_0InternalBehavior/GetDTCOfEvent, operation=EvtInfo_VCEvEcmPropFr02Tioutd.GetDTCOfEvent
        OpEventGetDTCOfEvent_GetDTCOfEvent_Event_VCEvEcmPropFr02Tioutd: start-on-event=DemSatellite_0InternalBehavior/GetDTCOfEvent, operation=Event_VCEvEcmPropFr02Tioutd.GetDTCOfEvent
        OpEventGetDTCOfEvent_GetDTCOfEvent_EvtInfo_Ga_TmSpdSyncFailed: start-on-event=DemSatellite_0InternalBehavior/GetDTCOfEvent, operation=EvtInfo_Ga_TmSpdSyncFailed.GetDTCOfEvent
        OpEventGetDTCOfEvent_GetDTCOfEvent_Event_Ga_TmSpdSyncFailed: start-on-event=DemSatellite_0InternalBehavior/GetDTCOfEvent, operation=Event_Ga_TmSpdSyncFailed.GetDTCOfEvent
        OpEventGetDTCOfEvent_GetDTCOfEvent_EvtInfo_INV_RSLVR_EXCT_ELEC_LO: start-on-event=DemSatellite_0InternalBehavior/GetDTCOfEvent, operation=EvtInfo_INV_RSLVR_EXCT_ELEC_LO.GetDTCOfEvent
        OpEventGetDTCOfEvent_GetDTCOfEvent_Event_INV_RSLVR_EXCT_ELEC_LO: start-on-event=DemSatellite_0InternalBehavior/GetDTCOfEvent, operation=Event_INV_RSLVR_EXCT_ELEC_LO.GetDTCOfEvent
        OpEventGetDTCOfEvent_GetDTCOfEvent_EvtInfo_VCEvEcmPropXevFr06Tioutd: start-on-event=DemSatellite_0InternalBehavior/GetDTCOfEvent, operation=EvtInfo_VCEvEcmPropXevFr06Tioutd.GetDTCOfEvent
        OpEventGetDTCOfEvent_GetDTCOfEvent_Event_VCEvEcmPropXevFr06Tioutd: start-on-event=DemSatellite_0InternalBehavior/GetDTCOfEvent, operation=Event_VCEvEcmPropXevFr06Tioutd.GetDTCOfEvent
        OpEventGetDTCOfEvent_GetDTCOfEvent_EvtInfo_VcEvCntrWhlMotSysTqAllwd: start-on-event=DemSatellite_0InternalBehavior/GetDTCOfEvent, operation=EvtInfo_VcEvCntrWhlMotSysTqAllwd.GetDTCOfEvent
        OpEventGetDTCOfEvent_GetDTCOfEvent_Event_VcEvCntrWhlMotSysTqAllwd: start-on-event=DemSatellite_0InternalBehavior/GetDTCOfEvent, operation=Event_VcEvCntrWhlMotSysTqAllwd.GetDTCOfEvent
        OpEventGetDTCOfEvent_GetDTCOfEvent_EvtInfo_INV_UHVDC_1_ELEC_HI: start-on-event=DemSatellite_0InternalBehavior/GetDTCOfEvent, operation=EvtInfo_INV_UHVDC_1_ELEC_HI.GetDTCOfEvent
        OpEventGetDTCOfEvent_GetDTCOfEvent_Event_INV_UHVDC_1_ELEC_HI: start-on-event=DemSatellite_0InternalBehavior/GetDTCOfEvent, operation=Event_INV_UHVDC_1_ELEC_HI.GetDTCOfEvent
        OpEventGetDTCOfEvent_GetDTCOfEvent_EvtInfo_INV_EM_STATOR_TEMP2_ELE_FLT: start-on-event=DemSatellite_0InternalBehavior/GetDTCOfEvent, operation=EvtInfo_INV_EM_STATOR_TEMP2_ELE_FLT.GetDTCOfEvent
        OpEventGetDTCOfEvent_GetDTCOfEvent_Event_INV_EM_STATOR_TEMP2_ELE_FLT: start-on-event=DemSatellite_0InternalBehavior/GetDTCOfEvent, operation=Event_INV_EM_STATOR_TEMP2_ELE_FLT.GetDTCOfEvent
        OpEventGetDTCOfEvent_GetDTCOfEvent_EvtInfo_AURIX_RST_SNG: start-on-event=DemSatellite_0InternalBehavior/GetDTCOfEvent, operation=EvtInfo_AURIX_RST_SNG.GetDTCOfEvent
        OpEventGetDTCOfEvent_GetDTCOfEvent_Event_AURIX_RST_SNG: start-on-event=DemSatellite_0InternalBehavior/GetDTCOfEvent, operation=Event_AURIX_RST_SNG.GetDTCOfEvent
        OpEventGetDTCOfEvent_GetDTCOfEvent_EvtInfo_VCEvEcmPropFr24MgmFr01Tioutd: start-on-event=DemSatellite_0InternalBehavior/GetDTCOfEvent, operation=EvtInfo_VCEvEcmPropFr24MgmFr01Tioutd.GetDTCOfEvent
        OpEventGetDTCOfEvent_GetDTCOfEvent_Event_VCEvEcmPropFr24MgmFr01Tioutd: start-on-event=DemSatellite_0InternalBehavior/GetDTCOfEvent, operation=Event_VCEvEcmPropFr24MgmFr01Tioutd.GetDTCOfEvent
        OpEventGetDTCOfEvent_GetDTCOfEvent_EvtInfo_INV_RSLVR_COS_ELEC_OPEN: start-on-event=DemSatellite_0InternalBehavior/GetDTCOfEvent, operation=EvtInfo_INV_RSLVR_COS_ELEC_OPEN.GetDTCOfEvent
        OpEventGetDTCOfEvent_GetDTCOfEvent_Event_INV_RSLVR_COS_ELEC_OPEN: start-on-event=DemSatellite_0InternalBehavior/GetDTCOfEvent, operation=Event_INV_RSLVR_COS_ELEC_OPEN.GetDTCOfEvent
        OpEventGetDTCOfEvent_GetDTCOfEvent_EvtInfo_INV_IAC_V_ELEC_LO: start-on-event=DemSatellite_0InternalBehavior/GetDTCOfEvent, operation=EvtInfo_INV_IAC_V_ELEC_LO.GetDTCOfEvent
        OpEventGetDTCOfEvent_GetDTCOfEvent_Event_INV_IAC_V_ELEC_LO: start-on-event=DemSatellite_0InternalBehavior/GetDTCOfEvent, operation=Event_INV_IAC_V_ELEC_LO.GetDTCOfEvent
        OpEventGetDTCOfEvent_GetDTCOfEvent_EvtInfo_INV_IAC_W_OFFS: start-on-event=DemSatellite_0InternalBehavior/GetDTCOfEvent, operation=EvtInfo_INV_IAC_W_OFFS.GetDTCOfEvent
        OpEventGetDTCOfEvent_GetDTCOfEvent_Event_INV_IAC_W_OFFS: start-on-event=DemSatellite_0InternalBehavior/GetDTCOfEvent, operation=Event_INV_IAC_W_OFFS.GetDTCOfEvent
        OpEventGetDTCOfEvent_GetDTCOfEvent_EvtInfo_INV_EM_STATOR_TEMP2_GRDT: start-on-event=DemSatellite_0InternalBehavior/GetDTCOfEvent, operation=EvtInfo_INV_EM_STATOR_TEMP2_GRDT.GetDTCOfEvent
        OpEventGetDTCOfEvent_GetDTCOfEvent_Event_INV_EM_STATOR_TEMP2_GRDT: start-on-event=DemSatellite_0InternalBehavior/GetDTCOfEvent, operation=Event_INV_EM_STATOR_TEMP2_GRDT.GetDTCOfEvent
        OpEventGetDTCOfEvent_GetDTCOfEvent_EvtInfo_INV_EM_OVRSPD_HWP: start-on-event=DemSatellite_0InternalBehavior/GetDTCOfEvent, operation=EvtInfo_INV_EM_OVRSPD_HWP.GetDTCOfEvent
        OpEventGetDTCOfEvent_GetDTCOfEvent_Event_INV_EM_OVRSPD_HWP: start-on-event=DemSatellite_0InternalBehavior/GetDTCOfEvent, operation=Event_INV_EM_OVRSPD_HWP.GetDTCOfEvent
        OpEventGetDTCOfEvent_GetDTCOfEvent_EvtInfo_CU_TEMP_HWP: start-on-event=DemSatellite_0InternalBehavior/GetDTCOfEvent, operation=EvtInfo_CU_TEMP_HWP.GetDTCOfEvent
        OpEventGetDTCOfEvent_GetDTCOfEvent_Event_CU_TEMP_HWP: start-on-event=DemSatellite_0InternalBehavior/GetDTCOfEvent, operation=Event_CU_TEMP_HWP.GetDTCOfEvent
        OpEventGetDTCOfEvent_GetDTCOfEvent_EvtInfo_INV_UHVDC_1_RNG_HI: start-on-event=DemSatellite_0InternalBehavior/GetDTCOfEvent, operation=EvtInfo_INV_UHVDC_1_RNG_HI.GetDTCOfEvent
        OpEventGetDTCOfEvent_GetDTCOfEvent_Event_INV_UHVDC_1_RNG_HI: start-on-event=DemSatellite_0InternalBehavior/GetDTCOfEvent, operation=Event_INV_UHVDC_1_RNG_HI.GetDTCOfEvent
        OpEventGetDTCOfEvent_GetDTCOfEvent_EvtInfo_VcEvEMPerfPlaus: start-on-event=DemSatellite_0InternalBehavior/GetDTCOfEvent, operation=EvtInfo_VcEvEMPerfPlaus.GetDTCOfEvent
        OpEventGetDTCOfEvent_GetDTCOfEvent_Event_VcEvEMPerfPlaus: start-on-event=DemSatellite_0InternalBehavior/GetDTCOfEvent, operation=Event_VcEvEMPerfPlaus.GetDTCOfEvent
        OpEventGetDTCOfEvent_GetDTCOfEvent_EvtInfo_VCEvVddmPropFr18Tioutd: start-on-event=DemSatellite_0InternalBehavior/GetDTCOfEvent, operation=EvtInfo_VCEvVddmPropFr18Tioutd.GetDTCOfEvent
        OpEventGetDTCOfEvent_GetDTCOfEvent_Event_VCEvVddmPropFr18Tioutd: start-on-event=DemSatellite_0InternalBehavior/GetDTCOfEvent, operation=Event_VCEvVddmPropFr18Tioutd.GetDTCOfEvent
        OpEventGetDTCOfEvent_GetDTCOfEvent_EvtInfo_INV_IAC_U_ELEC_HWP: start-on-event=DemSatellite_0InternalBehavior/GetDTCOfEvent, operation=EvtInfo_INV_IAC_U_ELEC_HWP.GetDTCOfEvent
        OpEventGetDTCOfEvent_GetDTCOfEvent_Event_INV_IAC_U_ELEC_HWP: start-on-event=DemSatellite_0InternalBehavior/GetDTCOfEvent, operation=Event_INV_IAC_U_ELEC_HWP.GetDTCOfEvent
        OpEventGetDTCOfEvent_GetDTCOfEvent_EvtInfo_VCEvVddmPropFr15Tioutd: start-on-event=DemSatellite_0InternalBehavior/GetDTCOfEvent, operation=EvtInfo_VCEvVddmPropFr15Tioutd.GetDTCOfEvent
        OpEventGetDTCOfEvent_GetDTCOfEvent_Event_VCEvVddmPropFr15Tioutd: start-on-event=DemSatellite_0InternalBehavior/GetDTCOfEvent, operation=Event_VCEvVddmPropFr15Tioutd.GetDTCOfEvent
        OpEventGetDTCOfEvent_GetDTCOfEvent_EvtInfo_Ga_GADisengageFailure: start-on-event=DemSatellite_0InternalBehavior/GetDTCOfEvent, operation=EvtInfo_Ga_GADisengageFailure.GetDTCOfEvent
        OpEventGetDTCOfEvent_GetDTCOfEvent_Event_Ga_GADisengageFailure: start-on-event=DemSatellite_0InternalBehavior/GetDTCOfEvent, operation=Event_Ga_GADisengageFailure.GetDTCOfEvent
        OpEventGetDTCOfEvent_GetDTCOfEvent_EvtInfo_CU_TEMP2_RNG_LO: start-on-event=DemSatellite_0InternalBehavior/GetDTCOfEvent, operation=EvtInfo_CU_TEMP2_RNG_LO.GetDTCOfEvent
        OpEventGetDTCOfEvent_GetDTCOfEvent_Event_CU_TEMP2_RNG_LO: start-on-event=DemSatellite_0InternalBehavior/GetDTCOfEvent, operation=Event_CU_TEMP2_RNG_LO.GetDTCOfEvent
        OpEventGetDTCOfEvent_GetDTCOfEvent_EvtInfo_INV_RSLVR_SIN_ELEC_OPEN: start-on-event=DemSatellite_0InternalBehavior/GetDTCOfEvent, operation=EvtInfo_INV_RSLVR_SIN_ELEC_OPEN.GetDTCOfEvent
        OpEventGetDTCOfEvent_GetDTCOfEvent_Event_INV_RSLVR_SIN_ELEC_OPEN: start-on-event=DemSatellite_0InternalBehavior/GetDTCOfEvent, operation=Event_INV_RSLVR_SIN_ELEC_OPEN.GetDTCOfEvent
        OpEventGetDTCOfEvent_GetDTCOfEvent_EvtInfo_VcEvChkSum: start-on-event=DemSatellite_0InternalBehavior/GetDTCOfEvent, operation=EvtInfo_VcEvChkSum.GetDTCOfEvent
        OpEventGetDTCOfEvent_GetDTCOfEvent_Event_VcEvChkSum: start-on-event=DemSatellite_0InternalBehavior/GetDTCOfEvent, operation=Event_VcEvChkSum.GetDTCOfEvent
        OpEventGetDTCOfEvent_GetDTCOfEvent_EvtInfo_PS_P5_UC_FLT: start-on-event=DemSatellite_0InternalBehavior/GetDTCOfEvent, operation=EvtInfo_PS_P5_UC_FLT.GetDTCOfEvent
        OpEventGetDTCOfEvent_GetDTCOfEvent_Event_PS_P5_UC_FLT: start-on-event=DemSatellite_0InternalBehavior/GetDTCOfEvent, operation=Event_PS_P5_UC_FLT.GetDTCOfEvent
        OpEventGetDTCOfEvent_GetDTCOfEvent_EvtInfo_INV_RSLVR_COS_ELEC_FLT: start-on-event=DemSatellite_0InternalBehavior/GetDTCOfEvent, operation=EvtInfo_INV_RSLVR_COS_ELEC_FLT.GetDTCOfEvent
        OpEventGetDTCOfEvent_GetDTCOfEvent_Event_INV_RSLVR_COS_ELEC_FLT: start-on-event=DemSatellite_0InternalBehavior/GetDTCOfEvent, operation=Event_INV_RSLVR_COS_ELEC_FLT.GetDTCOfEvent
        OpEventGetDTCOfEvent_GetDTCOfEvent_EvtInfo_INV_IAC_W_RNG_HI: start-on-event=DemSatellite_0InternalBehavior/GetDTCOfEvent, operation=EvtInfo_INV_IAC_W_RNG_HI.GetDTCOfEvent
        OpEventGetDTCOfEvent_GetDTCOfEvent_Event_INV_IAC_W_RNG_HI: start-on-event=DemSatellite_0InternalBehavior/GetDTCOfEvent, operation=Event_INV_IAC_W_RNG_HI.GetDTCOfEvent
        OpEventGetDTCOfEvent_GetDTCOfEvent_EvtInfo_PS_ECUSUPPLY_HIGH: start-on-event=DemSatellite_0InternalBehavior/GetDTCOfEvent, operation=EvtInfo_PS_ECUSUPPLY_HIGH.GetDTCOfEvent
        OpEventGetDTCOfEvent_GetDTCOfEvent_Event_PS_ECUSUPPLY_HIGH: start-on-event=DemSatellite_0InternalBehavior/GetDTCOfEvent, operation=Event_PS_ECUSUPPLY_HIGH.GetDTCOfEvent
        OpEventGetDTCOfEvent_GetDTCOfEvent_EvtInfo_VCEvEcmPropFr05Tioutd: start-on-event=DemSatellite_0InternalBehavior/GetDTCOfEvent, operation=EvtInfo_VCEvEcmPropFr05Tioutd.GetDTCOfEvent
        OpEventGetDTCOfEvent_GetDTCOfEvent_Event_VCEvEcmPropFr05Tioutd: start-on-event=DemSatellite_0InternalBehavior/GetDTCOfEvent, operation=Event_VCEvEcmPropFr05Tioutd.GetDTCOfEvent
        OpEventGetDTCOfEvent_GetDTCOfEvent_EvtInfo_PS_ECUSUPPLY_LOW: start-on-event=DemSatellite_0InternalBehavior/GetDTCOfEvent, operation=EvtInfo_PS_ECUSUPPLY_LOW.GetDTCOfEvent
        OpEventGetDTCOfEvent_GetDTCOfEvent_Event_PS_ECUSUPPLY_LOW: start-on-event=DemSatellite_0InternalBehavior/GetDTCOfEvent, operation=Event_PS_ECUSUPPLY_LOW.GetDTCOfEvent
        OpEventGetDTCOfEvent_GetDTCOfEvent_EvtInfo_VcEvChkSumHvSysRlySts: start-on-event=DemSatellite_0InternalBehavior/GetDTCOfEvent, operation=EvtInfo_VcEvChkSumHvSysRlySts.GetDTCOfEvent
        OpEventGetDTCOfEvent_GetDTCOfEvent_Event_VcEvChkSumHvSysRlySts: start-on-event=DemSatellite_0InternalBehavior/GetDTCOfEvent, operation=Event_VcEvChkSumHvSysRlySts.GetDTCOfEvent
        OpEventGetDTCOfEvent_GetDTCOfEvent_EvtInfo_VcEvMonMode: start-on-event=DemSatellite_0InternalBehavior/GetDTCOfEvent, operation=EvtInfo_VcEvMonMode.GetDTCOfEvent
        OpEventGetDTCOfEvent_GetDTCOfEvent_Event_VcEvMonMode: start-on-event=DemSatellite_0InternalBehavior/GetDTCOfEvent, operation=Event_VcEvMonMode.GetDTCOfEvent
        OpEventGetDTCOfEvent_GetDTCOfEvent_EvtInfo_INV_IAC_OC_SWP: start-on-event=DemSatellite_0InternalBehavior/GetDTCOfEvent, operation=EvtInfo_INV_IAC_OC_SWP.GetDTCOfEvent
        OpEventGetDTCOfEvent_GetDTCOfEvent_Event_INV_IAC_OC_SWP: start-on-event=DemSatellite_0InternalBehavior/GetDTCOfEvent, operation=Event_INV_IAC_OC_SWP.GetDTCOfEvent
        OpEventGetDTCOfEvent_GetDTCOfEvent_EvtInfo_INV_IMMO_AUTHFAIL: start-on-event=DemSatellite_0InternalBehavior/GetDTCOfEvent, operation=EvtInfo_INV_IMMO_AUTHFAIL.GetDTCOfEvent
        OpEventGetDTCOfEvent_GetDTCOfEvent_Event_INV_IMMO_AUTHFAIL: start-on-event=DemSatellite_0InternalBehavior/GetDTCOfEvent, operation=Event_INV_IMMO_AUTHFAIL.GetDTCOfEvent
        OpEventGetDTCOfEvent_GetDTCOfEvent_EvtInfo_PA_OpenCirc_FLT: start-on-event=DemSatellite_0InternalBehavior/GetDTCOfEvent, operation=EvtInfo_PA_OpenCirc_FLT.GetDTCOfEvent
        OpEventGetDTCOfEvent_GetDTCOfEvent_Event_PA_OpenCirc_FLT: start-on-event=DemSatellite_0InternalBehavior/GetDTCOfEvent, operation=Event_PA_OpenCirc_FLT.GetDTCOfEvent
        OpEventGetDTCOfEvent_GetDTCOfEvent_EvtInfo_INV_IAC_V_ELEC_HI: start-on-event=DemSatellite_0InternalBehavior/GetDTCOfEvent, operation=EvtInfo_INV_IAC_V_ELEC_HI.GetDTCOfEvent
        OpEventGetDTCOfEvent_GetDTCOfEvent_Event_INV_IAC_V_ELEC_HI: start-on-event=DemSatellite_0InternalBehavior/GetDTCOfEvent, operation=Event_INV_IAC_V_ELEC_HI.GetDTCOfEvent
        OpEventGetDTCOfEvent_GetDTCOfEvent_EvtInfo_VCEvEcmPropFr04Tioutd: start-on-event=DemSatellite_0InternalBehavior/GetDTCOfEvent, operation=EvtInfo_VCEvEcmPropFr04Tioutd.GetDTCOfEvent
        OpEventGetDTCOfEvent_GetDTCOfEvent_Event_VCEvEcmPropFr04Tioutd: start-on-event=DemSatellite_0InternalBehavior/GetDTCOfEvent, operation=Event_VCEvEcmPropFr04Tioutd.GetDTCOfEvent
        OpEventGetDTCOfEvent_GetDTCOfEvent_EvtInfo_VcEvMonTrqActPlaus: start-on-event=DemSatellite_0InternalBehavior/GetDTCOfEvent, operation=EvtInfo_VcEvMonTrqActPlaus.GetDTCOfEvent
        OpEventGetDTCOfEvent_GetDTCOfEvent_Event_VcEvMonTrqActPlaus: start-on-event=DemSatellite_0InternalBehavior/GetDTCOfEvent, operation=Event_VcEvMonTrqActPlaus.GetDTCOfEvent
        OpEventGetDTCOfEvent_GetDTCOfEvent_EvtInfo_VcEvMonTrqAct: start-on-event=DemSatellite_0InternalBehavior/GetDTCOfEvent, operation=EvtInfo_VcEvMonTrqAct.GetDTCOfEvent
        OpEventGetDTCOfEvent_GetDTCOfEvent_Event_VcEvMonTrqAct: start-on-event=DemSatellite_0InternalBehavior/GetDTCOfEvent, operation=Event_VcEvMonTrqAct.GetDTCOfEvent
        OpEventGetDTCOfEvent_GetDTCOfEvent_EvtInfo_INV_RSLVR_COS_ELEC_LO: start-on-event=DemSatellite_0InternalBehavior/GetDTCOfEvent, operation=EvtInfo_INV_RSLVR_COS_ELEC_LO.GetDTCOfEvent
        OpEventGetDTCOfEvent_GetDTCOfEvent_Event_INV_RSLVR_COS_ELEC_LO: start-on-event=DemSatellite_0InternalBehavior/GetDTCOfEvent, operation=Event_INV_RSLVR_COS_ELEC_LO.GetDTCOfEvent
        OpEventGetDTCOfEvent_GetDTCOfEvent_EvtInfo_INV_COOLT_INLET_TEMP_HWP: start-on-event=DemSatellite_0InternalBehavior/GetDTCOfEvent, operation=EvtInfo_INV_COOLT_INLET_TEMP_HWP.GetDTCOfEvent
        OpEventGetDTCOfEvent_GetDTCOfEvent_Event_INV_COOLT_INLET_TEMP_HWP: start-on-event=DemSatellite_0InternalBehavior/GetDTCOfEvent, operation=Event_INV_COOLT_INLET_TEMP_HWP.GetDTCOfEvent
        OpEventGetDTCOfEvent_GetDTCOfEvent_EvtInfo_VCEvEcmPropFr11Tioutd: start-on-event=DemSatellite_0InternalBehavior/GetDTCOfEvent, operation=EvtInfo_VCEvEcmPropFr11Tioutd.GetDTCOfEvent
        OpEventGetDTCOfEvent_GetDTCOfEvent_Event_VCEvEcmPropFr11Tioutd: start-on-event=DemSatellite_0InternalBehavior/GetDTCOfEvent, operation=Event_VCEvEcmPropFr11Tioutd.GetDTCOfEvent
        OpEventGetDTCOfEvent_GetDTCOfEvent_EvtInfo_PS_KL30_RNG_HI: start-on-event=DemSatellite_0InternalBehavior/GetDTCOfEvent, operation=EvtInfo_PS_KL30_RNG_HI.GetDTCOfEvent
        OpEventGetDTCOfEvent_GetDTCOfEvent_Event_PS_KL30_RNG_HI: start-on-event=DemSatellite_0InternalBehavior/GetDTCOfEvent, operation=Event_PS_KL30_RNG_HI.GetDTCOfEvent
        OpEventGetDTCOfEvent_GetDTCOfEvent_EvtInfo_INV_IAC_OC_HWP: start-on-event=DemSatellite_0InternalBehavior/GetDTCOfEvent, operation=EvtInfo_INV_IAC_OC_HWP.GetDTCOfEvent
        OpEventGetDTCOfEvent_GetDTCOfEvent_Event_INV_IAC_OC_HWP: start-on-event=DemSatellite_0InternalBehavior/GetDTCOfEvent, operation=Event_INV_IAC_OC_HWP.GetDTCOfEvent
        OpEventGetDTCOfEvent_GetDTCOfEvent_EvtInfo_INV_RSLVR_COS_RNG_HI: start-on-event=DemSatellite_0InternalBehavior/GetDTCOfEvent, operation=EvtInfo_INV_RSLVR_COS_RNG_HI.GetDTCOfEvent
        OpEventGetDTCOfEvent_GetDTCOfEvent_Event_INV_RSLVR_COS_RNG_HI: start-on-event=DemSatellite_0InternalBehavior/GetDTCOfEvent, operation=Event_INV_RSLVR_COS_RNG_HI.GetDTCOfEvent
        OpEventGetDTCOfEvent_GetDTCOfEvent_EvtInfo_INV_IAC_U_ELEC_HI: start-on-event=DemSatellite_0InternalBehavior/GetDTCOfEvent, operation=EvtInfo_INV_IAC_U_ELEC_HI.GetDTCOfEvent
        OpEventGetDTCOfEvent_GetDTCOfEvent_Event_INV_IAC_U_ELEC_HI: start-on-event=DemSatellite_0InternalBehavior/GetDTCOfEvent, operation=Event_INV_IAC_U_ELEC_HI.GetDTCOfEvent
        OpEventGetDTCOfEvent_GetDTCOfEvent_EvtInfo_INV_IAC_V_RNG_LO: start-on-event=DemSatellite_0InternalBehavior/GetDTCOfEvent, operation=EvtInfo_INV_IAC_V_RNG_LO.GetDTCOfEvent
        OpEventGetDTCOfEvent_GetDTCOfEvent_Event_INV_IAC_V_RNG_LO: start-on-event=DemSatellite_0InternalBehavior/GetDTCOfEvent, operation=Event_INV_IAC_V_RNG_LO.GetDTCOfEvent
        OpEventGetDTCOfEvent_GetDTCOfEvent_EvtInfo_INV_IAC_U_RNG_HI: start-on-event=DemSatellite_0InternalBehavior/GetDTCOfEvent, operation=EvtInfo_INV_IAC_U_RNG_HI.GetDTCOfEvent
        OpEventGetDTCOfEvent_GetDTCOfEvent_Event_INV_IAC_U_RNG_HI: start-on-event=DemSatellite_0InternalBehavior/GetDTCOfEvent, operation=Event_INV_IAC_U_RNG_HI.GetDTCOfEvent
        OpEventGetDTCOfEvent_GetDTCOfEvent_EvtInfo_VCEvEcmPropFr25Tioutd: start-on-event=DemSatellite_0InternalBehavior/GetDTCOfEvent, operation=EvtInfo_VCEvEcmPropFr25Tioutd.GetDTCOfEvent
        OpEventGetDTCOfEvent_GetDTCOfEvent_Event_VCEvEcmPropFr25Tioutd: start-on-event=DemSatellite_0InternalBehavior/GetDTCOfEvent, operation=Event_VCEvEcmPropFr25Tioutd.GetDTCOfEvent
        OpEventGetDTCOfEvent_GetDTCOfEvent_EvtInfo_INV_IGBT_TEMP_W_RNG_LO: start-on-event=DemSatellite_0InternalBehavior/GetDTCOfEvent, operation=EvtInfo_INV_IGBT_TEMP_W_RNG_LO.GetDTCOfEvent
        OpEventGetDTCOfEvent_GetDTCOfEvent_Event_INV_IGBT_TEMP_W_RNG_LO: start-on-event=DemSatellite_0InternalBehavior/GetDTCOfEvent, operation=Event_INV_IGBT_TEMP_W_RNG_LO.GetDTCOfEvent
        OpEventGetDTCOfEvent_GetDTCOfEvent_EvtInfo_PSnsr_RNG_NOK: start-on-event=DemSatellite_0InternalBehavior/GetDTCOfEvent, operation=EvtInfo_PSnsr_RNG_NOK.GetDTCOfEvent
        OpEventGetDTCOfEvent_GetDTCOfEvent_Event_PSnsr_RNG_NOK: start-on-event=DemSatellite_0InternalBehavior/GetDTCOfEvent, operation=Event_PSnsr_RNG_NOK.GetDTCOfEvent
        OpEventGetDTCOfEvent_GetDTCOfEvent_EvtInfo_INV_RSLVR_COS_RNG_NOK: start-on-event=DemSatellite_0InternalBehavior/GetDTCOfEvent, operation=EvtInfo_INV_RSLVR_COS_RNG_NOK.GetDTCOfEvent
        OpEventGetDTCOfEvent_GetDTCOfEvent_Event_INV_RSLVR_COS_RNG_NOK: start-on-event=DemSatellite_0InternalBehavior/GetDTCOfEvent, operation=Event_INV_RSLVR_COS_RNG_NOK.GetDTCOfEvent
        OpEventGetDTCOfEvent_GetDTCOfEvent_EvtInfo_PS_DRVB_Fault: start-on-event=DemSatellite_0InternalBehavior/GetDTCOfEvent, operation=EvtInfo_PS_DRVB_Fault.GetDTCOfEvent
        OpEventGetDTCOfEvent_GetDTCOfEvent_Event_PS_DRVB_Fault: start-on-event=DemSatellite_0InternalBehavior/GetDTCOfEvent, operation=Event_PS_DRVB_Fault.GetDTCOfEvent
        OpEventGetDTCOfEvent_GetDTCOfEvent_EvtInfo_INV_CU_TEMP1_RNG_NOK: start-on-event=DemSatellite_0InternalBehavior/GetDTCOfEvent, operation=EvtInfo_INV_CU_TEMP1_RNG_NOK.GetDTCOfEvent
        OpEventGetDTCOfEvent_GetDTCOfEvent_Event_INV_CU_TEMP1_RNG_NOK: start-on-event=DemSatellite_0InternalBehavior/GetDTCOfEvent, operation=Event_INV_CU_TEMP1_RNG_NOK.GetDTCOfEvent
        OpEventGetDTCOfEvent_GetDTCOfEvent_EvtInfo_VcEvCntr: start-on-event=DemSatellite_0InternalBehavior/GetDTCOfEvent, operation=EvtInfo_VcEvCntr.GetDTCOfEvent
        OpEventGetDTCOfEvent_GetDTCOfEvent_Event_VcEvCntr: start-on-event=DemSatellite_0InternalBehavior/GetDTCOfEvent, operation=Event_VcEvCntr.GetDTCOfEvent
        OpEventGetDTCOfEvent_GetDTCOfEvent_EvtInfo_INV_RSLVR_SIN_AMP: start-on-event=DemSatellite_0InternalBehavior/GetDTCOfEvent, operation=EvtInfo_INV_RSLVR_SIN_AMP.GetDTCOfEvent
        OpEventGetDTCOfEvent_GetDTCOfEvent_Event_INV_RSLVR_SIN_AMP: start-on-event=DemSatellite_0InternalBehavior/GetDTCOfEvent, operation=Event_INV_RSLVR_SIN_AMP.GetDTCOfEvent
        OpEventGetDTCOfEvent_GetDTCOfEvent_EvtInfo_INV_UHVDC_2_RNG_HI: start-on-event=DemSatellite_0InternalBehavior/GetDTCOfEvent, operation=EvtInfo_INV_UHVDC_2_RNG_HI.GetDTCOfEvent
        OpEventGetDTCOfEvent_GetDTCOfEvent_Event_INV_UHVDC_2_RNG_HI: start-on-event=DemSatellite_0InternalBehavior/GetDTCOfEvent, operation=Event_INV_UHVDC_2_RNG_HI.GetDTCOfEvent
        OpEventGetDTCOfEvent_GetDTCOfEvent_EvtInfo_INV_IGBT_TEMP_U_GRDT: start-on-event=DemSatellite_0InternalBehavior/GetDTCOfEvent, operation=EvtInfo_INV_IGBT_TEMP_U_GRDT.GetDTCOfEvent
        OpEventGetDTCOfEvent_GetDTCOfEvent_Event_INV_IGBT_TEMP_U_GRDT: start-on-event=DemSatellite_0InternalBehavior/GetDTCOfEvent, operation=Event_INV_IGBT_TEMP_U_GRDT.GetDTCOfEvent
        OpEventGetDTCOfEvent_GetDTCOfEvent_EvtInfo_MON_TQ_PLAUS_PWR_MDL: start-on-event=DemSatellite_0InternalBehavior/GetDTCOfEvent, operation=EvtInfo_MON_TQ_PLAUS_PWR_MDL.GetDTCOfEvent
        OpEventGetDTCOfEvent_GetDTCOfEvent_Event_MON_TQ_PLAUS_PWR_MDL: start-on-event=DemSatellite_0InternalBehavior/GetDTCOfEvent, operation=Event_MON_TQ_PLAUS_PWR_MDL.GetDTCOfEvent
        OpEventGetDTCOfEvent_GetDTCOfEvent_EvtInfo_INV_IGBT_TEMP_W_PLAUS: start-on-event=DemSatellite_0InternalBehavior/GetDTCOfEvent, operation=EvtInfo_INV_IGBT_TEMP_W_PLAUS.GetDTCOfEvent
        OpEventGetDTCOfEvent_GetDTCOfEvent_Event_INV_IGBT_TEMP_W_PLAUS: start-on-event=DemSatellite_0InternalBehavior/GetDTCOfEvent, operation=Event_INV_IGBT_TEMP_W_PLAUS.GetDTCOfEvent
        OpEventGetDTCOfEvent_GetDTCOfEvent_EvtInfo_PS_BLDC_UV_FLT: start-on-event=DemSatellite_0InternalBehavior/GetDTCOfEvent, operation=EvtInfo_PS_BLDC_UV_FLT.GetDTCOfEvent
        OpEventGetDTCOfEvent_GetDTCOfEvent_Event_PS_BLDC_UV_FLT: start-on-event=DemSatellite_0InternalBehavior/GetDTCOfEvent, operation=Event_PS_BLDC_UV_FLT.GetDTCOfEvent
        OpEventGetDTCOfEvent_GetDTCOfEvent_EvtInfo_INV_IAC_V_OFFS: start-on-event=DemSatellite_0InternalBehavior/GetDTCOfEvent, operation=EvtInfo_INV_IAC_V_OFFS.GetDTCOfEvent
        OpEventGetDTCOfEvent_GetDTCOfEvent_Event_INV_IAC_V_OFFS: start-on-event=DemSatellite_0InternalBehavior/GetDTCOfEvent, operation=Event_INV_IAC_V_OFFS.GetDTCOfEvent
        OpEventGetDTCOfEvent_GetDTCOfEvent_EvtInfo_INV_RSLVR_EXCT_FREQ_RNG_NOK: start-on-event=DemSatellite_0InternalBehavior/GetDTCOfEvent, operation=EvtInfo_INV_RSLVR_EXCT_FREQ_RNG_NOK.GetDTCOfEvent
        OpEventGetDTCOfEvent_GetDTCOfEvent_Event_INV_RSLVR_EXCT_FREQ_RNG_NOK: start-on-event=DemSatellite_0InternalBehavior/GetDTCOfEvent, operation=Event_INV_RSLVR_EXCT_FREQ_RNG_NOK.GetDTCOfEvent
        OpEventGetDTCOfEvent_GetDTCOfEvent_EvtInfo_PS_KL30_RNG_LO: start-on-event=DemSatellite_0InternalBehavior/GetDTCOfEvent, operation=EvtInfo_PS_KL30_RNG_LO.GetDTCOfEvent
        OpEventGetDTCOfEvent_GetDTCOfEvent_Event_PS_KL30_RNG_LO: start-on-event=DemSatellite_0InternalBehavior/GetDTCOfEvent, operation=Event_PS_KL30_RNG_LO.GetDTCOfEvent
        OpEventGetDTCOfEvent_GetDTCOfEvent_EvtInfo_INV_RSLVR_COS_RNG_LO: start-on-event=DemSatellite_0InternalBehavior/GetDTCOfEvent, operation=EvtInfo_INV_RSLVR_COS_RNG_LO.GetDTCOfEvent
        OpEventGetDTCOfEvent_GetDTCOfEvent_Event_INV_RSLVR_COS_RNG_LO: start-on-event=DemSatellite_0InternalBehavior/GetDTCOfEvent, operation=Event_INV_RSLVR_COS_RNG_LO.GetDTCOfEvent
        OpEventGetDTCOfEvent_GetDTCOfEvent_EvtInfo_PSnsr_ELE_FLT: start-on-event=DemSatellite_0InternalBehavior/GetDTCOfEvent, operation=EvtInfo_PSnsr_ELE_FLT.GetDTCOfEvent
        OpEventGetDTCOfEvent_GetDTCOfEvent_Event_PSnsr_ELE_FLT: start-on-event=DemSatellite_0InternalBehavior/GetDTCOfEvent, operation=Event_PSnsr_ELE_FLT.GetDTCOfEvent
        OpEventGetDTCOfEvent_GetDTCOfEvent_EvtInfo_INV_RSLVR_SIN_COS_PLAUS_AMP: start-on-event=DemSatellite_0InternalBehavior/GetDTCOfEvent, operation=EvtInfo_INV_RSLVR_SIN_COS_PLAUS_AMP.GetDTCOfEvent
        OpEventGetDTCOfEvent_GetDTCOfEvent_Event_INV_RSLVR_SIN_COS_PLAUS_AMP: start-on-event=DemSatellite_0InternalBehavior/GetDTCOfEvent, operation=Event_INV_RSLVR_SIN_COS_PLAUS_AMP.GetDTCOfEvent
        OpEventGetDTCOfEvent_GetDTCOfEvent_EvtInfo_INV_IAC_U_ELEC_LO: start-on-event=DemSatellite_0InternalBehavior/GetDTCOfEvent, operation=EvtInfo_INV_IAC_U_ELEC_LO.GetDTCOfEvent
        OpEventGetDTCOfEvent_GetDTCOfEvent_Event_INV_IAC_U_ELEC_LO: start-on-event=DemSatellite_0InternalBehavior/GetDTCOfEvent, operation=Event_INV_IAC_U_ELEC_LO.GetDTCOfEvent
        OpEventGetDTCOfEvent_GetDTCOfEvent_EvtInfo_INV_RSLVR_EXCT_ELEC_HI: start-on-event=DemSatellite_0InternalBehavior/GetDTCOfEvent, operation=EvtInfo_INV_RSLVR_EXCT_ELEC_HI.GetDTCOfEvent
        OpEventGetDTCOfEvent_GetDTCOfEvent_Event_INV_RSLVR_EXCT_ELEC_HI: start-on-event=DemSatellite_0InternalBehavior/GetDTCOfEvent, operation=Event_INV_RSLVR_EXCT_ELEC_HI.GetDTCOfEvent
        OpEventGetDTCOfEvent_GetDTCOfEvent_EvtInfo_INV_IAC_U_RNG_LO: start-on-event=DemSatellite_0InternalBehavior/GetDTCOfEvent, operation=EvtInfo_INV_IAC_U_RNG_LO.GetDTCOfEvent
        OpEventGetDTCOfEvent_GetDTCOfEvent_Event_INV_IAC_U_RNG_LO: start-on-event=DemSatellite_0InternalBehavior/GetDTCOfEvent, operation=Event_INV_IAC_U_RNG_LO.GetDTCOfEvent
        OpEventGetDTCOfEvent_GetDTCOfEvent_EvtInfo_INV_IAC_V_RNG_HI: start-on-event=DemSatellite_0InternalBehavior/GetDTCOfEvent, operation=EvtInfo_INV_IAC_V_RNG_HI.GetDTCOfEvent
        OpEventGetDTCOfEvent_GetDTCOfEvent_Event_INV_IAC_V_RNG_HI: start-on-event=DemSatellite_0InternalBehavior/GetDTCOfEvent, operation=Event_INV_IAC_V_RNG_HI.GetDTCOfEvent
        OpEventGetDTCOfEvent_GetDTCOfEvent_EvtInfo_INV_IGBT_TEMP_U_PLAUS: start-on-event=DemSatellite_0InternalBehavior/GetDTCOfEvent, operation=EvtInfo_INV_IGBT_TEMP_U_PLAUS.GetDTCOfEvent
        OpEventGetDTCOfEvent_GetDTCOfEvent_Event_INV_IGBT_TEMP_U_PLAUS: start-on-event=DemSatellite_0InternalBehavior/GetDTCOfEvent, operation=Event_INV_IGBT_TEMP_U_PLAUS.GetDTCOfEvent
        OpEventGetDTCOfEvent_GetDTCOfEvent_EvtInfo_INV_RSLVR_OFFS_DFT: start-on-event=DemSatellite_0InternalBehavior/GetDTCOfEvent, operation=EvtInfo_INV_RSLVR_OFFS_DFT.GetDTCOfEvent
        OpEventGetDTCOfEvent_GetDTCOfEvent_Event_INV_RSLVR_OFFS_DFT: start-on-event=DemSatellite_0InternalBehavior/GetDTCOfEvent, operation=Event_INV_RSLVR_OFFS_DFT.GetDTCOfEvent
        OpEventGetDTCOfEvent_GetDTCOfEvent_EvtInfo_Ga_MoveOverThd: start-on-event=DemSatellite_0InternalBehavior/GetDTCOfEvent, operation=EvtInfo_Ga_MoveOverThd.GetDTCOfEvent
        OpEventGetDTCOfEvent_GetDTCOfEvent_Event_Ga_MoveOverThd: start-on-event=DemSatellite_0InternalBehavior/GetDTCOfEvent, operation=Event_Ga_MoveOverThd.GetDTCOfEvent
        OpEventGetDTCOfEvent_GetDTCOfEvent_EvtInfo_VcEvMonIPH: start-on-event=DemSatellite_0InternalBehavior/GetDTCOfEvent, operation=EvtInfo_VcEvMonIPH.GetDTCOfEvent
        OpEventGetDTCOfEvent_GetDTCOfEvent_Event_VcEvMonIPH: start-on-event=DemSatellite_0InternalBehavior/GetDTCOfEvent, operation=Event_VcEvMonIPH.GetDTCOfEvent
        OpEventGetDTCOfEvent_GetDTCOfEvent_EvtInfo_INV_RSLVR_HW_FLT: start-on-event=DemSatellite_0InternalBehavior/GetDTCOfEvent, operation=EvtInfo_INV_RSLVR_HW_FLT.GetDTCOfEvent
        OpEventGetDTCOfEvent_GetDTCOfEvent_Event_INV_RSLVR_HW_FLT: start-on-event=DemSatellite_0InternalBehavior/GetDTCOfEvent, operation=Event_INV_RSLVR_HW_FLT.GetDTCOfEvent
        OpEventGetDTCOfEvent_GetDTCOfEvent_EvtInfo_INV_RSLVR_SIN_ELEC_LO: start-on-event=DemSatellite_0InternalBehavior/GetDTCOfEvent, operation=EvtInfo_INV_RSLVR_SIN_ELEC_LO.GetDTCOfEvent
        OpEventGetDTCOfEvent_GetDTCOfEvent_Event_INV_RSLVR_SIN_ELEC_LO: start-on-event=DemSatellite_0InternalBehavior/GetDTCOfEvent, operation=Event_INV_RSLVR_SIN_ELEC_LO.GetDTCOfEvent
        OpEventGetDTCOfEvent_GetDTCOfEvent_EvtInfo_INV_IAC_W_AMP: start-on-event=DemSatellite_0InternalBehavior/GetDTCOfEvent, operation=EvtInfo_INV_IAC_W_AMP.GetDTCOfEvent
        OpEventGetDTCOfEvent_GetDTCOfEvent_Event_INV_IAC_W_AMP: start-on-event=DemSatellite_0InternalBehavior/GetDTCOfEvent, operation=Event_INV_IAC_W_AMP.GetDTCOfEvent
        OpEventGetDTCOfEvent_GetDTCOfEvent_EvtInfo_VCC_OverVoltage: start-on-event=DemSatellite_0InternalBehavior/GetDTCOfEvent, operation=EvtInfo_VCC_OverVoltage.GetDTCOfEvent
        OpEventGetDTCOfEvent_GetDTCOfEvent_Event_VCC_OverVoltage: start-on-event=DemSatellite_0InternalBehavior/GetDTCOfEvent, operation=Event_VCC_OverVoltage.GetDTCOfEvent
        OpEventGetDTCOfEvent_GetDTCOfEvent_EvtInfo_PS_BLDC_OV_FLT: start-on-event=DemSatellite_0InternalBehavior/GetDTCOfEvent, operation=EvtInfo_PS_BLDC_OV_FLT.GetDTCOfEvent
        OpEventGetDTCOfEvent_GetDTCOfEvent_Event_PS_BLDC_OV_FLT: start-on-event=DemSatellite_0InternalBehavior/GetDTCOfEvent, operation=Event_PS_BLDC_OV_FLT.GetDTCOfEvent
        OpEventGetDTCOfEvent_GetDTCOfEvent_EvtInfo_AURIX_EEPROM_FLT: start-on-event=DemSatellite_0InternalBehavior/GetDTCOfEvent, operation=EvtInfo_AURIX_EEPROM_FLT.GetDTCOfEvent
        OpEventGetDTCOfEvent_GetDTCOfEvent_Event_AURIX_EEPROM_FLT: start-on-event=DemSatellite_0InternalBehavior/GetDTCOfEvent, operation=Event_AURIX_EEPROM_FLT.GetDTCOfEvent
        OpEventGetDTCOfEvent_GetDTCOfEvent_EvtInfo_FS_MONITIOR_ASC_FW_FLT: start-on-event=DemSatellite_0InternalBehavior/GetDTCOfEvent, operation=EvtInfo_FS_MONITIOR_ASC_FW_FLT.GetDTCOfEvent
        OpEventGetDTCOfEvent_GetDTCOfEvent_Event_FS_MONITIOR_ASC_FW_FLT: start-on-event=DemSatellite_0InternalBehavior/GetDTCOfEvent, operation=Event_FS_MONITIOR_ASC_FW_FLT.GetDTCOfEvent
        OpEventGetDTCOfEvent_GetDTCOfEvent_EvtInfo_VCEvSrsPropFr02Tioutd: start-on-event=DemSatellite_0InternalBehavior/GetDTCOfEvent, operation=EvtInfo_VCEvSrsPropFr02Tioutd.GetDTCOfEvent
        OpEventGetDTCOfEvent_GetDTCOfEvent_Event_VCEvSrsPropFr02Tioutd: start-on-event=DemSatellite_0InternalBehavior/GetDTCOfEvent, operation=Event_VCEvSrsPropFr02Tioutd.GetDTCOfEvent
        OpEventGetDTCOfEvent_GetDTCOfEvent_EvtInfo_VcEvMonErrMode: start-on-event=DemSatellite_0InternalBehavior/GetDTCOfEvent, operation=EvtInfo_VcEvMonErrMode.GetDTCOfEvent
        OpEventGetDTCOfEvent_GetDTCOfEvent_Event_VcEvMonErrMode: start-on-event=DemSatellite_0InternalBehavior/GetDTCOfEvent, operation=Event_VcEvMonErrMode.GetDTCOfEvent
        OpEventGetDTCOfEvent_GetDTCOfEvent_EvtInfo_AURIX_RST_MPL: start-on-event=DemSatellite_0InternalBehavior/GetDTCOfEvent, operation=EvtInfo_AURIX_RST_MPL.GetDTCOfEvent
        OpEventGetDTCOfEvent_GetDTCOfEvent_Event_AURIX_RST_MPL: start-on-event=DemSatellite_0InternalBehavior/GetDTCOfEvent, operation=Event_AURIX_RST_MPL.GetDTCOfEvent
        OpEventGetDTCOfEvent_GetDTCOfEvent_EvtInfo_VcEvNodeMisECM: start-on-event=DemSatellite_0InternalBehavior/GetDTCOfEvent, operation=EvtInfo_VcEvNodeMisECM.GetDTCOfEvent
        OpEventGetDTCOfEvent_GetDTCOfEvent_Event_VcEvNodeMisECM: start-on-event=DemSatellite_0InternalBehavior/GetDTCOfEvent, operation=Event_VcEvNodeMisECM.GetDTCOfEvent
        OpEventGetDTCOfEvent_GetDTCOfEvent_EvtInfo_PS_KL30_PLAUS: start-on-event=DemSatellite_0InternalBehavior/GetDTCOfEvent, operation=EvtInfo_PS_KL30_PLAUS.GetDTCOfEvent
        OpEventGetDTCOfEvent_GetDTCOfEvent_Event_PS_KL30_PLAUS: start-on-event=DemSatellite_0InternalBehavior/GetDTCOfEvent, operation=Event_PS_KL30_PLAUS.GetDTCOfEvent
        OpEventGetDTCOfEvent_GetDTCOfEvent_EvtInfo_INV_IAC_W_ELEC_HI: start-on-event=DemSatellite_0InternalBehavior/GetDTCOfEvent, operation=EvtInfo_INV_IAC_W_ELEC_HI.GetDTCOfEvent
        OpEventGetDTCOfEvent_GetDTCOfEvent_Event_INV_IAC_W_ELEC_HI: start-on-event=DemSatellite_0InternalBehavior/GetDTCOfEvent, operation=Event_INV_IAC_W_ELEC_HI.GetDTCOfEvent
        OpEventGetDTCOfEvent_GetDTCOfEvent_EvtInfo_VCEvVddmPropFr19Tioutd: start-on-event=DemSatellite_0InternalBehavior/GetDTCOfEvent, operation=EvtInfo_VCEvVddmPropFr19Tioutd.GetDTCOfEvent
        OpEventGetDTCOfEvent_GetDTCOfEvent_Event_VCEvVddmPropFr19Tioutd: start-on-event=DemSatellite_0InternalBehavior/GetDTCOfEvent, operation=Event_VCEvVddmPropFr19Tioutd.GetDTCOfEvent
        OpEventGetDTCOfEvent_GetDTCOfEvent_EvtInfo_INV_TEMP_DCHA_HW: start-on-event=DemSatellite_0InternalBehavior/GetDTCOfEvent, operation=EvtInfo_INV_TEMP_DCHA_HW.GetDTCOfEvent
        OpEventGetDTCOfEvent_GetDTCOfEvent_Event_INV_TEMP_DCHA_HW: start-on-event=DemSatellite_0InternalBehavior/GetDTCOfEvent, operation=Event_INV_TEMP_DCHA_HW.GetDTCOfEvent
        OpEventGetDTCOfEvent_GetDTCOfEvent_EvtInfo_VcEvPropCANGlbTiOutd: start-on-event=DemSatellite_0InternalBehavior/GetDTCOfEvent, operation=EvtInfo_VcEvPropCANGlbTiOutd.GetDTCOfEvent
        OpEventGetDTCOfEvent_GetDTCOfEvent_Event_VcEvPropCANGlbTiOutd: start-on-event=DemSatellite_0InternalBehavior/GetDTCOfEvent, operation=Event_VcEvPropCANGlbTiOutd.GetDTCOfEvent
        OpEventGetDTCOfEvent_GetDTCOfEvent_EvtInfo_INV_EM_STATOR_TEMP2_RNG_NOK: start-on-event=DemSatellite_0InternalBehavior/GetDTCOfEvent, operation=EvtInfo_INV_EM_STATOR_TEMP2_RNG_NOK.GetDTCOfEvent
        OpEventGetDTCOfEvent_GetDTCOfEvent_Event_INV_EM_STATOR_TEMP2_RNG_NOK: start-on-event=DemSatellite_0InternalBehavior/GetDTCOfEvent, operation=Event_INV_EM_STATOR_TEMP2_RNG_NOK.GetDTCOfEvent
        OpEventGetDTCOfEvent_GetDTCOfEvent_EvtInfo_INV_UHVDC_OV_HWP: start-on-event=DemSatellite_0InternalBehavior/GetDTCOfEvent, operation=EvtInfo_INV_UHVDC_OV_HWP.GetDTCOfEvent
        OpEventGetDTCOfEvent_GetDTCOfEvent_Event_INV_UHVDC_OV_HWP: start-on-event=DemSatellite_0InternalBehavior/GetDTCOfEvent, operation=Event_INV_UHVDC_OV_HWP.GetDTCOfEvent
        OpEventGetDTCOfEvent_GetDTCOfEvent_EvtInfo_Ga_FindEngleAngleFailed: start-on-event=DemSatellite_0InternalBehavior/GetDTCOfEvent, operation=EvtInfo_Ga_FindEngleAngleFailed.GetDTCOfEvent
        OpEventGetDTCOfEvent_GetDTCOfEvent_Event_Ga_FindEngleAngleFailed: start-on-event=DemSatellite_0InternalBehavior/GetDTCOfEvent, operation=Event_Ga_FindEngleAngleFailed.GetDTCOfEvent
        OpEventGetDTCOfEvent_GetDTCOfEvent_EvtInfo_VcEvMonTrqCmp: start-on-event=DemSatellite_0InternalBehavior/GetDTCOfEvent, operation=EvtInfo_VcEvMonTrqCmp.GetDTCOfEvent
        OpEventGetDTCOfEvent_GetDTCOfEvent_Event_VcEvMonTrqCmp: start-on-event=DemSatellite_0InternalBehavior/GetDTCOfEvent, operation=Event_VcEvMonTrqCmp.GetDTCOfEvent
        OpEventGetDTCOfEvent_GetDTCOfEvent_EvtInfo_INV_IGBT_TEMP_V_RNG_LO: start-on-event=DemSatellite_0InternalBehavior/GetDTCOfEvent, operation=EvtInfo_INV_IGBT_TEMP_V_RNG_LO.GetDTCOfEvent
        OpEventGetDTCOfEvent_GetDTCOfEvent_Event_INV_IGBT_TEMP_V_RNG_LO: start-on-event=DemSatellite_0InternalBehavior/GetDTCOfEvent, operation=Event_INV_IGBT_TEMP_V_RNG_LO.GetDTCOfEvent
        OpEventGetDTCOfEvent_GetDTCOfEvent_EvtInfo_INV_CONTROL_LIMIT: start-on-event=DemSatellite_0InternalBehavior/GetDTCOfEvent, operation=EvtInfo_INV_CONTROL_LIMIT.GetDTCOfEvent
        OpEventGetDTCOfEvent_GetDTCOfEvent_Event_INV_CONTROL_LIMIT: start-on-event=DemSatellite_0InternalBehavior/GetDTCOfEvent, operation=Event_INV_CONTROL_LIMIT.GetDTCOfEvent
        OpEventGetDTCOfEvent_GetDTCOfEvent_EvtInfo_COM_CarConfigErr: start-on-event=DemSatellite_0InternalBehavior/GetDTCOfEvent, operation=EvtInfo_COM_CarConfigErr.GetDTCOfEvent
        OpEventGetDTCOfEvent_GetDTCOfEvent_Event_COM_CarConfigErr: start-on-event=DemSatellite_0InternalBehavior/GetDTCOfEvent, operation=Event_COM_CarConfigErr.GetDTCOfEvent
        OpEventGetDTCOfEvent_GetDTCOfEvent_EvtInfo_VCEvEcmPropFr08Tioutd: start-on-event=DemSatellite_0InternalBehavior/GetDTCOfEvent, operation=EvtInfo_VCEvEcmPropFr08Tioutd.GetDTCOfEvent
        OpEventGetDTCOfEvent_GetDTCOfEvent_Event_VCEvEcmPropFr08Tioutd: start-on-event=DemSatellite_0InternalBehavior/GetDTCOfEvent, operation=Event_VCEvEcmPropFr08Tioutd.GetDTCOfEvent
        OpEventGetDTCOfEvent_GetDTCOfEvent_EvtInfo_CU_TEMP1_RNG_LO: start-on-event=DemSatellite_0InternalBehavior/GetDTCOfEvent, operation=EvtInfo_CU_TEMP1_RNG_LO.GetDTCOfEvent
        OpEventGetDTCOfEvent_GetDTCOfEvent_Event_CU_TEMP1_RNG_LO: start-on-event=DemSatellite_0InternalBehavior/GetDTCOfEvent, operation=Event_CU_TEMP1_RNG_LO.GetDTCOfEvent
        OpEventGetDTCOfEvent_GetDTCOfEvent_EvtInfo_INV_EM_STATOR_TEMP2_RNG_SWT: start-on-event=DemSatellite_0InternalBehavior/GetDTCOfEvent, operation=EvtInfo_INV_EM_STATOR_TEMP2_RNG_SWT.GetDTCOfEvent
        OpEventGetDTCOfEvent_GetDTCOfEvent_Event_INV_EM_STATOR_TEMP2_RNG_SWT: start-on-event=DemSatellite_0InternalBehavior/GetDTCOfEvent, operation=Event_INV_EM_STATOR_TEMP2_RNG_SWT.GetDTCOfEvent
        OpEventGetDTCOfEvent_GetDTCOfEvent_EvtInfo_GA_BLDC_POS_FLT: start-on-event=DemSatellite_0InternalBehavior/GetDTCOfEvent, operation=EvtInfo_GA_BLDC_POS_FLT.GetDTCOfEvent
        OpEventGetDTCOfEvent_GetDTCOfEvent_Event_GA_BLDC_POS_FLT: start-on-event=DemSatellite_0InternalBehavior/GetDTCOfEvent, operation=Event_GA_BLDC_POS_FLT.GetDTCOfEvent
        OpEventGetDTCOfEvent_GetDTCOfEvent_EvtInfo_PS_WhlSnsr_FLT: start-on-event=DemSatellite_0InternalBehavior/GetDTCOfEvent, operation=EvtInfo_PS_WhlSnsr_FLT.GetDTCOfEvent
        OpEventGetDTCOfEvent_GetDTCOfEvent_Event_PS_WhlSnsr_FLT: start-on-event=DemSatellite_0InternalBehavior/GetDTCOfEvent, operation=Event_PS_WhlSnsr_FLT.GetDTCOfEvent
        OpEventGetDTCOfEvent_GetDTCOfEvent_EvtInfo_INV_EM_STATOR_TEMP_RNG_LO: start-on-event=DemSatellite_0InternalBehavior/GetDTCOfEvent, operation=EvtInfo_INV_EM_STATOR_TEMP_RNG_LO.GetDTCOfEvent
        OpEventGetDTCOfEvent_GetDTCOfEvent_Event_INV_EM_STATOR_TEMP_RNG_LO: start-on-event=DemSatellite_0InternalBehavior/GetDTCOfEvent, operation=Event_INV_EM_STATOR_TEMP_RNG_LO.GetDTCOfEvent
        OpEventGetDTCOfEvent_GetDTCOfEvent_EvtInfo_INV_RSLVR_SIN_ELEC_HI: start-on-event=DemSatellite_0InternalBehavior/GetDTCOfEvent, operation=EvtInfo_INV_RSLVR_SIN_ELEC_HI.GetDTCOfEvent
        OpEventGetDTCOfEvent_GetDTCOfEvent_Event_INV_RSLVR_SIN_ELEC_HI: start-on-event=DemSatellite_0InternalBehavior/GetDTCOfEvent, operation=Event_INV_RSLVR_SIN_ELEC_HI.GetDTCOfEvent
        OpEventGetDTCOfEvent_GetDTCOfEvent_EvtInfo_INV_RSLVR_SIN_COS_PLAUS: start-on-event=DemSatellite_0InternalBehavior/GetDTCOfEvent, operation=EvtInfo_INV_RSLVR_SIN_COS_PLAUS.GetDTCOfEvent
        OpEventGetDTCOfEvent_GetDTCOfEvent_Event_INV_RSLVR_SIN_COS_PLAUS: start-on-event=DemSatellite_0InternalBehavior/GetDTCOfEvent, operation=Event_INV_RSLVR_SIN_COS_PLAUS.GetDTCOfEvent
        OpEventGetDTCOfEvent_GetDTCOfEvent_EvtInfo_INV_RSLVR_COS_AMP: start-on-event=DemSatellite_0InternalBehavior/GetDTCOfEvent, operation=EvtInfo_INV_RSLVR_COS_AMP.GetDTCOfEvent
        OpEventGetDTCOfEvent_GetDTCOfEvent_Event_INV_RSLVR_COS_AMP: start-on-event=DemSatellite_0InternalBehavior/GetDTCOfEvent, operation=Event_INV_RSLVR_COS_AMP.GetDTCOfEvent
        OpEventGetDTCOfEvent_GetDTCOfEvent_EvtInfo_INV_GATE_DRVR_BOT_HWP: start-on-event=DemSatellite_0InternalBehavior/GetDTCOfEvent, operation=EvtInfo_INV_GATE_DRVR_BOT_HWP.GetDTCOfEvent
        OpEventGetDTCOfEvent_GetDTCOfEvent_Event_INV_GATE_DRVR_BOT_HWP: start-on-event=DemSatellite_0InternalBehavior/GetDTCOfEvent, operation=Event_INV_GATE_DRVR_BOT_HWP.GetDTCOfEvent
        OpEventGetDTCOfEvent_GetDTCOfEvent_EvtInfo_Eg_HallVolWrong: start-on-event=DemSatellite_0InternalBehavior/GetDTCOfEvent, operation=EvtInfo_Eg_HallVolWrong.GetDTCOfEvent
        OpEventGetDTCOfEvent_GetDTCOfEvent_Event_Eg_HallVolWrong: start-on-event=DemSatellite_0InternalBehavior/GetDTCOfEvent, operation=Event_Eg_HallVolWrong.GetDTCOfEvent
        OpEventGetDTCOfEvent_GetDTCOfEvent_EvtInfo_INV_RSLVR_EXCT_RNG_NOK: start-on-event=DemSatellite_0InternalBehavior/GetDTCOfEvent, operation=EvtInfo_INV_RSLVR_EXCT_RNG_NOK.GetDTCOfEvent
        OpEventGetDTCOfEvent_GetDTCOfEvent_Event_INV_RSLVR_EXCT_RNG_NOK: start-on-event=DemSatellite_0InternalBehavior/GetDTCOfEvent, operation=Event_INV_RSLVR_EXCT_RNG_NOK.GetDTCOfEvent
        OpEventGetDTCOfEvent_GetDTCOfEvent_EvtInfo_PA_OpenCirc: start-on-event=DemSatellite_0InternalBehavior/GetDTCOfEvent, operation=EvtInfo_PA_OpenCirc.GetDTCOfEvent
        OpEventGetDTCOfEvent_GetDTCOfEvent_Event_PA_OpenCirc: start-on-event=DemSatellite_0InternalBehavior/GetDTCOfEvent, operation=Event_PA_OpenCirc.GetDTCOfEvent
        OpEventGetDTCOfEvent_GetDTCOfEvent_EvtInfo_INV_RSLVR_COS_ELEC_HI: start-on-event=DemSatellite_0InternalBehavior/GetDTCOfEvent, operation=EvtInfo_INV_RSLVR_COS_ELEC_HI.GetDTCOfEvent
        OpEventGetDTCOfEvent_GetDTCOfEvent_Event_INV_RSLVR_COS_ELEC_HI: start-on-event=DemSatellite_0InternalBehavior/GetDTCOfEvent, operation=Event_INV_RSLVR_COS_ELEC_HI.GetDTCOfEvent
        OpEventGetDTCOfEvent_GetDTCOfEvent_EvtInfo_VcEvCntrHvSysRlySts: start-on-event=DemSatellite_0InternalBehavior/GetDTCOfEvent, operation=EvtInfo_VcEvCntrHvSysRlySts.GetDTCOfEvent
        OpEventGetDTCOfEvent_GetDTCOfEvent_Event_VcEvCntrHvSysRlySts: start-on-event=DemSatellite_0InternalBehavior/GetDTCOfEvent, operation=Event_VcEvCntrHvSysRlySts.GetDTCOfEvent
        OpEventGetDTCOfEvent_GetDTCOfEvent_EvtInfo_CRASH_DTC: start-on-event=DemSatellite_0InternalBehavior/GetDTCOfEvent, operation=EvtInfo_CRASH_DTC.GetDTCOfEvent
        OpEventGetDTCOfEvent_GetDTCOfEvent_Event_CRASH_DTC: start-on-event=DemSatellite_0InternalBehavior/GetDTCOfEvent, operation=Event_CRASH_DTC.GetDTCOfEvent
        OpEventGetDTCOfEvent_GetDTCOfEvent_EvtInfo_INV_IGBT_TEMP_W_RNG_HI: start-on-event=DemSatellite_0InternalBehavior/GetDTCOfEvent, operation=EvtInfo_INV_IGBT_TEMP_W_RNG_HI.GetDTCOfEvent
        OpEventGetDTCOfEvent_GetDTCOfEvent_Event_INV_IGBT_TEMP_W_RNG_HI: start-on-event=DemSatellite_0InternalBehavior/GetDTCOfEvent, operation=Event_INV_IGBT_TEMP_W_RNG_HI.GetDTCOfEvent
        OpEventGetDTCOfEvent_GetDTCOfEvent_EvtInfo_VCEvBecmPropFr02Tioutd: start-on-event=DemSatellite_0InternalBehavior/GetDTCOfEvent, operation=EvtInfo_VCEvBecmPropFr02Tioutd.GetDTCOfEvent
        OpEventGetDTCOfEvent_GetDTCOfEvent_Event_VCEvBecmPropFr02Tioutd: start-on-event=DemSatellite_0InternalBehavior/GetDTCOfEvent, operation=Event_VCEvBecmPropFr02Tioutd.GetDTCOfEvent
        OpEventGetDTCOfEvent_GetDTCOfEvent_EvtInfo_INV_IGBT_TEMP_W_GRDT: start-on-event=DemSatellite_0InternalBehavior/GetDTCOfEvent, operation=EvtInfo_INV_IGBT_TEMP_W_GRDT.GetDTCOfEvent
        OpEventGetDTCOfEvent_GetDTCOfEvent_Event_INV_IGBT_TEMP_W_GRDT: start-on-event=DemSatellite_0InternalBehavior/GetDTCOfEvent, operation=Event_INV_IGBT_TEMP_W_GRDT.GetDTCOfEvent
        OpEventGetDTCOfEvent_GetDTCOfEvent_EvtInfo_EXT_UC_SPI_FLT: start-on-event=DemSatellite_0InternalBehavior/GetDTCOfEvent, operation=EvtInfo_EXT_UC_SPI_FLT.GetDTCOfEvent
        OpEventGetDTCOfEvent_GetDTCOfEvent_Event_EXT_UC_SPI_FLT: start-on-event=DemSatellite_0InternalBehavior/GetDTCOfEvent, operation=Event_EXT_UC_SPI_FLT.GetDTCOfEvent
        OpEventGetDTCOfEvent_GetDTCOfEvent_EvtInfo_INV_IAC_V_ELEC_HWP_001: start-on-event=DemSatellite_0InternalBehavior/GetDTCOfEvent, operation=EvtInfo_INV_IAC_V_ELEC_HWP_001.GetDTCOfEvent
        OpEventGetDTCOfEvent_GetDTCOfEvent_Event_INV_IAC_V_ELEC_HWP_001: start-on-event=DemSatellite_0InternalBehavior/GetDTCOfEvent, operation=Event_INV_IAC_V_ELEC_HWP_001.GetDTCOfEvent
        OpEventGetDTCOfEvent_GetDTCOfEvent_EvtInfo_VcEvChkSumWhlMotSysTqAllwd: start-on-event=DemSatellite_0InternalBehavior/GetDTCOfEvent, operation=EvtInfo_VcEvChkSumWhlMotSysTqAllwd.GetDTCOfEvent
        OpEventGetDTCOfEvent_GetDTCOfEvent_Event_VcEvChkSumWhlMotSysTqAllwd: start-on-event=DemSatellite_0InternalBehavior/GetDTCOfEvent, operation=Event_VcEvChkSumWhlMotSysTqAllwd.GetDTCOfEvent
        OpEventGetDTCOfEvent_GetDTCOfEvent_EvtInfo_FS_MONITIOR_ASC_FLT: start-on-event=DemSatellite_0InternalBehavior/GetDTCOfEvent, operation=EvtInfo_FS_MONITIOR_ASC_FLT.GetDTCOfEvent
        OpEventGetDTCOfEvent_GetDTCOfEvent_Event_FS_MONITIOR_ASC_FLT: start-on-event=DemSatellite_0InternalBehavior/GetDTCOfEvent, operation=Event_FS_MONITIOR_ASC_FLT.GetDTCOfEvent
        OpEventGetDTCOfEvent_GetDTCOfEvent_EvtInfo_INV_IAC_V_AMP: start-on-event=DemSatellite_0InternalBehavior/GetDTCOfEvent, operation=EvtInfo_INV_IAC_V_AMP.GetDTCOfEvent
        OpEventGetDTCOfEvent_GetDTCOfEvent_Event_INV_IAC_V_AMP: start-on-event=DemSatellite_0InternalBehavior/GetDTCOfEvent, operation=Event_INV_IAC_V_AMP.GetDTCOfEvent
        OpEventGetDTCOfEvent_GetDTCOfEvent_EvtInfo_INV_IAC_W_ELEC_LO: start-on-event=DemSatellite_0InternalBehavior/GetDTCOfEvent, operation=EvtInfo_INV_IAC_W_ELEC_LO.GetDTCOfEvent
        OpEventGetDTCOfEvent_GetDTCOfEvent_Event_INV_IAC_W_ELEC_LO: start-on-event=DemSatellite_0InternalBehavior/GetDTCOfEvent, operation=Event_INV_IAC_W_ELEC_LO.GetDTCOfEvent
        OpEventGetDTCOfEvent_GetDTCOfEvent_EvtInfo_VCEvVddmPropFr08Tioutd_001: start-on-event=DemSatellite_0InternalBehavior/GetDTCOfEvent, operation=EvtInfo_VCEvVddmPropFr08Tioutd_001.GetDTCOfEvent
        OpEventGetDTCOfEvent_GetDTCOfEvent_Event_VCEvVddmPropFr08Tioutd_001: start-on-event=DemSatellite_0InternalBehavior/GetDTCOfEvent, operation=Event_VCEvVddmPropFr08Tioutd_001.GetDTCOfEvent
        OpEventGetDTCOfEvent_GetDTCOfEvent_EvtInfo_PS_P12_RES_FLT: start-on-event=DemSatellite_0InternalBehavior/GetDTCOfEvent, operation=EvtInfo_PS_P12_RES_FLT.GetDTCOfEvent
        OpEventGetDTCOfEvent_GetDTCOfEvent_Event_PS_P12_RES_FLT: start-on-event=DemSatellite_0InternalBehavior/GetDTCOfEvent, operation=Event_PS_P12_RES_FLT.GetDTCOfEvent
        OpEventGetDTCOfEvent_GetDTCOfEvent_EvtInfo_INV_RSLVR_SIN_RNG_LO: start-on-event=DemSatellite_0InternalBehavior/GetDTCOfEvent, operation=EvtInfo_INV_RSLVR_SIN_RNG_LO.GetDTCOfEvent
        OpEventGetDTCOfEvent_GetDTCOfEvent_Event_INV_RSLVR_SIN_RNG_LO: start-on-event=DemSatellite_0InternalBehavior/GetDTCOfEvent, operation=Event_INV_RSLVR_SIN_RNG_LO.GetDTCOfEvent
        OpEventGetDTCOfEvent_GetDTCOfEvent_EvtInfo_CU_TEMP_HW_FLT: start-on-event=DemSatellite_0InternalBehavior/GetDTCOfEvent, operation=EvtInfo_CU_TEMP_HW_FLT.GetDTCOfEvent
        OpEventGetDTCOfEvent_GetDTCOfEvent_Event_CU_TEMP_HW_FLT: start-on-event=DemSatellite_0InternalBehavior/GetDTCOfEvent, operation=Event_CU_TEMP_HW_FLT.GetDTCOfEvent
        OpEventGetDTCOfEvent_GetDTCOfEvent_EvtInfo_VCEvEcmPropFr02MgmFr00Tioutd: start-on-event=DemSatellite_0InternalBehavior/GetDTCOfEvent, operation=EvtInfo_VCEvEcmPropFr02MgmFr00Tioutd.GetDTCOfEvent
        OpEventGetDTCOfEvent_GetDTCOfEvent_Event_VCEvEcmPropFr02MgmFr00Tioutd: start-on-event=DemSatellite_0InternalBehavior/GetDTCOfEvent, operation=Event_VCEvEcmPropFr02MgmFr00Tioutd.GetDTCOfEvent
        OpEventGetDTCOfEvent_GetDTCOfEvent_EvtInfo_PS_KL15_RNG_HI: start-on-event=DemSatellite_0InternalBehavior/GetDTCOfEvent, operation=EvtInfo_PS_KL15_RNG_HI.GetDTCOfEvent
        OpEventGetDTCOfEvent_GetDTCOfEvent_Event_PS_KL15_RNG_HI: start-on-event=DemSatellite_0InternalBehavior/GetDTCOfEvent, operation=Event_PS_KL15_RNG_HI.GetDTCOfEvent
        OpEventGetDTCOfEvent_GetDTCOfEvent_EvtInfo_VCEvVddmPropFr17Tioutd: start-on-event=DemSatellite_0InternalBehavior/GetDTCOfEvent, operation=EvtInfo_VCEvVddmPropFr17Tioutd.GetDTCOfEvent
        OpEventGetDTCOfEvent_GetDTCOfEvent_Event_VCEvVddmPropFr17Tioutd: start-on-event=DemSatellite_0InternalBehavior/GetDTCOfEvent, operation=Event_VCEvVddmPropFr17Tioutd.GetDTCOfEvent
        OpEventGetDTCOfEvent_GetDTCOfEvent_EvtInfo_VcEvChkSumCrashStsSafe: start-on-event=DemSatellite_0InternalBehavior/GetDTCOfEvent, operation=EvtInfo_VcEvChkSumCrashStsSafe.GetDTCOfEvent
        OpEventGetDTCOfEvent_GetDTCOfEvent_Event_VcEvChkSumCrashStsSafe: start-on-event=DemSatellite_0InternalBehavior/GetDTCOfEvent, operation=Event_VcEvChkSumCrashStsSafe.GetDTCOfEvent
        OpEventGetDTCOfEvent_GetDTCOfEvent_EvtInfo_DiagC_ClutchService: start-on-event=DemSatellite_0InternalBehavior/GetDTCOfEvent, operation=EvtInfo_DiagC_ClutchService.GetDTCOfEvent
        OpEventGetDTCOfEvent_GetDTCOfEvent_Event_DiagC_ClutchService: start-on-event=DemSatellite_0InternalBehavior/GetDTCOfEvent, operation=Event_DiagC_ClutchService.GetDTCOfEvent
        OpEventGetDTCOfEvent_GetDTCOfEvent_EvtInfo_INV_EM_STATOR_TEMP_RNG_HI: start-on-event=DemSatellite_0InternalBehavior/GetDTCOfEvent, operation=EvtInfo_INV_EM_STATOR_TEMP_RNG_HI.GetDTCOfEvent
        OpEventGetDTCOfEvent_GetDTCOfEvent_Event_INV_EM_STATOR_TEMP_RNG_HI: start-on-event=DemSatellite_0InternalBehavior/GetDTCOfEvent, operation=Event_INV_EM_STATOR_TEMP_RNG_HI.GetDTCOfEvent
        OpEventGetDTCOfEvent_GetDTCOfEvent_EvtInfo_INV_RSLVR_OFFS_OUT_RANG: start-on-event=DemSatellite_0InternalBehavior/GetDTCOfEvent, operation=EvtInfo_INV_RSLVR_OFFS_OUT_RANG.GetDTCOfEvent
        OpEventGetDTCOfEvent_GetDTCOfEvent_Event_INV_RSLVR_OFFS_OUT_RANG: start-on-event=DemSatellite_0InternalBehavior/GetDTCOfEvent, operation=Event_INV_RSLVR_OFFS_OUT_RANG.GetDTCOfEvent
        OpEventGetDTCOfEvent_GetDTCOfEvent_EvtInfo_INV_EM_STATOR_TEMP2_RNG_LO: start-on-event=DemSatellite_0InternalBehavior/GetDTCOfEvent, operation=EvtInfo_INV_EM_STATOR_TEMP2_RNG_LO.GetDTCOfEvent
        OpEventGetDTCOfEvent_GetDTCOfEvent_Event_INV_EM_STATOR_TEMP2_RNG_LO: start-on-event=DemSatellite_0InternalBehavior/GetDTCOfEvent, operation=Event_INV_EM_STATOR_TEMP2_RNG_LO.GetDTCOfEvent
        OpEventGetDTCOfEvent_GetDTCOfEvent_EvtInfo_VcEvMonISAR: start-on-event=DemSatellite_0InternalBehavior/GetDTCOfEvent, operation=EvtInfo_VcEvMonISAR.GetDTCOfEvent
        OpEventGetDTCOfEvent_GetDTCOfEvent_Event_VcEvMonISAR: start-on-event=DemSatellite_0InternalBehavior/GetDTCOfEvent, operation=Event_VcEvMonISAR.GetDTCOfEvent
        OpEventGetDTCOfEvent_GetDTCOfEvent_EvtInfo_GA_BLDC_FLT: start-on-event=DemSatellite_0InternalBehavior/GetDTCOfEvent, operation=EvtInfo_GA_BLDC_FLT.GetDTCOfEvent
        OpEventGetDTCOfEvent_GetDTCOfEvent_Event_GA_BLDC_FLT: start-on-event=DemSatellite_0InternalBehavior/GetDTCOfEvent, operation=Event_GA_BLDC_FLT.GetDTCOfEvent
        OpEventGetDTCOfEvent_GetDTCOfEvent_EvtInfo_INV_RSLVR_EXCT_ELEC_OPEN: start-on-event=DemSatellite_0InternalBehavior/GetDTCOfEvent, operation=EvtInfo_INV_RSLVR_EXCT_ELEC_OPEN.GetDTCOfEvent
        OpEventGetDTCOfEvent_GetDTCOfEvent_Event_INV_RSLVR_EXCT_ELEC_OPEN: start-on-event=DemSatellite_0InternalBehavior/GetDTCOfEvent, operation=Event_INV_RSLVR_EXCT_ELEC_OPEN.GetDTCOfEvent
        OpEventGetDTCOfEvent_GetDTCOfEvent_EvtInfo_INV_RSLVR_EXCT_PLAUS: start-on-event=DemSatellite_0InternalBehavior/GetDTCOfEvent, operation=EvtInfo_INV_RSLVR_EXCT_PLAUS.GetDTCOfEvent
        OpEventGetDTCOfEvent_GetDTCOfEvent_Event_INV_RSLVR_EXCT_PLAUS: start-on-event=DemSatellite_0InternalBehavior/GetDTCOfEvent, operation=Event_INV_RSLVR_EXCT_PLAUS.GetDTCOfEvent
        OpEventGetDTCOfEvent_GetDTCOfEvent_EvtInfo_PS_P15_U_FLT: start-on-event=DemSatellite_0InternalBehavior/GetDTCOfEvent, operation=EvtInfo_PS_P15_U_FLT.GetDTCOfEvent
        OpEventGetDTCOfEvent_GetDTCOfEvent_Event_PS_P15_U_FLT: start-on-event=DemSatellite_0InternalBehavior/GetDTCOfEvent, operation=Event_PS_P15_U_FLT.GetDTCOfEvent
        OpEventGetDTCOfEvent_GetDTCOfEvent_EvtInfo_INV_EM_STATOR_TEMP_RNG_SWT: start-on-event=DemSatellite_0InternalBehavior/GetDTCOfEvent, operation=EvtInfo_INV_EM_STATOR_TEMP_RNG_SWT.GetDTCOfEvent
        OpEventGetDTCOfEvent_GetDTCOfEvent_Event_INV_EM_STATOR_TEMP_RNG_SWT: start-on-event=DemSatellite_0InternalBehavior/GetDTCOfEvent, operation=Event_INV_EM_STATOR_TEMP_RNG_SWT.GetDTCOfEvent
        OpEventGetDTCOfEvent_GetDTCOfEvent_EvtInfo_INV_UHVDC_OV_SWP: start-on-event=DemSatellite_0InternalBehavior/GetDTCOfEvent, operation=EvtInfo_INV_UHVDC_OV_SWP.GetDTCOfEvent
        OpEventGetDTCOfEvent_GetDTCOfEvent_Event_INV_UHVDC_OV_SWP: start-on-event=DemSatellite_0InternalBehavior/GetDTCOfEvent, operation=Event_INV_UHVDC_OV_SWP.GetDTCOfEvent
        OpEventGetDTCOfEvent_GetDTCOfEvent_EvtInfo_AURIX_HW_FLT: start-on-event=DemSatellite_0InternalBehavior/GetDTCOfEvent, operation=EvtInfo_AURIX_HW_FLT.GetDTCOfEvent
        OpEventGetDTCOfEvent_GetDTCOfEvent_Event_AURIX_HW_FLT: start-on-event=DemSatellite_0InternalBehavior/GetDTCOfEvent, operation=Event_AURIX_HW_FLT.GetDTCOfEvent
        OpEventGetDTCOfEvent_GetDTCOfEvent_EvtInfo_INV_GATE_DRVR_TOP_HWP: start-on-event=DemSatellite_0InternalBehavior/GetDTCOfEvent, operation=EvtInfo_INV_GATE_DRVR_TOP_HWP.GetDTCOfEvent
        OpEventGetDTCOfEvent_GetDTCOfEvent_Event_INV_GATE_DRVR_TOP_HWP: start-on-event=DemSatellite_0InternalBehavior/GetDTCOfEvent, operation=Event_INV_GATE_DRVR_TOP_HWP.GetDTCOfEvent
        OpEventGetDTCOfEvent_GetDTCOfEvent_EvtInfo_INV_ACTV_DCHA_HW: start-on-event=DemSatellite_0InternalBehavior/GetDTCOfEvent, operation=EvtInfo_INV_ACTV_DCHA_HW.GetDTCOfEvent
        OpEventGetDTCOfEvent_GetDTCOfEvent_Event_INV_ACTV_DCHA_HW: start-on-event=DemSatellite_0InternalBehavior/GetDTCOfEvent, operation=Event_INV_ACTV_DCHA_HW.GetDTCOfEvent
        OpEventGetDTCOfEvent_GetDTCOfEvent_EvtInfo_INV_IGBT_TEMP_HWP: start-on-event=DemSatellite_0InternalBehavior/GetDTCOfEvent, operation=EvtInfo_INV_IGBT_TEMP_HWP.GetDTCOfEvent
        OpEventGetDTCOfEvent_GetDTCOfEvent_Event_INV_IGBT_TEMP_HWP: start-on-event=DemSatellite_0InternalBehavior/GetDTCOfEvent, operation=Event_INV_IGBT_TEMP_HWP.GetDTCOfEvent
        OpEventGetDTCOfEvent_GetDTCOfEvent_EvtInfo_INV_RSLVR_SIN_ELEC_FLT: start-on-event=DemSatellite_0InternalBehavior/GetDTCOfEvent, operation=EvtInfo_INV_RSLVR_SIN_ELEC_FLT.GetDTCOfEvent
        OpEventGetDTCOfEvent_GetDTCOfEvent_Event_INV_RSLVR_SIN_ELEC_FLT: start-on-event=DemSatellite_0InternalBehavior/GetDTCOfEvent, operation=Event_INV_RSLVR_SIN_ELEC_FLT.GetDTCOfEvent
        OpEventGetDTCOfEvent_GetDTCOfEvent_EvtInfo_CU_TEMP2_RNG_HI: start-on-event=DemSatellite_0InternalBehavior/GetDTCOfEvent, operation=EvtInfo_CU_TEMP2_RNG_HI.GetDTCOfEvent
        OpEventGetDTCOfEvent_GetDTCOfEvent_Event_CU_TEMP2_RNG_HI: start-on-event=DemSatellite_0InternalBehavior/GetDTCOfEvent, operation=Event_CU_TEMP2_RNG_HI.GetDTCOfEvent
        OpEventGetDTCOfEvent_GetDTCOfEvent_EvtInfo_INV_IAC_PHA_LOSS_MPL: start-on-event=DemSatellite_0InternalBehavior/GetDTCOfEvent, operation=EvtInfo_INV_IAC_PHA_LOSS_MPL.GetDTCOfEvent
        OpEventGetDTCOfEvent_GetDTCOfEvent_Event_INV_IAC_PHA_LOSS_MPL: start-on-event=DemSatellite_0InternalBehavior/GetDTCOfEvent, operation=Event_INV_IAC_PHA_LOSS_MPL.GetDTCOfEvent
        OpEventGetDTCOfEvent_GetDTCOfEvent_EvtInfo_INV_IAC_U_AMP: start-on-event=DemSatellite_0InternalBehavior/GetDTCOfEvent, operation=EvtInfo_INV_IAC_U_AMP.GetDTCOfEvent
        OpEventGetDTCOfEvent_GetDTCOfEvent_Event_INV_IAC_U_AMP: start-on-event=DemSatellite_0InternalBehavior/GetDTCOfEvent, operation=Event_INV_IAC_U_AMP.GetDTCOfEvent
        OpEventGetDTCOfEvent_GetDTCOfEvent_EvtInfo_PSnsr_GRADT_Flt: start-on-event=DemSatellite_0InternalBehavior/GetDTCOfEvent, operation=EvtInfo_PSnsr_GRADT_Flt.GetDTCOfEvent
        OpEventGetDTCOfEvent_GetDTCOfEvent_Event_PSnsr_GRADT_Flt: start-on-event=DemSatellite_0InternalBehavior/GetDTCOfEvent, operation=Event_PSnsr_GRADT_Flt.GetDTCOfEvent
        OpEventGetDTCOfEvent_GetDTCOfEvent_EvtInfo_AURIX_WATHDOG_FLT: start-on-event=DemSatellite_0InternalBehavior/GetDTCOfEvent, operation=EvtInfo_AURIX_WATHDOG_FLT.GetDTCOfEvent
        OpEventGetDTCOfEvent_GetDTCOfEvent_Event_AURIX_WATHDOG_FLT: start-on-event=DemSatellite_0InternalBehavior/GetDTCOfEvent, operation=Event_AURIX_WATHDOG_FLT.GetDTCOfEvent
        OpEventGetDTCOfEvent_GetDTCOfEvent_EvtInfo_VcEvNodeMisBECM: start-on-event=DemSatellite_0InternalBehavior/GetDTCOfEvent, operation=EvtInfo_VcEvNodeMisBECM.GetDTCOfEvent
        OpEventGetDTCOfEvent_GetDTCOfEvent_Event_VcEvNodeMisBECM: start-on-event=DemSatellite_0InternalBehavior/GetDTCOfEvent, operation=Event_VcEvNodeMisBECM.GetDTCOfEvent
        OpEventGetDTCOfEvent_GetDTCOfEvent_EvtInfo_INV_UHVDC_UV_HWP: start-on-event=DemSatellite_0InternalBehavior/GetDTCOfEvent, operation=EvtInfo_INV_UHVDC_UV_HWP.GetDTCOfEvent
        OpEventGetDTCOfEvent_GetDTCOfEvent_Event_INV_UHVDC_UV_HWP: start-on-event=DemSatellite_0InternalBehavior/GetDTCOfEvent, operation=Event_INV_UHVDC_UV_HWP.GetDTCOfEvent
        OpEventGetDTCOfEvent_GetDTCOfEvent_EvtInfo_VcEvMonESpd: start-on-event=DemSatellite_0InternalBehavior/GetDTCOfEvent, operation=EvtInfo_VcEvMonESpd.GetDTCOfEvent
        OpEventGetDTCOfEvent_GetDTCOfEvent_Event_VcEvMonESpd: start-on-event=DemSatellite_0InternalBehavior/GetDTCOfEvent, operation=Event_VcEvMonESpd.GetDTCOfEvent
        OpEventGetDTCOfEvent_GetDTCOfEvent_EvtInfo_COM_NotConfig: start-on-event=DemSatellite_0InternalBehavior/GetDTCOfEvent, operation=EvtInfo_COM_NotConfig.GetDTCOfEvent
        OpEventGetDTCOfEvent_GetDTCOfEvent_Event_COM_NotConfig: start-on-event=DemSatellite_0InternalBehavior/GetDTCOfEvent, operation=Event_COM_NotConfig.GetDTCOfEvent
        OpEventGetDTCOfEvent_GetDTCOfEvent_EvtInfo_INV_RSLVR_SIN_RNG_HI: start-on-event=DemSatellite_0InternalBehavior/GetDTCOfEvent, operation=EvtInfo_INV_RSLVR_SIN_RNG_HI.GetDTCOfEvent
        OpEventGetDTCOfEvent_GetDTCOfEvent_Event_INV_RSLVR_SIN_RNG_HI: start-on-event=DemSatellite_0InternalBehavior/GetDTCOfEvent, operation=Event_INV_RSLVR_SIN_RNG_HI.GetDTCOfEvent
        OpEventGetDTCOfEvent_GetDTCOfEvent_EvtInfo_INV_IGBT_TEMP_U_RNG_HI: start-on-event=DemSatellite_0InternalBehavior/GetDTCOfEvent, operation=EvtInfo_INV_IGBT_TEMP_U_RNG_HI.GetDTCOfEvent
        OpEventGetDTCOfEvent_GetDTCOfEvent_Event_INV_IGBT_TEMP_U_RNG_HI: start-on-event=DemSatellite_0InternalBehavior/GetDTCOfEvent, operation=Event_INV_IGBT_TEMP_U_RNG_HI.GetDTCOfEvent
        OpEventGetDTCOfEvent_GetDTCOfEvent_EvtInfo_VcEvMonMode_001: start-on-event=DemSatellite_0InternalBehavior/GetDTCOfEvent, operation=EvtInfo_VcEvMonMode_001.GetDTCOfEvent
        OpEventGetDTCOfEvent_GetDTCOfEvent_Event_VcEvMonMode_001: start-on-event=DemSatellite_0InternalBehavior/GetDTCOfEvent, operation=Event_VcEvMonMode_001.GetDTCOfEvent
        OpEventGetDTCOfEvent_GetDTCOfEvent_EvtInfo_PA_ACTION_FLT: start-on-event=DemSatellite_0InternalBehavior/GetDTCOfEvent, operation=EvtInfo_PA_ACTION_FLT.GetDTCOfEvent
        OpEventGetDTCOfEvent_GetDTCOfEvent_Event_PA_ACTION_FLT: start-on-event=DemSatellite_0InternalBehavior/GetDTCOfEvent, operation=Event_PA_ACTION_FLT.GetDTCOfEvent
        OpEventGetDTCOfEvent_GetDTCOfEvent_EvtInfo_INV_IAC_V_ELEC_HWP: start-on-event=DemSatellite_0InternalBehavior/GetDTCOfEvent, operation=EvtInfo_INV_IAC_V_ELEC_HWP.GetDTCOfEvent
        OpEventGetDTCOfEvent_GetDTCOfEvent_Event_INV_IAC_V_ELEC_HWP: start-on-event=DemSatellite_0InternalBehavior/GetDTCOfEvent, operation=Event_INV_IAC_V_ELEC_HWP.GetDTCOfEvent
        OpEventGetDTCOfEvent_GetDTCOfEvent_EvtInfo_CU_TEMP_HW_FLT_001: start-on-event=DemSatellite_0InternalBehavior/GetDTCOfEvent, operation=EvtInfo_CU_TEMP_HW_FLT_001.GetDTCOfEvent
        OpEventGetDTCOfEvent_GetDTCOfEvent_Event_CU_TEMP_HW_FLT_001: start-on-event=DemSatellite_0InternalBehavior/GetDTCOfEvent, operation=Event_CU_TEMP_HW_FLT_001.GetDTCOfEvent
        OpEventGetDTCOfEvent_GetDTCOfEvent_EvtInfo_VCC_UnderVoltage: start-on-event=DemSatellite_0InternalBehavior/GetDTCOfEvent, operation=EvtInfo_VCC_UnderVoltage.GetDTCOfEvent
        OpEventGetDTCOfEvent_GetDTCOfEvent_Event_VCC_UnderVoltage: start-on-event=DemSatellite_0InternalBehavior/GetDTCOfEvent, operation=Event_VCC_UnderVoltage.GetDTCOfEvent
        OpEventGetDTCOfEvent_GetDTCOfEvent_EvtInfo_VcEvTsttrPlaus: start-on-event=DemSatellite_0InternalBehavior/GetDTCOfEvent, operation=EvtInfo_VcEvTsttrPlaus.GetDTCOfEvent
        OpEventGetDTCOfEvent_GetDTCOfEvent_Event_VcEvTsttrPlaus: start-on-event=DemSatellite_0InternalBehavior/GetDTCOfEvent, operation=Event_VcEvTsttrPlaus.GetDTCOfEvent
        OpEventGetDTCOfEvent_GetDTCOfEvent_EvtInfo_INV_RSLVR_EXCT_ELEC_FLT: start-on-event=DemSatellite_0InternalBehavior/GetDTCOfEvent, operation=EvtInfo_INV_RSLVR_EXCT_ELEC_FLT.GetDTCOfEvent
        OpEventGetDTCOfEvent_GetDTCOfEvent_Event_INV_RSLVR_EXCT_ELEC_FLT: start-on-event=DemSatellite_0InternalBehavior/GetDTCOfEvent, operation=Event_INV_RSLVR_EXCT_ELEC_FLT.GetDTCOfEvent
        OpEventGetDTCOfEvent_GetDTCOfEvent_EvtInfo_INV_RSLVR_EXCT_RNG_LO: start-on-event=DemSatellite_0InternalBehavior/GetDTCOfEvent, operation=EvtInfo_INV_RSLVR_EXCT_RNG_LO.GetDTCOfEvent
        OpEventGetDTCOfEvent_GetDTCOfEvent_Event_INV_RSLVR_EXCT_RNG_LO: start-on-event=DemSatellite_0InternalBehavior/GetDTCOfEvent, operation=Event_INV_RSLVR_EXCT_RNG_LO.GetDTCOfEvent
        OpEventGetDTCOfEvent_GetDTCOfEvent_EvtInfo_INV_EM_STATOR_TEMP2_RNG_HI: start-on-event=DemSatellite_0InternalBehavior/GetDTCOfEvent, operation=EvtInfo_INV_EM_STATOR_TEMP2_RNG_HI.GetDTCOfEvent
        OpEventGetDTCOfEvent_GetDTCOfEvent_Event_INV_EM_STATOR_TEMP2_RNG_HI: start-on-event=DemSatellite_0InternalBehavior/GetDTCOfEvent, operation=Event_INV_EM_STATOR_TEMP2_RNG_HI.GetDTCOfEvent
        OpEventGetDTCOfEvent_GetDTCOfEvent_EvtInfo_INV_SHUT_OFF_PAH_START_UP: start-on-event=DemSatellite_0InternalBehavior/GetDTCOfEvent, operation=EvtInfo_INV_SHUT_OFF_PAH_START_UP.GetDTCOfEvent
        OpEventGetDTCOfEvent_GetDTCOfEvent_Event_INV_SHUT_OFF_PAH_START_UP: start-on-event=DemSatellite_0InternalBehavior/GetDTCOfEvent, operation=Event_INV_SHUT_OFF_PAH_START_UP.GetDTCOfEvent
        OpEventGetDTCOfEvent_GetDTCOfEvent_EvtInfo_VCEvVddmPropFr08Tioutd: start-on-event=DemSatellite_0InternalBehavior/GetDTCOfEvent, operation=EvtInfo_VCEvVddmPropFr08Tioutd.GetDTCOfEvent
        OpEventGetDTCOfEvent_GetDTCOfEvent_Event_VCEvVddmPropFr08Tioutd: start-on-event=DemSatellite_0InternalBehavior/GetDTCOfEvent, operation=Event_VCEvVddmPropFr08Tioutd.GetDTCOfEvent
        OpEventGetDTCOfEvent_GetDTCOfEvent_EvtInfo_INV_RSLVR_EXCT_OC_HWP_001: start-on-event=DemSatellite_0InternalBehavior/GetDTCOfEvent, operation=EvtInfo_INV_RSLVR_EXCT_OC_HWP_001.GetDTCOfEvent
        OpEventGetDTCOfEvent_GetDTCOfEvent_Event_INV_RSLVR_EXCT_OC_HWP_001: start-on-event=DemSatellite_0InternalBehavior/GetDTCOfEvent, operation=Event_INV_RSLVR_EXCT_OC_HWP_001.GetDTCOfEvent
        OpEventGetDTCOfEvent_GetDTCOfEvent_EvtInfo_INV_RSLVR_EXCT_OC_HWP_002: start-on-event=DemSatellite_0InternalBehavior/GetDTCOfEvent, operation=EvtInfo_INV_RSLVR_EXCT_OC_HWP_002.GetDTCOfEvent
        OpEventGetDTCOfEvent_GetDTCOfEvent_Event_INV_RSLVR_EXCT_OC_HWP_002: start-on-event=DemSatellite_0InternalBehavior/GetDTCOfEvent, operation=Event_INV_RSLVR_EXCT_OC_HWP_002.GetDTCOfEvent
        OpEventGetDTCOfEvent_GetDTCOfEvent_EvtInfo_INV_EM_STATOR_TEMP_ELE_FLT: start-on-event=DemSatellite_0InternalBehavior/GetDTCOfEvent, operation=EvtInfo_INV_EM_STATOR_TEMP_ELE_FLT.GetDTCOfEvent
        OpEventGetDTCOfEvent_GetDTCOfEvent_Event_INV_EM_STATOR_TEMP_ELE_FLT: start-on-event=DemSatellite_0InternalBehavior/GetDTCOfEvent, operation=Event_INV_EM_STATOR_TEMP_ELE_FLT.GetDTCOfEvent
        OpEventGetDTCOfEvent_GetDTCOfEvent_EvtInfo_INV_INTERLOCK_FLT: start-on-event=DemSatellite_0InternalBehavior/GetDTCOfEvent, operation=EvtInfo_INV_INTERLOCK_FLT.GetDTCOfEvent
        OpEventGetDTCOfEvent_GetDTCOfEvent_Event_INV_INTERLOCK_FLT: start-on-event=DemSatellite_0InternalBehavior/GetDTCOfEvent, operation=Event_INV_INTERLOCK_FLT.GetDTCOfEvent
        OpEventGetDTCOfEvent_GetDTCOfEvent_EvtInfo_Ga_ZeroFindDistanFailure: start-on-event=DemSatellite_0InternalBehavior/GetDTCOfEvent, operation=EvtInfo_Ga_ZeroFindDistanFailure.GetDTCOfEvent
        OpEventGetDTCOfEvent_GetDTCOfEvent_Event_Ga_ZeroFindDistanFailure: start-on-event=DemSatellite_0InternalBehavior/GetDTCOfEvent, operation=Event_Ga_ZeroFindDistanFailure.GetDTCOfEvent
        OpEventGetDTCOfEvent_GetDTCOfEvent_EvtInfo_PLOCK_Current_RNG_OUT: start-on-event=DemSatellite_0InternalBehavior/GetDTCOfEvent, operation=EvtInfo_PLOCK_Current_RNG_OUT.GetDTCOfEvent
        OpEventGetDTCOfEvent_GetDTCOfEvent_Event_PLOCK_Current_RNG_OUT: start-on-event=DemSatellite_0InternalBehavior/GetDTCOfEvent, operation=Event_PLOCK_Current_RNG_OUT.GetDTCOfEvent
        OpEventGetDTCOfEvent_GetDTCOfEvent_EvtInfo_VCEvVddmPropFr05Tioutd: start-on-event=DemSatellite_0InternalBehavior/GetDTCOfEvent, operation=EvtInfo_VCEvVddmPropFr05Tioutd.GetDTCOfEvent
        OpEventGetDTCOfEvent_GetDTCOfEvent_Event_VCEvVddmPropFr05Tioutd: start-on-event=DemSatellite_0InternalBehavior/GetDTCOfEvent, operation=Event_VCEvVddmPropFr05Tioutd.GetDTCOfEvent
        OpEventGetDTCOfEvent_GetDTCOfEvent_EvtInfo_INV_IGBT_TEMP_V_GRDT: start-on-event=DemSatellite_0InternalBehavior/GetDTCOfEvent, operation=EvtInfo_INV_IGBT_TEMP_V_GRDT.GetDTCOfEvent
        OpEventGetDTCOfEvent_GetDTCOfEvent_Event_INV_IGBT_TEMP_V_GRDT: start-on-event=DemSatellite_0InternalBehavior/GetDTCOfEvent, operation=Event_INV_IGBT_TEMP_V_GRDT.GetDTCOfEvent
        OpEventGetDTCOfEvent_GetDTCOfEvent_EvtInfo_PS_5V_Fault: start-on-event=DemSatellite_0InternalBehavior/GetDTCOfEvent, operation=EvtInfo_PS_5V_Fault.GetDTCOfEvent
        OpEventGetDTCOfEvent_GetDTCOfEvent_Event_PS_5V_Fault: start-on-event=DemSatellite_0InternalBehavior/GetDTCOfEvent, operation=Event_PS_5V_Fault.GetDTCOfEvent
        OpEventGetDTCOfEvent_GetDTCOfEvent_EvtInfo_VcEvCntrCrashStsSafe: start-on-event=DemSatellite_0InternalBehavior/GetDTCOfEvent, operation=EvtInfo_VcEvCntrCrashStsSafe.GetDTCOfEvent
        OpEventGetDTCOfEvent_GetDTCOfEvent_Event_VcEvCntrCrashStsSafe: start-on-event=DemSatellite_0InternalBehavior/GetDTCOfEvent, operation=Event_VcEvCntrCrashStsSafe.GetDTCOfEvent
        OpEventGetDTCOfEvent_GetDTCOfEvent_EvtInfo_INV_EM_STATOR_TEMP_GRDT: start-on-event=DemSatellite_0InternalBehavior/GetDTCOfEvent, operation=EvtInfo_INV_EM_STATOR_TEMP_GRDT.GetDTCOfEvent
        OpEventGetDTCOfEvent_GetDTCOfEvent_Event_INV_EM_STATOR_TEMP_GRDT: start-on-event=DemSatellite_0InternalBehavior/GetDTCOfEvent, operation=Event_INV_EM_STATOR_TEMP_GRDT.GetDTCOfEvent
        OpEventGetDTCOfEvent_GetDTCOfEvent_EvtInfo_PS_P15_V_FLT: start-on-event=DemSatellite_0InternalBehavior/GetDTCOfEvent, operation=EvtInfo_PS_P15_V_FLT.GetDTCOfEvent
        OpEventGetDTCOfEvent_GetDTCOfEvent_Event_PS_P15_V_FLT: start-on-event=DemSatellite_0InternalBehavior/GetDTCOfEvent, operation=Event_PS_P15_V_FLT.GetDTCOfEvent
        OpEventGetDTCOfEvent_GetDTCOfEvent_EvtInfo_INV_EM_STATOR_TEMP_RNG_NOK: start-on-event=DemSatellite_0InternalBehavior/GetDTCOfEvent, operation=EvtInfo_INV_EM_STATOR_TEMP_RNG_NOK.GetDTCOfEvent
        OpEventGetDTCOfEvent_GetDTCOfEvent_Event_INV_EM_STATOR_TEMP_RNG_NOK: start-on-event=DemSatellite_0InternalBehavior/GetDTCOfEvent, operation=Event_INV_EM_STATOR_TEMP_RNG_NOK.GetDTCOfEvent
        OpEventGetDTCOfEvent_GetDTCOfEvent_EvtInfo_INV_RSLVR_SIN_RNG_NOK: start-on-event=DemSatellite_0InternalBehavior/GetDTCOfEvent, operation=EvtInfo_INV_RSLVR_SIN_RNG_NOK.GetDTCOfEvent
        OpEventGetDTCOfEvent_GetDTCOfEvent_Event_INV_RSLVR_SIN_RNG_NOK: start-on-event=DemSatellite_0InternalBehavior/GetDTCOfEvent, operation=Event_INV_RSLVR_SIN_RNG_NOK.GetDTCOfEvent
        OpEventGetDTCOfEvent_GetDTCOfEvent_EvtInfo_INV_IAC_U_OFFS: start-on-event=DemSatellite_0InternalBehavior/GetDTCOfEvent, operation=EvtInfo_INV_IAC_U_OFFS.GetDTCOfEvent
        OpEventGetDTCOfEvent_GetDTCOfEvent_Event_INV_IAC_U_OFFS: start-on-event=DemSatellite_0InternalBehavior/GetDTCOfEvent, operation=Event_INV_IAC_U_OFFS.GetDTCOfEvent
        OpEventGetDTCOfEvent_GetDTCOfEvent_EvtInfo_PS_KL30_BACKUP_FLT: start-on-event=DemSatellite_0InternalBehavior/GetDTCOfEvent, operation=EvtInfo_PS_KL30_BACKUP_FLT.GetDTCOfEvent
        OpEventGetDTCOfEvent_GetDTCOfEvent_Event_PS_KL30_BACKUP_FLT: start-on-event=DemSatellite_0InternalBehavior/GetDTCOfEvent, operation=Event_PS_KL30_BACKUP_FLT.GetDTCOfEvent
        OpEventGetDTCOfEvent_GetDTCOfEvent_EvtInfo_INV_IGBT_TEMP_U_RNG_LO: start-on-event=DemSatellite_0InternalBehavior/GetDTCOfEvent, operation=EvtInfo_INV_IGBT_TEMP_U_RNG_LO.GetDTCOfEvent
        OpEventGetDTCOfEvent_GetDTCOfEvent_Event_INV_IGBT_TEMP_U_RNG_LO: start-on-event=DemSatellite_0InternalBehavior/GetDTCOfEvent, operation=Event_INV_IGBT_TEMP_U_RNG_LO.GetDTCOfEvent
        OpEventGetDTCOfEvent_GetDTCOfEvent_EvtInfo_INV_EM_STATOR_TEMP_HWP: start-on-event=DemSatellite_0InternalBehavior/GetDTCOfEvent, operation=EvtInfo_INV_EM_STATOR_TEMP_HWP.GetDTCOfEvent
        OpEventGetDTCOfEvent_GetDTCOfEvent_Event_INV_EM_STATOR_TEMP_HWP: start-on-event=DemSatellite_0InternalBehavior/GetDTCOfEvent, operation=Event_INV_EM_STATOR_TEMP_HWP.GetDTCOfEvent
        OpEventGetDTCOfEvent_GetDTCOfEvent_EvtInfo_CU_TEMP1_RNG_HI: start-on-event=DemSatellite_0InternalBehavior/GetDTCOfEvent, operation=EvtInfo_CU_TEMP1_RNG_HI.GetDTCOfEvent
        OpEventGetDTCOfEvent_GetDTCOfEvent_Event_CU_TEMP1_RNG_HI: start-on-event=DemSatellite_0InternalBehavior/GetDTCOfEvent, operation=Event_CU_TEMP1_RNG_HI.GetDTCOfEvent
        OpEventGetDTCOfEvent_GetDTCOfEvent_EvtInfo_INV_IGBT_TEMP_V_RNG_HI: start-on-event=DemSatellite_0InternalBehavior/GetDTCOfEvent, operation=EvtInfo_INV_IGBT_TEMP_V_RNG_HI.GetDTCOfEvent
        OpEventGetDTCOfEvent_GetDTCOfEvent_Event_INV_IGBT_TEMP_V_RNG_HI: start-on-event=DemSatellite_0InternalBehavior/GetDTCOfEvent, operation=Event_INV_IGBT_TEMP_V_RNG_HI.GetDTCOfEvent
        OpEventGetDTCOfEvent_GetDTCOfEvent_EvtInfo_VcEvNodeMisVDDM: start-on-event=DemSatellite_0InternalBehavior/GetDTCOfEvent, operation=EvtInfo_VcEvNodeMisVDDM.GetDTCOfEvent
        OpEventGetDTCOfEvent_GetDTCOfEvent_Event_VcEvNodeMisVDDM: start-on-event=DemSatellite_0InternalBehavior/GetDTCOfEvent, operation=Event_VcEvNodeMisVDDM.GetDTCOfEvent
        OpEventGetDTCOfEvent_GetDTCOfEvent_EvtInfo_INV_UHVDC_PLAUS: start-on-event=DemSatellite_0InternalBehavior/GetDTCOfEvent, operation=EvtInfo_INV_UHVDC_PLAUS.GetDTCOfEvent
        OpEventGetDTCOfEvent_GetDTCOfEvent_Event_INV_UHVDC_PLAUS: start-on-event=DemSatellite_0InternalBehavior/GetDTCOfEvent, operation=Event_INV_UHVDC_PLAUS.GetDTCOfEvent
        OpEventGetDTCOfEvent_GetDTCOfEvent_EvtInfo_INV_QUIESCENT_FLT: start-on-event=DemSatellite_0InternalBehavior/GetDTCOfEvent, operation=EvtInfo_INV_QUIESCENT_FLT.GetDTCOfEvent
        OpEventGetDTCOfEvent_GetDTCOfEvent_Event_INV_QUIESCENT_FLT: start-on-event=DemSatellite_0InternalBehavior/GetDTCOfEvent, operation=Event_INV_QUIESCENT_FLT.GetDTCOfEvent
        OpEventGetDTCOfEvent_GetDTCOfEvent_EvtInfo_INV_RSLVR_EXCT_RNG_HI: start-on-event=DemSatellite_0InternalBehavior/GetDTCOfEvent, operation=EvtInfo_INV_RSLVR_EXCT_RNG_HI.GetDTCOfEvent
        OpEventGetDTCOfEvent_GetDTCOfEvent_Event_INV_RSLVR_EXCT_RNG_HI: start-on-event=DemSatellite_0InternalBehavior/GetDTCOfEvent, operation=Event_INV_RSLVR_EXCT_RNG_HI.GetDTCOfEvent
        OpEventGetDTCOfEvent_GetDTCOfEvent_GeneralEvtInfo: start-on-event=DemSatellite_0InternalBehavior/GetDTCOfEvent, operation=GeneralEvtInfo.GetDTCOfEvent
        OpEventGetFaultDetectionCounter_GetFaultDetectionCounter_EvtInfo_VCEvBecmPropFr01Tioutd: start-on-event=DemSatellite_0InternalBehavior/GetFaultDetectionCounter, operation=EvtInfo_VCEvBecmPropFr01Tioutd.GetFaultDetectionCounter
        OpEventGetFaultDetectionCounter_GetFaultDetectionCounter_Event_VCEvBecmPropFr01Tioutd: start-on-event=DemSatellite_0InternalBehavior/GetFaultDetectionCounter, operation=Event_VCEvBecmPropFr01Tioutd.GetFaultDetectionCounter
        OpEventGetFaultDetectionCounter_GetFaultDetectionCounter_EvtInfo_INV_CU_TEMP2_RNG_NOK: start-on-event=DemSatellite_0InternalBehavior/GetFaultDetectionCounter, operation=EvtInfo_INV_CU_TEMP2_RNG_NOK.GetFaultDetectionCounter
        OpEventGetFaultDetectionCounter_GetFaultDetectionCounter_Event_INV_CU_TEMP2_RNG_NOK: start-on-event=DemSatellite_0InternalBehavior/GetFaultDetectionCounter, operation=Event_INV_CU_TEMP2_RNG_NOK.GetFaultDetectionCounter
        OpEventGetFaultDetectionCounter_GetFaultDetectionCounter_EvtInfo_COM_Busoff: start-on-event=DemSatellite_0InternalBehavior/GetFaultDetectionCounter, operation=EvtInfo_COM_Busoff.GetFaultDetectionCounter
        OpEventGetFaultDetectionCounter_GetFaultDetectionCounter_Event_COM_Busoff: start-on-event=DemSatellite_0InternalBehavior/GetFaultDetectionCounter, operation=Event_COM_Busoff.GetFaultDetectionCounter
        OpEventGetFaultDetectionCounter_GetFaultDetectionCounter_EvtInfo_INV_IMMO_NOKEY: start-on-event=DemSatellite_0InternalBehavior/GetFaultDetectionCounter, operation=EvtInfo_INV_IMMO_NOKEY.GetFaultDetectionCounter
        OpEventGetFaultDetectionCounter_GetFaultDetectionCounter_Event_INV_IMMO_NOKEY: start-on-event=DemSatellite_0InternalBehavior/GetFaultDetectionCounter, operation=Event_INV_IMMO_NOKEY.GetFaultDetectionCounter
        OpEventGetFaultDetectionCounter_GetFaultDetectionCounter_EvtInfo_INV_RSLVR_EXCT_OC_HWP: start-on-event=DemSatellite_0InternalBehavior/GetFaultDetectionCounter, operation=EvtInfo_INV_RSLVR_EXCT_OC_HWP.GetFaultDetectionCounter
        OpEventGetFaultDetectionCounter_GetFaultDetectionCounter_Event_INV_RSLVR_EXCT_OC_HWP: start-on-event=DemSatellite_0InternalBehavior/GetFaultDetectionCounter, operation=Event_INV_RSLVR_EXCT_OC_HWP.GetFaultDetectionCounter
        OpEventGetFaultDetectionCounter_GetFaultDetectionCounter_EvtInfo_PS_P15_W_FLT: start-on-event=DemSatellite_0InternalBehavior/GetFaultDetectionCounter, operation=EvtInfo_PS_P15_W_FLT.GetFaultDetectionCounter
        OpEventGetFaultDetectionCounter_GetFaultDetectionCounter_Event_PS_P15_W_FLT: start-on-event=DemSatellite_0InternalBehavior/GetFaultDetectionCounter, operation=Event_PS_P15_W_FLT.GetFaultDetectionCounter
        OpEventGetFaultDetectionCounter_GetFaultDetectionCounter_EvtInfo_INV_IAC_PLAUS_SUM: start-on-event=DemSatellite_0InternalBehavior/GetFaultDetectionCounter, operation=EvtInfo_INV_IAC_PLAUS_SUM.GetFaultDetectionCounter
        OpEventGetFaultDetectionCounter_GetFaultDetectionCounter_Event_INV_IAC_PLAUS_SUM: start-on-event=DemSatellite_0InternalBehavior/GetFaultDetectionCounter, operation=Event_INV_IAC_PLAUS_SUM.GetFaultDetectionCounter
        OpEventGetFaultDetectionCounter_GetFaultDetectionCounter_EvtInfo_PA_ELE_FLT: start-on-event=DemSatellite_0InternalBehavior/GetFaultDetectionCounter, operation=EvtInfo_PA_ELE_FLT.GetFaultDetectionCounter
        OpEventGetFaultDetectionCounter_GetFaultDetectionCounter_Event_PA_ELE_FLT: start-on-event=DemSatellite_0InternalBehavior/GetFaultDetectionCounter, operation=Event_PA_ELE_FLT.GetFaultDetectionCounter
        OpEventGetFaultDetectionCounter_GetFaultDetectionCounter_EvtInfo_CU_TEMP_GRDT: start-on-event=DemSatellite_0InternalBehavior/GetFaultDetectionCounter, operation=EvtInfo_CU_TEMP_GRDT.GetFaultDetectionCounter
        OpEventGetFaultDetectionCounter_GetFaultDetectionCounter_Event_CU_TEMP_GRDT: start-on-event=DemSatellite_0InternalBehavior/GetFaultDetectionCounter, operation=Event_CU_TEMP_GRDT.GetFaultDetectionCounter
        OpEventGetFaultDetectionCounter_GetFaultDetectionCounter_EvtInfo_INV_IGBT_TEMP_V_PLAUS: start-on-event=DemSatellite_0InternalBehavior/GetFaultDetectionCounter, operation=EvtInfo_INV_IGBT_TEMP_V_PLAUS.GetFaultDetectionCounter
        OpEventGetFaultDetectionCounter_GetFaultDetectionCounter_Event_INV_IGBT_TEMP_V_PLAUS: start-on-event=DemSatellite_0InternalBehavior/GetFaultDetectionCounter, operation=Event_INV_IGBT_TEMP_V_PLAUS.GetFaultDetectionCounter
        OpEventGetFaultDetectionCounter_GetFaultDetectionCounter_EvtInfo_Ga_GAEngageFailure: start-on-event=DemSatellite_0InternalBehavior/GetFaultDetectionCounter, operation=EvtInfo_Ga_GAEngageFailure.GetFaultDetectionCounter
        OpEventGetFaultDetectionCounter_GetFaultDetectionCounter_Event_Ga_GAEngageFailure: start-on-event=DemSatellite_0InternalBehavior/GetFaultDetectionCounter, operation=Event_Ga_GAEngageFailure.GetFaultDetectionCounter
        OpEventGetFaultDetectionCounter_GetFaultDetectionCounter_EvtInfo_INV_IAC_W_RNG_LO: start-on-event=DemSatellite_0InternalBehavior/GetFaultDetectionCounter, operation=EvtInfo_INV_IAC_W_RNG_LO.GetFaultDetectionCounter
        OpEventGetFaultDetectionCounter_GetFaultDetectionCounter_Event_INV_IAC_W_RNG_LO: start-on-event=DemSatellite_0InternalBehavior/GetFaultDetectionCounter, operation=Event_INV_IAC_W_RNG_LO.GetFaultDetectionCounter
        OpEventGetFaultDetectionCounter_GetFaultDetectionCounter_EvtInfo_PS_WhlSnsr_Vltg_FLT: start-on-event=DemSatellite_0InternalBehavior/GetFaultDetectionCounter, operation=EvtInfo_PS_WhlSnsr_Vltg_FLT.GetFaultDetectionCounter
        OpEventGetFaultDetectionCounter_GetFaultDetectionCounter_Event_PS_WhlSnsr_Vltg_FLT: start-on-event=DemSatellite_0InternalBehavior/GetFaultDetectionCounter, operation=Event_PS_WhlSnsr_Vltg_FLT.GetFaultDetectionCounter
        OpEventGetFaultDetectionCounter_GetFaultDetectionCounter_EvtInfo_VCEvEcmPropFr02Tioutd: start-on-event=DemSatellite_0InternalBehavior/GetFaultDetectionCounter, operation=EvtInfo_VCEvEcmPropFr02Tioutd.GetFaultDetectionCounter
        OpEventGetFaultDetectionCounter_GetFaultDetectionCounter_Event_VCEvEcmPropFr02Tioutd: start-on-event=DemSatellite_0InternalBehavior/GetFaultDetectionCounter, operation=Event_VCEvEcmPropFr02Tioutd.GetFaultDetectionCounter
        OpEventGetFaultDetectionCounter_GetFaultDetectionCounter_EvtInfo_Ga_TmSpdSyncFailed: start-on-event=DemSatellite_0InternalBehavior/GetFaultDetectionCounter, operation=EvtInfo_Ga_TmSpdSyncFailed.GetFaultDetectionCounter
        OpEventGetFaultDetectionCounter_GetFaultDetectionCounter_Event_Ga_TmSpdSyncFailed: start-on-event=DemSatellite_0InternalBehavior/GetFaultDetectionCounter, operation=Event_Ga_TmSpdSyncFailed.GetFaultDetectionCounter
        OpEventGetFaultDetectionCounter_GetFaultDetectionCounter_EvtInfo_INV_RSLVR_EXCT_ELEC_LO: start-on-event=DemSatellite_0InternalBehavior/GetFaultDetectionCounter, operation=EvtInfo_INV_RSLVR_EXCT_ELEC_LO.GetFaultDetectionCounter
        OpEventGetFaultDetectionCounter_GetFaultDetectionCounter_Event_INV_RSLVR_EXCT_ELEC_LO: start-on-event=DemSatellite_0InternalBehavior/GetFaultDetectionCounter, operation=Event_INV_RSLVR_EXCT_ELEC_LO.GetFaultDetectionCounter
        OpEventGetFaultDetectionCounter_GetFaultDetectionCounter_EvtInfo_VCEvEcmPropXevFr06Tioutd: start-on-event=DemSatellite_0InternalBehavior/GetFaultDetectionCounter, operation=EvtInfo_VCEvEcmPropXevFr06Tioutd.GetFaultDetectionCounter
        OpEventGetFaultDetectionCounter_GetFaultDetectionCounter_Event_VCEvEcmPropXevFr06Tioutd: start-on-event=DemSatellite_0InternalBehavior/GetFaultDetectionCounter, operation=Event_VCEvEcmPropXevFr06Tioutd.GetFaultDetectionCounter
        OpEventGetFaultDetectionCounter_GetFaultDetectionCounter_EvtInfo_VcEvCntrWhlMotSysTqAllwd: start-on-event=DemSatellite_0InternalBehavior/GetFaultDetectionCounter, operation=EvtInfo_VcEvCntrWhlMotSysTqAllwd.GetFaultDetectionCounter
        OpEventGetFaultDetectionCounter_GetFaultDetectionCounter_Event_VcEvCntrWhlMotSysTqAllwd: start-on-event=DemSatellite_0InternalBehavior/GetFaultDetectionCounter, operation=Event_VcEvCntrWhlMotSysTqAllwd.GetFaultDetectionCounter
        OpEventGetFaultDetectionCounter_GetFaultDetectionCounter_EvtInfo_INV_UHVDC_1_ELEC_HI: start-on-event=DemSatellite_0InternalBehavior/GetFaultDetectionCounter, operation=EvtInfo_INV_UHVDC_1_ELEC_HI.GetFaultDetectionCounter
        OpEventGetFaultDetectionCounter_GetFaultDetectionCounter_Event_INV_UHVDC_1_ELEC_HI: start-on-event=DemSatellite_0InternalBehavior/GetFaultDetectionCounter, operation=Event_INV_UHVDC_1_ELEC_HI.GetFaultDetectionCounter
        OpEventGetFaultDetectionCounter_GetFaultDetectionCounter_EvtInfo_INV_EM_STATOR_TEMP2_ELE_FLT: start-on-event=DemSatellite_0InternalBehavior/GetFaultDetectionCounter, operation=EvtInfo_INV_EM_STATOR_TEMP2_ELE_FLT.GetFaultDetectionCounter
        OpEventGetFaultDetectionCounter_GetFaultDetectionCounter_Event_INV_EM_STATOR_TEMP2_ELE_FLT: start-on-event=DemSatellite_0InternalBehavior/GetFaultDetectionCounter, operation=Event_INV_EM_STATOR_TEMP2_ELE_FLT.GetFaultDetectionCounter
        OpEventGetFaultDetectionCounter_GetFaultDetectionCounter_EvtInfo_AURIX_RST_SNG: start-on-event=DemSatellite_0InternalBehavior/GetFaultDetectionCounter, operation=EvtInfo_AURIX_RST_SNG.GetFaultDetectionCounter
        OpEventGetFaultDetectionCounter_GetFaultDetectionCounter_Event_AURIX_RST_SNG: start-on-event=DemSatellite_0InternalBehavior/GetFaultDetectionCounter, operation=Event_AURIX_RST_SNG.GetFaultDetectionCounter
        OpEventGetFaultDetectionCounter_GetFaultDetectionCounter_EvtInfo_VCEvEcmPropFr24MgmFr01Tioutd: start-on-event=DemSatellite_0InternalBehavior/GetFaultDetectionCounter, operation=EvtInfo_VCEvEcmPropFr24MgmFr01Tioutd.GetFaultDetectionCounter
        OpEventGetFaultDetectionCounter_GetFaultDetectionCounter_Event_VCEvEcmPropFr24MgmFr01Tioutd: start-on-event=DemSatellite_0InternalBehavior/GetFaultDetectionCounter, operation=Event_VCEvEcmPropFr24MgmFr01Tioutd.GetFaultDetectionCounter
        OpEventGetFaultDetectionCounter_GetFaultDetectionCounter_EvtInfo_INV_RSLVR_COS_ELEC_OPEN: start-on-event=DemSatellite_0InternalBehavior/GetFaultDetectionCounter, operation=EvtInfo_INV_RSLVR_COS_ELEC_OPEN.GetFaultDetectionCounter
        OpEventGetFaultDetectionCounter_GetFaultDetectionCounter_Event_INV_RSLVR_COS_ELEC_OPEN: start-on-event=DemSatellite_0InternalBehavior/GetFaultDetectionCounter, operation=Event_INV_RSLVR_COS_ELEC_OPEN.GetFaultDetectionCounter
        OpEventGetFaultDetectionCounter_GetFaultDetectionCounter_EvtInfo_INV_IAC_V_ELEC_LO: start-on-event=DemSatellite_0InternalBehavior/GetFaultDetectionCounter, operation=EvtInfo_INV_IAC_V_ELEC_LO.GetFaultDetectionCounter
        OpEventGetFaultDetectionCounter_GetFaultDetectionCounter_Event_INV_IAC_V_ELEC_LO: start-on-event=DemSatellite_0InternalBehavior/GetFaultDetectionCounter, operation=Event_INV_IAC_V_ELEC_LO.GetFaultDetectionCounter
        OpEventGetFaultDetectionCounter_GetFaultDetectionCounter_EvtInfo_INV_IAC_W_OFFS: start-on-event=DemSatellite_0InternalBehavior/GetFaultDetectionCounter, operation=EvtInfo_INV_IAC_W_OFFS.GetFaultDetectionCounter
        OpEventGetFaultDetectionCounter_GetFaultDetectionCounter_Event_INV_IAC_W_OFFS: start-on-event=DemSatellite_0InternalBehavior/GetFaultDetectionCounter, operation=Event_INV_IAC_W_OFFS.GetFaultDetectionCounter
        OpEventGetFaultDetectionCounter_GetFaultDetectionCounter_EvtInfo_INV_EM_STATOR_TEMP2_GRDT: start-on-event=DemSatellite_0InternalBehavior/GetFaultDetectionCounter, operation=EvtInfo_INV_EM_STATOR_TEMP2_GRDT.GetFaultDetectionCounter
        OpEventGetFaultDetectionCounter_GetFaultDetectionCounter_Event_INV_EM_STATOR_TEMP2_GRDT: start-on-event=DemSatellite_0InternalBehavior/GetFaultDetectionCounter, operation=Event_INV_EM_STATOR_TEMP2_GRDT.GetFaultDetectionCounter
        OpEventGetFaultDetectionCounter_GetFaultDetectionCounter_EvtInfo_INV_EM_OVRSPD_HWP: start-on-event=DemSatellite_0InternalBehavior/GetFaultDetectionCounter, operation=EvtInfo_INV_EM_OVRSPD_HWP.GetFaultDetectionCounter
        OpEventGetFaultDetectionCounter_GetFaultDetectionCounter_Event_INV_EM_OVRSPD_HWP: start-on-event=DemSatellite_0InternalBehavior/GetFaultDetectionCounter, operation=Event_INV_EM_OVRSPD_HWP.GetFaultDetectionCounter
        OpEventGetFaultDetectionCounter_GetFaultDetectionCounter_EvtInfo_CU_TEMP_HWP: start-on-event=DemSatellite_0InternalBehavior/GetFaultDetectionCounter, operation=EvtInfo_CU_TEMP_HWP.GetFaultDetectionCounter
        OpEventGetFaultDetectionCounter_GetFaultDetectionCounter_Event_CU_TEMP_HWP: start-on-event=DemSatellite_0InternalBehavior/GetFaultDetectionCounter, operation=Event_CU_TEMP_HWP.GetFaultDetectionCounter
        OpEventGetFaultDetectionCounter_GetFaultDetectionCounter_EvtInfo_INV_UHVDC_1_RNG_HI: start-on-event=DemSatellite_0InternalBehavior/GetFaultDetectionCounter, operation=EvtInfo_INV_UHVDC_1_RNG_HI.GetFaultDetectionCounter
        OpEventGetFaultDetectionCounter_GetFaultDetectionCounter_Event_INV_UHVDC_1_RNG_HI: start-on-event=DemSatellite_0InternalBehavior/GetFaultDetectionCounter, operation=Event_INV_UHVDC_1_RNG_HI.GetFaultDetectionCounter
        OpEventGetFaultDetectionCounter_GetFaultDetectionCounter_EvtInfo_VcEvEMPerfPlaus: start-on-event=DemSatellite_0InternalBehavior/GetFaultDetectionCounter, operation=EvtInfo_VcEvEMPerfPlaus.GetFaultDetectionCounter
        OpEventGetFaultDetectionCounter_GetFaultDetectionCounter_Event_VcEvEMPerfPlaus: start-on-event=DemSatellite_0InternalBehavior/GetFaultDetectionCounter, operation=Event_VcEvEMPerfPlaus.GetFaultDetectionCounter
        OpEventGetFaultDetectionCounter_GetFaultDetectionCounter_EvtInfo_VCEvVddmPropFr18Tioutd: start-on-event=DemSatellite_0InternalBehavior/GetFaultDetectionCounter, operation=EvtInfo_VCEvVddmPropFr18Tioutd.GetFaultDetectionCounter
        OpEventGetFaultDetectionCounter_GetFaultDetectionCounter_Event_VCEvVddmPropFr18Tioutd: start-on-event=DemSatellite_0InternalBehavior/GetFaultDetectionCounter, operation=Event_VCEvVddmPropFr18Tioutd.GetFaultDetectionCounter
        OpEventGetFaultDetectionCounter_GetFaultDetectionCounter_EvtInfo_INV_IAC_U_ELEC_HWP: start-on-event=DemSatellite_0InternalBehavior/GetFaultDetectionCounter, operation=EvtInfo_INV_IAC_U_ELEC_HWP.GetFaultDetectionCounter
        OpEventGetFaultDetectionCounter_GetFaultDetectionCounter_Event_INV_IAC_U_ELEC_HWP: start-on-event=DemSatellite_0InternalBehavior/GetFaultDetectionCounter, operation=Event_INV_IAC_U_ELEC_HWP.GetFaultDetectionCounter
        OpEventGetFaultDetectionCounter_GetFaultDetectionCounter_EvtInfo_VCEvVddmPropFr15Tioutd: start-on-event=DemSatellite_0InternalBehavior/GetFaultDetectionCounter, operation=EvtInfo_VCEvVddmPropFr15Tioutd.GetFaultDetectionCounter
        OpEventGetFaultDetectionCounter_GetFaultDetectionCounter_Event_VCEvVddmPropFr15Tioutd: start-on-event=DemSatellite_0InternalBehavior/GetFaultDetectionCounter, operation=Event_VCEvVddmPropFr15Tioutd.GetFaultDetectionCounter
        OpEventGetFaultDetectionCounter_GetFaultDetectionCounter_EvtInfo_Ga_GADisengageFailure: start-on-event=DemSatellite_0InternalBehavior/GetFaultDetectionCounter, operation=EvtInfo_Ga_GADisengageFailure.GetFaultDetectionCounter
        OpEventGetFaultDetectionCounter_GetFaultDetectionCounter_Event_Ga_GADisengageFailure: start-on-event=DemSatellite_0InternalBehavior/GetFaultDetectionCounter, operation=Event_Ga_GADisengageFailure.GetFaultDetectionCounter
        OpEventGetFaultDetectionCounter_GetFaultDetectionCounter_EvtInfo_CU_TEMP2_RNG_LO: start-on-event=DemSatellite_0InternalBehavior/GetFaultDetectionCounter, operation=EvtInfo_CU_TEMP2_RNG_LO.GetFaultDetectionCounter
        OpEventGetFaultDetectionCounter_GetFaultDetectionCounter_Event_CU_TEMP2_RNG_LO: start-on-event=DemSatellite_0InternalBehavior/GetFaultDetectionCounter, operation=Event_CU_TEMP2_RNG_LO.GetFaultDetectionCounter
        OpEventGetFaultDetectionCounter_GetFaultDetectionCounter_EvtInfo_INV_RSLVR_SIN_ELEC_OPEN: start-on-event=DemSatellite_0InternalBehavior/GetFaultDetectionCounter, operation=EvtInfo_INV_RSLVR_SIN_ELEC_OPEN.GetFaultDetectionCounter
        OpEventGetFaultDetectionCounter_GetFaultDetectionCounter_Event_INV_RSLVR_SIN_ELEC_OPEN: start-on-event=DemSatellite_0InternalBehavior/GetFaultDetectionCounter, operation=Event_INV_RSLVR_SIN_ELEC_OPEN.GetFaultDetectionCounter
        OpEventGetFaultDetectionCounter_GetFaultDetectionCounter_EvtInfo_VcEvChkSum: start-on-event=DemSatellite_0InternalBehavior/GetFaultDetectionCounter, operation=EvtInfo_VcEvChkSum.GetFaultDetectionCounter
        OpEventGetFaultDetectionCounter_GetFaultDetectionCounter_Event_VcEvChkSum: start-on-event=DemSatellite_0InternalBehavior/GetFaultDetectionCounter, operation=Event_VcEvChkSum.GetFaultDetectionCounter
        OpEventGetFaultDetectionCounter_GetFaultDetectionCounter_EvtInfo_PS_P5_UC_FLT: start-on-event=DemSatellite_0InternalBehavior/GetFaultDetectionCounter, operation=EvtInfo_PS_P5_UC_FLT.GetFaultDetectionCounter
        OpEventGetFaultDetectionCounter_GetFaultDetectionCounter_Event_PS_P5_UC_FLT: start-on-event=DemSatellite_0InternalBehavior/GetFaultDetectionCounter, operation=Event_PS_P5_UC_FLT.GetFaultDetectionCounter
        OpEventGetFaultDetectionCounter_GetFaultDetectionCounter_EvtInfo_INV_RSLVR_COS_ELEC_FLT: start-on-event=DemSatellite_0InternalBehavior/GetFaultDetectionCounter, operation=EvtInfo_INV_RSLVR_COS_ELEC_FLT.GetFaultDetectionCounter
        OpEventGetFaultDetectionCounter_GetFaultDetectionCounter_Event_INV_RSLVR_COS_ELEC_FLT: start-on-event=DemSatellite_0InternalBehavior/GetFaultDetectionCounter, operation=Event_INV_RSLVR_COS_ELEC_FLT.GetFaultDetectionCounter
        OpEventGetFaultDetectionCounter_GetFaultDetectionCounter_EvtInfo_INV_IAC_W_RNG_HI: start-on-event=DemSatellite_0InternalBehavior/GetFaultDetectionCounter, operation=EvtInfo_INV_IAC_W_RNG_HI.GetFaultDetectionCounter
        OpEventGetFaultDetectionCounter_GetFaultDetectionCounter_Event_INV_IAC_W_RNG_HI: start-on-event=DemSatellite_0InternalBehavior/GetFaultDetectionCounter, operation=Event_INV_IAC_W_RNG_HI.GetFaultDetectionCounter
        OpEventGetFaultDetectionCounter_GetFaultDetectionCounter_EvtInfo_PS_ECUSUPPLY_HIGH: start-on-event=DemSatellite_0InternalBehavior/GetFaultDetectionCounter, operation=EvtInfo_PS_ECUSUPPLY_HIGH.GetFaultDetectionCounter
        OpEventGetFaultDetectionCounter_GetFaultDetectionCounter_Event_PS_ECUSUPPLY_HIGH: start-on-event=DemSatellite_0InternalBehavior/GetFaultDetectionCounter, operation=Event_PS_ECUSUPPLY_HIGH.GetFaultDetectionCounter
        OpEventGetFaultDetectionCounter_GetFaultDetectionCounter_EvtInfo_VCEvEcmPropFr05Tioutd: start-on-event=DemSatellite_0InternalBehavior/GetFaultDetectionCounter, operation=EvtInfo_VCEvEcmPropFr05Tioutd.GetFaultDetectionCounter
        OpEventGetFaultDetectionCounter_GetFaultDetectionCounter_Event_VCEvEcmPropFr05Tioutd: start-on-event=DemSatellite_0InternalBehavior/GetFaultDetectionCounter, operation=Event_VCEvEcmPropFr05Tioutd.GetFaultDetectionCounter
        OpEventGetFaultDetectionCounter_GetFaultDetectionCounter_EvtInfo_PS_ECUSUPPLY_LOW: start-on-event=DemSatellite_0InternalBehavior/GetFaultDetectionCounter, operation=EvtInfo_PS_ECUSUPPLY_LOW.GetFaultDetectionCounter
        OpEventGetFaultDetectionCounter_GetFaultDetectionCounter_Event_PS_ECUSUPPLY_LOW: start-on-event=DemSatellite_0InternalBehavior/GetFaultDetectionCounter, operation=Event_PS_ECUSUPPLY_LOW.GetFaultDetectionCounter
        OpEventGetFaultDetectionCounter_GetFaultDetectionCounter_EvtInfo_VcEvChkSumHvSysRlySts: start-on-event=DemSatellite_0InternalBehavior/GetFaultDetectionCounter, operation=EvtInfo_VcEvChkSumHvSysRlySts.GetFaultDetectionCounter
        OpEventGetFaultDetectionCounter_GetFaultDetectionCounter_Event_VcEvChkSumHvSysRlySts: start-on-event=DemSatellite_0InternalBehavior/GetFaultDetectionCounter, operation=Event_VcEvChkSumHvSysRlySts.GetFaultDetectionCounter
        OpEventGetFaultDetectionCounter_GetFaultDetectionCounter_EvtInfo_VcEvMonMode: start-on-event=DemSatellite_0InternalBehavior/GetFaultDetectionCounter, operation=EvtInfo_VcEvMonMode.GetFaultDetectionCounter
        OpEventGetFaultDetectionCounter_GetFaultDetectionCounter_Event_VcEvMonMode: start-on-event=DemSatellite_0InternalBehavior/GetFaultDetectionCounter, operation=Event_VcEvMonMode.GetFaultDetectionCounter
        OpEventGetFaultDetectionCounter_GetFaultDetectionCounter_EvtInfo_INV_IAC_OC_SWP: start-on-event=DemSatellite_0InternalBehavior/GetFaultDetectionCounter, operation=EvtInfo_INV_IAC_OC_SWP.GetFaultDetectionCounter
        OpEventGetFaultDetectionCounter_GetFaultDetectionCounter_Event_INV_IAC_OC_SWP: start-on-event=DemSatellite_0InternalBehavior/GetFaultDetectionCounter, operation=Event_INV_IAC_OC_SWP.GetFaultDetectionCounter
        OpEventGetFaultDetectionCounter_GetFaultDetectionCounter_EvtInfo_INV_IMMO_AUTHFAIL: start-on-event=DemSatellite_0InternalBehavior/GetFaultDetectionCounter, operation=EvtInfo_INV_IMMO_AUTHFAIL.GetFaultDetectionCounter
        OpEventGetFaultDetectionCounter_GetFaultDetectionCounter_Event_INV_IMMO_AUTHFAIL: start-on-event=DemSatellite_0InternalBehavior/GetFaultDetectionCounter, operation=Event_INV_IMMO_AUTHFAIL.GetFaultDetectionCounter
        OpEventGetFaultDetectionCounter_GetFaultDetectionCounter_EvtInfo_PA_OpenCirc_FLT: start-on-event=DemSatellite_0InternalBehavior/GetFaultDetectionCounter, operation=EvtInfo_PA_OpenCirc_FLT.GetFaultDetectionCounter
        OpEventGetFaultDetectionCounter_GetFaultDetectionCounter_Event_PA_OpenCirc_FLT: start-on-event=DemSatellite_0InternalBehavior/GetFaultDetectionCounter, operation=Event_PA_OpenCirc_FLT.GetFaultDetectionCounter
        OpEventGetFaultDetectionCounter_GetFaultDetectionCounter_EvtInfo_INV_IAC_V_ELEC_HI: start-on-event=DemSatellite_0InternalBehavior/GetFaultDetectionCounter, operation=EvtInfo_INV_IAC_V_ELEC_HI.GetFaultDetectionCounter
        OpEventGetFaultDetectionCounter_GetFaultDetectionCounter_Event_INV_IAC_V_ELEC_HI: start-on-event=DemSatellite_0InternalBehavior/GetFaultDetectionCounter, operation=Event_INV_IAC_V_ELEC_HI.GetFaultDetectionCounter
        OpEventGetFaultDetectionCounter_GetFaultDetectionCounter_EvtInfo_VCEvEcmPropFr04Tioutd: start-on-event=DemSatellite_0InternalBehavior/GetFaultDetectionCounter, operation=EvtInfo_VCEvEcmPropFr04Tioutd.GetFaultDetectionCounter
        OpEventGetFaultDetectionCounter_GetFaultDetectionCounter_Event_VCEvEcmPropFr04Tioutd: start-on-event=DemSatellite_0InternalBehavior/GetFaultDetectionCounter, operation=Event_VCEvEcmPropFr04Tioutd.GetFaultDetectionCounter
        OpEventGetFaultDetectionCounter_GetFaultDetectionCounter_EvtInfo_VcEvMonTrqActPlaus: start-on-event=DemSatellite_0InternalBehavior/GetFaultDetectionCounter, operation=EvtInfo_VcEvMonTrqActPlaus.GetFaultDetectionCounter
        OpEventGetFaultDetectionCounter_GetFaultDetectionCounter_Event_VcEvMonTrqActPlaus: start-on-event=DemSatellite_0InternalBehavior/GetFaultDetectionCounter, operation=Event_VcEvMonTrqActPlaus.GetFaultDetectionCounter
        OpEventGetFaultDetectionCounter_GetFaultDetectionCounter_EvtInfo_VcEvMonTrqAct: start-on-event=DemSatellite_0InternalBehavior/GetFaultDetectionCounter, operation=EvtInfo_VcEvMonTrqAct.GetFaultDetectionCounter
        OpEventGetFaultDetectionCounter_GetFaultDetectionCounter_Event_VcEvMonTrqAct: start-on-event=DemSatellite_0InternalBehavior/GetFaultDetectionCounter, operation=Event_VcEvMonTrqAct.GetFaultDetectionCounter
        OpEventGetFaultDetectionCounter_GetFaultDetectionCounter_EvtInfo_INV_RSLVR_COS_ELEC_LO: start-on-event=DemSatellite_0InternalBehavior/GetFaultDetectionCounter, operation=EvtInfo_INV_RSLVR_COS_ELEC_LO.GetFaultDetectionCounter
        OpEventGetFaultDetectionCounter_GetFaultDetectionCounter_Event_INV_RSLVR_COS_ELEC_LO: start-on-event=DemSatellite_0InternalBehavior/GetFaultDetectionCounter, operation=Event_INV_RSLVR_COS_ELEC_LO.GetFaultDetectionCounter
        OpEventGetFaultDetectionCounter_GetFaultDetectionCounter_EvtInfo_INV_COOLT_INLET_TEMP_HWP: start-on-event=DemSatellite_0InternalBehavior/GetFaultDetectionCounter, operation=EvtInfo_INV_COOLT_INLET_TEMP_HWP.GetFaultDetectionCounter
        OpEventGetFaultDetectionCounter_GetFaultDetectionCounter_Event_INV_COOLT_INLET_TEMP_HWP: start-on-event=DemSatellite_0InternalBehavior/GetFaultDetectionCounter, operation=Event_INV_COOLT_INLET_TEMP_HWP.GetFaultDetectionCounter
        OpEventGetFaultDetectionCounter_GetFaultDetectionCounter_EvtInfo_VCEvEcmPropFr11Tioutd: start-on-event=DemSatellite_0InternalBehavior/GetFaultDetectionCounter, operation=EvtInfo_VCEvEcmPropFr11Tioutd.GetFaultDetectionCounter
        OpEventGetFaultDetectionCounter_GetFaultDetectionCounter_Event_VCEvEcmPropFr11Tioutd: start-on-event=DemSatellite_0InternalBehavior/GetFaultDetectionCounter, operation=Event_VCEvEcmPropFr11Tioutd.GetFaultDetectionCounter
        OpEventGetFaultDetectionCounter_GetFaultDetectionCounter_EvtInfo_PS_KL30_RNG_HI: start-on-event=DemSatellite_0InternalBehavior/GetFaultDetectionCounter, operation=EvtInfo_PS_KL30_RNG_HI.GetFaultDetectionCounter
        OpEventGetFaultDetectionCounter_GetFaultDetectionCounter_Event_PS_KL30_RNG_HI: start-on-event=DemSatellite_0InternalBehavior/GetFaultDetectionCounter, operation=Event_PS_KL30_RNG_HI.GetFaultDetectionCounter
        OpEventGetFaultDetectionCounter_GetFaultDetectionCounter_EvtInfo_INV_IAC_OC_HWP: start-on-event=DemSatellite_0InternalBehavior/GetFaultDetectionCounter, operation=EvtInfo_INV_IAC_OC_HWP.GetFaultDetectionCounter
        OpEventGetFaultDetectionCounter_GetFaultDetectionCounter_Event_INV_IAC_OC_HWP: start-on-event=DemSatellite_0InternalBehavior/GetFaultDetectionCounter, operation=Event_INV_IAC_OC_HWP.GetFaultDetectionCounter
        OpEventGetFaultDetectionCounter_GetFaultDetectionCounter_EvtInfo_INV_RSLVR_COS_RNG_HI: start-on-event=DemSatellite_0InternalBehavior/GetFaultDetectionCounter, operation=EvtInfo_INV_RSLVR_COS_RNG_HI.GetFaultDetectionCounter
        OpEventGetFaultDetectionCounter_GetFaultDetectionCounter_Event_INV_RSLVR_COS_RNG_HI: start-on-event=DemSatellite_0InternalBehavior/GetFaultDetectionCounter, operation=Event_INV_RSLVR_COS_RNG_HI.GetFaultDetectionCounter
        OpEventGetFaultDetectionCounter_GetFaultDetectionCounter_EvtInfo_INV_IAC_U_ELEC_HI: start-on-event=DemSatellite_0InternalBehavior/GetFaultDetectionCounter, operation=EvtInfo_INV_IAC_U_ELEC_HI.GetFaultDetectionCounter
        OpEventGetFaultDetectionCounter_GetFaultDetectionCounter_Event_INV_IAC_U_ELEC_HI: start-on-event=DemSatellite_0InternalBehavior/GetFaultDetectionCounter, operation=Event_INV_IAC_U_ELEC_HI.GetFaultDetectionCounter
        OpEventGetFaultDetectionCounter_GetFaultDetectionCounter_EvtInfo_INV_IAC_V_RNG_LO: start-on-event=DemSatellite_0InternalBehavior/GetFaultDetectionCounter, operation=EvtInfo_INV_IAC_V_RNG_LO.GetFaultDetectionCounter
        OpEventGetFaultDetectionCounter_GetFaultDetectionCounter_Event_INV_IAC_V_RNG_LO: start-on-event=DemSatellite_0InternalBehavior/GetFaultDetectionCounter, operation=Event_INV_IAC_V_RNG_LO.GetFaultDetectionCounter

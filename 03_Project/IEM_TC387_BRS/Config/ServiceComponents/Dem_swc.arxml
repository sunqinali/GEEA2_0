[part 2 of 6: package /MICROSAR/Dem_swc/ComponentTypes]
AUTOSAR XML (schema 4-2-2)
package /MICROSAR/Dem_swc/ComponentTypes  (continued)
  service sw component type DemSatellite_0: category=SERVICE_COMPONENT  (continued)
    behavior DemSatellite_0InternalBehavior: handle-termination-and-restart=NO-SUPPORT, included-data-type-set=data-type=[Dem_EventIdType, Dem_RatioIdType, Dem_EventStatusType, Dem_UdsStatusByteType, Dem_DTCFormatType, Dem_InitMonitorReasonType, Dem_OperationCycleStateType, Dem_DTCStatusMaskType, Dem_IndicatorStatusType, Dem_MaxDataValueType, Dem_DTCKindType, Dem_DTCGroupType, Dem_IumprDenomCondIdType, Dem_IumprDenomCondStatusType, Dem_DebounceResetStatusType, Dem_DebouncingStateType, Dem_IumprReadinessGroupType, Dem_DTRControlType, Dem_DTCSeverityType, Dem_MonitorStatusType]  (continued)
      4543 x operation invoked event:  (continued)
        OpEventGetEventUdsStatus_GetEventUdsStatus_EvtInfo_VcEvMonTrqAct: start-on-event=DemSatellite_0InternalBehavior/GetEventUdsStatus, operation=EvtInfo_VcEvMonTrqAct.GetEventUdsStatus
        OpEventGetEventUdsStatus_GetEventUdsStatus_Event_VcEvMonTrqAct: start-on-event=DemSatellite_0InternalBehavior/GetEventUdsStatus, operation=Event_VcEvMonTrqAct.GetEventUdsStatus
        OpEventGetEventUdsStatus_GetEventUdsStatus_EvtInfo_INV_RSLVR_COS_ELEC_LO: start-on-event=DemSatellite_0InternalBehavior/GetEventUdsStatus, operation=EvtInfo_INV_RSLVR_COS_ELEC_LO.GetEventUdsStatus
        OpEventGetEventUdsStatus_GetEventUdsStatus_Event_INV_RSLVR_COS_ELEC_LO: start-on-event=DemSatellite_0InternalBehavior/GetEventUdsStatus, operation=Event_INV_RSLVR_COS_ELEC_LO.GetEventUdsStatus
        OpEventGetEventUdsStatus_GetEventUdsStatus_EvtInfo_INV_COOLT_INLET_TEMP_HWP: start-on-event=DemSatellite_0InternalBehavior/GetEventUdsStatus, operation=EvtInfo_INV_COOLT_INLET_TEMP_HWP.GetEventUdsStatus
        OpEventGetEventUdsStatus_GetEventUdsStatus_Event_INV_COOLT_INLET_TEMP_HWP: start-on-event=DemSatellite_0InternalBehavior/GetEventUdsStatus, operation=Event_INV_COOLT_INLET_TEMP_HWP.GetEventUdsStatus
        OpEventGetEventUdsStatus_GetEventUdsStatus_EvtInfo_VCEvEcmPropFr11Tioutd: start-on-event=DemSatellite_0InternalBehavior/GetEventUdsStatus, operation=EvtInfo_VCEvEcmPropFr11Tioutd.GetEventUdsStatus
        OpEventGetEventUdsStatus_GetEventUdsStatus_Event_VCEvEcmPropFr11Tioutd: start-on-event=DemSatellite_0InternalBehavior/GetEventUdsStatus, operation=Event_VCEvEcmPropFr11Tioutd.GetEventUdsStatus
        OpEventGetEventUdsStatus_GetEventUdsStatus_EvtInfo_PS_KL30_RNG_HI: start-on-event=DemSatellite_0InternalBehavior/GetEventUdsStatus, operation=EvtInfo_PS_KL30_RNG_HI.GetEventUdsStatus
        OpEventGetEventUdsStatus_GetEventUdsStatus_Event_PS_KL30_RNG_HI: start-on-event=DemSatellite_0InternalBehavior/GetEventUdsStatus, operation=Event_PS_KL30_RNG_HI.GetEventUdsStatus
        OpEventGetEventUdsStatus_GetEventUdsStatus_EvtInfo_INV_IAC_OC_HWP: start-on-event=DemSatellite_0InternalBehavior/GetEventUdsStatus, operation=EvtInfo_INV_IAC_OC_HWP.GetEventUdsStatus
        OpEventGetEventUdsStatus_GetEventUdsStatus_Event_INV_IAC_OC_HWP: start-on-event=DemSatellite_0InternalBehavior/GetEventUdsStatus, operation=Event_INV_IAC_OC_HWP.GetEventUdsStatus
        OpEventGetEventUdsStatus_GetEventUdsStatus_EvtInfo_INV_RSLVR_COS_RNG_HI: start-on-event=DemSatellite_0InternalBehavior/GetEventUdsStatus, operation=EvtInfo_INV_RSLVR_COS_RNG_HI.GetEventUdsStatus
        OpEventGetEventUdsStatus_GetEventUdsStatus_Event_INV_RSLVR_COS_RNG_HI: start-on-event=DemSatellite_0InternalBehavior/GetEventUdsStatus, operation=Event_INV_RSLVR_COS_RNG_HI.GetEventUdsStatus
        OpEventGetEventUdsStatus_GetEventUdsStatus_EvtInfo_INV_IAC_U_ELEC_HI: start-on-event=DemSatellite_0InternalBehavior/GetEventUdsStatus, operation=EvtInfo_INV_IAC_U_ELEC_HI.GetEventUdsStatus
        OpEventGetEventUdsStatus_GetEventUdsStatus_Event_INV_IAC_U_ELEC_HI: start-on-event=DemSatellite_0InternalBehavior/GetEventUdsStatus, operation=Event_INV_IAC_U_ELEC_HI.GetEventUdsStatus
        OpEventGetEventUdsStatus_GetEventUdsStatus_EvtInfo_INV_IAC_V_RNG_LO: start-on-event=DemSatellite_0InternalBehavior/GetEventUdsStatus, operation=EvtInfo_INV_IAC_V_RNG_LO.GetEventUdsStatus
        OpEventGetEventUdsStatus_GetEventUdsStatus_Event_INV_IAC_V_RNG_LO: start-on-event=DemSatellite_0InternalBehavior/GetEventUdsStatus, operation=Event_INV_IAC_V_RNG_LO.GetEventUdsStatus
        OpEventGetEventUdsStatus_GetEventUdsStatus_EvtInfo_INV_IAC_U_RNG_HI: start-on-event=DemSatellite_0InternalBehavior/GetEventUdsStatus, operation=EvtInfo_INV_IAC_U_RNG_HI.GetEventUdsStatus
        OpEventGetEventUdsStatus_GetEventUdsStatus_Event_INV_IAC_U_RNG_HI: start-on-event=DemSatellite_0InternalBehavior/GetEventUdsStatus, operation=Event_INV_IAC_U_RNG_HI.GetEventUdsStatus
        OpEventGetEventUdsStatus_GetEventUdsStatus_EvtInfo_VCEvEcmPropFr25Tioutd: start-on-event=DemSatellite_0InternalBehavior/GetEventUdsStatus, operation=EvtInfo_VCEvEcmPropFr25Tioutd.GetEventUdsStatus
        OpEventGetEventUdsStatus_GetEventUdsStatus_Event_VCEvEcmPropFr25Tioutd: start-on-event=DemSatellite_0InternalBehavior/GetEventUdsStatus, operation=Event_VCEvEcmPropFr25Tioutd.GetEventUdsStatus
        OpEventGetEventUdsStatus_GetEventUdsStatus_EvtInfo_INV_IGBT_TEMP_W_RNG_LO: start-on-event=DemSatellite_0InternalBehavior/GetEventUdsStatus, operation=EvtInfo_INV_IGBT_TEMP_W_RNG_LO.GetEventUdsStatus
        OpEventGetEventUdsStatus_GetEventUdsStatus_Event_INV_IGBT_TEMP_W_RNG_LO: start-on-event=DemSatellite_0InternalBehavior/GetEventUdsStatus, operation=Event_INV_IGBT_TEMP_W_RNG_LO.GetEventUdsStatus
        OpEventGetEventUdsStatus_GetEventUdsStatus_EvtInfo_PSnsr_RNG_NOK: start-on-event=DemSatellite_0InternalBehavior/GetEventUdsStatus, operation=EvtInfo_PSnsr_RNG_NOK.GetEventUdsStatus
        OpEventGetEventUdsStatus_GetEventUdsStatus_Event_PSnsr_RNG_NOK: start-on-event=DemSatellite_0InternalBehavior/GetEventUdsStatus, operation=Event_PSnsr_RNG_NOK.GetEventUdsStatus
        OpEventGetEventUdsStatus_GetEventUdsStatus_EvtInfo_INV_RSLVR_COS_RNG_NOK: start-on-event=DemSatellite_0InternalBehavior/GetEventUdsStatus, operation=EvtInfo_INV_RSLVR_COS_RNG_NOK.GetEventUdsStatus
        OpEventGetEventUdsStatus_GetEventUdsStatus_Event_INV_RSLVR_COS_RNG_NOK: start-on-event=DemSatellite_0InternalBehavior/GetEventUdsStatus, operation=Event_INV_RSLVR_COS_RNG_NOK.GetEventUdsStatus
        OpEventGetEventUdsStatus_GetEventUdsStatus_EvtInfo_PS_DRVB_Fault: start-on-event=DemSatellite_0InternalBehavior/GetEventUdsStatus, operation=EvtInfo_PS_DRVB_Fault.GetEventUdsStatus
        OpEventGetEventUdsStatus_GetEventUdsStatus_Event_PS_DRVB_Fault: start-on-event=DemSatellite_0InternalBehavior/GetEventUdsStatus, operation=Event_PS_DRVB_Fault.GetEventUdsStatus
        OpEventGetEventUdsStatus_GetEventUdsStatus_EvtInfo_INV_CU_TEMP1_RNG_NOK: start-on-event=DemSatellite_0InternalBehavior/GetEventUdsStatus, operation=EvtInfo_INV_CU_TEMP1_RNG_NOK.GetEventUdsStatus
        OpEventGetEventUdsStatus_GetEventUdsStatus_Event_INV_CU_TEMP1_RNG_NOK: start-on-event=DemSatellite_0InternalBehavior/GetEventUdsStatus, operation=Event_INV_CU_TEMP1_RNG_NOK.GetEventUdsStatus
        OpEventGetEventUdsStatus_GetEventUdsStatus_EvtInfo_VcEvCntr: start-on-event=DemSatellite_0InternalBehavior/GetEventUdsStatus, operation=EvtInfo_VcEvCntr.GetEventUdsStatus
        OpEventGetEventUdsStatus_GetEventUdsStatus_Event_VcEvCntr: start-on-event=DemSatellite_0InternalBehavior/GetEventUdsStatus, operation=Event_VcEvCntr.GetEventUdsStatus
        OpEventGetEventUdsStatus_GetEventUdsStatus_EvtInfo_INV_RSLVR_SIN_AMP: start-on-event=DemSatellite_0InternalBehavior/GetEventUdsStatus, operation=EvtInfo_INV_RSLVR_SIN_AMP.GetEventUdsStatus
        OpEventGetEventUdsStatus_GetEventUdsStatus_Event_INV_RSLVR_SIN_AMP: start-on-event=DemSatellite_0InternalBehavior/GetEventUdsStatus, operation=Event_INV_RSLVR_SIN_AMP.GetEventUdsStatus
        OpEventGetEventUdsStatus_GetEventUdsStatus_EvtInfo_INV_UHVDC_2_RNG_HI: start-on-event=DemSatellite_0InternalBehavior/GetEventUdsStatus, operation=EvtInfo_INV_UHVDC_2_RNG_HI.GetEventUdsStatus
        OpEventGetEventUdsStatus_GetEventUdsStatus_Event_INV_UHVDC_2_RNG_HI: start-on-event=DemSatellite_0InternalBehavior/GetEventUdsStatus, operation=Event_INV_UHVDC_2_RNG_HI.GetEventUdsStatus
        OpEventGetEventUdsStatus_GetEventUdsStatus_EvtInfo_INV_IGBT_TEMP_U_GRDT: start-on-event=DemSatellite_0InternalBehavior/GetEventUdsStatus, operation=EvtInfo_INV_IGBT_TEMP_U_GRDT.GetEventUdsStatus
        OpEventGetEventUdsStatus_GetEventUdsStatus_Event_INV_IGBT_TEMP_U_GRDT: start-on-event=DemSatellite_0InternalBehavior/GetEventUdsStatus, operation=Event_INV_IGBT_TEMP_U_GRDT.GetEventUdsStatus
        OpEventGetEventUdsStatus_GetEventUdsStatus_EvtInfo_MON_TQ_PLAUS_PWR_MDL: start-on-event=DemSatellite_0InternalBehavior/GetEventUdsStatus, operation=EvtInfo_MON_TQ_PLAUS_PWR_MDL.GetEventUdsStatus
        OpEventGetEventUdsStatus_GetEventUdsStatus_Event_MON_TQ_PLAUS_PWR_MDL: start-on-event=DemSatellite_0InternalBehavior/GetEventUdsStatus, operation=Event_MON_TQ_PLAUS_PWR_MDL.GetEventUdsStatus
        OpEventGetEventUdsStatus_GetEventUdsStatus_EvtInfo_INV_IGBT_TEMP_W_PLAUS: start-on-event=DemSatellite_0InternalBehavior/GetEventUdsStatus, operation=EvtInfo_INV_IGBT_TEMP_W_PLAUS.GetEventUdsStatus
        OpEventGetEventUdsStatus_GetEventUdsStatus_Event_INV_IGBT_TEMP_W_PLAUS: start-on-event=DemSatellite_0InternalBehavior/GetEventUdsStatus, operation=Event_INV_IGBT_TEMP_W_PLAUS.GetEventUdsStatus
        OpEventGetEventUdsStatus_GetEventUdsStatus_EvtInfo_PS_BLDC_UV_FLT: start-on-event=DemSatellite_0InternalBehavior/GetEventUdsStatus, operation=EvtInfo_PS_BLDC_UV_FLT.GetEventUdsStatus
        OpEventGetEventUdsStatus_GetEventUdsStatus_Event_PS_BLDC_UV_FLT: start-on-event=DemSatellite_0InternalBehavior/GetEventUdsStatus, operation=Event_PS_BLDC_UV_FLT.GetEventUdsStatus
        OpEventGetEventUdsStatus_GetEventUdsStatus_EvtInfo_INV_IAC_V_OFFS: start-on-event=DemSatellite_0InternalBehavior/GetEventUdsStatus, operation=EvtInfo_INV_IAC_V_OFFS.GetEventUdsStatus
        OpEventGetEventUdsStatus_GetEventUdsStatus_Event_INV_IAC_V_OFFS: start-on-event=DemSatellite_0InternalBehavior/GetEventUdsStatus, operation=Event_INV_IAC_V_OFFS.GetEventUdsStatus
        OpEventGetEventUdsStatus_GetEventUdsStatus_EvtInfo_INV_RSLVR_EXCT_FREQ_RNG_NOK: start-on-event=DemSatellite_0InternalBehavior/GetEventUdsStatus, operation=EvtInfo_INV_RSLVR_EXCT_FREQ_RNG_NOK.GetEventUdsStatus
        OpEventGetEventUdsStatus_GetEventUdsStatus_Event_INV_RSLVR_EXCT_FREQ_RNG_NOK: start-on-event=DemSatellite_0InternalBehavior/GetEventUdsStatus, operation=Event_INV_RSLVR_EXCT_FREQ_RNG_NOK.GetEventUdsStatus
        OpEventGetEventUdsStatus_GetEventUdsStatus_EvtInfo_PS_KL30_RNG_LO: start-on-event=DemSatellite_0InternalBehavior/GetEventUdsStatus, operation=EvtInfo_PS_KL30_RNG_LO.GetEventUdsStatus
        OpEventGetEventUdsStatus_GetEventUdsStatus_Event_PS_KL30_RNG_LO: start-on-event=DemSatellite_0InternalBehavior/GetEventUdsStatus, operation=Event_PS_KL30_RNG_LO.GetEventUdsStatus
        OpEventGetEventUdsStatus_GetEventUdsStatus_EvtInfo_INV_RSLVR_COS_RNG_LO: start-on-event=DemSatellite_0InternalBehavior/GetEventUdsStatus, operation=EvtInfo_INV_RSLVR_COS_RNG_LO.GetEventUdsStatus
        OpEventGetEventUdsStatus_GetEventUdsStatus_Event_INV_RSLVR_COS_RNG_LO: start-on-event=DemSatellite_0InternalBehavior/GetEventUdsStatus, operation=Event_INV_RSLVR_COS_RNG_LO.GetEventUdsStatus
        OpEventGetEventUdsStatus_GetEventUdsStatus_EvtInfo_PSnsr_ELE_FLT: start-on-event=DemSatellite_0InternalBehavior/GetEventUdsStatus, operation=EvtInfo_PSnsr_ELE_FLT.GetEventUdsStatus
        OpEventGetEventUdsStatus_GetEventUdsStatus_Event_PSnsr_ELE_FLT: start-on-event=DemSatellite_0InternalBehavior/GetEventUdsStatus, operation=Event_PSnsr_ELE_FLT.GetEventUdsStatus
        OpEventGetEventUdsStatus_GetEventUdsStatus_EvtInfo_INV_RSLVR_SIN_COS_PLAUS_AMP: start-on-event=DemSatellite_0InternalBehavior/GetEventUdsStatus, operation=EvtInfo_INV_RSLVR_SIN_COS_PLAUS_AMP.GetEventUdsStatus
        OpEventGetEventUdsStatus_GetEventUdsStatus_Event_INV_RSLVR_SIN_COS_PLAUS_AMP: start-on-event=DemSatellite_0InternalBehavior/GetEventUdsStatus, operation=Event_INV_RSLVR_SIN_COS_PLAUS_AMP.GetEventUdsStatus
        OpEventGetEventUdsStatus_GetEventUdsStatus_EvtInfo_INV_IAC_U_ELEC_LO: start-on-event=DemSatellite_0InternalBehavior/GetEventUdsStatus, operation=EvtInfo_INV_IAC_U_ELEC_LO.GetEventUdsStatus
        OpEventGetEventUdsStatus_GetEventUdsStatus_Event_INV_IAC_U_ELEC_LO: start-on-event=DemSatellite_0InternalBehavior/GetEventUdsStatus, operation=Event_INV_IAC_U_ELEC_LO.GetEventUdsStatus
        OpEventGetEventUdsStatus_GetEventUdsStatus_EvtInfo_INV_RSLVR_EXCT_ELEC_HI: start-on-event=DemSatellite_0InternalBehavior/GetEventUdsStatus, operation=EvtInfo_INV_RSLVR_EXCT_ELEC_HI.GetEventUdsStatus
        OpEventGetEventUdsStatus_GetEventUdsStatus_Event_INV_RSLVR_EXCT_ELEC_HI: start-on-event=DemSatellite_0InternalBehavior/GetEventUdsStatus, operation=Event_INV_RSLVR_EXCT_ELEC_HI.GetEventUdsStatus
        OpEventGetEventUdsStatus_GetEventUdsStatus_EvtInfo_INV_IAC_U_RNG_LO: start-on-event=DemSatellite_0InternalBehavior/GetEventUdsStatus, operation=EvtInfo_INV_IAC_U_RNG_LO.GetEventUdsStatus
        OpEventGetEventUdsStatus_GetEventUdsStatus_Event_INV_IAC_U_RNG_LO: start-on-event=DemSatellite_0InternalBehavior/GetEventUdsStatus, operation=Event_INV_IAC_U_RNG_LO.GetEventUdsStatus
        OpEventGetEventUdsStatus_GetEventUdsStatus_EvtInfo_INV_IAC_V_RNG_HI: start-on-event=DemSatellite_0InternalBehavior/GetEventUdsStatus, operation=EvtInfo_INV_IAC_V_RNG_HI.GetEventUdsStatus
        OpEventGetEventUdsStatus_GetEventUdsStatus_Event_INV_IAC_V_RNG_HI: start-on-event=DemSatellite_0InternalBehavior/GetEventUdsStatus, operation=Event_INV_IAC_V_RNG_HI.GetEventUdsStatus
        OpEventGetEventUdsStatus_GetEventUdsStatus_EvtInfo_INV_IGBT_TEMP_U_PLAUS: start-on-event=DemSatellite_0InternalBehavior/GetEventUdsStatus, operation=EvtInfo_INV_IGBT_TEMP_U_PLAUS.GetEventUdsStatus
        OpEventGetEventUdsStatus_GetEventUdsStatus_Event_INV_IGBT_TEMP_U_PLAUS: start-on-event=DemSatellite_0InternalBehavior/GetEventUdsStatus, operation=Event_INV_IGBT_TEMP_U_PLAUS.GetEventUdsStatus
        OpEventGetEventUdsStatus_GetEventUdsStatus_EvtInfo_INV_RSLVR_OFFS_DFT: start-on-event=DemSatellite_0InternalBehavior/GetEventUdsStatus, operation=EvtInfo_INV_RSLVR_OFFS_DFT.GetEventUdsStatus
        OpEventGetEventUdsStatus_GetEventUdsStatus_Event_INV_RSLVR_OFFS_DFT: start-on-event=DemSatellite_0InternalBehavior/GetEventUdsStatus, operation=Event_INV_RSLVR_OFFS_DFT.GetEventUdsStatus
        OpEventGetEventUdsStatus_GetEventUdsStatus_EvtInfo_Ga_MoveOverThd: start-on-event=DemSatellite_0InternalBehavior/GetEventUdsStatus, operation=EvtInfo_Ga_MoveOverThd.GetEventUdsStatus
        OpEventGetEventUdsStatus_GetEventUdsStatus_Event_Ga_MoveOverThd: start-on-event=DemSatellite_0InternalBehavior/GetEventUdsStatus, operation=Event_Ga_MoveOverThd.GetEventUdsStatus
        OpEventGetEventUdsStatus_GetEventUdsStatus_EvtInfo_VcEvMonIPH: start-on-event=DemSatellite_0InternalBehavior/GetEventUdsStatus, operation=EvtInfo_VcEvMonIPH.GetEventUdsStatus
        OpEventGetEventUdsStatus_GetEventUdsStatus_Event_VcEvMonIPH: start-on-event=DemSatellite_0InternalBehavior/GetEventUdsStatus, operation=Event_VcEvMonIPH.GetEventUdsStatus
        OpEventGetEventUdsStatus_GetEventUdsStatus_EvtInfo_INV_RSLVR_HW_FLT: start-on-event=DemSatellite_0InternalBehavior/GetEventUdsStatus, operation=EvtInfo_INV_RSLVR_HW_FLT.GetEventUdsStatus
        OpEventGetEventUdsStatus_GetEventUdsStatus_Event_INV_RSLVR_HW_FLT: start-on-event=DemSatellite_0InternalBehavior/GetEventUdsStatus, operation=Event_INV_RSLVR_HW_FLT.GetEventUdsStatus
        OpEventGetEventUdsStatus_GetEventUdsStatus_EvtInfo_INV_RSLVR_SIN_ELEC_LO: start-on-event=DemSatellite_0InternalBehavior/GetEventUdsStatus, operation=EvtInfo_INV_RSLVR_SIN_ELEC_LO.GetEventUdsStatus
        OpEventGetEventUdsStatus_GetEventUdsStatus_Event_INV_RSLVR_SIN_ELEC_LO: start-on-event=DemSatellite_0InternalBehavior/GetEventUdsStatus, operation=Event_INV_RSLVR_SIN_ELEC_LO.GetEventUdsStatus
        OpEventGetEventUdsStatus_GetEventUdsStatus_EvtInfo_INV_IAC_W_AMP: start-on-event=DemSatellite_0InternalBehavior/GetEventUdsStatus, operation=EvtInfo_INV_IAC_W_AMP.GetEventUdsStatus
        OpEventGetEventUdsStatus_GetEventUdsStatus_Event_INV_IAC_W_AMP: start-on-event=DemSatellite_0InternalBehavior/GetEventUdsStatus, operation=Event_INV_IAC_W_AMP.GetEventUdsStatus
        OpEventGetEventUdsStatus_GetEventUdsStatus_EvtInfo_VCC_OverVoltage: start-on-event=DemSatellite_0InternalBehavior/GetEventUdsStatus, operation=EvtInfo_VCC_OverVoltage.GetEventUdsStatus
        OpEventGetEventUdsStatus_GetEventUdsStatus_Event_VCC_OverVoltage: start-on-event=DemSatellite_0InternalBehavior/GetEventUdsStatus, operation=Event_VCC_OverVoltage.GetEventUdsStatus
        OpEventGetEventUdsStatus_GetEventUdsStatus_EvtInfo_PS_BLDC_OV_FLT: start-on-event=DemSatellite_0InternalBehavior/GetEventUdsStatus, operation=EvtInfo_PS_BLDC_OV_FLT.GetEventUdsStatus
        OpEventGetEventUdsStatus_GetEventUdsStatus_Event_PS_BLDC_OV_FLT: start-on-event=DemSatellite_0InternalBehavior/GetEventUdsStatus, operation=Event_PS_BLDC_OV_FLT.GetEventUdsStatus
        OpEventGetEventUdsStatus_GetEventUdsStatus_EvtInfo_AURIX_EEPROM_FLT: start-on-event=DemSatellite_0InternalBehavior/GetEventUdsStatus, operation=EvtInfo_AURIX_EEPROM_FLT.GetEventUdsStatus
        OpEventGetEventUdsStatus_GetEventUdsStatus_Event_AURIX_EEPROM_FLT: start-on-event=DemSatellite_0InternalBehavior/GetEventUdsStatus, operation=Event_AURIX_EEPROM_FLT.GetEventUdsStatus
        OpEventGetEventUdsStatus_GetEventUdsStatus_EvtInfo_FS_MONITIOR_ASC_FW_FLT: start-on-event=DemSatellite_0InternalBehavior/GetEventUdsStatus, operation=EvtInfo_FS_MONITIOR_ASC_FW_FLT.GetEventUdsStatus
        OpEventGetEventUdsStatus_GetEventUdsStatus_Event_FS_MONITIOR_ASC_FW_FLT: start-on-event=DemSatellite_0InternalBehavior/GetEventUdsStatus, operation=Event_FS_MONITIOR_ASC_FW_FLT.GetEventUdsStatus
        OpEventGetEventUdsStatus_GetEventUdsStatus_EvtInfo_VCEvSrsPropFr02Tioutd: start-on-event=DemSatellite_0InternalBehavior/GetEventUdsStatus, operation=EvtInfo_VCEvSrsPropFr02Tioutd.GetEventUdsStatus
        OpEventGetEventUdsStatus_GetEventUdsStatus_Event_VCEvSrsPropFr02Tioutd: start-on-event=DemSatellite_0InternalBehavior/GetEventUdsStatus, operation=Event_VCEvSrsPropFr02Tioutd.GetEventUdsStatus
        OpEventGetEventUdsStatus_GetEventUdsStatus_EvtInfo_VcEvMonErrMode: start-on-event=DemSatellite_0InternalBehavior/GetEventUdsStatus, operation=EvtInfo_VcEvMonErrMode.GetEventUdsStatus
        OpEventGetEventUdsStatus_GetEventUdsStatus_Event_VcEvMonErrMode: start-on-event=DemSatellite_0InternalBehavior/GetEventUdsStatus, operation=Event_VcEvMonErrMode.GetEventUdsStatus
        OpEventGetEventUdsStatus_GetEventUdsStatus_EvtInfo_AURIX_RST_MPL: start-on-event=DemSatellite_0InternalBehavior/GetEventUdsStatus, operation=EvtInfo_AURIX_RST_MPL.GetEventUdsStatus
        OpEventGetEventUdsStatus_GetEventUdsStatus_Event_AURIX_RST_MPL: start-on-event=DemSatellite_0InternalBehavior/GetEventUdsStatus, operation=Event_AURIX_RST_MPL.GetEventUdsStatus
        OpEventGetEventUdsStatus_GetEventUdsStatus_EvtInfo_VcEvNodeMisECM: start-on-event=DemSatellite_0InternalBehavior/GetEventUdsStatus, operation=EvtInfo_VcEvNodeMisECM.GetEventUdsStatus
        OpEventGetEventUdsStatus_GetEventUdsStatus_Event_VcEvNodeMisECM: start-on-event=DemSatellite_0InternalBehavior/GetEventUdsStatus, operation=Event_VcEvNodeMisECM.GetEventUdsStatus
        OpEventGetEventUdsStatus_GetEventUdsStatus_EvtInfo_PS_KL30_PLAUS: start-on-event=DemSatellite_0InternalBehavior/GetEventUdsStatus, operation=EvtInfo_PS_KL30_PLAUS.GetEventUdsStatus
        OpEventGetEventUdsStatus_GetEventUdsStatus_Event_PS_KL30_PLAUS: start-on-event=DemSatellite_0InternalBehavior/GetEventUdsStatus, operation=Event_PS_KL30_PLAUS.GetEventUdsStatus
        OpEventGetEventUdsStatus_GetEventUdsStatus_EvtInfo_INV_IAC_W_ELEC_HI: start-on-event=DemSatellite_0InternalBehavior/GetEventUdsStatus, operation=EvtInfo_INV_IAC_W_ELEC_HI.GetEventUdsStatus
        OpEventGetEventUdsStatus_GetEventUdsStatus_Event_INV_IAC_W_ELEC_HI: start-on-event=DemSatellite_0InternalBehavior/GetEventUdsStatus, operation=Event_INV_IAC_W_ELEC_HI.GetEventUdsStatus
        OpEventGetEventUdsStatus_GetEventUdsStatus_EvtInfo_VCEvVddmPropFr19Tioutd: start-on-event=DemSatellite_0InternalBehavior/GetEventUdsStatus, operation=EvtInfo_VCEvVddmPropFr19Tioutd.GetEventUdsStatus
        OpEventGetEventUdsStatus_GetEventUdsStatus_Event_VCEvVddmPropFr19Tioutd: start-on-event=DemSatellite_0InternalBehavior/GetEventUdsStatus, operation=Event_VCEvVddmPropFr19Tioutd.GetEventUdsStatus
        OpEventGetEventUdsStatus_GetEventUdsStatus_EvtInfo_INV_TEMP_DCHA_HW: start-on-event=DemSatellite_0InternalBehavior/GetEventUdsStatus, operation=EvtInfo_INV_TEMP_DCHA_HW.GetEventUdsStatus
        OpEventGetEventUdsStatus_GetEventUdsStatus_Event_INV_TEMP_DCHA_HW: start-on-event=DemSatellite_0InternalBehavior/GetEventUdsStatus, operation=Event_INV_TEMP_DCHA_HW.GetEventUdsStatus
        OpEventGetEventUdsStatus_GetEventUdsStatus_EvtInfo_VcEvPropCANGlbTiOutd: start-on-event=DemSatellite_0InternalBehavior/GetEventUdsStatus, operation=EvtInfo_VcEvPropCANGlbTiOutd.GetEventUdsStatus
        OpEventGetEventUdsStatus_GetEventUdsStatus_Event_VcEvPropCANGlbTiOutd: start-on-event=DemSatellite_0InternalBehavior/GetEventUdsStatus, operation=Event_VcEvPropCANGlbTiOutd.GetEventUdsStatus
        OpEventGetEventUdsStatus_GetEventUdsStatus_EvtInfo_INV_EM_STATOR_TEMP2_RNG_NOK: start-on-event=DemSatellite_0InternalBehavior/GetEventUdsStatus, operation=EvtInfo_INV_EM_STATOR_TEMP2_RNG_NOK.GetEventUdsStatus
        OpEventGetEventUdsStatus_GetEventUdsStatus_Event_INV_EM_STATOR_TEMP2_RNG_NOK: start-on-event=DemSatellite_0InternalBehavior/GetEventUdsStatus, operation=Event_INV_EM_STATOR_TEMP2_RNG_NOK.GetEventUdsStatus
        OpEventGetEventUdsStatus_GetEventUdsStatus_EvtInfo_INV_UHVDC_OV_HWP: start-on-event=DemSatellite_0InternalBehavior/GetEventUdsStatus, operation=EvtInfo_INV_UHVDC_OV_HWP.GetEventUdsStatus
        OpEventGetEventUdsStatus_GetEventUdsStatus_Event_INV_UHVDC_OV_HWP: start-on-event=DemSatellite_0InternalBehavior/GetEventUdsStatus, operation=Event_INV_UHVDC_OV_HWP.GetEventUdsStatus
        OpEventGetEventUdsStatus_GetEventUdsStatus_EvtInfo_Ga_FindEngleAngleFailed: start-on-event=DemSatellite_0InternalBehavior/GetEventUdsStatus, operation=EvtInfo_Ga_FindEngleAngleFailed.GetEventUdsStatus
        OpEventGetEventUdsStatus_GetEventUdsStatus_Event_Ga_FindEngleAngleFailed: start-on-event=DemSatellite_0InternalBehavior/GetEventUdsStatus, operation=Event_Ga_FindEngleAngleFailed.GetEventUdsStatus
        OpEventGetEventUdsStatus_GetEventUdsStatus_EvtInfo_VcEvMonTrqCmp: start-on-event=DemSatellite_0InternalBehavior/GetEventUdsStatus, operation=EvtInfo_VcEvMonTrqCmp.GetEventUdsStatus
        OpEventGetEventUdsStatus_GetEventUdsStatus_Event_VcEvMonTrqCmp: start-on-event=DemSatellite_0InternalBehavior/GetEventUdsStatus, operation=Event_VcEvMonTrqCmp.GetEventUdsStatus
        OpEventGetEventUdsStatus_GetEventUdsStatus_EvtInfo_INV_IGBT_TEMP_V_RNG_LO: start-on-event=DemSatellite_0InternalBehavior/GetEventUdsStatus, operation=EvtInfo_INV_IGBT_TEMP_V_RNG_LO.GetEventUdsStatus
        OpEventGetEventUdsStatus_GetEventUdsStatus_Event_INV_IGBT_TEMP_V_RNG_LO: start-on-event=DemSatellite_0InternalBehavior/GetEventUdsStatus, operation=Event_INV_IGBT_TEMP_V_RNG_LO.GetEventUdsStatus
        OpEventGetEventUdsStatus_GetEventUdsStatus_EvtInfo_INV_CONTROL_LIMIT: start-on-event=DemSatellite_0InternalBehavior/GetEventUdsStatus, operation=EvtInfo_INV_CONTROL_LIMIT.GetEventUdsStatus
        OpEventGetEventUdsStatus_GetEventUdsStatus_Event_INV_CONTROL_LIMIT: start-on-event=DemSatellite_0InternalBehavior/GetEventUdsStatus, operation=Event_INV_CONTROL_LIMIT.GetEventUdsStatus
        OpEventGetEventUdsStatus_GetEventUdsStatus_EvtInfo_COM_CarConfigErr: start-on-event=DemSatellite_0InternalBehavior/GetEventUdsStatus, operation=EvtInfo_COM_CarConfigErr.GetEventUdsStatus
        OpEventGetEventUdsStatus_GetEventUdsStatus_Event_COM_CarConfigErr: start-on-event=DemSatellite_0InternalBehavior/GetEventUdsStatus, operation=Event_COM_CarConfigErr.GetEventUdsStatus
        OpEventGetEventUdsStatus_GetEventUdsStatus_EvtInfo_VCEvEcmPropFr08Tioutd: start-on-event=DemSatellite_0InternalBehavior/GetEventUdsStatus, operation=EvtInfo_VCEvEcmPropFr08Tioutd.GetEventUdsStatus
        OpEventGetEventUdsStatus_GetEventUdsStatus_Event_VCEvEcmPropFr08Tioutd: start-on-event=DemSatellite_0InternalBehavior/GetEventUdsStatus, operation=Event_VCEvEcmPropFr08Tioutd.GetEventUdsStatus
        OpEventGetEventUdsStatus_GetEventUdsStatus_EvtInfo_CU_TEMP1_RNG_LO: start-on-event=DemSatellite_0InternalBehavior/GetEventUdsStatus, operation=EvtInfo_CU_TEMP1_RNG_LO.GetEventUdsStatus
        OpEventGetEventUdsStatus_GetEventUdsStatus_Event_CU_TEMP1_RNG_LO: start-on-event=DemSatellite_0InternalBehavior/GetEventUdsStatus, operation=Event_CU_TEMP1_RNG_LO.GetEventUdsStatus
        OpEventGetEventUdsStatus_GetEventUdsStatus_EvtInfo_INV_EM_STATOR_TEMP2_RNG_SWT: start-on-event=DemSatellite_0InternalBehavior/GetEventUdsStatus, operation=EvtInfo_INV_EM_STATOR_TEMP2_RNG_SWT.GetEventUdsStatus
        OpEventGetEventUdsStatus_GetEventUdsStatus_Event_INV_EM_STATOR_TEMP2_RNG_SWT: start-on-event=DemSatellite_0InternalBehavior/GetEventUdsStatus, operation=Event_INV_EM_STATOR_TEMP2_RNG_SWT.GetEventUdsStatus
        OpEventGetEventUdsStatus_GetEventUdsStatus_EvtInfo_GA_BLDC_POS_FLT: start-on-event=DemSatellite_0InternalBehavior/GetEventUdsStatus, operation=EvtInfo_GA_BLDC_POS_FLT.GetEventUdsStatus
        OpEventGetEventUdsStatus_GetEventUdsStatus_Event_GA_BLDC_POS_FLT: start-on-event=DemSatellite_0InternalBehavior/GetEventUdsStatus, operation=Event_GA_BLDC_POS_FLT.GetEventUdsStatus
        OpEventGetEventUdsStatus_GetEventUdsStatus_EvtInfo_PS_WhlSnsr_FLT: start-on-event=DemSatellite_0InternalBehavior/GetEventUdsStatus, operation=EvtInfo_PS_WhlSnsr_FLT.GetEventUdsStatus
        OpEventGetEventUdsStatus_GetEventUdsStatus_Event_PS_WhlSnsr_FLT: start-on-event=DemSatellite_0InternalBehavior/GetEventUdsStatus, operation=Event_PS_WhlSnsr_FLT.GetEventUdsStatus
        OpEventGetEventUdsStatus_GetEventUdsStatus_EvtInfo_INV_EM_STATOR_TEMP_RNG_LO: start-on-event=DemSatellite_0InternalBehavior/GetEventUdsStatus, operation=EvtInfo_INV_EM_STATOR_TEMP_RNG_LO.GetEventUdsStatus
        OpEventGetEventUdsStatus_GetEventUdsStatus_Event_INV_EM_STATOR_TEMP_RNG_LO: start-on-event=DemSatellite_0InternalBehavior/GetEventUdsStatus, operation=Event_INV_EM_STATOR_TEMP_RNG_LO.GetEventUdsStatus
        OpEventGetEventUdsStatus_GetEventUdsStatus_EvtInfo_INV_RSLVR_SIN_ELEC_HI: start-on-event=DemSatellite_0InternalBehavior/GetEventUdsStatus, operation=EvtInfo_INV_RSLVR_SIN_ELEC_HI.GetEventUdsStatus
        OpEventGetEventUdsStatus_GetEventUdsStatus_Event_INV_RSLVR_SIN_ELEC_HI: start-on-event=DemSatellite_0InternalBehavior/GetEventUdsStatus, operation=Event_INV_RSLVR_SIN_ELEC_HI.GetEventUdsStatus
        OpEventGetEventUdsStatus_GetEventUdsStatus_EvtInfo_INV_RSLVR_SIN_COS_PLAUS: start-on-event=DemSatellite_0InternalBehavior/GetEventUdsStatus, operation=EvtInfo_INV_RSLVR_SIN_COS_PLAUS.GetEventUdsStatus
        OpEventGetEventUdsStatus_GetEventUdsStatus_Event_INV_RSLVR_SIN_COS_PLAUS: start-on-event=DemSatellite_0InternalBehavior/GetEventUdsStatus, operation=Event_INV_RSLVR_SIN_COS_PLAUS.GetEventUdsStatus
        OpEventGetEventUdsStatus_GetEventUdsStatus_EvtInfo_INV_RSLVR_COS_AMP: start-on-event=DemSatellite_0InternalBehavior/GetEventUdsStatus, operation=EvtInfo_INV_RSLVR_COS_AMP.GetEventUdsStatus
        OpEventGetEventUdsStatus_GetEventUdsStatus_Event_INV_RSLVR_COS_AMP: start-on-event=DemSatellite_0InternalBehavior/GetEventUdsStatus, operation=Event_INV_RSLVR_COS_AMP.GetEventUdsStatus
        OpEventGetEventUdsStatus_GetEventUdsStatus_EvtInfo_INV_GATE_DRVR_BOT_HWP: start-on-event=DemSatellite_0InternalBehavior/GetEventUdsStatus, operation=EvtInfo_INV_GATE_DRVR_BOT_HWP.GetEventUdsStatus
        OpEventGetEventUdsStatus_GetEventUdsStatus_Event_INV_GATE_DRVR_BOT_HWP: start-on-event=DemSatellite_0InternalBehavior/GetEventUdsStatus, operation=Event_INV_GATE_DRVR_BOT_HWP.GetEventUdsStatus
        OpEventGetEventUdsStatus_GetEventUdsStatus_EvtInfo_Eg_HallVolWrong: start-on-event=DemSatellite_0InternalBehavior/GetEventUdsStatus, operation=EvtInfo_Eg_HallVolWrong.GetEventUdsStatus
        OpEventGetEventUdsStatus_GetEventUdsStatus_Event_Eg_HallVolWrong: start-on-event=DemSatellite_0InternalBehavior/GetEventUdsStatus, operation=Event_Eg_HallVolWrong.GetEventUdsStatus
        OpEventGetEventUdsStatus_GetEventUdsStatus_EvtInfo_INV_RSLVR_EXCT_RNG_NOK: start-on-event=DemSatellite_0InternalBehavior/GetEventUdsStatus, operation=EvtInfo_INV_RSLVR_EXCT_RNG_NOK.GetEventUdsStatus
        OpEventGetEventUdsStatus_GetEventUdsStatus_Event_INV_RSLVR_EXCT_RNG_NOK: start-on-event=DemSatellite_0InternalBehavior/GetEventUdsStatus, operation=Event_INV_RSLVR_EXCT_RNG_NOK.GetEventUdsStatus
        OpEventGetEventUdsStatus_GetEventUdsStatus_EvtInfo_PA_OpenCirc: start-on-event=DemSatellite_0InternalBehavior/GetEventUdsStatus, operation=EvtInfo_PA_OpenCirc.GetEventUdsStatus
        OpEventGetEventUdsStatus_GetEventUdsStatus_Event_PA_OpenCirc: start-on-event=DemSatellite_0InternalBehavior/GetEventUdsStatus, operation=Event_PA_OpenCirc.GetEventUdsStatus
        OpEventGetEventUdsStatus_GetEventUdsStatus_EvtInfo_INV_RSLVR_COS_ELEC_HI: start-on-event=DemSatellite_0InternalBehavior/GetEventUdsStatus, operation=EvtInfo_INV_RSLVR_COS_ELEC_HI.GetEventUdsStatus
        OpEventGetEventUdsStatus_GetEventUdsStatus_Event_INV_RSLVR_COS_ELEC_HI: start-on-event=DemSatellite_0InternalBehavior/GetEventUdsStatus, operation=Event_INV_RSLVR_COS_ELEC_HI.GetEventUdsStatus
        OpEventGetEventUdsStatus_GetEventUdsStatus_EvtInfo_VcEvCntrHvSysRlySts: start-on-event=DemSatellite_0InternalBehavior/GetEventUdsStatus, operation=EvtInfo_VcEvCntrHvSysRlySts.GetEventUdsStatus
        OpEventGetEventUdsStatus_GetEventUdsStatus_Event_VcEvCntrHvSysRlySts: start-on-event=DemSatellite_0InternalBehavior/GetEventUdsStatus, operation=Event_VcEvCntrHvSysRlySts.GetEventUdsStatus
        OpEventGetEventUdsStatus_GetEventUdsStatus_EvtInfo_CRASH_DTC: start-on-event=DemSatellite_0InternalBehavior/GetEventUdsStatus, operation=EvtInfo_CRASH_DTC.GetEventUdsStatus
        OpEventGetEventUdsStatus_GetEventUdsStatus_Event_CRASH_DTC: start-on-event=DemSatellite_0InternalBehavior/GetEventUdsStatus, operation=Event_CRASH_DTC.GetEventUdsStatus
        OpEventGetEventUdsStatus_GetEventUdsStatus_EvtInfo_INV_IGBT_TEMP_W_RNG_HI: start-on-event=DemSatellite_0InternalBehavior/GetEventUdsStatus, operation=EvtInfo_INV_IGBT_TEMP_W_RNG_HI.GetEventUdsStatus
        OpEventGetEventUdsStatus_GetEventUdsStatus_Event_INV_IGBT_TEMP_W_RNG_HI: start-on-event=DemSatellite_0InternalBehavior/GetEventUdsStatus, operation=Event_INV_IGBT_TEMP_W_RNG_HI.GetEventUdsStatus
        OpEventGetEventUdsStatus_GetEventUdsStatus_EvtInfo_VCEvBecmPropFr02Tioutd: start-on-event=DemSatellite_0InternalBehavior/GetEventUdsStatus, operation=EvtInfo_VCEvBecmPropFr02Tioutd.GetEventUdsStatus
        OpEventGetEventUdsStatus_GetEventUdsStatus_Event_VCEvBecmPropFr02Tioutd: start-on-event=DemSatellite_0InternalBehavior/GetEventUdsStatus, operation=Event_VCEvBecmPropFr02Tioutd.GetEventUdsStatus
        OpEventGetEventUdsStatus_GetEventUdsStatus_EvtInfo_INV_IGBT_TEMP_W_GRDT: start-on-event=DemSatellite_0InternalBehavior/GetEventUdsStatus, operation=EvtInfo_INV_IGBT_TEMP_W_GRDT.GetEventUdsStatus
        OpEventGetEventUdsStatus_GetEventUdsStatus_Event_INV_IGBT_TEMP_W_GRDT: start-on-event=DemSatellite_0InternalBehavior/GetEventUdsStatus, operation=Event_INV_IGBT_TEMP_W_GRDT.GetEventUdsStatus
        OpEventGetEventUdsStatus_GetEventUdsStatus_EvtInfo_EXT_UC_SPI_FLT: start-on-event=DemSatellite_0InternalBehavior/GetEventUdsStatus, operation=EvtInfo_EXT_UC_SPI_FLT.GetEventUdsStatus
        OpEventGetEventUdsStatus_GetEventUdsStatus_Event_EXT_UC_SPI_FLT: start-on-event=DemSatellite_0InternalBehavior/GetEventUdsStatus, operation=Event_EXT_UC_SPI_FLT.GetEventUdsStatus
        OpEventGetEventUdsStatus_GetEventUdsStatus_EvtInfo_INV_IAC_V_ELEC_HWP_001: start-on-event=DemSatellite_0InternalBehavior/GetEventUdsStatus, operation=EvtInfo_INV_IAC_V_ELEC_HWP_001.GetEventUdsStatus
        OpEventGetEventUdsStatus_GetEventUdsStatus_Event_INV_IAC_V_ELEC_HWP_001: start-on-event=DemSatellite_0InternalBehavior/GetEventUdsStatus, operation=Event_INV_IAC_V_ELEC_HWP_001.GetEventUdsStatus
        OpEventGetEventUdsStatus_GetEventUdsStatus_EvtInfo_VcEvChkSumWhlMotSysTqAllwd: start-on-event=DemSatellite_0InternalBehavior/GetEventUdsStatus, operation=EvtInfo_VcEvChkSumWhlMotSysTqAllwd.GetEventUdsStatus
        OpEventGetEventUdsStatus_GetEventUdsStatus_Event_VcEvChkSumWhlMotSysTqAllwd: start-on-event=DemSatellite_0InternalBehavior/GetEventUdsStatus, operation=Event_VcEvChkSumWhlMotSysTqAllwd.GetEventUdsStatus
        OpEventGetEventUdsStatus_GetEventUdsStatus_EvtInfo_FS_MONITIOR_ASC_FLT: start-on-event=DemSatellite_0InternalBehavior/GetEventUdsStatus, operation=EvtInfo_FS_MONITIOR_ASC_FLT.GetEventUdsStatus
        OpEventGetEventUdsStatus_GetEventUdsStatus_Event_FS_MONITIOR_ASC_FLT: start-on-event=DemSatellite_0InternalBehavior/GetEventUdsStatus, operation=Event_FS_MONITIOR_ASC_FLT.GetEventUdsStatus
        OpEventGetEventUdsStatus_GetEventUdsStatus_EvtInfo_INV_IAC_V_AMP: start-on-event=DemSatellite_0InternalBehavior/GetEventUdsStatus, operation=EvtInfo_INV_IAC_V_AMP.GetEventUdsStatus
        OpEventGetEventUdsStatus_GetEventUdsStatus_Event_INV_IAC_V_AMP: start-on-event=DemSatellite_0InternalBehavior/GetEventUdsStatus, operation=Event_INV_IAC_V_AMP.GetEventUdsStatus
        OpEventGetEventUdsStatus_GetEventUdsStatus_EvtInfo_INV_IAC_W_ELEC_LO: start-on-event=DemSatellite_0InternalBehavior/GetEventUdsStatus, operation=EvtInfo_INV_IAC_W_ELEC_LO.GetEventUdsStatus
        OpEventGetEventUdsStatus_GetEventUdsStatus_Event_INV_IAC_W_ELEC_LO: start-on-event=DemSatellite_0InternalBehavior/GetEventUdsStatus, operation=Event_INV_IAC_W_ELEC_LO.GetEventUdsStatus
        OpEventGetEventUdsStatus_GetEventUdsStatus_EvtInfo_VCEvVddmPropFr08Tioutd_001: start-on-event=DemSatellite_0InternalBehavior/GetEventUdsStatus, operation=EvtInfo_VCEvVddmPropFr08Tioutd_001.GetEventUdsStatus
        OpEventGetEventUdsStatus_GetEventUdsStatus_Event_VCEvVddmPropFr08Tioutd_001: start-on-event=DemSatellite_0InternalBehavior/GetEventUdsStatus, operation=Event_VCEvVddmPropFr08Tioutd_001.GetEventUdsStatus
        OpEventGetEventUdsStatus_GetEventUdsStatus_EvtInfo_PS_P12_RES_FLT: start-on-event=DemSatellite_0InternalBehavior/GetEventUdsStatus, operation=EvtInfo_PS_P12_RES_FLT.GetEventUdsStatus
        OpEventGetEventUdsStatus_GetEventUdsStatus_Event_PS_P12_RES_FLT: start-on-event=DemSatellite_0InternalBehavior/GetEventUdsStatus, operation=Event_PS_P12_RES_FLT.GetEventUdsStatus
        OpEventGetEventUdsStatus_GetEventUdsStatus_EvtInfo_INV_RSLVR_SIN_RNG_LO: start-on-event=DemSatellite_0InternalBehavior/GetEventUdsStatus, operation=EvtInfo_INV_RSLVR_SIN_RNG_LO.GetEventUdsStatus
        OpEventGetEventUdsStatus_GetEventUdsStatus_Event_INV_RSLVR_SIN_RNG_LO: start-on-event=DemSatellite_0InternalBehavior/GetEventUdsStatus, operation=Event_INV_RSLVR_SIN_RNG_LO.GetEventUdsStatus
        OpEventGetEventUdsStatus_GetEventUdsStatus_EvtInfo_CU_TEMP_HW_FLT: start-on-event=DemSatellite_0InternalBehavior/GetEventUdsStatus, operation=EvtInfo_CU_TEMP_HW_FLT.GetEventUdsStatus
        OpEventGetEventUdsStatus_GetEventUdsStatus_Event_CU_TEMP_HW_FLT: start-on-event=DemSatellite_0InternalBehavior/GetEventUdsStatus, operation=Event_CU_TEMP_HW_FLT.GetEventUdsStatus
        OpEventGetEventUdsStatus_GetEventUdsStatus_EvtInfo_VCEvEcmPropFr02MgmFr00Tioutd: start-on-event=DemSatellite_0InternalBehavior/GetEventUdsStatus, operation=EvtInfo_VCEvEcmPropFr02MgmFr00Tioutd.GetEventUdsStatus
        OpEventGetEventUdsStatus_GetEventUdsStatus_Event_VCEvEcmPropFr02MgmFr00Tioutd: start-on-event=DemSatellite_0InternalBehavior/GetEventUdsStatus, operation=Event_VCEvEcmPropFr02MgmFr00Tioutd.GetEventUdsStatus
        OpEventGetEventUdsStatus_GetEventUdsStatus_EvtInfo_PS_KL15_RNG_HI: start-on-event=DemSatellite_0InternalBehavior/GetEventUdsStatus, operation=EvtInfo_PS_KL15_RNG_HI.GetEventUdsStatus
        OpEventGetEventUdsStatus_GetEventUdsStatus_Event_PS_KL15_RNG_HI: start-on-event=DemSatellite_0InternalBehavior/GetEventUdsStatus, operation=Event_PS_KL15_RNG_HI.GetEventUdsStatus
        OpEventGetEventUdsStatus_GetEventUdsStatus_EvtInfo_VCEvVddmPropFr17Tioutd: start-on-event=DemSatellite_0InternalBehavior/GetEventUdsStatus, operation=EvtInfo_VCEvVddmPropFr17Tioutd.GetEventUdsStatus
        OpEventGetEventUdsStatus_GetEventUdsStatus_Event_VCEvVddmPropFr17Tioutd: start-on-event=DemSatellite_0InternalBehavior/GetEventUdsStatus, operation=Event_VCEvVddmPropFr17Tioutd.GetEventUdsStatus
        OpEventGetEventUdsStatus_GetEventUdsStatus_EvtInfo_VcEvChkSumCrashStsSafe: start-on-event=DemSatellite_0InternalBehavior/GetEventUdsStatus, operation=EvtInfo_VcEvChkSumCrashStsSafe.GetEventUdsStatus
        OpEventGetEventUdsStatus_GetEventUdsStatus_Event_VcEvChkSumCrashStsSafe: start-on-event=DemSatellite_0InternalBehavior/GetEventUdsStatus, operation=Event_VcEvChkSumCrashStsSafe.GetEventUdsStatus
        OpEventGetEventUdsStatus_GetEventUdsStatus_EvtInfo_DiagC_ClutchService: start-on-event=DemSatellite_0InternalBehavior/GetEventUdsStatus, operation=EvtInfo_DiagC_ClutchService.GetEventUdsStatus
        OpEventGetEventUdsStatus_GetEventUdsStatus_Event_DiagC_ClutchService: start-on-event=DemSatellite_0InternalBehavior/GetEventUdsStatus, operation=Event_DiagC_ClutchService.GetEventUdsStatus
        OpEventGetEventUdsStatus_GetEventUdsStatus_EvtInfo_INV_EM_STATOR_TEMP_RNG_HI: start-on-event=DemSatellite_0InternalBehavior/GetEventUdsStatus, operation=EvtInfo_INV_EM_STATOR_TEMP_RNG_HI.GetEventUdsStatus
        OpEventGetEventUdsStatus_GetEventUdsStatus_Event_INV_EM_STATOR_TEMP_RNG_HI: start-on-event=DemSatellite_0InternalBehavior/GetEventUdsStatus, operation=Event_INV_EM_STATOR_TEMP_RNG_HI.GetEventUdsStatus
        OpEventGetEventUdsStatus_GetEventUdsStatus_EvtInfo_INV_RSLVR_OFFS_OUT_RANG: start-on-event=DemSatellite_0InternalBehavior/GetEventUdsStatus, operation=EvtInfo_INV_RSLVR_OFFS_OUT_RANG.GetEventUdsStatus
        OpEventGetEventUdsStatus_GetEventUdsStatus_Event_INV_RSLVR_OFFS_OUT_RANG: start-on-event=DemSatellite_0InternalBehavior/GetEventUdsStatus, operation=Event_INV_RSLVR_OFFS_OUT_RANG.GetEventUdsStatus
        OpEventGetEventUdsStatus_GetEventUdsStatus_EvtInfo_INV_EM_STATOR_TEMP2_RNG_LO: start-on-event=DemSatellite_0InternalBehavior/GetEventUdsStatus, operation=EvtInfo_INV_EM_STATOR_TEMP2_RNG_LO.GetEventUdsStatus
        OpEventGetEventUdsStatus_GetEventUdsStatus_Event_INV_EM_STATOR_TEMP2_RNG_LO: start-on-event=DemSatellite_0InternalBehavior/GetEventUdsStatus, operation=Event_INV_EM_STATOR_TEMP2_RNG_LO.GetEventUdsStatus
        OpEventGetEventUdsStatus_GetEventUdsStatus_EvtInfo_VcEvMonISAR: start-on-event=DemSatellite_0InternalBehavior/GetEventUdsStatus, operation=EvtInfo_VcEvMonISAR.GetEventUdsStatus
        OpEventGetEventUdsStatus_GetEventUdsStatus_Event_VcEvMonISAR: start-on-event=DemSatellite_0InternalBehavior/GetEventUdsStatus, operation=Event_VcEvMonISAR.GetEventUdsStatus
        OpEventGetEventUdsStatus_GetEventUdsStatus_EvtInfo_GA_BLDC_FLT: start-on-event=DemSatellite_0InternalBehavior/GetEventUdsStatus, operation=EvtInfo_GA_BLDC_FLT.GetEventUdsStatus
        OpEventGetEventUdsStatus_GetEventUdsStatus_Event_GA_BLDC_FLT: start-on-event=DemSatellite_0InternalBehavior/GetEventUdsStatus, operation=Event_GA_BLDC_FLT.GetEventUdsStatus
        OpEventGetEventUdsStatus_GetEventUdsStatus_EvtInfo_INV_RSLVR_EXCT_ELEC_OPEN: start-on-event=DemSatellite_0InternalBehavior/GetEventUdsStatus, operation=EvtInfo_INV_RSLVR_EXCT_ELEC_OPEN.GetEventUdsStatus
        OpEventGetEventUdsStatus_GetEventUdsStatus_Event_INV_RSLVR_EXCT_ELEC_OPEN: start-on-event=DemSatellite_0InternalBehavior/GetEventUdsStatus, operation=Event_INV_RSLVR_EXCT_ELEC_OPEN.GetEventUdsStatus
        OpEventGetEventUdsStatus_GetEventUdsStatus_EvtInfo_INV_RSLVR_EXCT_PLAUS: start-on-event=DemSatellite_0InternalBehavior/GetEventUdsStatus, operation=EvtInfo_INV_RSLVR_EXCT_PLAUS.GetEventUdsStatus
        OpEventGetEventUdsStatus_GetEventUdsStatus_Event_INV_RSLVR_EXCT_PLAUS: start-on-event=DemSatellite_0InternalBehavior/GetEventUdsStatus, operation=Event_INV_RSLVR_EXCT_PLAUS.GetEventUdsStatus
        OpEventGetEventUdsStatus_GetEventUdsStatus_EvtInfo_PS_P15_U_FLT: start-on-event=DemSatellite_0InternalBehavior/GetEventUdsStatus, operation=EvtInfo_PS_P15_U_FLT.GetEventUdsStatus
        OpEventGetEventUdsStatus_GetEventUdsStatus_Event_PS_P15_U_FLT: start-on-event=DemSatellite_0InternalBehavior/GetEventUdsStatus, operation=Event_PS_P15_U_FLT.GetEventUdsStatus
        OpEventGetEventUdsStatus_GetEventUdsStatus_EvtInfo_INV_EM_STATOR_TEMP_RNG_SWT: start-on-event=DemSatellite_0InternalBehavior/GetEventUdsStatus, operation=EvtInfo_INV_EM_STATOR_TEMP_RNG_SWT.GetEventUdsStatus
        OpEventGetEventUdsStatus_GetEventUdsStatus_Event_INV_EM_STATOR_TEMP_RNG_SWT: start-on-event=DemSatellite_0InternalBehavior/GetEventUdsStatus, operation=Event_INV_EM_STATOR_TEMP_RNG_SWT.GetEventUdsStatus
        OpEventGetEventUdsStatus_GetEventUdsStatus_EvtInfo_INV_UHVDC_OV_SWP: start-on-event=DemSatellite_0InternalBehavior/GetEventUdsStatus, operation=EvtInfo_INV_UHVDC_OV_SWP.GetEventUdsStatus
        OpEventGetEventUdsStatus_GetEventUdsStatus_Event_INV_UHVDC_OV_SWP: start-on-event=DemSatellite_0InternalBehavior/GetEventUdsStatus, operation=Event_INV_UHVDC_OV_SWP.GetEventUdsStatus
        OpEventGetEventUdsStatus_GetEventUdsStatus_EvtInfo_AURIX_HW_FLT: start-on-event=DemSatellite_0InternalBehavior/GetEventUdsStatus, operation=EvtInfo_AURIX_HW_FLT.GetEventUdsStatus
        OpEventGetEventUdsStatus_GetEventUdsStatus_Event_AURIX_HW_FLT: start-on-event=DemSatellite_0InternalBehavior/GetEventUdsStatus, operation=Event_AURIX_HW_FLT.GetEventUdsStatus
        OpEventGetEventUdsStatus_GetEventUdsStatus_EvtInfo_INV_GATE_DRVR_TOP_HWP: start-on-event=DemSatellite_0InternalBehavior/GetEventUdsStatus, operation=EvtInfo_INV_GATE_DRVR_TOP_HWP.GetEventUdsStatus
        OpEventGetEventUdsStatus_GetEventUdsStatus_Event_INV_GATE_DRVR_TOP_HWP: start-on-event=DemSatellite_0InternalBehavior/GetEventUdsStatus, operation=Event_INV_GATE_DRVR_TOP_HWP.GetEventUdsStatus
        OpEventGetEventUdsStatus_GetEventUdsStatus_EvtInfo_INV_ACTV_DCHA_HW: start-on-event=DemSatellite_0InternalBehavior/GetEventUdsStatus, operation=EvtInfo_INV_ACTV_DCHA_HW.GetEventUdsStatus
        OpEventGetEventUdsStatus_GetEventUdsStatus_Event_INV_ACTV_DCHA_HW: start-on-event=DemSatellite_0InternalBehavior/GetEventUdsStatus, operation=Event_INV_ACTV_DCHA_HW.GetEventUdsStatus
        OpEventGetEventUdsStatus_GetEventUdsStatus_EvtInfo_INV_IGBT_TEMP_HWP: start-on-event=DemSatellite_0InternalBehavior/GetEventUdsStatus, operation=EvtInfo_INV_IGBT_TEMP_HWP.GetEventUdsStatus
        OpEventGetEventUdsStatus_GetEventUdsStatus_Event_INV_IGBT_TEMP_HWP: start-on-event=DemSatellite_0InternalBehavior/GetEventUdsStatus, operation=Event_INV_IGBT_TEMP_HWP.GetEventUdsStatus
        OpEventGetEventUdsStatus_GetEventUdsStatus_EvtInfo_INV_RSLVR_SIN_ELEC_FLT: start-on-event=DemSatellite_0InternalBehavior/GetEventUdsStatus, operation=EvtInfo_INV_RSLVR_SIN_ELEC_FLT.GetEventUdsStatus
        OpEventGetEventUdsStatus_GetEventUdsStatus_Event_INV_RSLVR_SIN_ELEC_FLT: start-on-event=DemSatellite_0InternalBehavior/GetEventUdsStatus, operation=Event_INV_RSLVR_SIN_ELEC_FLT.GetEventUdsStatus
        OpEventGetEventUdsStatus_GetEventUdsStatus_EvtInfo_CU_TEMP2_RNG_HI: start-on-event=DemSatellite_0InternalBehavior/GetEventUdsStatus, operation=EvtInfo_CU_TEMP2_RNG_HI.GetEventUdsStatus
        OpEventGetEventUdsStatus_GetEventUdsStatus_Event_CU_TEMP2_RNG_HI: start-on-event=DemSatellite_0InternalBehavior/GetEventUdsStatus, operation=Event_CU_TEMP2_RNG_HI.GetEventUdsStatus
        OpEventGetEventUdsStatus_GetEventUdsStatus_EvtInfo_INV_IAC_PHA_LOSS_MPL: start-on-event=DemSatellite_0InternalBehavior/GetEventUdsStatus, operation=EvtInfo_INV_IAC_PHA_LOSS_MPL.GetEventUdsStatus
        OpEventGetEventUdsStatus_GetEventUdsStatus_Event_INV_IAC_PHA_LOSS_MPL: start-on-event=DemSatellite_0InternalBehavior/GetEventUdsStatus, operation=Event_INV_IAC_PHA_LOSS_MPL.GetEventUdsStatus
        OpEventGetEventUdsStatus_GetEventUdsStatus_EvtInfo_INV_IAC_U_AMP: start-on-event=DemSatellite_0InternalBehavior/GetEventUdsStatus, operation=EvtInfo_INV_IAC_U_AMP.GetEventUdsStatus
        OpEventGetEventUdsStatus_GetEventUdsStatus_Event_INV_IAC_U_AMP: start-on-event=DemSatellite_0InternalBehavior/GetEventUdsStatus, operation=Event_INV_IAC_U_AMP.GetEventUdsStatus
        OpEventGetEventUdsStatus_GetEventUdsStatus_EvtInfo_PSnsr_GRADT_Flt: start-on-event=DemSatellite_0InternalBehavior/GetEventUdsStatus, operation=EvtInfo_PSnsr_GRADT_Flt.GetEventUdsStatus
        OpEventGetEventUdsStatus_GetEventUdsStatus_Event_PSnsr_GRADT_Flt: start-on-event=DemSatellite_0InternalBehavior/GetEventUdsStatus, operation=Event_PSnsr_GRADT_Flt.GetEventUdsStatus
        OpEventGetEventUdsStatus_GetEventUdsStatus_EvtInfo_AURIX_WATHDOG_FLT: start-on-event=DemSatellite_0InternalBehavior/GetEventUdsStatus, operation=EvtInfo_AURIX_WATHDOG_FLT.GetEventUdsStatus
        OpEventGetEventUdsStatus_GetEventUdsStatus_Event_AURIX_WATHDOG_FLT: start-on-event=DemSatellite_0InternalBehavior/GetEventUdsStatus, operation=Event_AURIX_WATHDOG_FLT.GetEventUdsStatus
        OpEventGetEventUdsStatus_GetEventUdsStatus_EvtInfo_VcEvNodeMisBECM: start-on-event=DemSatellite_0InternalBehavior/GetEventUdsStatus, operation=EvtInfo_VcEvNodeMisBECM.GetEventUdsStatus
        OpEventGetEventUdsStatus_GetEventUdsStatus_Event_VcEvNodeMisBECM: start-on-event=DemSatellite_0InternalBehavior/GetEventUdsStatus, operation=Event_VcEvNodeMisBECM.GetEventUdsStatus
        OpEventGetEventUdsStatus_GetEventUdsStatus_EvtInfo_INV_UHVDC_UV_HWP: start-on-event=DemSatellite_0InternalBehavior/GetEventUdsStatus, operation=EvtInfo_INV_UHVDC_UV_HWP.GetEventUdsStatus
        OpEventGetEventUdsStatus_GetEventUdsStatus_Event_INV_UHVDC_UV_HWP: start-on-event=DemSatellite_0InternalBehavior/GetEventUdsStatus, operation=Event_INV_UHVDC_UV_HWP.GetEventUdsStatus
        OpEventGetEventUdsStatus_GetEventUdsStatus_EvtInfo_VcEvMonESpd: start-on-event=DemSatellite_0InternalBehavior/GetEventUdsStatus, operation=EvtInfo_VcEvMonESpd.GetEventUdsStatus
        OpEventGetEventUdsStatus_GetEventUdsStatus_Event_VcEvMonESpd: start-on-event=DemSatellite_0InternalBehavior/GetEventUdsStatus, operation=Event_VcEvMonESpd.GetEventUdsStatus
        OpEventGetEventUdsStatus_GetEventUdsStatus_EvtInfo_COM_NotConfig: start-on-event=DemSatellite_0InternalBehavior/GetEventUdsStatus, operation=EvtInfo_COM_NotConfig.GetEventUdsStatus
        OpEventGetEventUdsStatus_GetEventUdsStatus_Event_COM_NotConfig: start-on-event=DemSatellite_0InternalBehavior/GetEventUdsStatus, operation=Event_COM_NotConfig.GetEventUdsStatus
        OpEventGetEventUdsStatus_GetEventUdsStatus_EvtInfo_INV_RSLVR_SIN_RNG_HI: start-on-event=DemSatellite_0InternalBehavior/GetEventUdsStatus, operation=EvtInfo_INV_RSLVR_SIN_RNG_HI.GetEventUdsStatus
        OpEventGetEventUdsStatus_GetEventUdsStatus_Event_INV_RSLVR_SIN_RNG_HI: start-on-event=DemSatellite_0InternalBehavior/GetEventUdsStatus, operation=Event_INV_RSLVR_SIN_RNG_HI.GetEventUdsStatus
        OpEventGetEventUdsStatus_GetEventUdsStatus_EvtInfo_INV_IGBT_TEMP_U_RNG_HI: start-on-event=DemSatellite_0InternalBehavior/GetEventUdsStatus, operation=EvtInfo_INV_IGBT_TEMP_U_RNG_HI.GetEventUdsStatus
        OpEventGetEventUdsStatus_GetEventUdsStatus_Event_INV_IGBT_TEMP_U_RNG_HI: start-on-event=DemSatellite_0InternalBehavior/GetEventUdsStatus, operation=Event_INV_IGBT_TEMP_U_RNG_HI.GetEventUdsStatus
        OpEventGetEventUdsStatus_GetEventUdsStatus_EvtInfo_VcEvMonMode_001: start-on-event=DemSatellite_0InternalBehavior/GetEventUdsStatus, operation=EvtInfo_VcEvMonMode_001.GetEventUdsStatus
        OpEventGetEventUdsStatus_GetEventUdsStatus_Event_VcEvMonMode_001: start-on-event=DemSatellite_0InternalBehavior/GetEventUdsStatus, operation=Event_VcEvMonMode_001.GetEventUdsStatus
        OpEventGetEventUdsStatus_GetEventUdsStatus_EvtInfo_PA_ACTION_FLT: start-on-event=DemSatellite_0InternalBehavior/GetEventUdsStatus, operation=EvtInfo_PA_ACTION_FLT.GetEventUdsStatus
        OpEventGetEventUdsStatus_GetEventUdsStatus_Event_PA_ACTION_FLT: start-on-event=DemSatellite_0InternalBehavior/GetEventUdsStatus, operation=Event_PA_ACTION_FLT.GetEventUdsStatus
        OpEventGetEventUdsStatus_GetEventUdsStatus_EvtInfo_INV_IAC_V_ELEC_HWP: start-on-event=DemSatellite_0InternalBehavior/GetEventUdsStatus, operation=EvtInfo_INV_IAC_V_ELEC_HWP.GetEventUdsStatus
        OpEventGetEventUdsStatus_GetEventUdsStatus_Event_INV_IAC_V_ELEC_HWP: start-on-event=DemSatellite_0InternalBehavior/GetEventUdsStatus, operation=Event_INV_IAC_V_ELEC_HWP.GetEventUdsStatus
        OpEventGetEventUdsStatus_GetEventUdsStatus_EvtInfo_CU_TEMP_HW_FLT_001: start-on-event=DemSatellite_0InternalBehavior/GetEventUdsStatus, operation=EvtInfo_CU_TEMP_HW_FLT_001.GetEventUdsStatus
        OpEventGetEventUdsStatus_GetEventUdsStatus_Event_CU_TEMP_HW_FLT_001: start-on-event=DemSatellite_0InternalBehavior/GetEventUdsStatus, operation=Event_CU_TEMP_HW_FLT_001.GetEventUdsStatus
        OpEventGetEventUdsStatus_GetEventUdsStatus_EvtInfo_VCC_UnderVoltage: start-on-event=DemSatellite_0InternalBehavior/GetEventUdsStatus, operation=EvtInfo_VCC_UnderVoltage.GetEventUdsStatus
        OpEventGetEventUdsStatus_GetEventUdsStatus_Event_VCC_UnderVoltage: start-on-event=DemSatellite_0InternalBehavior/GetEventUdsStatus, operation=Event_VCC_UnderVoltage.GetEventUdsStatus
        OpEventGetEventUdsStatus_GetEventUdsStatus_EvtInfo_VcEvTsttrPlaus: start-on-event=DemSatellite_0InternalBehavior/GetEventUdsStatus, operation=EvtInfo_VcEvTsttrPlaus.GetEventUdsStatus
        OpEventGetEventUdsStatus_GetEventUdsStatus_Event_VcEvTsttrPlaus: start-on-event=DemSatellite_0InternalBehavior/GetEventUdsStatus, operation=Event_VcEvTsttrPlaus.GetEventUdsStatus
        OpEventGetEventUdsStatus_GetEventUdsStatus_EvtInfo_INV_RSLVR_EXCT_ELEC_FLT: start-on-event=DemSatellite_0InternalBehavior/GetEventUdsStatus, operation=EvtInfo_INV_RSLVR_EXCT_ELEC_FLT.GetEventUdsStatus
        OpEventGetEventUdsStatus_GetEventUdsStatus_Event_INV_RSLVR_EXCT_ELEC_FLT: start-on-event=DemSatellite_0InternalBehavior/GetEventUdsStatus, operation=Event_INV_RSLVR_EXCT_ELEC_FLT.GetEventUdsStatus
        OpEventGetEventUdsStatus_GetEventUdsStatus_EvtInfo_INV_RSLVR_EXCT_RNG_LO: start-on-event=DemSatellite_0InternalBehavior/GetEventUdsStatus, operation=EvtInfo_INV_RSLVR_EXCT_RNG_LO.GetEventUdsStatus
        OpEventGetEventUdsStatus_GetEventUdsStatus_Event_INV_RSLVR_EXCT_RNG_LO: start-on-event=DemSatellite_0InternalBehavior/GetEventUdsStatus, operation=Event_INV_RSLVR_EXCT_RNG_LO.GetEventUdsStatus
        OpEventGetEventUdsStatus_GetEventUdsStatus_EvtInfo_INV_EM_STATOR_TEMP2_RNG_HI: start-on-event=DemSatellite_0InternalBehavior/GetEventUdsStatus, operation=EvtInfo_INV_EM_STATOR_TEMP2_RNG_HI.GetEventUdsStatus
        OpEventGetEventUdsStatus_GetEventUdsStatus_Event_INV_EM_STATOR_TEMP2_RNG_HI: start-on-event=DemSatellite_0InternalBehavior/GetEventUdsStatus, operation=Event_INV_EM_STATOR_TEMP2_RNG_HI.GetEventUdsStatus
        OpEventGetEventUdsStatus_GetEventUdsStatus_EvtInfo_INV_SHUT_OFF_PAH_START_UP: start-on-event=DemSatellite_0InternalBehavior/GetEventUdsStatus, operation=EvtInfo_INV_SHUT_OFF_PAH_START_UP.GetEventUdsStatus
        OpEventGetEventUdsStatus_GetEventUdsStatus_Event_INV_SHUT_OFF_PAH_START_UP: start-on-event=DemSatellite_0InternalBehavior/GetEventUdsStatus, operation=Event_INV_SHUT_OFF_PAH_START_UP.GetEventUdsStatus
        OpEventGetEventUdsStatus_GetEventUdsStatus_EvtInfo_VCEvVddmPropFr08Tioutd: start-on-event=DemSatellite_0InternalBehavior/GetEventUdsStatus, operation=EvtInfo_VCEvVddmPropFr08Tioutd.GetEventUdsStatus
        OpEventGetEventUdsStatus_GetEventUdsStatus_Event_VCEvVddmPropFr08Tioutd: start-on-event=DemSatellite_0InternalBehavior/GetEventUdsStatus, operation=Event_VCEvVddmPropFr08Tioutd.GetEventUdsStatus
        OpEventGetEventUdsStatus_GetEventUdsStatus_EvtInfo_INV_RSLVR_EXCT_OC_HWP_001: start-on-event=DemSatellite_0InternalBehavior/GetEventUdsStatus, operation=EvtInfo_INV_RSLVR_EXCT_OC_HWP_001.GetEventUdsStatus
        OpEventGetEventUdsStatus_GetEventUdsStatus_Event_INV_RSLVR_EXCT_OC_HWP_001: start-on-event=DemSatellite_0InternalBehavior/GetEventUdsStatus, operation=Event_INV_RSLVR_EXCT_OC_HWP_001.GetEventUdsStatus
        OpEventGetEventUdsStatus_GetEventUdsStatus_EvtInfo_INV_RSLVR_EXCT_OC_HWP_002: start-on-event=DemSatellite_0InternalBehavior/GetEventUdsStatus, operation=EvtInfo_INV_RSLVR_EXCT_OC_HWP_002.GetEventUdsStatus
        OpEventGetEventUdsStatus_GetEventUdsStatus_Event_INV_RSLVR_EXCT_OC_HWP_002: start-on-event=DemSatellite_0InternalBehavior/GetEventUdsStatus, operation=Event_INV_RSLVR_EXCT_OC_HWP_002.GetEventUdsStatus
        OpEventGetEventUdsStatus_GetEventUdsStatus_EvtInfo_INV_EM_STATOR_TEMP_ELE_FLT: start-on-event=DemSatellite_0InternalBehavior/GetEventUdsStatus, operation=EvtInfo_INV_EM_STATOR_TEMP_ELE_FLT.GetEventUdsStatus
        OpEventGetEventUdsStatus_GetEventUdsStatus_Event_INV_EM_STATOR_TEMP_ELE_FLT: start-on-event=DemSatellite_0InternalBehavior/GetEventUdsStatus, operation=Event_INV_EM_STATOR_TEMP_ELE_FLT.GetEventUdsStatus
        OpEventGetEventUdsStatus_GetEventUdsStatus_EvtInfo_INV_INTERLOCK_FLT: start-on-event=DemSatellite_0InternalBehavior/GetEventUdsStatus, operation=EvtInfo_INV_INTERLOCK_FLT.GetEventUdsStatus
        OpEventGetEventUdsStatus_GetEventUdsStatus_Event_INV_INTERLOCK_FLT: start-on-event=DemSatellite_0InternalBehavior/GetEventUdsStatus, operation=Event_INV_INTERLOCK_FLT.GetEventUdsStatus
        OpEventGetEventUdsStatus_GetEventUdsStatus_EvtInfo_Ga_ZeroFindDistanFailure: start-on-event=DemSatellite_0InternalBehavior/GetEventUdsStatus, operation=EvtInfo_Ga_ZeroFindDistanFailure.GetEventUdsStatus
        OpEventGetEventUdsStatus_GetEventUdsStatus_Event_Ga_ZeroFindDistanFailure: start-on-event=DemSatellite_0InternalBehavior/GetEventUdsStatus, operation=Event_Ga_ZeroFindDistanFailure.GetEventUdsStatus
        OpEventGetEventUdsStatus_GetEventUdsStatus_EvtInfo_PLOCK_Current_RNG_OUT: start-on-event=DemSatellite_0InternalBehavior/GetEventUdsStatus, operation=EvtInfo_PLOCK_Current_RNG_OUT.GetEventUdsStatus
        OpEventGetEventUdsStatus_GetEventUdsStatus_Event_PLOCK_Current_RNG_OUT: start-on-event=DemSatellite_0InternalBehavior/GetEventUdsStatus, operation=Event_PLOCK_Current_RNG_OUT.GetEventUdsStatus
        OpEventGetEventUdsStatus_GetEventUdsStatus_EvtInfo_VCEvVddmPropFr05Tioutd: start-on-event=DemSatellite_0InternalBehavior/GetEventUdsStatus, operation=EvtInfo_VCEvVddmPropFr05Tioutd.GetEventUdsStatus
        OpEventGetEventUdsStatus_GetEventUdsStatus_Event_VCEvVddmPropFr05Tioutd: start-on-event=DemSatellite_0InternalBehavior/GetEventUdsStatus, operation=Event_VCEvVddmPropFr05Tioutd.GetEventUdsStatus
        OpEventGetEventUdsStatus_GetEventUdsStatus_EvtInfo_INV_IGBT_TEMP_V_GRDT: start-on-event=DemSatellite_0InternalBehavior/GetEventUdsStatus, operation=EvtInfo_INV_IGBT_TEMP_V_GRDT.GetEventUdsStatus
        OpEventGetEventUdsStatus_GetEventUdsStatus_Event_INV_IGBT_TEMP_V_GRDT: start-on-event=DemSatellite_0InternalBehavior/GetEventUdsStatus, operation=Event_INV_IGBT_TEMP_V_GRDT.GetEventUdsStatus
        OpEventGetEventUdsStatus_GetEventUdsStatus_EvtInfo_PS_5V_Fault: start-on-event=DemSatellite_0InternalBehavior/GetEventUdsStatus, operation=EvtInfo_PS_5V_Fault.GetEventUdsStatus
        OpEventGetEventUdsStatus_GetEventUdsStatus_Event_PS_5V_Fault: start-on-event=DemSatellite_0InternalBehavior/GetEventUdsStatus, operation=Event_PS_5V_Fault.GetEventUdsStatus
        OpEventGetEventUdsStatus_GetEventUdsStatus_EvtInfo_VcEvCntrCrashStsSafe: start-on-event=DemSatellite_0InternalBehavior/GetEventUdsStatus, operation=EvtInfo_VcEvCntrCrashStsSafe.GetEventUdsStatus
        OpEventGetEventUdsStatus_GetEventUdsStatus_Event_VcEvCntrCrashStsSafe: start-on-event=DemSatellite_0InternalBehavior/GetEventUdsStatus, operation=Event_VcEvCntrCrashStsSafe.GetEventUdsStatus
        OpEventGetEventUdsStatus_GetEventUdsStatus_EvtInfo_INV_EM_STATOR_TEMP_GRDT: start-on-event=DemSatellite_0InternalBehavior/GetEventUdsStatus, operation=EvtInfo_INV_EM_STATOR_TEMP_GRDT.GetEventUdsStatus
        OpEventGetEventUdsStatus_GetEventUdsStatus_Event_INV_EM_STATOR_TEMP_GRDT: start-on-event=DemSatellite_0InternalBehavior/GetEventUdsStatus, operation=Event_INV_EM_STATOR_TEMP_GRDT.GetEventUdsStatus
        OpEventGetEventUdsStatus_GetEventUdsStatus_EvtInfo_PS_P15_V_FLT: start-on-event=DemSatellite_0InternalBehavior/GetEventUdsStatus, operation=EvtInfo_PS_P15_V_FLT.GetEventUdsStatus
        OpEventGetEventUdsStatus_GetEventUdsStatus_Event_PS_P15_V_FLT: start-on-event=DemSatellite_0InternalBehavior/GetEventUdsStatus, operation=Event_PS_P15_V_FLT.GetEventUdsStatus
        OpEventGetEventUdsStatus_GetEventUdsStatus_EvtInfo_INV_EM_STATOR_TEMP_RNG_NOK: start-on-event=DemSatellite_0InternalBehavior/GetEventUdsStatus, operation=EvtInfo_INV_EM_STATOR_TEMP_RNG_NOK.GetEventUdsStatus
        OpEventGetEventUdsStatus_GetEventUdsStatus_Event_INV_EM_STATOR_TEMP_RNG_NOK: start-on-event=DemSatellite_0InternalBehavior/GetEventUdsStatus, operation=Event_INV_EM_STATOR_TEMP_RNG_NOK.GetEventUdsStatus
        OpEventGetEventUdsStatus_GetEventUdsStatus_EvtInfo_INV_RSLVR_SIN_RNG_NOK: start-on-event=DemSatellite_0InternalBehavior/GetEventUdsStatus, operation=EvtInfo_INV_RSLVR_SIN_RNG_NOK.GetEventUdsStatus
        OpEventGetEventUdsStatus_GetEventUdsStatus_Event_INV_RSLVR_SIN_RNG_NOK: start-on-event=DemSatellite_0InternalBehavior/GetEventUdsStatus, operation=Event_INV_RSLVR_SIN_RNG_NOK.GetEventUdsStatus
        OpEventGetEventUdsStatus_GetEventUdsStatus_EvtInfo_INV_IAC_U_OFFS: start-on-event=DemSatellite_0InternalBehavior/GetEventUdsStatus, operation=EvtInfo_INV_IAC_U_OFFS.GetEventUdsStatus
        OpEventGetEventUdsStatus_GetEventUdsStatus_Event_INV_IAC_U_OFFS: start-on-event=DemSatellite_0InternalBehavior/GetEventUdsStatus, operation=Event_INV_IAC_U_OFFS.GetEventUdsStatus
        OpEventGetEventUdsStatus_GetEventUdsStatus_EvtInfo_PS_KL30_BACKUP_FLT: start-on-event=DemSatellite_0InternalBehavior/GetEventUdsStatus, operation=EvtInfo_PS_KL30_BACKUP_FLT.GetEventUdsStatus
        OpEventGetEventUdsStatus_GetEventUdsStatus_Event_PS_KL30_BACKUP_FLT: start-on-event=DemSatellite_0InternalBehavior/GetEventUdsStatus, operation=Event_PS_KL30_BACKUP_FLT.GetEventUdsStatus
        OpEventGetEventUdsStatus_GetEventUdsStatus_EvtInfo_INV_IGBT_TEMP_U_RNG_LO: start-on-event=DemSatellite_0InternalBehavior/GetEventUdsStatus, operation=EvtInfo_INV_IGBT_TEMP_U_RNG_LO.GetEventUdsStatus
        OpEventGetEventUdsStatus_GetEventUdsStatus_Event_INV_IGBT_TEMP_U_RNG_LO: start-on-event=DemSatellite_0InternalBehavior/GetEventUdsStatus, operation=Event_INV_IGBT_TEMP_U_RNG_LO.GetEventUdsStatus
        OpEventGetEventUdsStatus_GetEventUdsStatus_EvtInfo_INV_EM_STATOR_TEMP_HWP: start-on-event=DemSatellite_0InternalBehavior/GetEventUdsStatus, operation=EvtInfo_INV_EM_STATOR_TEMP_HWP.GetEventUdsStatus
        OpEventGetEventUdsStatus_GetEventUdsStatus_Event_INV_EM_STATOR_TEMP_HWP: start-on-event=DemSatellite_0InternalBehavior/GetEventUdsStatus, operation=Event_INV_EM_STATOR_TEMP_HWP.GetEventUdsStatus
        OpEventGetEventUdsStatus_GetEventUdsStatus_EvtInfo_CU_TEMP1_RNG_HI: start-on-event=DemSatellite_0InternalBehavior/GetEventUdsStatus, operation=EvtInfo_CU_TEMP1_RNG_HI.GetEventUdsStatus
        OpEventGetEventUdsStatus_GetEventUdsStatus_Event_CU_TEMP1_RNG_HI: start-on-event=DemSatellite_0InternalBehavior/GetEventUdsStatus, operation=Event_CU_TEMP1_RNG_HI.GetEventUdsStatus
        OpEventGetEventUdsStatus_GetEventUdsStatus_EvtInfo_INV_IGBT_TEMP_V_RNG_HI: start-on-event=DemSatellite_0InternalBehavior/GetEventUdsStatus, operation=EvtInfo_INV_IGBT_TEMP_V_RNG_HI.GetEventUdsStatus
        OpEventGetEventUdsStatus_GetEventUdsStatus_Event_INV_IGBT_TEMP_V_RNG_HI: start-on-event=DemSatellite_0InternalBehavior/GetEventUdsStatus, operation=Event_INV_IGBT_TEMP_V_RNG_HI.GetEventUdsStatus
        OpEventGetEventUdsStatus_GetEventUdsStatus_EvtInfo_VcEvNodeMisVDDM: start-on-event=DemSatellite_0InternalBehavior/GetEventUdsStatus, operation=EvtInfo_VcEvNodeMisVDDM.GetEventUdsStatus
        OpEventGetEventUdsStatus_GetEventUdsStatus_Event_VcEvNodeMisVDDM: start-on-event=DemSatellite_0InternalBehavior/GetEventUdsStatus, operation=Event_VcEvNodeMisVDDM.GetEventUdsStatus
        OpEventGetEventUdsStatus_GetEventUdsStatus_EvtInfo_INV_UHVDC_PLAUS: start-on-event=DemSatellite_0InternalBehavior/GetEventUdsStatus, operation=EvtInfo_INV_UHVDC_PLAUS.GetEventUdsStatus
        OpEventGetEventUdsStatus_GetEventUdsStatus_Event_INV_UHVDC_PLAUS: start-on-event=DemSatellite_0InternalBehavior/GetEventUdsStatus, operation=Event_INV_UHVDC_PLAUS.GetEventUdsStatus
        OpEventGetEventUdsStatus_GetEventUdsStatus_EvtInfo_INV_QUIESCENT_FLT: start-on-event=DemSatellite_0InternalBehavior/GetEventUdsStatus, operation=EvtInfo_INV_QUIESCENT_FLT.GetEventUdsStatus
        OpEventGetEventUdsStatus_GetEventUdsStatus_Event_INV_QUIESCENT_FLT: start-on-event=DemSatellite_0InternalBehavior/GetEventUdsStatus, operation=Event_INV_QUIESCENT_FLT.GetEventUdsStatus
        OpEventGetEventUdsStatus_GetEventUdsStatus_EvtInfo_INV_RSLVR_EXCT_RNG_HI: start-on-event=DemSatellite_0InternalBehavior/GetEventUdsStatus, operation=EvtInfo_INV_RSLVR_EXCT_RNG_HI.GetEventUdsStatus
        OpEventGetEventUdsStatus_GetEventUdsStatus_Event_INV_RSLVR_EXCT_RNG_HI: start-on-event=DemSatellite_0InternalBehavior/GetEventUdsStatus, operation=Event_INV_RSLVR_EXCT_RNG_HI.GetEventUdsStatus
        OpEventGetEventUdsStatus_GetEventUdsStatus_GeneralEvtInfo: start-on-event=DemSatellite_0InternalBehavior/GetEventUdsStatus, operation=GeneralEvtInfo.GetEventUdsStatus
        OpEventGetEventStatus_GetEventStatus_EvtInfo_VCEvBecmPropFr01Tioutd: start-on-event=DemSatellite_0InternalBehavior/GetEventStatus, operation=EvtInfo_VCEvBecmPropFr01Tioutd.GetEventStatus
        OpEventGetEventStatus_GetEventStatus_Event_VCEvBecmPropFr01Tioutd: start-on-event=DemSatellite_0InternalBehavior/GetEventStatus, operation=Event_VCEvBecmPropFr01Tioutd.GetEventStatus
        OpEventGetEventStatus_GetEventStatus_EvtInfo_INV_CU_TEMP2_RNG_NOK: start-on-event=DemSatellite_0InternalBehavior/GetEventStatus, operation=EvtInfo_INV_CU_TEMP2_RNG_NOK.GetEventStatus
        OpEventGetEventStatus_GetEventStatus_Event_INV_CU_TEMP2_RNG_NOK: start-on-event=DemSatellite_0InternalBehavior/GetEventStatus, operation=Event_INV_CU_TEMP2_RNG_NOK.GetEventStatus
        OpEventGetEventStatus_GetEventStatus_EvtInfo_COM_Busoff: start-on-event=DemSatellite_0InternalBehavior/GetEventStatus, operation=EvtInfo_COM_Busoff.GetEventStatus
        OpEventGetEventStatus_GetEventStatus_Event_COM_Busoff: start-on-event=DemSatellite_0InternalBehavior/GetEventStatus, operation=Event_COM_Busoff.GetEventStatus
        OpEventGetEventStatus_GetEventStatus_EvtInfo_INV_IMMO_NOKEY: start-on-event=DemSatellite_0InternalBehavior/GetEventStatus, operation=EvtInfo_INV_IMMO_NOKEY.GetEventStatus
        OpEventGetEventStatus_GetEventStatus_Event_INV_IMMO_NOKEY: start-on-event=DemSatellite_0InternalBehavior/GetEventStatus, operation=Event_INV_IMMO_NOKEY.GetEventStatus
        OpEventGetEventStatus_GetEventStatus_EvtInfo_INV_RSLVR_EXCT_OC_HWP: start-on-event=DemSatellite_0InternalBehavior/GetEventStatus, operation=EvtInfo_INV_RSLVR_EXCT_OC_HWP.GetEventStatus
        OpEventGetEventStatus_GetEventStatus_Event_INV_RSLVR_EXCT_OC_HWP: start-on-event=DemSatellite_0InternalBehavior/GetEventStatus, operation=Event_INV_RSLVR_EXCT_OC_HWP.GetEventStatus
        OpEventGetEventStatus_GetEventStatus_EvtInfo_PS_P15_W_FLT: start-on-event=DemSatellite_0InternalBehavior/GetEventStatus, operation=EvtInfo_PS_P15_W_FLT.GetEventStatus
        OpEventGetEventStatus_GetEventStatus_Event_PS_P15_W_FLT: start-on-event=DemSatellite_0InternalBehavior/GetEventStatus, operation=Event_PS_P15_W_FLT.GetEventStatus
        OpEventGetEventStatus_GetEventStatus_EvtInfo_INV_IAC_PLAUS_SUM: start-on-event=DemSatellite_0InternalBehavior/GetEventStatus, operation=EvtInfo_INV_IAC_PLAUS_SUM.GetEventStatus
        OpEventGetEventStatus_GetEventStatus_Event_INV_IAC_PLAUS_SUM: start-on-event=DemSatellite_0InternalBehavior/GetEventStatus, operation=Event_INV_IAC_PLAUS_SUM.GetEventStatus
        OpEventGetEventStatus_GetEventStatus_EvtInfo_PA_ELE_FLT: start-on-event=DemSatellite_0InternalBehavior/GetEventStatus, operation=EvtInfo_PA_ELE_FLT.GetEventStatus
        OpEventGetEventStatus_GetEventStatus_Event_PA_ELE_FLT: start-on-event=DemSatellite_0InternalBehavior/GetEventStatus, operation=Event_PA_ELE_FLT.GetEventStatus
        OpEventGetEventStatus_GetEventStatus_EvtInfo_CU_TEMP_GRDT: start-on-event=DemSatellite_0InternalBehavior/GetEventStatus, operation=EvtInfo_CU_TEMP_GRDT.GetEventStatus
        OpEventGetEventStatus_GetEventStatus_Event_CU_TEMP_GRDT: start-on-event=DemSatellite_0InternalBehavior/GetEventStatus, operation=Event_CU_TEMP_GRDT.GetEventStatus
        OpEventGetEventStatus_GetEventStatus_EvtInfo_INV_IGBT_TEMP_V_PLAUS: start-on-event=DemSatellite_0InternalBehavior/GetEventStatus, operation=EvtInfo_INV_IGBT_TEMP_V_PLAUS.GetEventStatus
        OpEventGetEventStatus_GetEventStatus_Event_INV_IGBT_TEMP_V_PLAUS: start-on-event=DemSatellite_0InternalBehavior/GetEventStatus, operation=Event_INV_IGBT_TEMP_V_PLAUS.GetEventStatus
        OpEventGetEventStatus_GetEventStatus_EvtInfo_Ga_GAEngageFailure: start-on-event=DemSatellite_0InternalBehavior/GetEventStatus, operation=EvtInfo_Ga_GAEngageFailure.GetEventStatus
        OpEventGetEventStatus_GetEventStatus_Event_Ga_GAEngageFailure: start-on-event=DemSatellite_0InternalBehavior/GetEventStatus, operation=Event_Ga_GAEngageFailure.GetEventStatus
        OpEventGetEventStatus_GetEventStatus_EvtInfo_INV_IAC_W_RNG_LO: start-on-event=DemSatellite_0InternalBehavior/GetEventStatus, operation=EvtInfo_INV_IAC_W_RNG_LO.GetEventStatus
        OpEventGetEventStatus_GetEventStatus_Event_INV_IAC_W_RNG_LO: start-on-event=DemSatellite_0InternalBehavior/GetEventStatus, operation=Event_INV_IAC_W_RNG_LO.GetEventStatus
        OpEventGetEventStatus_GetEventStatus_EvtInfo_PS_WhlSnsr_Vltg_FLT: start-on-event=DemSatellite_0InternalBehavior/GetEventStatus, operation=EvtInfo_PS_WhlSnsr_Vltg_FLT.GetEventStatus
        OpEventGetEventStatus_GetEventStatus_Event_PS_WhlSnsr_Vltg_FLT: start-on-event=DemSatellite_0InternalBehavior/GetEventStatus, operation=Event_PS_WhlSnsr_Vltg_FLT.GetEventStatus
        OpEventGetEventStatus_GetEventStatus_EvtInfo_VCEvEcmPropFr02Tioutd: start-on-event=DemSatellite_0InternalBehavior/GetEventStatus, operation=EvtInfo_VCEvEcmPropFr02Tioutd.GetEventStatus
        OpEventGetEventStatus_GetEventStatus_Event_VCEvEcmPropFr02Tioutd: start-on-event=DemSatellite_0InternalBehavior/GetEventStatus, operation=Event_VCEvEcmPropFr02Tioutd.GetEventStatus
        OpEventGetEventStatus_GetEventStatus_EvtInfo_Ga_TmSpdSyncFailed: start-on-event=DemSatellite_0InternalBehavior/GetEventStatus, operation=EvtInfo_Ga_TmSpdSyncFailed.GetEventStatus
        OpEventGetEventStatus_GetEventStatus_Event_Ga_TmSpdSyncFailed: start-on-event=DemSatellite_0InternalBehavior/GetEventStatus, operation=Event_Ga_TmSpdSyncFailed.GetEventStatus
        OpEventGetEventStatus_GetEventStatus_EvtInfo_INV_RSLVR_EXCT_ELEC_LO: start-on-event=DemSatellite_0InternalBehavior/GetEventStatus, operation=EvtInfo_INV_RSLVR_EXCT_ELEC_LO.GetEventStatus
        OpEventGetEventStatus_GetEventStatus_Event_INV_RSLVR_EXCT_ELEC_LO: start-on-event=DemSatellite_0InternalBehavior/GetEventStatus, operation=Event_INV_RSLVR_EXCT_ELEC_LO.GetEventStatus
        OpEventGetEventStatus_GetEventStatus_EvtInfo_VCEvEcmPropXevFr06Tioutd: start-on-event=DemSatellite_0InternalBehavior/GetEventStatus, operation=EvtInfo_VCEvEcmPropXevFr06Tioutd.GetEventStatus
        OpEventGetEventStatus_GetEventStatus_Event_VCEvEcmPropXevFr06Tioutd: start-on-event=DemSatellite_0InternalBehavior/GetEventStatus, operation=Event_VCEvEcmPropXevFr06Tioutd.GetEventStatus
        OpEventGetEventStatus_GetEventStatus_EvtInfo_VcEvCntrWhlMotSysTqAllwd: start-on-event=DemSatellite_0InternalBehavior/GetEventStatus, operation=EvtInfo_VcEvCntrWhlMotSysTqAllwd.GetEventStatus
        OpEventGetEventStatus_GetEventStatus_Event_VcEvCntrWhlMotSysTqAllwd: start-on-event=DemSatellite_0InternalBehavior/GetEventStatus, operation=Event_VcEvCntrWhlMotSysTqAllwd.GetEventStatus
        OpEventGetEventStatus_GetEventStatus_EvtInfo_INV_UHVDC_1_ELEC_HI: start-on-event=DemSatellite_0InternalBehavior/GetEventStatus, operation=EvtInfo_INV_UHVDC_1_ELEC_HI.GetEventStatus
        OpEventGetEventStatus_GetEventStatus_Event_INV_UHVDC_1_ELEC_HI: start-on-event=DemSatellite_0InternalBehavior/GetEventStatus, operation=Event_INV_UHVDC_1_ELEC_HI.GetEventStatus
        OpEventGetEventStatus_GetEventStatus_EvtInfo_INV_EM_STATOR_TEMP2_ELE_FLT: start-on-event=DemSatellite_0InternalBehavior/GetEventStatus, operation=EvtInfo_INV_EM_STATOR_TEMP2_ELE_FLT.GetEventStatus
        OpEventGetEventStatus_GetEventStatus_Event_INV_EM_STATOR_TEMP2_ELE_FLT: start-on-event=DemSatellite_0InternalBehavior/GetEventStatus, operation=Event_INV_EM_STATOR_TEMP2_ELE_FLT.GetEventStatus
        OpEventGetEventStatus_GetEventStatus_EvtInfo_AURIX_RST_SNG: start-on-event=DemSatellite_0InternalBehavior/GetEventStatus, operation=EvtInfo_AURIX_RST_SNG.GetEventStatus
        OpEventGetEventStatus_GetEventStatus_Event_AURIX_RST_SNG: start-on-event=DemSatellite_0InternalBehavior/GetEventStatus, operation=Event_AURIX_RST_SNG.GetEventStatus
        OpEventGetEventStatus_GetEventStatus_EvtInfo_VCEvEcmPropFr24MgmFr01Tioutd: start-on-event=DemSatellite_0InternalBehavior/GetEventStatus, operation=EvtInfo_VCEvEcmPropFr24MgmFr01Tioutd.GetEventStatus
        OpEventGetEventStatus_GetEventStatus_Event_VCEvEcmPropFr24MgmFr01Tioutd: start-on-event=DemSatellite_0InternalBehavior/GetEventStatus, operation=Event_VCEvEcmPropFr24MgmFr01Tioutd.GetEventStatus
        OpEventGetEventStatus_GetEventStatus_EvtInfo_INV_RSLVR_COS_ELEC_OPEN: start-on-event=DemSatellite_0InternalBehavior/GetEventStatus, operation=EvtInfo_INV_RSLVR_COS_ELEC_OPEN.GetEventStatus
        OpEventGetEventStatus_GetEventStatus_Event_INV_RSLVR_COS_ELEC_OPEN: start-on-event=DemSatellite_0InternalBehavior/GetEventStatus, operation=Event_INV_RSLVR_COS_ELEC_OPEN.GetEventStatus
        OpEventGetEventStatus_GetEventStatus_EvtInfo_INV_IAC_V_ELEC_LO: start-on-event=DemSatellite_0InternalBehavior/GetEventStatus, operation=EvtInfo_INV_IAC_V_ELEC_LO.GetEventStatus
        OpEventGetEventStatus_GetEventStatus_Event_INV_IAC_V_ELEC_LO: start-on-event=DemSatellite_0InternalBehavior/GetEventStatus, operation=Event_INV_IAC_V_ELEC_LO.GetEventStatus
        OpEventGetEventStatus_GetEventStatus_EvtInfo_INV_IAC_W_OFFS: start-on-event=DemSatellite_0InternalBehavior/GetEventStatus, operation=EvtInfo_INV_IAC_W_OFFS.GetEventStatus
        OpEventGetEventStatus_GetEventStatus_Event_INV_IAC_W_OFFS: start-on-event=DemSatellite_0InternalBehavior/GetEventStatus, operation=Event_INV_IAC_W_OFFS.GetEventStatus
        OpEventGetEventStatus_GetEventStatus_EvtInfo_INV_EM_STATOR_TEMP2_GRDT: start-on-event=DemSatellite_0InternalBehavior/GetEventStatus, operation=EvtInfo_INV_EM_STATOR_TEMP2_GRDT.GetEventStatus
        OpEventGetEventStatus_GetEventStatus_Event_INV_EM_STATOR_TEMP2_GRDT: start-on-event=DemSatellite_0InternalBehavior/GetEventStatus, operation=Event_INV_EM_STATOR_TEMP2_GRDT.GetEventStatus
        OpEventGetEventStatus_GetEventStatus_EvtInfo_INV_EM_OVRSPD_HWP: start-on-event=DemSatellite_0InternalBehavior/GetEventStatus, operation=EvtInfo_INV_EM_OVRSPD_HWP.GetEventStatus
        OpEventGetEventStatus_GetEventStatus_Event_INV_EM_OVRSPD_HWP: start-on-event=DemSatellite_0InternalBehavior/GetEventStatus, operation=Event_INV_EM_OVRSPD_HWP.GetEventStatus
        OpEventGetEventStatus_GetEventStatus_EvtInfo_CU_TEMP_HWP: start-on-event=DemSatellite_0InternalBehavior/GetEventStatus, operation=EvtInfo_CU_TEMP_HWP.GetEventStatus
        OpEventGetEventStatus_GetEventStatus_Event_CU_TEMP_HWP: start-on-event=DemSatellite_0InternalBehavior/GetEventStatus, operation=Event_CU_TEMP_HWP.GetEventStatus
        OpEventGetEventStatus_GetEventStatus_EvtInfo_INV_UHVDC_1_RNG_HI: start-on-event=DemSatellite_0InternalBehavior/GetEventStatus, operation=EvtInfo_INV_UHVDC_1_RNG_HI.GetEventStatus
        OpEventGetEventStatus_GetEventStatus_Event_INV_UHVDC_1_RNG_HI: start-on-event=DemSatellite_0InternalBehavior/GetEventStatus, operation=Event_INV_UHVDC_1_RNG_HI.GetEventStatus
        OpEventGetEventStatus_GetEventStatus_EvtInfo_VcEvEMPerfPlaus: start-on-event=DemSatellite_0InternalBehavior/GetEventStatus, operation=EvtInfo_VcEvEMPerfPlaus.GetEventStatus
        OpEventGetEventStatus_GetEventStatus_Event_VcEvEMPerfPlaus: start-on-event=DemSatellite_0InternalBehavior/GetEventStatus, operation=Event_VcEvEMPerfPlaus.GetEventStatus
        OpEventGetEventStatus_GetEventStatus_EvtInfo_VCEvVddmPropFr18Tioutd: start-on-event=DemSatellite_0InternalBehavior/GetEventStatus, operation=EvtInfo_VCEvVddmPropFr18Tioutd.GetEventStatus
        OpEventGetEventStatus_GetEventStatus_Event_VCEvVddmPropFr18Tioutd: start-on-event=DemSatellite_0InternalBehavior/GetEventStatus, operation=Event_VCEvVddmPropFr18Tioutd.GetEventStatus
        OpEventGetEventStatus_GetEventStatus_EvtInfo_INV_IAC_U_ELEC_HWP: start-on-event=DemSatellite_0InternalBehavior/GetEventStatus, operation=EvtInfo_INV_IAC_U_ELEC_HWP.GetEventStatus
        OpEventGetEventStatus_GetEventStatus_Event_INV_IAC_U_ELEC_HWP: start-on-event=DemSatellite_0InternalBehavior/GetEventStatus, operation=Event_INV_IAC_U_ELEC_HWP.GetEventStatus
        OpEventGetEventStatus_GetEventStatus_EvtInfo_VCEvVddmPropFr15Tioutd: start-on-event=DemSatellite_0InternalBehavior/GetEventStatus, operation=EvtInfo_VCEvVddmPropFr15Tioutd.GetEventStatus
        OpEventGetEventStatus_GetEventStatus_Event_VCEvVddmPropFr15Tioutd: start-on-event=DemSatellite_0InternalBehavior/GetEventStatus, operation=Event_VCEvVddmPropFr15Tioutd.GetEventStatus
        OpEventGetEventStatus_GetEventStatus_EvtInfo_Ga_GADisengageFailure: start-on-event=DemSatellite_0InternalBehavior/GetEventStatus, operation=EvtInfo_Ga_GADisengageFailure.GetEventStatus
        OpEventGetEventStatus_GetEventStatus_Event_Ga_GADisengageFailure: start-on-event=DemSatellite_0InternalBehavior/GetEventStatus, operation=Event_Ga_GADisengageFailure.GetEventStatus
        OpEventGetEventStatus_GetEventStatus_EvtInfo_CU_TEMP2_RNG_LO: start-on-event=DemSatellite_0InternalBehavior/GetEventStatus, operation=EvtInfo_CU_TEMP2_RNG_LO.GetEventStatus
        OpEventGetEventStatus_GetEventStatus_Event_CU_TEMP2_RNG_LO: start-on-event=DemSatellite_0InternalBehavior/GetEventStatus, operation=Event_CU_TEMP2_RNG_LO.GetEventStatus
        OpEventGetEventStatus_GetEventStatus_EvtInfo_INV_RSLVR_SIN_ELEC_OPEN: start-on-event=DemSatellite_0InternalBehavior/GetEventStatus, operation=EvtInfo_INV_RSLVR_SIN_ELEC_OPEN.GetEventStatus
        OpEventGetEventStatus_GetEventStatus_Event_INV_RSLVR_SIN_ELEC_OPEN: start-on-event=DemSatellite_0InternalBehavior/GetEventStatus, operation=Event_INV_RSLVR_SIN_ELEC_OPEN.GetEventStatus
        OpEventGetEventStatus_GetEventStatus_EvtInfo_VcEvChkSum: start-on-event=DemSatellite_0InternalBehavior/GetEventStatus, operation=EvtInfo_VcEvChkSum.GetEventStatus
        OpEventGetEventStatus_GetEventStatus_Event_VcEvChkSum: start-on-event=DemSatellite_0InternalBehavior/GetEventStatus, operation=Event_VcEvChkSum.GetEventStatus
        OpEventGetEventStatus_GetEventStatus_EvtInfo_PS_P5_UC_FLT: start-on-event=DemSatellite_0InternalBehavior/GetEventStatus, operation=EvtInfo_PS_P5_UC_FLT.GetEventStatus
        OpEventGetEventStatus_GetEventStatus_Event_PS_P5_UC_FLT: start-on-event=DemSatellite_0InternalBehavior/GetEventStatus, operation=Event_PS_P5_UC_FLT.GetEventStatus
        OpEventGetEventStatus_GetEventStatus_EvtInfo_INV_RSLVR_COS_ELEC_FLT: start-on-event=DemSatellite_0InternalBehavior/GetEventStatus, operation=EvtInfo_INV_RSLVR_COS_ELEC_FLT.GetEventStatus
        OpEventGetEventStatus_GetEventStatus_Event_INV_RSLVR_COS_ELEC_FLT: start-on-event=DemSatellite_0InternalBehavior/GetEventStatus, operation=Event_INV_RSLVR_COS_ELEC_FLT.GetEventStatus
        OpEventGetEventStatus_GetEventStatus_EvtInfo_INV_IAC_W_RNG_HI: start-on-event=DemSatellite_0InternalBehavior/GetEventStatus, operation=EvtInfo_INV_IAC_W_RNG_HI.GetEventStatus
        OpEventGetEventStatus_GetEventStatus_Event_INV_IAC_W_RNG_HI: start-on-event=DemSatellite_0InternalBehavior/GetEventStatus, operation=Event_INV_IAC_W_RNG_HI.GetEventStatus
        OpEventGetEventStatus_GetEventStatus_EvtInfo_PS_ECUSUPPLY_HIGH: start-on-event=DemSatellite_0InternalBehavior/GetEventStatus, operation=EvtInfo_PS_ECUSUPPLY_HIGH.GetEventStatus
        OpEventGetEventStatus_GetEventStatus_Event_PS_ECUSUPPLY_HIGH: start-on-event=DemSatellite_0InternalBehavior/GetEventStatus, operation=Event_PS_ECUSUPPLY_HIGH.GetEventStatus
        OpEventGetEventStatus_GetEventStatus_EvtInfo_VCEvEcmPropFr05Tioutd: start-on-event=DemSatellite_0InternalBehavior/GetEventStatus, operation=EvtInfo_VCEvEcmPropFr05Tioutd.GetEventStatus
        OpEventGetEventStatus_GetEventStatus_Event_VCEvEcmPropFr05Tioutd: start-on-event=DemSatellite_0InternalBehavior/GetEventStatus, operation=Event_VCEvEcmPropFr05Tioutd.GetEventStatus
        OpEventGetEventStatus_GetEventStatus_EvtInfo_PS_ECUSUPPLY_LOW: start-on-event=DemSatellite_0InternalBehavior/GetEventStatus, operation=EvtInfo_PS_ECUSUPPLY_LOW.GetEventStatus
        OpEventGetEventStatus_GetEventStatus_Event_PS_ECUSUPPLY_LOW: start-on-event=DemSatellite_0InternalBehavior/GetEventStatus, operation=Event_PS_ECUSUPPLY_LOW.GetEventStatus
        OpEventGetEventStatus_GetEventStatus_EvtInfo_VcEvChkSumHvSysRlySts: start-on-event=DemSatellite_0InternalBehavior/GetEventStatus, operation=EvtInfo_VcEvChkSumHvSysRlySts.GetEventStatus
        OpEventGetEventStatus_GetEventStatus_Event_VcEvChkSumHvSysRlySts: start-on-event=DemSatellite_0InternalBehavior/GetEventStatus, operation=Event_VcEvChkSumHvSysRlySts.GetEventStatus
        OpEventGetEventStatus_GetEventStatus_EvtInfo_VcEvMonMode: start-on-event=DemSatellite_0InternalBehavior/GetEventStatus, operation=EvtInfo_VcEvMonMode.GetEventStatus
        OpEventGetEventStatus_GetEventStatus_Event_VcEvMonMode: start-on-event=DemSatellite_0InternalBehavior/GetEventStatus, operation=Event_VcEvMonMode.GetEventStatus
        OpEventGetEventStatus_GetEventStatus_EvtInfo_INV_IAC_OC_SWP: start-on-event=DemSatellite_0InternalBehavior/GetEventStatus, operation=EvtInfo_INV_IAC_OC_SWP.GetEventStatus
        OpEventGetEventStatus_GetEventStatus_Event_INV_IAC_OC_SWP: start-on-event=DemSatellite_0InternalBehavior/GetEventStatus, operation=Event_INV_IAC_OC_SWP.GetEventStatus
        OpEventGetEventStatus_GetEventStatus_EvtInfo_INV_IMMO_AUTHFAIL: start-on-event=DemSatellite_0InternalBehavior/GetEventStatus, operation=EvtInfo_INV_IMMO_AUTHFAIL.GetEventStatus
        OpEventGetEventStatus_GetEventStatus_Event_INV_IMMO_AUTHFAIL: start-on-event=DemSatellite_0InternalBehavior/GetEventStatus, operation=Event_INV_IMMO_AUTHFAIL.GetEventStatus
        OpEventGetEventStatus_GetEventStatus_EvtInfo_PA_OpenCirc_FLT: start-on-event=DemSatellite_0InternalBehavior/GetEventStatus, operation=EvtInfo_PA_OpenCirc_FLT.GetEventStatus
        OpEventGetEventStatus_GetEventStatus_Event_PA_OpenCirc_FLT: start-on-event=DemSatellite_0InternalBehavior/GetEventStatus, operation=Event_PA_OpenCirc_FLT.GetEventStatus
        OpEventGetEventStatus_GetEventStatus_EvtInfo_INV_IAC_V_ELEC_HI: start-on-event=DemSatellite_0InternalBehavior/GetEventStatus, operation=EvtInfo_INV_IAC_V_ELEC_HI.GetEventStatus
        OpEventGetEventStatus_GetEventStatus_Event_INV_IAC_V_ELEC_HI: start-on-event=DemSatellite_0InternalBehavior/GetEventStatus, operation=Event_INV_IAC_V_ELEC_HI.GetEventStatus
        OpEventGetEventStatus_GetEventStatus_EvtInfo_VCEvEcmPropFr04Tioutd: start-on-event=DemSatellite_0InternalBehavior/GetEventStatus, operation=EvtInfo_VCEvEcmPropFr04Tioutd.GetEventStatus
        OpEventGetEventStatus_GetEventStatus_Event_VCEvEcmPropFr04Tioutd: start-on-event=DemSatellite_0InternalBehavior/GetEventStatus, operation=Event_VCEvEcmPropFr04Tioutd.GetEventStatus
        OpEventGetEventStatus_GetEventStatus_EvtInfo_VcEvMonTrqActPlaus: start-on-event=DemSatellite_0InternalBehavior/GetEventStatus, operation=EvtInfo_VcEvMonTrqActPlaus.GetEventStatus
        OpEventGetEventStatus_GetEventStatus_Event_VcEvMonTrqActPlaus: start-on-event=DemSatellite_0InternalBehavior/GetEventStatus, operation=Event_VcEvMonTrqActPlaus.GetEventStatus
        OpEventGetEventStatus_GetEventStatus_EvtInfo_VcEvMonTrqAct: start-on-event=DemSatellite_0InternalBehavior/GetEventStatus, operation=EvtInfo_VcEvMonTrqAct.GetEventStatus
        OpEventGetEventStatus_GetEventStatus_Event_VcEvMonTrqAct: start-on-event=DemSatellite_0InternalBehavior/GetEventStatus, operation=Event_VcEvMonTrqAct.GetEventStatus
        OpEventGetEventStatus_GetEventStatus_EvtInfo_INV_RSLVR_COS_ELEC_LO: start-on-event=DemSatellite_0InternalBehavior/GetEventStatus, operation=EvtInfo_INV_RSLVR_COS_ELEC_LO.GetEventStatus
        OpEventGetEventStatus_GetEventStatus_Event_INV_RSLVR_COS_ELEC_LO: start-on-event=DemSatellite_0InternalBehavior/GetEventStatus, operation=Event_INV_RSLVR_COS_ELEC_LO.GetEventStatus
        OpEventGetEventStatus_GetEventStatus_EvtInfo_INV_COOLT_INLET_TEMP_HWP: start-on-event=DemSatellite_0InternalBehavior/GetEventStatus, operation=EvtInfo_INV_COOLT_INLET_TEMP_HWP.GetEventStatus
        OpEventGetEventStatus_GetEventStatus_Event_INV_COOLT_INLET_TEMP_HWP: start-on-event=DemSatellite_0InternalBehavior/GetEventStatus, operation=Event_INV_COOLT_INLET_TEMP_HWP.GetEventStatus
        OpEventGetEventStatus_GetEventStatus_EvtInfo_VCEvEcmPropFr11Tioutd: start-on-event=DemSatellite_0InternalBehavior/GetEventStatus, operation=EvtInfo_VCEvEcmPropFr11Tioutd.GetEventStatus
        OpEventGetEventStatus_GetEventStatus_Event_VCEvEcmPropFr11Tioutd: start-on-event=DemSatellite_0InternalBehavior/GetEventStatus, operation=Event_VCEvEcmPropFr11Tioutd.GetEventStatus
        OpEventGetEventStatus_GetEventStatus_EvtInfo_PS_KL30_RNG_HI: start-on-event=DemSatellite_0InternalBehavior/GetEventStatus, operation=EvtInfo_PS_KL30_RNG_HI.GetEventStatus
        OpEventGetEventStatus_GetEventStatus_Event_PS_KL30_RNG_HI: start-on-event=DemSatellite_0InternalBehavior/GetEventStatus, operation=Event_PS_KL30_RNG_HI.GetEventStatus
        OpEventGetEventStatus_GetEventStatus_EvtInfo_INV_IAC_OC_HWP: start-on-event=DemSatellite_0InternalBehavior/GetEventStatus, operation=EvtInfo_INV_IAC_OC_HWP.GetEventStatus
        OpEventGetEventStatus_GetEventStatus_Event_INV_IAC_OC_HWP: start-on-event=DemSatellite_0InternalBehavior/GetEventStatus, operation=Event_INV_IAC_OC_HWP.GetEventStatus
        OpEventGetEventStatus_GetEventStatus_EvtInfo_INV_RSLVR_COS_RNG_HI: start-on-event=DemSatellite_0InternalBehavior/GetEventStatus, operation=EvtInfo_INV_RSLVR_COS_RNG_HI.GetEventStatus
        OpEventGetEventStatus_GetEventStatus_Event_INV_RSLVR_COS_RNG_HI: start-on-event=DemSatellite_0InternalBehavior/GetEventStatus, operation=Event_INV_RSLVR_COS_RNG_HI.GetEventStatus
        OpEventGetEventStatus_GetEventStatus_EvtInfo_INV_IAC_U_ELEC_HI: start-on-event=DemSatellite_0InternalBehavior/GetEventStatus, operation=EvtInfo_INV_IAC_U_ELEC_HI.GetEventStatus
        OpEventGetEventStatus_GetEventStatus_Event_INV_IAC_U_ELEC_HI: start-on-event=DemSatellite_0InternalBehavior/GetEventStatus, operation=Event_INV_IAC_U_ELEC_HI.GetEventStatus
        OpEventGetEventStatus_GetEventStatus_EvtInfo_INV_IAC_V_RNG_LO: start-on-event=DemSatellite_0InternalBehavior/GetEventStatus, operation=EvtInfo_INV_IAC_V_RNG_LO.GetEventStatus
        OpEventGetEventStatus_GetEventStatus_Event_INV_IAC_V_RNG_LO: start-on-event=DemSatellite_0InternalBehavior/GetEventStatus, operation=Event_INV_IAC_V_RNG_LO.GetEventStatus
        OpEventGetEventStatus_GetEventStatus_EvtInfo_INV_IAC_U_RNG_HI: start-on-event=DemSatellite_0InternalBehavior/GetEventStatus, operation=EvtInfo_INV_IAC_U_RNG_HI.GetEventStatus
        OpEventGetEventStatus_GetEventStatus_Event_INV_IAC_U_RNG_HI: start-on-event=DemSatellite_0InternalBehavior/GetEventStatus, operation=Event_INV_IAC_U_RNG_HI.GetEventStatus
        OpEventGetEventStatus_GetEventStatus_EvtInfo_VCEvEcmPropFr25Tioutd: start-on-event=DemSatellite_0InternalBehavior/GetEventStatus, operation=EvtInfo_VCEvEcmPropFr25Tioutd.GetEventStatus
        OpEventGetEventStatus_GetEventStatus_Event_VCEvEcmPropFr25Tioutd: start-on-event=DemSatellite_0InternalBehavior/GetEventStatus, operation=Event_VCEvEcmPropFr25Tioutd.GetEventStatus
        OpEventGetEventStatus_GetEventStatus_EvtInfo_INV_IGBT_TEMP_W_RNG_LO: start-on-event=DemSatellite_0InternalBehavior/GetEventStatus, operation=EvtInfo_INV_IGBT_TEMP_W_RNG_LO.GetEventStatus
        OpEventGetEventStatus_GetEventStatus_Event_INV_IGBT_TEMP_W_RNG_LO: start-on-event=DemSatellite_0InternalBehavior/GetEventStatus, operation=Event_INV_IGBT_TEMP_W_RNG_LO.GetEventStatus
        OpEventGetEventStatus_GetEventStatus_EvtInfo_PSnsr_RNG_NOK: start-on-event=DemSatellite_0InternalBehavior/GetEventStatus, operation=EvtInfo_PSnsr_RNG_NOK.GetEventStatus
        OpEventGetEventStatus_GetEventStatus_Event_PSnsr_RNG_NOK: start-on-event=DemSatellite_0InternalBehavior/GetEventStatus, operation=Event_PSnsr_RNG_NOK.GetEventStatus
        OpEventGetEventStatus_GetEventStatus_EvtInfo_INV_RSLVR_COS_RNG_NOK: start-on-event=DemSatellite_0InternalBehavior/GetEventStatus, operation=EvtInfo_INV_RSLVR_COS_RNG_NOK.GetEventStatus
        OpEventGetEventStatus_GetEventStatus_Event_INV_RSLVR_COS_RNG_NOK: start-on-event=DemSatellite_0InternalBehavior/GetEventStatus, operation=Event_INV_RSLVR_COS_RNG_NOK.GetEventStatus
        OpEventGetEventStatus_GetEventStatus_EvtInfo_PS_DRVB_Fault: start-on-event=DemSatellite_0InternalBehavior/GetEventStatus, operation=EvtInfo_PS_DRVB_Fault.GetEventStatus
        OpEventGetEventStatus_GetEventStatus_Event_PS_DRVB_Fault: start-on-event=DemSatellite_0InternalBehavior/GetEventStatus, operation=Event_PS_DRVB_Fault.GetEventStatus
        OpEventGetEventStatus_GetEventStatus_EvtInfo_INV_CU_TEMP1_RNG_NOK: start-on-event=DemSatellite_0InternalBehavior/GetEventStatus, operation=EvtInfo_INV_CU_TEMP1_RNG_NOK.GetEventStatus
        OpEventGetEventStatus_GetEventStatus_Event_INV_CU_TEMP1_RNG_NOK: start-on-event=DemSatellite_0InternalBehavior/GetEventStatus, operation=Event_INV_CU_TEMP1_RNG_NOK.GetEventStatus
        OpEventGetEventStatus_GetEventStatus_EvtInfo_VcEvCntr: start-on-event=DemSatellite_0InternalBehavior/GetEventStatus, operation=EvtInfo_VcEvCntr.GetEventStatus
        OpEventGetEventStatus_GetEventStatus_Event_VcEvCntr: start-on-event=DemSatellite_0InternalBehavior/GetEventStatus, operation=Event_VcEvCntr.GetEventStatus
        OpEventGetEventStatus_GetEventStatus_EvtInfo_INV_RSLVR_SIN_AMP: start-on-event=DemSatellite_0InternalBehavior/GetEventStatus, operation=EvtInfo_INV_RSLVR_SIN_AMP.GetEventStatus
        OpEventGetEventStatus_GetEventStatus_Event_INV_RSLVR_SIN_AMP: start-on-event=DemSatellite_0InternalBehavior/GetEventStatus, operation=Event_INV_RSLVR_SIN_AMP.GetEventStatus
        OpEventGetEventStatus_GetEventStatus_EvtInfo_INV_UHVDC_2_RNG_HI: start-on-event=DemSatellite_0InternalBehavior/GetEventStatus, operation=EvtInfo_INV_UHVDC_2_RNG_HI.GetEventStatus
        OpEventGetEventStatus_GetEventStatus_Event_INV_UHVDC_2_RNG_HI: start-on-event=DemSatellite_0InternalBehavior/GetEventStatus, operation=Event_INV_UHVDC_2_RNG_HI.GetEventStatus
        OpEventGetEventStatus_GetEventStatus_EvtInfo_INV_IGBT_TEMP_U_GRDT: start-on-event=DemSatellite_0InternalBehavior/GetEventStatus, operation=EvtInfo_INV_IGBT_TEMP_U_GRDT.GetEventStatus
        OpEventGetEventStatus_GetEventStatus_Event_INV_IGBT_TEMP_U_GRDT: start-on-event=DemSatellite_0InternalBehavior/GetEventStatus, operation=Event_INV_IGBT_TEMP_U_GRDT.GetEventStatus
        OpEventGetEventStatus_GetEventStatus_EvtInfo_MON_TQ_PLAUS_PWR_MDL: start-on-event=DemSatellite_0InternalBehavior/GetEventStatus, operation=EvtInfo_MON_TQ_PLAUS_PWR_MDL.GetEventStatus
        OpEventGetEventStatus_GetEventStatus_Event_MON_TQ_PLAUS_PWR_MDL: start-on-event=DemSatellite_0InternalBehavior/GetEventStatus, operation=Event_MON_TQ_PLAUS_PWR_MDL.GetEventStatus
        OpEventGetEventStatus_GetEventStatus_EvtInfo_INV_IGBT_TEMP_W_PLAUS: start-on-event=DemSatellite_0InternalBehavior/GetEventStatus, operation=EvtInfo_INV_IGBT_TEMP_W_PLAUS.GetEventStatus
        OpEventGetEventStatus_GetEventStatus_Event_INV_IGBT_TEMP_W_PLAUS: start-on-event=DemSatellite_0InternalBehavior/GetEventStatus, operation=Event_INV_IGBT_TEMP_W_PLAUS.GetEventStatus
        OpEventGetEventStatus_GetEventStatus_EvtInfo_PS_BLDC_UV_FLT: start-on-event=DemSatellite_0InternalBehavior/GetEventStatus, operation=EvtInfo_PS_BLDC_UV_FLT.GetEventStatus
        OpEventGetEventStatus_GetEventStatus_Event_PS_BLDC_UV_FLT: start-on-event=DemSatellite_0InternalBehavior/GetEventStatus, operation=Event_PS_BLDC_UV_FLT.GetEventStatus
        OpEventGetEventStatus_GetEventStatus_EvtInfo_INV_IAC_V_OFFS: start-on-event=DemSatellite_0InternalBehavior/GetEventStatus, operation=EvtInfo_INV_IAC_V_OFFS.GetEventStatus
        OpEventGetEventStatus_GetEventStatus_Event_INV_IAC_V_OFFS: start-on-event=DemSatellite_0InternalBehavior/GetEventStatus, operation=Event_INV_IAC_V_OFFS.GetEventStatus
        OpEventGetEventStatus_GetEventStatus_EvtInfo_INV_RSLVR_EXCT_FREQ_RNG_NOK: start-on-event=DemSatellite_0InternalBehavior/GetEventStatus, operation=EvtInfo_INV_RSLVR_EXCT_FREQ_RNG_NOK.GetEventStatus
        OpEventGetEventStatus_GetEventStatus_Event_INV_RSLVR_EXCT_FREQ_RNG_NOK: start-on-event=DemSatellite_0InternalBehavior/GetEventStatus, operation=Event_INV_RSLVR_EXCT_FREQ_RNG_NOK.GetEventStatus
        OpEventGetEventStatus_GetEventStatus_EvtInfo_PS_KL30_RNG_LO: start-on-event=DemSatellite_0InternalBehavior/GetEventStatus, operation=EvtInfo_PS_KL30_RNG_LO.GetEventStatus
        OpEventGetEventStatus_GetEventStatus_Event_PS_KL30_RNG_LO: start-on-event=DemSatellite_0InternalBehavior/GetEventStatus, operation=Event_PS_KL30_RNG_LO.GetEventStatus
        OpEventGetEventStatus_GetEventStatus_EvtInfo_INV_RSLVR_COS_RNG_LO: start-on-event=DemSatellite_0InternalBehavior/GetEventStatus, operation=EvtInfo_INV_RSLVR_COS_RNG_LO.GetEventStatus
        OpEventGetEventStatus_GetEventStatus_Event_INV_RSLVR_COS_RNG_LO: start-on-event=DemSatellite_0InternalBehavior/GetEventStatus, operation=Event_INV_RSLVR_COS_RNG_LO.GetEventStatus
        OpEventGetEventStatus_GetEventStatus_EvtInfo_PSnsr_ELE_FLT: start-on-event=DemSatellite_0InternalBehavior/GetEventStatus, operation=EvtInfo_PSnsr_ELE_FLT.GetEventStatus
        OpEventGetEventStatus_GetEventStatus_Event_PSnsr_ELE_FLT: start-on-event=DemSatellite_0InternalBehavior/GetEventStatus, operation=Event_PSnsr_ELE_FLT.GetEventStatus
        OpEventGetEventStatus_GetEventStatus_EvtInfo_INV_RSLVR_SIN_COS_PLAUS_AMP: start-on-event=DemSatellite_0InternalBehavior/GetEventStatus, operation=EvtInfo_INV_RSLVR_SIN_COS_PLAUS_AMP.GetEventStatus
        OpEventGetEventStatus_GetEventStatus_Event_INV_RSLVR_SIN_COS_PLAUS_AMP: start-on-event=DemSatellite_0InternalBehavior/GetEventStatus, operation=Event_INV_RSLVR_SIN_COS_PLAUS_AMP.GetEventStatus
        OpEventGetEventStatus_GetEventStatus_EvtInfo_INV_IAC_U_ELEC_LO: start-on-event=DemSatellite_0InternalBehavior/GetEventStatus, operation=EvtInfo_INV_IAC_U_ELEC_LO.GetEventStatus
        OpEventGetEventStatus_GetEventStatus_Event_INV_IAC_U_ELEC_LO: start-on-event=DemSatellite_0InternalBehavior/GetEventStatus, operation=Event_INV_IAC_U_ELEC_LO.GetEventStatus
        OpEventGetEventStatus_GetEventStatus_EvtInfo_INV_RSLVR_EXCT_ELEC_HI: start-on-event=DemSatellite_0InternalBehavior/GetEventStatus, operation=EvtInfo_INV_RSLVR_EXCT_ELEC_HI.GetEventStatus
        OpEventGetEventStatus_GetEventStatus_Event_INV_RSLVR_EXCT_ELEC_HI: start-on-event=DemSatellite_0InternalBehavior/GetEventStatus, operation=Event_INV_RSLVR_EXCT_ELEC_HI.GetEventStatus
        OpEventGetEventStatus_GetEventStatus_EvtInfo_INV_IAC_U_RNG_LO: start-on-event=DemSatellite_0InternalBehavior/GetEventStatus, operation=EvtInfo_INV_IAC_U_RNG_LO.GetEventStatus
        OpEventGetEventStatus_GetEventStatus_Event_INV_IAC_U_RNG_LO: start-on-event=DemSatellite_0InternalBehavior/GetEventStatus, operation=Event_INV_IAC_U_RNG_LO.GetEventStatus
        OpEventGetEventStatus_GetEventStatus_EvtInfo_INV_IAC_V_RNG_HI: start-on-event=DemSatellite_0InternalBehavior/GetEventStatus, operation=EvtInfo_INV_IAC_V_RNG_HI.GetEventStatus
        OpEventGetEventStatus_GetEventStatus_Event_INV_IAC_V_RNG_HI: start-on-event=DemSatellite_0InternalBehavior/GetEventStatus, operation=Event_INV_IAC_V_RNG_HI.GetEventStatus
        OpEventGetEventStatus_GetEventStatus_EvtInfo_INV_IGBT_TEMP_U_PLAUS: start-on-event=DemSatellite_0InternalBehavior/GetEventStatus, operation=EvtInfo_INV_IGBT_TEMP_U_PLAUS.GetEventStatus
        OpEventGetEventStatus_GetEventStatus_Event_INV_IGBT_TEMP_U_PLAUS: start-on-event=DemSatellite_0InternalBehavior/GetEventStatus, operation=Event_INV_IGBT_TEMP_U_PLAUS.GetEventStatus
        OpEventGetEventStatus_GetEventStatus_EvtInfo_INV_RSLVR_OFFS_DFT: start-on-event=DemSatellite_0InternalBehavior/GetEventStatus, operation=EvtInfo_INV_RSLVR_OFFS_DFT.GetEventStatus
        OpEventGetEventStatus_GetEventStatus_Event_INV_RSLVR_OFFS_DFT: start-on-event=DemSatellite_0InternalBehavior/GetEventStatus, operation=Event_INV_RSLVR_OFFS_DFT.GetEventStatus
        OpEventGetEventStatus_GetEventStatus_EvtInfo_Ga_MoveOverThd: start-on-event=DemSatellite_0InternalBehavior/GetEventStatus, operation=EvtInfo_Ga_MoveOverThd.GetEventStatus
        OpEventGetEventStatus_GetEventStatus_Event_Ga_MoveOverThd: start-on-event=DemSatellite_0InternalBehavior/GetEventStatus, operation=Event_Ga_MoveOverThd.GetEventStatus
        OpEventGetEventStatus_GetEventStatus_EvtInfo_VcEvMonIPH: start-on-event=DemSatellite_0InternalBehavior/GetEventStatus, operation=EvtInfo_VcEvMonIPH.GetEventStatus
        OpEventGetEventStatus_GetEventStatus_Event_VcEvMonIPH: start-on-event=DemSatellite_0InternalBehavior/GetEventStatus, operation=Event_VcEvMonIPH.GetEventStatus
        OpEventGetEventStatus_GetEventStatus_EvtInfo_INV_RSLVR_HW_FLT: start-on-event=DemSatellite_0InternalBehavior/GetEventStatus, operation=EvtInfo_INV_RSLVR_HW_FLT.GetEventStatus
        OpEventGetEventStatus_GetEventStatus_Event_INV_RSLVR_HW_FLT: start-on-event=DemSatellite_0InternalBehavior/GetEventStatus, operation=Event_INV_RSLVR_HW_FLT.GetEventStatus
        OpEventGetEventStatus_GetEventStatus_EvtInfo_INV_RSLVR_SIN_ELEC_LO: start-on-event=DemSatellite_0InternalBehavior/GetEventStatus, operation=EvtInfo_INV_RSLVR_SIN_ELEC_LO.GetEventStatus
        OpEventGetEventStatus_GetEventStatus_Event_INV_RSLVR_SIN_ELEC_LO: start-on-event=DemSatellite_0InternalBehavior/GetEventStatus, operation=Event_INV_RSLVR_SIN_ELEC_LO.GetEventStatus
        OpEventGetEventStatus_GetEventStatus_EvtInfo_INV_IAC_W_AMP: start-on-event=DemSatellite_0InternalBehavior/GetEventStatus, operation=EvtInfo_INV_IAC_W_AMP.GetEventStatus
        OpEventGetEventStatus_GetEventStatus_Event_INV_IAC_W_AMP: start-on-event=DemSatellite_0InternalBehavior/GetEventStatus, operation=Event_INV_IAC_W_AMP.GetEventStatus
        OpEventGetEventStatus_GetEventStatus_EvtInfo_VCC_OverVoltage: start-on-event=DemSatellite_0InternalBehavior/GetEventStatus, operation=EvtInfo_VCC_OverVoltage.GetEventStatus
        OpEventGetEventStatus_GetEventStatus_Event_VCC_OverVoltage: start-on-event=DemSatellite_0InternalBehavior/GetEventStatus, operation=Event_VCC_OverVoltage.GetEventStatus
        OpEventGetEventStatus_GetEventStatus_EvtInfo_PS_BLDC_OV_FLT: start-on-event=DemSatellite_0InternalBehavior/GetEventStatus, operation=EvtInfo_PS_BLDC_OV_FLT.GetEventStatus
        OpEventGetEventStatus_GetEventStatus_Event_PS_BLDC_OV_FLT: start-on-event=DemSatellite_0InternalBehavior/GetEventStatus, operation=Event_PS_BLDC_OV_FLT.GetEventStatus
        OpEventGetEventStatus_GetEventStatus_EvtInfo_AURIX_EEPROM_FLT: start-on-event=DemSatellite_0InternalBehavior/GetEventStatus, operation=EvtInfo_AURIX_EEPROM_FLT.GetEventStatus
        OpEventGetEventStatus_GetEventStatus_Event_AURIX_EEPROM_FLT: start-on-event=DemSatellite_0InternalBehavior/GetEventStatus, operation=Event_AURIX_EEPROM_FLT.GetEventStatus
        OpEventGetEventStatus_GetEventStatus_EvtInfo_FS_MONITIOR_ASC_FW_FLT: start-on-event=DemSatellite_0InternalBehavior/GetEventStatus, operation=EvtInfo_FS_MONITIOR_ASC_FW_FLT.GetEventStatus
        OpEventGetEventStatus_GetEventStatus_Event_FS_MONITIOR_ASC_FW_FLT: start-on-event=DemSatellite_0InternalBehavior/GetEventStatus, operation=Event_FS_MONITIOR_ASC_FW_FLT.GetEventStatus
        OpEventGetEventStatus_GetEventStatus_EvtInfo_VCEvSrsPropFr02Tioutd: start-on-event=DemSatellite_0InternalBehavior/GetEventStatus, operation=EvtInfo_VCEvSrsPropFr02Tioutd.GetEventStatus
        OpEventGetEventStatus_GetEventStatus_Event_VCEvSrsPropFr02Tioutd: start-on-event=DemSatellite_0InternalBehavior/GetEventStatus, operation=Event_VCEvSrsPropFr02Tioutd.GetEventStatus
        OpEventGetEventStatus_GetEventStatus_EvtInfo_VcEvMonErrMode: start-on-event=DemSatellite_0InternalBehavior/GetEventStatus, operation=EvtInfo_VcEvMonErrMode.GetEventStatus
        OpEventGetEventStatus_GetEventStatus_Event_VcEvMonErrMode: start-on-event=DemSatellite_0InternalBehavior/GetEventStatus, operation=Event_VcEvMonErrMode.GetEventStatus
        OpEventGetEventStatus_GetEventStatus_EvtInfo_AURIX_RST_MPL: start-on-event=DemSatellite_0InternalBehavior/GetEventStatus, operation=EvtInfo_AURIX_RST_MPL.GetEventStatus
        OpEventGetEventStatus_GetEventStatus_Event_AURIX_RST_MPL: start-on-event=DemSatellite_0InternalBehavior/GetEventStatus, operation=Event_AURIX_RST_MPL.GetEventStatus
        OpEventGetEventStatus_GetEventStatus_EvtInfo_VcEvNodeMisECM: start-on-event=DemSatellite_0InternalBehavior/GetEventStatus, operation=EvtInfo_VcEvNodeMisECM.GetEventStatus
        OpEventGetEventStatus_GetEventStatus_Event_VcEvNodeMisECM: start-on-event=DemSatellite_0InternalBehavior/GetEventStatus, operation=Event_VcEvNodeMisECM.GetEventStatus
        OpEventGetEventStatus_GetEventStatus_EvtInfo_PS_KL30_PLAUS: start-on-event=DemSatellite_0InternalBehavior/GetEventStatus, operation=EvtInfo_PS_KL30_PLAUS.GetEventStatus
        OpEventGetEventStatus_GetEventStatus_Event_PS_KL30_PLAUS: start-on-event=DemSatellite_0InternalBehavior/GetEventStatus, operation=Event_PS_KL30_PLAUS.GetEventStatus
        OpEventGetEventStatus_GetEventStatus_EvtInfo_INV_IAC_W_ELEC_HI: start-on-event=DemSatellite_0InternalBehavior/GetEventStatus, operation=EvtInfo_INV_IAC_W_ELEC_HI.GetEventStatus
        OpEventGetEventStatus_GetEventStatus_Event_INV_IAC_W_ELEC_HI: start-on-event=DemSatellite_0InternalBehavior/GetEventStatus, operation=Event_INV_IAC_W_ELEC_HI.GetEventStatus
        OpEventGetEventStatus_GetEventStatus_EvtInfo_VCEvVddmPropFr19Tioutd: start-on-event=DemSatellite_0InternalBehavior/GetEventStatus, operation=EvtInfo_VCEvVddmPropFr19Tioutd.GetEventStatus
        OpEventGetEventStatus_GetEventStatus_Event_VCEvVddmPropFr19Tioutd: start-on-event=DemSatellite_0InternalBehavior/GetEventStatus, operation=Event_VCEvVddmPropFr19Tioutd.GetEventStatus
        OpEventGetEventStatus_GetEventStatus_EvtInfo_INV_TEMP_DCHA_HW: start-on-event=DemSatellite_0InternalBehavior/GetEventStatus, operation=EvtInfo_INV_TEMP_DCHA_HW.GetEventStatus
        OpEventGetEventStatus_GetEventStatus_Event_INV_TEMP_DCHA_HW: start-on-event=DemSatellite_0InternalBehavior/GetEventStatus, operation=Event_INV_TEMP_DCHA_HW.GetEventStatus
        OpEventGetEventStatus_GetEventStatus_EvtInfo_VcEvPropCANGlbTiOutd: start-on-event=DemSatellite_0InternalBehavior/GetEventStatus, operation=EvtInfo_VcEvPropCANGlbTiOutd.GetEventStatus
        OpEventGetEventStatus_GetEventStatus_Event_VcEvPropCANGlbTiOutd: start-on-event=DemSatellite_0InternalBehavior/GetEventStatus, operation=Event_VcEvPropCANGlbTiOutd.GetEventStatus
        OpEventGetEventStatus_GetEventStatus_EvtInfo_INV_EM_STATOR_TEMP2_RNG_NOK: start-on-event=DemSatellite_0InternalBehavior/GetEventStatus, operation=EvtInfo_INV_EM_STATOR_TEMP2_RNG_NOK.GetEventStatus
        OpEventGetEventStatus_GetEventStatus_Event_INV_EM_STATOR_TEMP2_RNG_NOK: start-on-event=DemSatellite_0InternalBehavior/GetEventStatus, operation=Event_INV_EM_STATOR_TEMP2_RNG_NOK.GetEventStatus
        OpEventGetEventStatus_GetEventStatus_EvtInfo_INV_UHVDC_OV_HWP: start-on-event=DemSatellite_0InternalBehavior/GetEventStatus, operation=EvtInfo_INV_UHVDC_OV_HWP.GetEventStatus
        OpEventGetEventStatus_GetEventStatus_Event_INV_UHVDC_OV_HWP: start-on-event=DemSatellite_0InternalBehavior/GetEventStatus, operation=Event_INV_UHVDC_OV_HWP.GetEventStatus
        OpEventGetEventStatus_GetEventStatus_EvtInfo_Ga_FindEngleAngleFailed: start-on-event=DemSatellite_0InternalBehavior/GetEventStatus, operation=EvtInfo_Ga_FindEngleAngleFailed.GetEventStatus
        OpEventGetEventStatus_GetEventStatus_Event_Ga_FindEngleAngleFailed: start-on-event=DemSatellite_0InternalBehavior/GetEventStatus, operation=Event_Ga_FindEngleAngleFailed.GetEventStatus
        OpEventGetEventStatus_GetEventStatus_EvtInfo_VcEvMonTrqCmp: start-on-event=DemSatellite_0InternalBehavior/GetEventStatus, operation=EvtInfo_VcEvMonTrqCmp.GetEventStatus
        OpEventGetEventStatus_GetEventStatus_Event_VcEvMonTrqCmp: start-on-event=DemSatellite_0InternalBehavior/GetEventStatus, operation=Event_VcEvMonTrqCmp.GetEventStatus
        OpEventGetEventStatus_GetEventStatus_EvtInfo_INV_IGBT_TEMP_V_RNG_LO: start-on-event=DemSatellite_0InternalBehavior/GetEventStatus, operation=EvtInfo_INV_IGBT_TEMP_V_RNG_LO.GetEventStatus
        OpEventGetEventStatus_GetEventStatus_Event_INV_IGBT_TEMP_V_RNG_LO: start-on-event=DemSatellite_0InternalBehavior/GetEventStatus, operation=Event_INV_IGBT_TEMP_V_RNG_LO.GetEventStatus
        OpEventGetEventStatus_GetEventStatus_EvtInfo_INV_CONTROL_LIMIT: start-on-event=DemSatellite_0InternalBehavior/GetEventStatus, operation=EvtInfo_INV_CONTROL_LIMIT.GetEventStatus
        OpEventGetEventStatus_GetEventStatus_Event_INV_CONTROL_LIMIT: start-on-event=DemSatellite_0InternalBehavior/GetEventStatus, operation=Event_INV_CONTROL_LIMIT.GetEventStatus
        OpEventGetEventStatus_GetEventStatus_EvtInfo_COM_CarConfigErr: start-on-event=DemSatellite_0InternalBehavior/GetEventStatus, operation=EvtInfo_COM_CarConfigErr.GetEventStatus
        OpEventGetEventStatus_GetEventStatus_Event_COM_CarConfigErr: start-on-event=DemSatellite_0InternalBehavior/GetEventStatus, operation=Event_COM_CarConfigErr.GetEventStatus
        OpEventGetEventStatus_GetEventStatus_EvtInfo_VCEvEcmPropFr08Tioutd: start-on-event=DemSatellite_0InternalBehavior/GetEventStatus, operation=EvtInfo_VCEvEcmPropFr08Tioutd.GetEventStatus
        OpEventGetEventStatus_GetEventStatus_Event_VCEvEcmPropFr08Tioutd: start-on-event=DemSatellite_0InternalBehavior/GetEventStatus, operation=Event_VCEvEcmPropFr08Tioutd.GetEventStatus
        OpEventGetEventStatus_GetEventStatus_EvtInfo_CU_TEMP1_RNG_LO: start-on-event=DemSatellite_0InternalBehavior/GetEventStatus, operation=EvtInfo_CU_TEMP1_RNG_LO.GetEventStatus
        OpEventGetEventStatus_GetEventStatus_Event_CU_TEMP1_RNG_LO: start-on-event=DemSatellite_0InternalBehavior/GetEventStatus, operation=Event_CU_TEMP1_RNG_LO.GetEventStatus
        OpEventGetEventStatus_GetEventStatus_EvtInfo_INV_EM_STATOR_TEMP2_RNG_SWT: start-on-event=DemSatellite_0InternalBehavior/GetEventStatus, operation=EvtInfo_INV_EM_STATOR_TEMP2_RNG_SWT.GetEventStatus
        OpEventGetEventStatus_GetEventStatus_Event_INV_EM_STATOR_TEMP2_RNG_SWT: start-on-event=DemSatellite_0InternalBehavior/GetEventStatus, operation=Event_INV_EM_STATOR_TEMP2_RNG_SWT.GetEventStatus
        OpEventGetEventStatus_GetEventStatus_EvtInfo_GA_BLDC_POS_FLT: start-on-event=DemSatellite_0InternalBehavior/GetEventStatus, operation=EvtInfo_GA_BLDC_POS_FLT.GetEventStatus
        OpEventGetEventStatus_GetEventStatus_Event_GA_BLDC_POS_FLT: start-on-event=DemSatellite_0InternalBehavior/GetEventStatus, operation=Event_GA_BLDC_POS_FLT.GetEventStatus
        OpEventGetEventStatus_GetEventStatus_EvtInfo_PS_WhlSnsr_FLT: start-on-event=DemSatellite_0InternalBehavior/GetEventStatus, operation=EvtInfo_PS_WhlSnsr_FLT.GetEventStatus
        OpEventGetEventStatus_GetEventStatus_Event_PS_WhlSnsr_FLT: start-on-event=DemSatellite_0InternalBehavior/GetEventStatus, operation=Event_PS_WhlSnsr_FLT.GetEventStatus
        OpEventGetEventStatus_GetEventStatus_EvtInfo_INV_EM_STATOR_TEMP_RNG_LO: start-on-event=DemSatellite_0InternalBehavior/GetEventStatus, operation=EvtInfo_INV_EM_STATOR_TEMP_RNG_LO.GetEventStatus
        OpEventGetEventStatus_GetEventStatus_Event_INV_EM_STATOR_TEMP_RNG_LO: start-on-event=DemSatellite_0InternalBehavior/GetEventStatus, operation=Event_INV_EM_STATOR_TEMP_RNG_LO.GetEventStatus
        OpEventGetEventStatus_GetEventStatus_EvtInfo_INV_RSLVR_SIN_ELEC_HI: start-on-event=DemSatellite_0InternalBehavior/GetEventStatus, operation=EvtInfo_INV_RSLVR_SIN_ELEC_HI.GetEventStatus
        OpEventGetEventStatus_GetEventStatus_Event_INV_RSLVR_SIN_ELEC_HI: start-on-event=DemSatellite_0InternalBehavior/GetEventStatus, operation=Event_INV_RSLVR_SIN_ELEC_HI.GetEventStatus
        OpEventGetEventStatus_GetEventStatus_EvtInfo_INV_RSLVR_SIN_COS_PLAUS: start-on-event=DemSatellite_0InternalBehavior/GetEventStatus, operation=EvtInfo_INV_RSLVR_SIN_COS_PLAUS.GetEventStatus
        OpEventGetEventStatus_GetEventStatus_Event_INV_RSLVR_SIN_COS_PLAUS: start-on-event=DemSatellite_0InternalBehavior/GetEventStatus, operation=Event_INV_RSLVR_SIN_COS_PLAUS.GetEventStatus
        OpEventGetEventStatus_GetEventStatus_EvtInfo_INV_RSLVR_COS_AMP: start-on-event=DemSatellite_0InternalBehavior/GetEventStatus, operation=EvtInfo_INV_RSLVR_COS_AMP.GetEventStatus
        OpEventGetEventStatus_GetEventStatus_Event_INV_RSLVR_COS_AMP: start-on-event=DemSatellite_0InternalBehavior/GetEventStatus, operation=Event_INV_RSLVR_COS_AMP.GetEventStatus
        OpEventGetEventStatus_GetEventStatus_EvtInfo_INV_GATE_DRVR_BOT_HWP: start-on-event=DemSatellite_0InternalBehavior/GetEventStatus, operation=EvtInfo_INV_GATE_DRVR_BOT_HWP.GetEventStatus
        OpEventGetEventStatus_GetEventStatus_Event_INV_GATE_DRVR_BOT_HWP: start-on-event=DemSatellite_0InternalBehavior/GetEventStatus, operation=Event_INV_GATE_DRVR_BOT_HWP.GetEventStatus
        OpEventGetEventStatus_GetEventStatus_EvtInfo_Eg_HallVolWrong: start-on-event=DemSatellite_0InternalBehavior/GetEventStatus, operation=EvtInfo_Eg_HallVolWrong.GetEventStatus
        OpEventGetEventStatus_GetEventStatus_Event_Eg_HallVolWrong: start-on-event=DemSatellite_0InternalBehavior/GetEventStatus, operation=Event_Eg_HallVolWrong.GetEventStatus
        OpEventGetEventStatus_GetEventStatus_EvtInfo_INV_RSLVR_EXCT_RNG_NOK: start-on-event=DemSatellite_0InternalBehavior/GetEventStatus, operation=EvtInfo_INV_RSLVR_EXCT_RNG_NOK.GetEventStatus
        OpEventGetEventStatus_GetEventStatus_Event_INV_RSLVR_EXCT_RNG_NOK: start-on-event=DemSatellite_0InternalBehavior/GetEventStatus, operation=Event_INV_RSLVR_EXCT_RNG_NOK.GetEventStatus
        OpEventGetEventStatus_GetEventStatus_EvtInfo_PA_OpenCirc: start-on-event=DemSatellite_0InternalBehavior/GetEventStatus, operation=EvtInfo_PA_OpenCirc.GetEventStatus
        OpEventGetEventStatus_GetEventStatus_Event_PA_OpenCirc: start-on-event=DemSatellite_0InternalBehavior/GetEventStatus, operation=Event_PA_OpenCirc.GetEventStatus
        OpEventGetEventStatus_GetEventStatus_EvtInfo_INV_RSLVR_COS_ELEC_HI: start-on-event=DemSatellite_0InternalBehavior/GetEventStatus, operation=EvtInfo_INV_RSLVR_COS_ELEC_HI.GetEventStatus
        OpEventGetEventStatus_GetEventStatus_Event_INV_RSLVR_COS_ELEC_HI: start-on-event=DemSatellite_0InternalBehavior/GetEventStatus, operation=Event_INV_RSLVR_COS_ELEC_HI.GetEventStatus
        OpEventGetEventStatus_GetEventStatus_EvtInfo_VcEvCntrHvSysRlySts: start-on-event=DemSatellite_0InternalBehavior/GetEventStatus, operation=EvtInfo_VcEvCntrHvSysRlySts.GetEventStatus
        OpEventGetEventStatus_GetEventStatus_Event_VcEvCntrHvSysRlySts: start-on-event=DemSatellite_0InternalBehavior/GetEventStatus, operation=Event_VcEvCntrHvSysRlySts.GetEventStatus
        OpEventGetEventStatus_GetEventStatus_EvtInfo_CRASH_DTC: start-on-event=DemSatellite_0InternalBehavior/GetEventStatus, operation=EvtInfo_CRASH_DTC.GetEventStatus
        OpEventGetEventStatus_GetEventStatus_Event_CRASH_DTC: start-on-event=DemSatellite_0InternalBehavior/GetEventStatus, operation=Event_CRASH_DTC.GetEventStatus
        OpEventGetEventStatus_GetEventStatus_EvtInfo_INV_IGBT_TEMP_W_RNG_HI: start-on-event=DemSatellite_0InternalBehavior/GetEventStatus, operation=EvtInfo_INV_IGBT_TEMP_W_RNG_HI.GetEventStatus
        OpEventGetEventStatus_GetEventStatus_Event_INV_IGBT_TEMP_W_RNG_HI: start-on-event=DemSatellite_0InternalBehavior/GetEventStatus, operation=Event_INV_IGBT_TEMP_W_RNG_HI.GetEventStatus
        OpEventGetEventStatus_GetEventStatus_EvtInfo_VCEvBecmPropFr02Tioutd: start-on-event=DemSatellite_0InternalBehavior/GetEventStatus, operation=EvtInfo_VCEvBecmPropFr02Tioutd.GetEventStatus
        OpEventGetEventStatus_GetEventStatus_Event_VCEvBecmPropFr02Tioutd: start-on-event=DemSatellite_0InternalBehavior/GetEventStatus, operation=Event_VCEvBecmPropFr02Tioutd.GetEventStatus
        OpEventGetEventStatus_GetEventStatus_EvtInfo_INV_IGBT_TEMP_W_GRDT: start-on-event=DemSatellite_0InternalBehavior/GetEventStatus, operation=EvtInfo_INV_IGBT_TEMP_W_GRDT.GetEventStatus
        OpEventGetEventStatus_GetEventStatus_Event_INV_IGBT_TEMP_W_GRDT: start-on-event=DemSatellite_0InternalBehavior/GetEventStatus, operation=Event_INV_IGBT_TEMP_W_GRDT.GetEventStatus
        OpEventGetEventStatus_GetEventStatus_EvtInfo_EXT_UC_SPI_FLT: start-on-event=DemSatellite_0InternalBehavior/GetEventStatus, operation=EvtInfo_EXT_UC_SPI_FLT.GetEventStatus
        OpEventGetEventStatus_GetEventStatus_Event_EXT_UC_SPI_FLT: start-on-event=DemSatellite_0InternalBehavior/GetEventStatus, operation=Event_EXT_UC_SPI_FLT.GetEventStatus
        OpEventGetEventStatus_GetEventStatus_EvtInfo_INV_IAC_V_ELEC_HWP_001: start-on-event=DemSatellite_0InternalBehavior/GetEventStatus, operation=EvtInfo_INV_IAC_V_ELEC_HWP_001.GetEventStatus
        OpEventGetEventStatus_GetEventStatus_Event_INV_IAC_V_ELEC_HWP_001: start-on-event=DemSatellite_0InternalBehavior/GetEventStatus, operation=Event_INV_IAC_V_ELEC_HWP_001.GetEventStatus
        OpEventGetEventStatus_GetEventStatus_EvtInfo_VcEvChkSumWhlMotSysTqAllwd: start-on-event=DemSatellite_0InternalBehavior/GetEventStatus, operation=EvtInfo_VcEvChkSumWhlMotSysTqAllwd.GetEventStatus
        OpEventGetEventStatus_GetEventStatus_Event_VcEvChkSumWhlMotSysTqAllwd: start-on-event=DemSatellite_0InternalBehavior/GetEventStatus, operation=Event_VcEvChkSumWhlMotSysTqAllwd.GetEventStatus
        OpEventGetEventStatus_GetEventStatus_EvtInfo_FS_MONITIOR_ASC_FLT: start-on-event=DemSatellite_0InternalBehavior/GetEventStatus, operation=EvtInfo_FS_MONITIOR_ASC_FLT.GetEventStatus
        OpEventGetEventStatus_GetEventStatus_Event_FS_MONITIOR_ASC_FLT: start-on-event=DemSatellite_0InternalBehavior/GetEventStatus, operation=Event_FS_MONITIOR_ASC_FLT.GetEventStatus
        OpEventGetEventStatus_GetEventStatus_EvtInfo_INV_IAC_V_AMP: start-on-event=DemSatellite_0InternalBehavior/GetEventStatus, operation=EvtInfo_INV_IAC_V_AMP.GetEventStatus
        OpEventGetEventStatus_GetEventStatus_Event_INV_IAC_V_AMP: start-on-event=DemSatellite_0InternalBehavior/GetEventStatus, operation=Event_INV_IAC_V_AMP.GetEventStatus
        OpEventGetEventStatus_GetEventStatus_EvtInfo_INV_IAC_W_ELEC_LO: start-on-event=DemSatellite_0InternalBehavior/GetEventStatus, operation=EvtInfo_INV_IAC_W_ELEC_LO.GetEventStatus
        OpEventGetEventStatus_GetEventStatus_Event_INV_IAC_W_ELEC_LO: start-on-event=DemSatellite_0InternalBehavior/GetEventStatus, operation=Event_INV_IAC_W_ELEC_LO.GetEventStatus
        OpEventGetEventStatus_GetEventStatus_EvtInfo_VCEvVddmPropFr08Tioutd_001: start-on-event=DemSatellite_0InternalBehavior/GetEventStatus, operation=EvtInfo_VCEvVddmPropFr08Tioutd_001.GetEventStatus
        OpEventGetEventStatus_GetEventStatus_Event_VCEvVddmPropFr08Tioutd_001: start-on-event=DemSatellite_0InternalBehavior/GetEventStatus, operation=Event_VCEvVddmPropFr08Tioutd_001.GetEventStatus
        OpEventGetEventStatus_GetEventStatus_EvtInfo_PS_P12_RES_FLT: start-on-event=DemSatellite_0InternalBehavior/GetEventStatus, operation=EvtInfo_PS_P12_RES_FLT.GetEventStatus
        OpEventGetEventStatus_GetEventStatus_Event_PS_P12_RES_FLT: start-on-event=DemSatellite_0InternalBehavior/GetEventStatus, operation=Event_PS_P12_RES_FLT.GetEventStatus
        OpEventGetEventStatus_GetEventStatus_EvtInfo_INV_RSLVR_SIN_RNG_LO: start-on-event=DemSatellite_0InternalBehavior/GetEventStatus, operation=EvtInfo_INV_RSLVR_SIN_RNG_LO.GetEventStatus
        OpEventGetEventStatus_GetEventStatus_Event_INV_RSLVR_SIN_RNG_LO: start-on-event=DemSatellite_0InternalBehavior/GetEventStatus, operation=Event_INV_RSLVR_SIN_RNG_LO.GetEventStatus
        OpEventGetEventStatus_GetEventStatus_EvtInfo_CU_TEMP_HW_FLT: start-on-event=DemSatellite_0InternalBehavior/GetEventStatus, operation=EvtInfo_CU_TEMP_HW_FLT.GetEventStatus
        OpEventGetEventStatus_GetEventStatus_Event_CU_TEMP_HW_FLT: start-on-event=DemSatellite_0InternalBehavior/GetEventStatus, operation=Event_CU_TEMP_HW_FLT.GetEventStatus
        OpEventGetEventStatus_GetEventStatus_EvtInfo_VCEvEcmPropFr02MgmFr00Tioutd: start-on-event=DemSatellite_0InternalBehavior/GetEventStatus, operation=EvtInfo_VCEvEcmPropFr02MgmFr00Tioutd.GetEventStatus
        OpEventGetEventStatus_GetEventStatus_Event_VCEvEcmPropFr02MgmFr00Tioutd: start-on-event=DemSatellite_0InternalBehavior/GetEventStatus, operation=Event_VCEvEcmPropFr02MgmFr00Tioutd.GetEventStatus
        OpEventGetEventStatus_GetEventStatus_EvtInfo_PS_KL15_RNG_HI: start-on-event=DemSatellite_0InternalBehavior/GetEventStatus, operation=EvtInfo_PS_KL15_RNG_HI.GetEventStatus
        OpEventGetEventStatus_GetEventStatus_Event_PS_KL15_RNG_HI: start-on-event=DemSatellite_0InternalBehavior/GetEventStatus, operation=Event_PS_KL15_RNG_HI.GetEventStatus
        OpEventGetEventStatus_GetEventStatus_EvtInfo_VCEvVddmPropFr17Tioutd: start-on-event=DemSatellite_0InternalBehavior/GetEventStatus, operation=EvtInfo_VCEvVddmPropFr17Tioutd.GetEventStatus
        OpEventGetEventStatus_GetEventStatus_Event_VCEvVddmPropFr17Tioutd: start-on-event=DemSatellite_0InternalBehavior/GetEventStatus, operation=Event_VCEvVddmPropFr17Tioutd.GetEventStatus
        OpEventGetEventStatus_GetEventStatus_EvtInfo_VcEvChkSumCrashStsSafe: start-on-event=DemSatellite_0InternalBehavior/GetEventStatus, operation=EvtInfo_VcEvChkSumCrashStsSafe.GetEventStatus
        OpEventGetEventStatus_GetEventStatus_Event_VcEvChkSumCrashStsSafe: start-on-event=DemSatellite_0InternalBehavior/GetEventStatus, operation=Event_VcEvChkSumCrashStsSafe.GetEventStatus
        OpEventGetEventStatus_GetEventStatus_EvtInfo_DiagC_ClutchService: start-on-event=DemSatellite_0InternalBehavior/GetEventStatus, operation=EvtInfo_DiagC_ClutchService.GetEventStatus
        OpEventGetEventStatus_GetEventStatus_Event_DiagC_ClutchService: start-on-event=DemSatellite_0InternalBehavior/GetEventStatus, operation=Event_DiagC_ClutchService.GetEventStatus
        OpEventGetEventStatus_GetEventStatus_EvtInfo_INV_EM_STATOR_TEMP_RNG_HI: start-on-event=DemSatellite_0InternalBehavior/GetEventStatus, operation=EvtInfo_INV_EM_STATOR_TEMP_RNG_HI.GetEventStatus
        OpEventGetEventStatus_GetEventStatus_Event_INV_EM_STATOR_TEMP_RNG_HI: start-on-event=DemSatellite_0InternalBehavior/GetEventStatus, operation=Event_INV_EM_STATOR_TEMP_RNG_HI.GetEventStatus
        OpEventGetEventStatus_GetEventStatus_EvtInfo_INV_RSLVR_OFFS_OUT_RANG: start-on-event=DemSatellite_0InternalBehavior/GetEventStatus, operation=EvtInfo_INV_RSLVR_OFFS_OUT_RANG.GetEventStatus
        OpEventGetEventStatus_GetEventStatus_Event_INV_RSLVR_OFFS_OUT_RANG: start-on-event=DemSatellite_0InternalBehavior/GetEventStatus, operation=Event_INV_RSLVR_OFFS_OUT_RANG.GetEventStatus
        OpEventGetEventStatus_GetEventStatus_EvtInfo_INV_EM_STATOR_TEMP2_RNG_LO: start-on-event=DemSatellite_0InternalBehavior/GetEventStatus, operation=EvtInfo_INV_EM_STATOR_TEMP2_RNG_LO.GetEventStatus
        OpEventGetEventStatus_GetEventStatus_Event_INV_EM_STATOR_TEMP2_RNG_LO: start-on-event=DemSatellite_0InternalBehavior/GetEventStatus, operation=Event_INV_EM_STATOR_TEMP2_RNG_LO.GetEventStatus
        OpEventGetEventStatus_GetEventStatus_EvtInfo_VcEvMonISAR: start-on-event=DemSatellite_0InternalBehavior/GetEventStatus, operation=EvtInfo_VcEvMonISAR.GetEventStatus
        OpEventGetEventStatus_GetEventStatus_Event_VcEvMonISAR: start-on-event=DemSatellite_0InternalBehavior/GetEventStatus, operation=Event_VcEvMonISAR.GetEventStatus
        OpEventGetEventStatus_GetEventStatus_EvtInfo_GA_BLDC_FLT: start-on-event=DemSatellite_0InternalBehavior/GetEventStatus, operation=EvtInfo_GA_BLDC_FLT.GetEventStatus
        OpEventGetEventStatus_GetEventStatus_Event_GA_BLDC_FLT: start-on-event=DemSatellite_0InternalBehavior/GetEventStatus, operation=Event_GA_BLDC_FLT.GetEventStatus
        OpEventGetEventStatus_GetEventStatus_EvtInfo_INV_RSLVR_EXCT_ELEC_OPEN: start-on-event=DemSatellite_0InternalBehavior/GetEventStatus, operation=EvtInfo_INV_RSLVR_EXCT_ELEC_OPEN.GetEventStatus
        OpEventGetEventStatus_GetEventStatus_Event_INV_RSLVR_EXCT_ELEC_OPEN: start-on-event=DemSatellite_0InternalBehavior/GetEventStatus, operation=Event_INV_RSLVR_EXCT_ELEC_OPEN.GetEventStatus
        OpEventGetEventStatus_GetEventStatus_EvtInfo_INV_RSLVR_EXCT_PLAUS: start-on-event=DemSatellite_0InternalBehavior/GetEventStatus, operation=EvtInfo_INV_RSLVR_EXCT_PLAUS.GetEventStatus
        OpEventGetEventStatus_GetEventStatus_Event_INV_RSLVR_EXCT_PLAUS: start-on-event=DemSatellite_0InternalBehavior/GetEventStatus, operation=Event_INV_RSLVR_EXCT_PLAUS.GetEventStatus
        OpEventGetEventStatus_GetEventStatus_EvtInfo_PS_P15_U_FLT: start-on-event=DemSatellite_0InternalBehavior/GetEventStatus, operation=EvtInfo_PS_P15_U_FLT.GetEventStatus
        OpEventGetEventStatus_GetEventStatus_Event_PS_P15_U_FLT: start-on-event=DemSatellite_0InternalBehavior/GetEventStatus, operation=Event_PS_P15_U_FLT.GetEventStatus
        OpEventGetEventStatus_GetEventStatus_EvtInfo_INV_EM_STATOR_TEMP_RNG_SWT: start-on-event=DemSatellite_0InternalBehavior/GetEventStatus, operation=EvtInfo_INV_EM_STATOR_TEMP_RNG_SWT.GetEventStatus
        OpEventGetEventStatus_GetEventStatus_Event_INV_EM_STATOR_TEMP_RNG_SWT: start-on-event=DemSatellite_0InternalBehavior/GetEventStatus, operation=Event_INV_EM_STATOR_TEMP_RNG_SWT.GetEventStatus
        OpEventGetEventStatus_GetEventStatus_EvtInfo_INV_UHVDC_OV_SWP: start-on-event=DemSatellite_0InternalBehavior/GetEventStatus, operation=EvtInfo_INV_UHVDC_OV_SWP.GetEventStatus
        OpEventGetEventStatus_GetEventStatus_Event_INV_UHVDC_OV_SWP: start-on-event=DemSatellite_0InternalBehavior/GetEventStatus, operation=Event_INV_UHVDC_OV_SWP.GetEventStatus
        OpEventGetEventStatus_GetEventStatus_EvtInfo_AURIX_HW_FLT: start-on-event=DemSatellite_0InternalBehavior/GetEventStatus, operation=EvtInfo_AURIX_HW_FLT.GetEventStatus
        OpEventGetEventStatus_GetEventStatus_Event_AURIX_HW_FLT: start-on-event=DemSatellite_0InternalBehavior/GetEventStatus, operation=Event_AURIX_HW_FLT.GetEventStatus
        OpEventGetEventStatus_GetEventStatus_EvtInfo_INV_GATE_DRVR_TOP_HWP: start-on-event=DemSatellite_0InternalBehavior/GetEventStatus, operation=EvtInfo_INV_GATE_DRVR_TOP_HWP.GetEventStatus
        OpEventGetEventStatus_GetEventStatus_Event_INV_GATE_DRVR_TOP_HWP: start-on-event=DemSatellite_0InternalBehavior/GetEventStatus, operation=Event_INV_GATE_DRVR_TOP_HWP.GetEventStatus
        OpEventGetEventStatus_GetEventStatus_EvtInfo_INV_ACTV_DCHA_HW: start-on-event=DemSatellite_0InternalBehavior/GetEventStatus, operation=EvtInfo_INV_ACTV_DCHA_HW.GetEventStatus
        OpEventGetEventStatus_GetEventStatus_Event_INV_ACTV_DCHA_HW: start-on-event=DemSatellite_0InternalBehavior/GetEventStatus, operation=Event_INV_ACTV_DCHA_HW.GetEventStatus
        OpEventGetEventStatus_GetEventStatus_EvtInfo_INV_IGBT_TEMP_HWP: start-on-event=DemSatellite_0InternalBehavior/GetEventStatus, operation=EvtInfo_INV_IGBT_TEMP_HWP.GetEventStatus
        OpEventGetEventStatus_GetEventStatus_Event_INV_IGBT_TEMP_HWP: start-on-event=DemSatellite_0InternalBehavior/GetEventStatus, operation=Event_INV_IGBT_TEMP_HWP.GetEventStatus
        OpEventGetEventStatus_GetEventStatus_EvtInfo_INV_RSLVR_SIN_ELEC_FLT: start-on-event=DemSatellite_0InternalBehavior/GetEventStatus, operation=EvtInfo_INV_RSLVR_SIN_ELEC_FLT.GetEventStatus
        OpEventGetEventStatus_GetEventStatus_Event_INV_RSLVR_SIN_ELEC_FLT: start-on-event=DemSatellite_0InternalBehavior/GetEventStatus, operation=Event_INV_RSLVR_SIN_ELEC_FLT.GetEventStatus
        OpEventGetEventStatus_GetEventStatus_EvtInfo_CU_TEMP2_RNG_HI: start-on-event=DemSatellite_0InternalBehavior/GetEventStatus, operation=EvtInfo_CU_TEMP2_RNG_HI.GetEventStatus
        OpEventGetEventStatus_GetEventStatus_Event_CU_TEMP2_RNG_HI: start-on-event=DemSatellite_0InternalBehavior/GetEventStatus, operation=Event_CU_TEMP2_RNG_HI.GetEventStatus
        OpEventGetEventStatus_GetEventStatus_EvtInfo_INV_IAC_PHA_LOSS_MPL: start-on-event=DemSatellite_0InternalBehavior/GetEventStatus, operation=EvtInfo_INV_IAC_PHA_LOSS_MPL.GetEventStatus
        OpEventGetEventStatus_GetEventStatus_Event_INV_IAC_PHA_LOSS_MPL: start-on-event=DemSatellite_0InternalBehavior/GetEventStatus, operation=Event_INV_IAC_PHA_LOSS_MPL.GetEventStatus
        OpEventGetEventStatus_GetEventStatus_EvtInfo_INV_IAC_U_AMP: start-on-event=DemSatellite_0InternalBehavior/GetEventStatus, operation=EvtInfo_INV_IAC_U_AMP.GetEventStatus
        OpEventGetEventStatus_GetEventStatus_Event_INV_IAC_U_AMP: start-on-event=DemSatellite_0InternalBehavior/GetEventStatus, operation=Event_INV_IAC_U_AMP.GetEventStatus
        OpEventGetEventStatus_GetEventStatus_EvtInfo_PSnsr_GRADT_Flt: start-on-event=DemSatellite_0InternalBehavior/GetEventStatus, operation=EvtInfo_PSnsr_GRADT_Flt.GetEventStatus
        OpEventGetEventStatus_GetEventStatus_Event_PSnsr_GRADT_Flt: start-on-event=DemSatellite_0InternalBehavior/GetEventStatus, operation=Event_PSnsr_GRADT_Flt.GetEventStatus
        OpEventGetEventStatus_GetEventStatus_EvtInfo_AURIX_WATHDOG_FLT: start-on-event=DemSatellite_0InternalBehavior/GetEventStatus, operation=EvtInfo_AURIX_WATHDOG_FLT.GetEventStatus
        OpEventGetEventStatus_GetEventStatus_Event_AURIX_WATHDOG_FLT: start-on-event=DemSatellite_0InternalBehavior/GetEventStatus, operation=Event_AURIX_WATHDOG_FLT.GetEventStatus
        OpEventGetEventStatus_GetEventStatus_EvtInfo_VcEvNodeMisBECM: start-on-event=DemSatellite_0InternalBehavior/GetEventStatus, operation=EvtInfo_VcEvNodeMisBECM.GetEventStatus
        OpEventGetEventStatus_GetEventStatus_Event_VcEvNodeMisBECM: start-on-event=DemSatellite_0InternalBehavior/GetEventStatus, operation=Event_VcEvNodeMisBECM.GetEventStatus
        OpEventGetEventStatus_GetEventStatus_EvtInfo_INV_UHVDC_UV_HWP: start-on-event=DemSatellite_0InternalBehavior/GetEventStatus, operation=EvtInfo_INV_UHVDC_UV_HWP.GetEventStatus
        OpEventGetEventStatus_GetEventStatus_Event_INV_UHVDC_UV_HWP: start-on-event=DemSatellite_0InternalBehavior/GetEventStatus, operation=Event_INV_UHVDC_UV_HWP.GetEventStatus
        OpEventGetEventStatus_GetEventStatus_EvtInfo_VcEvMonESpd: start-on-event=DemSatellite_0InternalBehavior/GetEventStatus, operation=EvtInfo_VcEvMonESpd.GetEventStatus
        OpEventGetEventStatus_GetEventStatus_Event_VcEvMonESpd: start-on-event=DemSatellite_0InternalBehavior/GetEventStatus, operation=Event_VcEvMonESpd.GetEventStatus
        OpEventGetEventStatus_GetEventStatus_EvtInfo_COM_NotConfig: start-on-event=DemSatellite_0InternalBehavior/GetEventStatus, operation=EvtInfo_COM_NotConfig.GetEventStatus
        OpEventGetEventStatus_GetEventStatus_Event_COM_NotConfig: start-on-event=DemSatellite_0InternalBehavior/GetEventStatus, operation=Event_COM_NotConfig.GetEventStatus
        OpEventGetEventStatus_GetEventStatus_EvtInfo_INV_RSLVR_SIN_RNG_HI: start-on-event=DemSatellite_0InternalBehavior/GetEventStatus, operation=EvtInfo_INV_RSLVR_SIN_RNG_HI.GetEventStatus
        OpEventGetEventStatus_GetEventStatus_Event_INV_RSLVR_SIN_RNG_HI: start-on-event=DemSatellite_0InternalBehavior/GetEventStatus, operation=Event_INV_RSLVR_SIN_RNG_HI.GetEventStatus
        OpEventGetEventStatus_GetEventStatus_EvtInfo_INV_IGBT_TEMP_U_RNG_HI: start-on-event=DemSatellite_0InternalBehavior/GetEventStatus, operation=EvtInfo_INV_IGBT_TEMP_U_RNG_HI.GetEventStatus
        OpEventGetEventStatus_GetEventStatus_Event_INV_IGBT_TEMP_U_RNG_HI: start-on-event=DemSatellite_0InternalBehavior/GetEventStatus, operation=Event_INV_IGBT_TEMP_U_RNG_HI.GetEventStatus
        OpEventGetEventStatus_GetEventStatus_EvtInfo_VcEvMonMode_001: start-on-event=DemSatellite_0InternalBehavior/GetEventStatus, operation=EvtInfo_VcEvMonMode_001.GetEventStatus
        OpEventGetEventStatus_GetEventStatus_Event_VcEvMonMode_001: start-on-event=DemSatellite_0InternalBehavior/GetEventStatus, operation=Event_VcEvMonMode_001.GetEventStatus
        OpEventGetEventStatus_GetEventStatus_EvtInfo_PA_ACTION_FLT: start-on-event=DemSatellite_0InternalBehavior/GetEventStatus, operation=EvtInfo_PA_ACTION_FLT.GetEventStatus
        OpEventGetEventStatus_GetEventStatus_Event_PA_ACTION_FLT: start-on-event=DemSatellite_0InternalBehavior/GetEventStatus, operation=Event_PA_ACTION_FLT.GetEventStatus
        OpEventGetEventStatus_GetEventStatus_EvtInfo_INV_IAC_V_ELEC_HWP: start-on-event=DemSatellite_0InternalBehavior/GetEventStatus, operation=EvtInfo_INV_IAC_V_ELEC_HWP.GetEventStatus
        OpEventGetEventStatus_GetEventStatus_Event_INV_IAC_V_ELEC_HWP: start-on-event=DemSatellite_0InternalBehavior/GetEventStatus, operation=Event_INV_IAC_V_ELEC_HWP.GetEventStatus
        OpEventGetEventStatus_GetEventStatus_EvtInfo_CU_TEMP_HW_FLT_001: start-on-event=DemSatellite_0InternalBehavior/GetEventStatus, operation=EvtInfo_CU_TEMP_HW_FLT_001.GetEventStatus
        OpEventGetEventStatus_GetEventStatus_Event_CU_TEMP_HW_FLT_001: start-on-event=DemSatellite_0InternalBehavior/GetEventStatus, operation=Event_CU_TEMP_HW_FLT_001.GetEventStatus
        OpEventGetEventStatus_GetEventStatus_EvtInfo_VCC_UnderVoltage: start-on-event=DemSatellite_0InternalBehavior/GetEventStatus, operation=EvtInfo_VCC_UnderVoltage.GetEventStatus
        OpEventGetEventStatus_GetEventStatus_Event_VCC_UnderVoltage: start-on-event=DemSatellite_0InternalBehavior/GetEventStatus, operation=Event_VCC_UnderVoltage.GetEventStatus
        OpEventGetEventStatus_GetEventStatus_EvtInfo_VcEvTsttrPlaus: start-on-event=DemSatellite_0InternalBehavior/GetEventStatus, operation=EvtInfo_VcEvTsttrPlaus.GetEventStatus
        OpEventGetEventStatus_GetEventStatus_Event_VcEvTsttrPlaus: start-on-event=DemSatellite_0InternalBehavior/GetEventStatus, operation=Event_VcEvTsttrPlaus.GetEventStatus
        OpEventGetEventStatus_GetEventStatus_EvtInfo_INV_RSLVR_EXCT_ELEC_FLT: start-on-event=DemSatellite_0InternalBehavior/GetEventStatus, operation=EvtInfo_INV_RSLVR_EXCT_ELEC_FLT.GetEventStatus
        OpEventGetEventStatus_GetEventStatus_Event_INV_RSLVR_EXCT_ELEC_FLT: start-on-event=DemSatellite_0InternalBehavior/GetEventStatus, operation=Event_INV_RSLVR_EXCT_ELEC_FLT.GetEventStatus
        OpEventGetEventStatus_GetEventStatus_EvtInfo_INV_RSLVR_EXCT_RNG_LO: start-on-event=DemSatellite_0InternalBehavior/GetEventStatus, operation=EvtInfo_INV_RSLVR_EXCT_RNG_LO.GetEventStatus
        OpEventGetEventStatus_GetEventStatus_Event_INV_RSLVR_EXCT_RNG_LO: start-on-event=DemSatellite_0InternalBehavior/GetEventStatus, operation=Event_INV_RSLVR_EXCT_RNG_LO.GetEventStatus
        OpEventGetEventStatus_GetEventStatus_EvtInfo_INV_EM_STATOR_TEMP2_RNG_HI: start-on-event=DemSatellite_0InternalBehavior/GetEventStatus, operation=EvtInfo_INV_EM_STATOR_TEMP2_RNG_HI.GetEventStatus
        OpEventGetEventStatus_GetEventStatus_Event_INV_EM_STATOR_TEMP2_RNG_HI: start-on-event=DemSatellite_0InternalBehavior/GetEventStatus, operation=Event_INV_EM_STATOR_TEMP2_RNG_HI.GetEventStatus
        OpEventGetEventStatus_GetEventStatus_EvtInfo_INV_SHUT_OFF_PAH_START_UP: start-on-event=DemSatellite_0InternalBehavior/GetEventStatus, operation=EvtInfo_INV_SHUT_OFF_PAH_START_UP.GetEventStatus
        OpEventGetEventStatus_GetEventStatus_Event_INV_SHUT_OFF_PAH_START_UP: start-on-event=DemSatellite_0InternalBehavior/GetEventStatus, operation=Event_INV_SHUT_OFF_PAH_START_UP.GetEventStatus
        OpEventGetEventStatus_GetEventStatus_EvtInfo_VCEvVddmPropFr08Tioutd: start-on-event=DemSatellite_0InternalBehavior/GetEventStatus, operation=EvtInfo_VCEvVddmPropFr08Tioutd.GetEventStatus
        OpEventGetEventStatus_GetEventStatus_Event_VCEvVddmPropFr08Tioutd: start-on-event=DemSatellite_0InternalBehavior/GetEventStatus, operation=Event_VCEvVddmPropFr08Tioutd.GetEventStatus
        OpEventGetEventStatus_GetEventStatus_EvtInfo_INV_RSLVR_EXCT_OC_HWP_001: start-on-event=DemSatellite_0InternalBehavior/GetEventStatus, operation=EvtInfo_INV_RSLVR_EXCT_OC_HWP_001.GetEventStatus
        OpEventGetEventStatus_GetEventStatus_Event_INV_RSLVR_EXCT_OC_HWP_001: start-on-event=DemSatellite_0InternalBehavior/GetEventStatus, operation=Event_INV_RSLVR_EXCT_OC_HWP_001.GetEventStatus
        OpEventGetEventStatus_GetEventStatus_EvtInfo_INV_RSLVR_EXCT_OC_HWP_002: start-on-event=DemSatellite_0InternalBehavior/GetEventStatus, operation=EvtInfo_INV_RSLVR_EXCT_OC_HWP_002.GetEventStatus
        OpEventGetEventStatus_GetEventStatus_Event_INV_RSLVR_EXCT_OC_HWP_002: start-on-event=DemSatellite_0InternalBehavior/GetEventStatus, operation=Event_INV_RSLVR_EXCT_OC_HWP_002.GetEventStatus
        OpEventGetEventStatus_GetEventStatus_EvtInfo_INV_EM_STATOR_TEMP_ELE_FLT: start-on-event=DemSatellite_0InternalBehavior/GetEventStatus, operation=EvtInfo_INV_EM_STATOR_TEMP_ELE_FLT.GetEventStatus
        OpEventGetEventStatus_GetEventStatus_Event_INV_EM_STATOR_TEMP_ELE_FLT: start-on-event=DemSatellite_0InternalBehavior/GetEventStatus, operation=Event_INV_EM_STATOR_TEMP_ELE_FLT.GetEventStatus
        OpEventGetEventStatus_GetEventStatus_EvtInfo_INV_INTERLOCK_FLT: start-on-event=DemSatellite_0InternalBehavior/GetEventStatus, operation=EvtInfo_INV_INTERLOCK_FLT.GetEventStatus
        OpEventGetEventStatus_GetEventStatus_Event_INV_INTERLOCK_FLT: start-on-event=DemSatellite_0InternalBehavior/GetEventStatus, operation=Event_INV_INTERLOCK_FLT.GetEventStatus
        OpEventGetEventStatus_GetEventStatus_EvtInfo_Ga_ZeroFindDistanFailure: start-on-event=DemSatellite_0InternalBehavior/GetEventStatus, operation=EvtInfo_Ga_ZeroFindDistanFailure.GetEventStatus
        OpEventGetEventStatus_GetEventStatus_Event_Ga_ZeroFindDistanFailure: start-on-event=DemSatellite_0InternalBehavior/GetEventStatus, operation=Event_Ga_ZeroFindDistanFailure.GetEventStatus
        OpEventGetEventStatus_GetEventStatus_EvtInfo_PLOCK_Current_RNG_OUT: start-on-event=DemSatellite_0InternalBehavior/GetEventStatus, operation=EvtInfo_PLOCK_Current_RNG_OUT.GetEventStatus
        OpEventGetEventStatus_GetEventStatus_Event_PLOCK_Current_RNG_OUT: start-on-event=DemSatellite_0InternalBehavior/GetEventStatus, operation=Event_PLOCK_Current_RNG_OUT.GetEventStatus
        OpEventGetEventStatus_GetEventStatus_EvtInfo_VCEvVddmPropFr05Tioutd: start-on-event=DemSatellite_0InternalBehavior/GetEventStatus, operation=EvtInfo_VCEvVddmPropFr05Tioutd.GetEventStatus
        OpEventGetEventStatus_GetEventStatus_Event_VCEvVddmPropFr05Tioutd: start-on-event=DemSatellite_0InternalBehavior/GetEventStatus, operation=Event_VCEvVddmPropFr05Tioutd.GetEventStatus
        OpEventGetEventStatus_GetEventStatus_EvtInfo_INV_IGBT_TEMP_V_GRDT: start-on-event=DemSatellite_0InternalBehavior/GetEventStatus, operation=EvtInfo_INV_IGBT_TEMP_V_GRDT.GetEventStatus
        OpEventGetEventStatus_GetEventStatus_Event_INV_IGBT_TEMP_V_GRDT: start-on-event=DemSatellite_0InternalBehavior/GetEventStatus, operation=Event_INV_IGBT_TEMP_V_GRDT.GetEventStatus
        OpEventGetEventStatus_GetEventStatus_EvtInfo_PS_5V_Fault: start-on-event=DemSatellite_0InternalBehavior/GetEventStatus, operation=EvtInfo_PS_5V_Fault.GetEventStatus
        OpEventGetEventStatus_GetEventStatus_Event_PS_5V_Fault: start-on-event=DemSatellite_0InternalBehavior/GetEventStatus, operation=Event_PS_5V_Fault.GetEventStatus
        OpEventGetEventStatus_GetEventStatus_EvtInfo_VcEvCntrCrashStsSafe: start-on-event=DemSatellite_0InternalBehavior/GetEventStatus, operation=EvtInfo_VcEvCntrCrashStsSafe.GetEventStatus
        OpEventGetEventStatus_GetEventStatus_Event_VcEvCntrCrashStsSafe: start-on-event=DemSatellite_0InternalBehavior/GetEventStatus, operation=Event_VcEvCntrCrashStsSafe.GetEventStatus
        OpEventGetEventStatus_GetEventStatus_EvtInfo_INV_EM_STATOR_TEMP_GRDT: start-on-event=DemSatellite_0InternalBehavior/GetEventStatus, operation=EvtInfo_INV_EM_STATOR_TEMP_GRDT.GetEventStatus
        OpEventGetEventStatus_GetEventStatus_Event_INV_EM_STATOR_TEMP_GRDT: start-on-event=DemSatellite_0InternalBehavior/GetEventStatus, operation=Event_INV_EM_STATOR_TEMP_GRDT.GetEventStatus
        OpEventGetEventStatus_GetEventStatus_EvtInfo_PS_P15_V_FLT: start-on-event=DemSatellite_0InternalBehavior/GetEventStatus, operation=EvtInfo_PS_P15_V_FLT.GetEventStatus
        OpEventGetEventStatus_GetEventStatus_Event_PS_P15_V_FLT: start-on-event=DemSatellite_0InternalBehavior/GetEventStatus, operation=Event_PS_P15_V_FLT.GetEventStatus
        OpEventGetEventStatus_GetEventStatus_EvtInfo_INV_EM_STATOR_TEMP_RNG_NOK: start-on-event=DemSatellite_0InternalBehavior/GetEventStatus, operation=EvtInfo_INV_EM_STATOR_TEMP_RNG_NOK.GetEventStatus
        OpEventGetEventStatus_GetEventStatus_Event_INV_EM_STATOR_TEMP_RNG_NOK: start-on-event=DemSatellite_0InternalBehavior/GetEventStatus, operation=Event_INV_EM_STATOR_TEMP_RNG_NOK.GetEventStatus
        OpEventGetEventStatus_GetEventStatus_EvtInfo_INV_RSLVR_SIN_RNG_NOK: start-on-event=DemSatellite_0InternalBehavior/GetEventStatus, operation=EvtInfo_INV_RSLVR_SIN_RNG_NOK.GetEventStatus
        OpEventGetEventStatus_GetEventStatus_Event_INV_RSLVR_SIN_RNG_NOK: start-on-event=DemSatellite_0InternalBehavior/GetEventStatus, operation=Event_INV_RSLVR_SIN_RNG_NOK.GetEventStatus
        OpEventGetEventStatus_GetEventStatus_EvtInfo_INV_IAC_U_OFFS: start-on-event=DemSatellite_0InternalBehavior/GetEventStatus, operation=EvtInfo_INV_IAC_U_OFFS.GetEventStatus
        OpEventGetEventStatus_GetEventStatus_Event_INV_IAC_U_OFFS: start-on-event=DemSatellite_0InternalBehavior/GetEventStatus, operation=Event_INV_IAC_U_OFFS.GetEventStatus
        OpEventGetEventStatus_GetEventStatus_EvtInfo_PS_KL30_BACKUP_FLT: start-on-event=DemSatellite_0InternalBehavior/GetEventStatus, operation=EvtInfo_PS_KL30_BACKUP_FLT.GetEventStatus
        OpEventGetEventStatus_GetEventStatus_Event_PS_KL30_BACKUP_FLT: start-on-event=DemSatellite_0InternalBehavior/GetEventStatus, operation=Event_PS_KL30_BACKUP_FLT.GetEventStatus
        OpEventGetEventStatus_GetEventStatus_EvtInfo_INV_IGBT_TEMP_U_RNG_LO: start-on-event=DemSatellite_0InternalBehavior/GetEventStatus, operation=EvtInfo_INV_IGBT_TEMP_U_RNG_LO.GetEventStatus
        OpEventGetEventStatus_GetEventStatus_Event_INV_IGBT_TEMP_U_RNG_LO: start-on-event=DemSatellite_0InternalBehavior/GetEventStatus, operation=Event_INV_IGBT_TEMP_U_RNG_LO.GetEventStatus
        OpEventGetEventStatus_GetEventStatus_EvtInfo_INV_EM_STATOR_TEMP_HWP: start-on-event=DemSatellite_0InternalBehavior/GetEventStatus, operation=EvtInfo_INV_EM_STATOR_TEMP_HWP.GetEventStatus
        OpEventGetEventStatus_GetEventStatus_Event_INV_EM_STATOR_TEMP_HWP: start-on-event=DemSatellite_0InternalBehavior/GetEventStatus, operation=Event_INV_EM_STATOR_TEMP_HWP.GetEventStatus
        OpEventGetEventStatus_GetEventStatus_EvtInfo_CU_TEMP1_RNG_HI: start-on-event=DemSatellite_0InternalBehavior/GetEventStatus, operation=EvtInfo_CU_TEMP1_RNG_HI.GetEventStatus
        OpEventGetEventStatus_GetEventStatus_Event_CU_TEMP1_RNG_HI: start-on-event=DemSatellite_0InternalBehavior/GetEventStatus, operation=Event_CU_TEMP1_RNG_HI.GetEventStatus
        OpEventGetEventStatus_GetEventStatus_EvtInfo_INV_IGBT_TEMP_V_RNG_HI: start-on-event=DemSatellite_0InternalBehavior/GetEventStatus, operation=EvtInfo_INV_IGBT_TEMP_V_RNG_HI.GetEventStatus
        OpEventGetEventStatus_GetEventStatus_Event_INV_IGBT_TEMP_V_RNG_HI: start-on-event=DemSatellite_0InternalBehavior/GetEventStatus, operation=Event_INV_IGBT_TEMP_V_RNG_HI.GetEventStatus
        OpEventGetEventStatus_GetEventStatus_EvtInfo_VcEvNodeMisVDDM: start-on-event=DemSatellite_0InternalBehavior/GetEventStatus, operation=EvtInfo_VcEvNodeMisVDDM.GetEventStatus
        OpEventGetEventStatus_GetEventStatus_Event_VcEvNodeMisVDDM: start-on-event=DemSatellite_0InternalBehavior/GetEventStatus, operation=Event_VcEvNodeMisVDDM.GetEventStatus
        OpEventGetEventStatus_GetEventStatus_EvtInfo_INV_UHVDC_PLAUS: start-on-event=DemSatellite_0InternalBehavior/GetEventStatus, operation=EvtInfo_INV_UHVDC_PLAUS.GetEventStatus
        OpEventGetEventStatus_GetEventStatus_Event_INV_UHVDC_PLAUS: start-on-event=DemSatellite_0InternalBehavior/GetEventStatus, operation=Event_INV_UHVDC_PLAUS.GetEventStatus
        OpEventGetEventStatus_GetEventStatus_EvtInfo_INV_QUIESCENT_FLT: start-on-event=DemSatellite_0InternalBehavior/GetEventStatus, operation=EvtInfo_INV_QUIESCENT_FLT.GetEventStatus
        OpEventGetEventStatus_GetEventStatus_Event_INV_QUIESCENT_FLT: start-on-event=DemSatellite_0InternalBehavior/GetEventStatus, operation=Event_INV_QUIESCENT_FLT.GetEventStatus
        OpEventGetEventStatus_GetEventStatus_EvtInfo_INV_RSLVR_EXCT_RNG_HI: start-on-event=DemSatellite_0InternalBehavior/GetEventStatus, operation=EvtInfo_INV_RSLVR_EXCT_RNG_HI.GetEventStatus
        OpEventGetEventStatus_GetEventStatus_Event_INV_RSLVR_EXCT_RNG_HI: start-on-event=DemSatellite_0InternalBehavior/GetEventStatus, operation=Event_INV_RSLVR_EXCT_RNG_HI.GetEventStatus
        OpEventGetEventStatus_GetEventStatus_GeneralEvtInfo: start-on-event=DemSatellite_0InternalBehavior/GetEventStatus, operation=GeneralEvtInfo.GetEventStatus
        OpEventGetEventFailed_GetEventFailed_EvtInfo_VCEvBecmPropFr01Tioutd: start-on-event=DemSatellite_0InternalBehavior/GetEventFailed, operation=EvtInfo_VCEvBecmPropFr01Tioutd.GetEventFailed
        OpEventGetEventFailed_GetEventFailed_Event_VCEvBecmPropFr01Tioutd: start-on-event=DemSatellite_0InternalBehavior/GetEventFailed, operation=Event_VCEvBecmPropFr01Tioutd.GetEventFailed
        OpEventGetEventFailed_GetEventFailed_EvtInfo_INV_CU_TEMP2_RNG_NOK: start-on-event=DemSatellite_0InternalBehavior/GetEventFailed, operation=EvtInfo_INV_CU_TEMP2_RNG_NOK.GetEventFailed
        OpEventGetEventFailed_GetEventFailed_Event_INV_CU_TEMP2_RNG_NOK: start-on-event=DemSatellite_0InternalBehavior/GetEventFailed, operation=Event_INV_CU_TEMP2_RNG_NOK.GetEventFailed
        OpEventGetEventFailed_GetEventFailed_EvtInfo_COM_Busoff: start-on-event=DemSatellite_0InternalBehavior/GetEventFailed, operation=EvtInfo_COM_Busoff.GetEventFailed
        OpEventGetEventFailed_GetEventFailed_Event_COM_Busoff: start-on-event=DemSatellite_0InternalBehavior/GetEventFailed, operation=Event_COM_Busoff.GetEventFailed
        OpEventGetEventFailed_GetEventFailed_EvtInfo_INV_IMMO_NOKEY: start-on-event=DemSatellite_0InternalBehavior/GetEventFailed, operation=EvtInfo_INV_IMMO_NOKEY.GetEventFailed
        OpEventGetEventFailed_GetEventFailed_Event_INV_IMMO_NOKEY: start-on-event=DemSatellite_0InternalBehavior/GetEventFailed, operation=Event_INV_IMMO_NOKEY.GetEventFailed
        OpEventGetEventFailed_GetEventFailed_EvtInfo_INV_RSLVR_EXCT_OC_HWP: start-on-event=DemSatellite_0InternalBehavior/GetEventFailed, operation=EvtInfo_INV_RSLVR_EXCT_OC_HWP.GetEventFailed
        OpEventGetEventFailed_GetEventFailed_Event_INV_RSLVR_EXCT_OC_HWP: start-on-event=DemSatellite_0InternalBehavior/GetEventFailed, operation=Event_INV_RSLVR_EXCT_OC_HWP.GetEventFailed
        OpEventGetEventFailed_GetEventFailed_EvtInfo_PS_P15_W_FLT: start-on-event=DemSatellite_0InternalBehavior/GetEventFailed, operation=EvtInfo_PS_P15_W_FLT.GetEventFailed
        OpEventGetEventFailed_GetEventFailed_Event_PS_P15_W_FLT: start-on-event=DemSatellite_0InternalBehavior/GetEventFailed, operation=Event_PS_P15_W_FLT.GetEventFailed
        OpEventGetEventFailed_GetEventFailed_EvtInfo_INV_IAC_PLAUS_SUM: start-on-event=DemSatellite_0InternalBehavior/GetEventFailed, operation=EvtInfo_INV_IAC_PLAUS_SUM.GetEventFailed
        OpEventGetEventFailed_GetEventFailed_Event_INV_IAC_PLAUS_SUM: start-on-event=DemSatellite_0InternalBehavior/GetEventFailed, operation=Event_INV_IAC_PLAUS_SUM.GetEventFailed
        OpEventGetEventFailed_GetEventFailed_EvtInfo_PA_ELE_FLT: start-on-event=DemSatellite_0InternalBehavior/GetEventFailed, operation=EvtInfo_PA_ELE_FLT.GetEventFailed
        OpEventGetEventFailed_GetEventFailed_Event_PA_ELE_FLT: start-on-event=DemSatellite_0InternalBehavior/GetEventFailed, operation=Event_PA_ELE_FLT.GetEventFailed
        OpEventGetEventFailed_GetEventFailed_EvtInfo_CU_TEMP_GRDT: start-on-event=DemSatellite_0InternalBehavior/GetEventFailed, operation=EvtInfo_CU_TEMP_GRDT.GetEventFailed
        OpEventGetEventFailed_GetEventFailed_Event_CU_TEMP_GRDT: start-on-event=DemSatellite_0InternalBehavior/GetEventFailed, operation=Event_CU_TEMP_GRDT.GetEventFailed
        OpEventGetEventFailed_GetEventFailed_EvtInfo_INV_IGBT_TEMP_V_PLAUS: start-on-event=DemSatellite_0InternalBehavior/GetEventFailed, operation=EvtInfo_INV_IGBT_TEMP_V_PLAUS.GetEventFailed
        OpEventGetEventFailed_GetEventFailed_Event_INV_IGBT_TEMP_V_PLAUS: start-on-event=DemSatellite_0InternalBehavior/GetEventFailed, operation=Event_INV_IGBT_TEMP_V_PLAUS.GetEventFailed
        OpEventGetEventFailed_GetEventFailed_EvtInfo_Ga_GAEngageFailure: start-on-event=DemSatellite_0InternalBehavior/GetEventFailed, operation=EvtInfo_Ga_GAEngageFailure.GetEventFailed
        OpEventGetEventFailed_GetEventFailed_Event_Ga_GAEngageFailure: start-on-event=DemSatellite_0InternalBehavior/GetEventFailed, operation=Event_Ga_GAEngageFailure.GetEventFailed
        OpEventGetEventFailed_GetEventFailed_EvtInfo_INV_IAC_W_RNG_LO: start-on-event=DemSatellite_0InternalBehavior/GetEventFailed, operation=EvtInfo_INV_IAC_W_RNG_LO.GetEventFailed
        OpEventGetEventFailed_GetEventFailed_Event_INV_IAC_W_RNG_LO: start-on-event=DemSatellite_0InternalBehavior/GetEventFailed, operation=Event_INV_IAC_W_RNG_LO.GetEventFailed
        OpEventGetEventFailed_GetEventFailed_EvtInfo_PS_WhlSnsr_Vltg_FLT: start-on-event=DemSatellite_0InternalBehavior/GetEventFailed, operation=EvtInfo_PS_WhlSnsr_Vltg_FLT.GetEventFailed
        OpEventGetEventFailed_GetEventFailed_Event_PS_WhlSnsr_Vltg_FLT: start-on-event=DemSatellite_0InternalBehavior/GetEventFailed, operation=Event_PS_WhlSnsr_Vltg_FLT.GetEventFailed
        OpEventGetEventFailed_GetEventFailed_EvtInfo_VCEvEcmPropFr02Tioutd: start-on-event=DemSatellite_0InternalBehavior/GetEventFailed, operation=EvtInfo_VCEvEcmPropFr02Tioutd.GetEventFailed
        OpEventGetEventFailed_GetEventFailed_Event_VCEvEcmPropFr02Tioutd: start-on-event=DemSatellite_0InternalBehavior/GetEventFailed, operation=Event_VCEvEcmPropFr02Tioutd.GetEventFailed
        OpEventGetEventFailed_GetEventFailed_EvtInfo_Ga_TmSpdSyncFailed: start-on-event=DemSatellite_0InternalBehavior/GetEventFailed, operation=EvtInfo_Ga_TmSpdSyncFailed.GetEventFailed
        OpEventGetEventFailed_GetEventFailed_Event_Ga_TmSpdSyncFailed: start-on-event=DemSatellite_0InternalBehavior/GetEventFailed, operation=Event_Ga_TmSpdSyncFailed.GetEventFailed
        OpEventGetEventFailed_GetEventFailed_EvtInfo_INV_RSLVR_EXCT_ELEC_LO: start-on-event=DemSatellite_0InternalBehavior/GetEventFailed, operation=EvtInfo_INV_RSLVR_EXCT_ELEC_LO.GetEventFailed
        OpEventGetEventFailed_GetEventFailed_Event_INV_RSLVR_EXCT_ELEC_LO: start-on-event=DemSatellite_0InternalBehavior/GetEventFailed, operation=Event_INV_RSLVR_EXCT_ELEC_LO.GetEventFailed
        OpEventGetEventFailed_GetEventFailed_EvtInfo_VCEvEcmPropXevFr06Tioutd: start-on-event=DemSatellite_0InternalBehavior/GetEventFailed, operation=EvtInfo_VCEvEcmPropXevFr06Tioutd.GetEventFailed
        OpEventGetEventFailed_GetEventFailed_Event_VCEvEcmPropXevFr06Tioutd: start-on-event=DemSatellite_0InternalBehavior/GetEventFailed, operation=Event_VCEvEcmPropXevFr06Tioutd.GetEventFailed
        OpEventGetEventFailed_GetEventFailed_EvtInfo_VcEvCntrWhlMotSysTqAllwd: start-on-event=DemSatellite_0InternalBehavior/GetEventFailed, operation=EvtInfo_VcEvCntrWhlMotSysTqAllwd.GetEventFailed
        OpEventGetEventFailed_GetEventFailed_Event_VcEvCntrWhlMotSysTqAllwd: start-on-event=DemSatellite_0InternalBehavior/GetEventFailed, operation=Event_VcEvCntrWhlMotSysTqAllwd.GetEventFailed
        OpEventGetEventFailed_GetEventFailed_EvtInfo_INV_UHVDC_1_ELEC_HI: start-on-event=DemSatellite_0InternalBehavior/GetEventFailed, operation=EvtInfo_INV_UHVDC_1_ELEC_HI.GetEventFailed
        OpEventGetEventFailed_GetEventFailed_Event_INV_UHVDC_1_ELEC_HI: start-on-event=DemSatellite_0InternalBehavior/GetEventFailed, operation=Event_INV_UHVDC_1_ELEC_HI.GetEventFailed
        OpEventGetEventFailed_GetEventFailed_EvtInfo_INV_EM_STATOR_TEMP2_ELE_FLT: start-on-event=DemSatellite_0InternalBehavior/GetEventFailed, operation=EvtInfo_INV_EM_STATOR_TEMP2_ELE_FLT.GetEventFailed
        OpEventGetEventFailed_GetEventFailed_Event_INV_EM_STATOR_TEMP2_ELE_FLT: start-on-event=DemSatellite_0InternalBehavior/GetEventFailed, operation=Event_INV_EM_STATOR_TEMP2_ELE_FLT.GetEventFailed
        OpEventGetEventFailed_GetEventFailed_EvtInfo_AURIX_RST_SNG: start-on-event=DemSatellite_0InternalBehavior/GetEventFailed, operation=EvtInfo_AURIX_RST_SNG.GetEventFailed
        OpEventGetEventFailed_GetEventFailed_Event_AURIX_RST_SNG: start-on-event=DemSatellite_0InternalBehavior/GetEventFailed, operation=Event_AURIX_RST_SNG.GetEventFailed
        OpEventGetEventFailed_GetEventFailed_EvtInfo_VCEvEcmPropFr24MgmFr01Tioutd: start-on-event=DemSatellite_0InternalBehavior/GetEventFailed, operation=EvtInfo_VCEvEcmPropFr24MgmFr01Tioutd.GetEventFailed
        OpEventGetEventFailed_GetEventFailed_Event_VCEvEcmPropFr24MgmFr01Tioutd: start-on-event=DemSatellite_0InternalBehavior/GetEventFailed, operation=Event_VCEvEcmPropFr24MgmFr01Tioutd.GetEventFailed
        OpEventGetEventFailed_GetEventFailed_EvtInfo_INV_RSLVR_COS_ELEC_OPEN: start-on-event=DemSatellite_0InternalBehavior/GetEventFailed, operation=EvtInfo_INV_RSLVR_COS_ELEC_OPEN.GetEventFailed
        OpEventGetEventFailed_GetEventFailed_Event_INV_RSLVR_COS_ELEC_OPEN: start-on-event=DemSatellite_0InternalBehavior/GetEventFailed, operation=Event_INV_RSLVR_COS_ELEC_OPEN.GetEventFailed
        OpEventGetEventFailed_GetEventFailed_EvtInfo_INV_IAC_V_ELEC_LO: start-on-event=DemSatellite_0InternalBehavior/GetEventFailed, operation=EvtInfo_INV_IAC_V_ELEC_LO.GetEventFailed
        OpEventGetEventFailed_GetEventFailed_Event_INV_IAC_V_ELEC_LO: start-on-event=DemSatellite_0InternalBehavior/GetEventFailed, operation=Event_INV_IAC_V_ELEC_LO.GetEventFailed
        OpEventGetEventFailed_GetEventFailed_EvtInfo_INV_IAC_W_OFFS: start-on-event=DemSatellite_0InternalBehavior/GetEventFailed, operation=EvtInfo_INV_IAC_W_OFFS.GetEventFailed
        OpEventGetEventFailed_GetEventFailed_Event_INV_IAC_W_OFFS: start-on-event=DemSatellite_0InternalBehavior/GetEventFailed, operation=Event_INV_IAC_W_OFFS.GetEventFailed
        OpEventGetEventFailed_GetEventFailed_EvtInfo_INV_EM_STATOR_TEMP2_GRDT: start-on-event=DemSatellite_0InternalBehavior/GetEventFailed, operation=EvtInfo_INV_EM_STATOR_TEMP2_GRDT.GetEventFailed
        OpEventGetEventFailed_GetEventFailed_Event_INV_EM_STATOR_TEMP2_GRDT: start-on-event=DemSatellite_0InternalBehavior/GetEventFailed, operation=Event_INV_EM_STATOR_TEMP2_GRDT.GetEventFailed
        OpEventGetEventFailed_GetEventFailed_EvtInfo_INV_EM_OVRSPD_HWP: start-on-event=DemSatellite_0InternalBehavior/GetEventFailed, operation=EvtInfo_INV_EM_OVRSPD_HWP.GetEventFailed
        OpEventGetEventFailed_GetEventFailed_Event_INV_EM_OVRSPD_HWP: start-on-event=DemSatellite_0InternalBehavior/GetEventFailed, operation=Event_INV_EM_OVRSPD_HWP.GetEventFailed
        OpEventGetEventFailed_GetEventFailed_EvtInfo_CU_TEMP_HWP: start-on-event=DemSatellite_0InternalBehavior/GetEventFailed, operation=EvtInfo_CU_TEMP_HWP.GetEventFailed
        OpEventGetEventFailed_GetEventFailed_Event_CU_TEMP_HWP: start-on-event=DemSatellite_0InternalBehavior/GetEventFailed, operation=Event_CU_TEMP_HWP.GetEventFailed
        OpEventGetEventFailed_GetEventFailed_EvtInfo_INV_UHVDC_1_RNG_HI: start-on-event=DemSatellite_0InternalBehavior/GetEventFailed, operation=EvtInfo_INV_UHVDC_1_RNG_HI.GetEventFailed
        OpEventGetEventFailed_GetEventFailed_Event_INV_UHVDC_1_RNG_HI: start-on-event=DemSatellite_0InternalBehavior/GetEventFailed, operation=Event_INV_UHVDC_1_RNG_HI.GetEventFailed
        OpEventGetEventFailed_GetEventFailed_EvtInfo_VcEvEMPerfPlaus: start-on-event=DemSatellite_0InternalBehavior/GetEventFailed, operation=EvtInfo_VcEvEMPerfPlaus.GetEventFailed
        OpEventGetEventFailed_GetEventFailed_Event_VcEvEMPerfPlaus: start-on-event=DemSatellite_0InternalBehavior/GetEventFailed, operation=Event_VcEvEMPerfPlaus.GetEventFailed
        OpEventGetEventFailed_GetEventFailed_EvtInfo_VCEvVddmPropFr18Tioutd: start-on-event=DemSatellite_0InternalBehavior/GetEventFailed, operation=EvtInfo_VCEvVddmPropFr18Tioutd.GetEventFailed
        OpEventGetEventFailed_GetEventFailed_Event_VCEvVddmPropFr18Tioutd: start-on-event=DemSatellite_0InternalBehavior/GetEventFailed, operation=Event_VCEvVddmPropFr18Tioutd.GetEventFailed
        OpEventGetEventFailed_GetEventFailed_EvtInfo_INV_IAC_U_ELEC_HWP: start-on-event=DemSatellite_0InternalBehavior/GetEventFailed, operation=EvtInfo_INV_IAC_U_ELEC_HWP.GetEventFailed
        OpEventGetEventFailed_GetEventFailed_Event_INV_IAC_U_ELEC_HWP: start-on-event=DemSatellite_0InternalBehavior/GetEventFailed, operation=Event_INV_IAC_U_ELEC_HWP.GetEventFailed
        OpEventGetEventFailed_GetEventFailed_EvtInfo_VCEvVddmPropFr15Tioutd: start-on-event=DemSatellite_0InternalBehavior/GetEventFailed, operation=EvtInfo_VCEvVddmPropFr15Tioutd.GetEventFailed
        OpEventGetEventFailed_GetEventFailed_Event_VCEvVddmPropFr15Tioutd: start-on-event=DemSatellite_0InternalBehavior/GetEventFailed, operation=Event_VCEvVddmPropFr15Tioutd.GetEventFailed
        OpEventGetEventFailed_GetEventFailed_EvtInfo_Ga_GADisengageFailure: start-on-event=DemSatellite_0InternalBehavior/GetEventFailed, operation=EvtInfo_Ga_GADisengageFailure.GetEventFailed
        OpEventGetEventFailed_GetEventFailed_Event_Ga_GADisengageFailure: start-on-event=DemSatellite_0InternalBehavior/GetEventFailed, operation=Event_Ga_GADisengageFailure.GetEventFailed
        OpEventGetEventFailed_GetEventFailed_EvtInfo_CU_TEMP2_RNG_LO: start-on-event=DemSatellite_0InternalBehavior/GetEventFailed, operation=EvtInfo_CU_TEMP2_RNG_LO.GetEventFailed
        OpEventGetEventFailed_GetEventFailed_Event_CU_TEMP2_RNG_LO: start-on-event=DemSatellite_0InternalBehavior/GetEventFailed, operation=Event_CU_TEMP2_RNG_LO.GetEventFailed
        OpEventGetEventFailed_GetEventFailed_EvtInfo_INV_RSLVR_SIN_ELEC_OPEN: start-on-event=DemSatellite_0InternalBehavior/GetEventFailed, operation=EvtInfo_INV_RSLVR_SIN_ELEC_OPEN.GetEventFailed
        OpEventGetEventFailed_GetEventFailed_Event_INV_RSLVR_SIN_ELEC_OPEN: start-on-event=DemSatellite_0InternalBehavior/GetEventFailed, operation=Event_INV_RSLVR_SIN_ELEC_OPEN.GetEventFailed
        OpEventGetEventFailed_GetEventFailed_EvtInfo_VcEvChkSum: start-on-event=DemSatellite_0InternalBehavior/GetEventFailed, operation=EvtInfo_VcEvChkSum.GetEventFailed
        OpEventGetEventFailed_GetEventFailed_Event_VcEvChkSum: start-on-event=DemSatellite_0InternalBehavior/GetEventFailed, operation=Event_VcEvChkSum.GetEventFailed
        OpEventGetEventFailed_GetEventFailed_EvtInfo_PS_P5_UC_FLT: start-on-event=DemSatellite_0InternalBehavior/GetEventFailed, operation=EvtInfo_PS_P5_UC_FLT.GetEventFailed
        OpEventGetEventFailed_GetEventFailed_Event_PS_P5_UC_FLT: start-on-event=DemSatellite_0InternalBehavior/GetEventFailed, operation=Event_PS_P5_UC_FLT.GetEventFailed
        OpEventGetEventFailed_GetEventFailed_EvtInfo_INV_RSLVR_COS_ELEC_FLT: start-on-event=DemSatellite_0InternalBehavior/GetEventFailed, operation=EvtInfo_INV_RSLVR_COS_ELEC_FLT.GetEventFailed
        OpEventGetEventFailed_GetEventFailed_Event_INV_RSLVR_COS_ELEC_FLT: start-on-event=DemSatellite_0InternalBehavior/GetEventFailed, operation=Event_INV_RSLVR_COS_ELEC_FLT.GetEventFailed
        OpEventGetEventFailed_GetEventFailed_EvtInfo_INV_IAC_W_RNG_HI: start-on-event=DemSatellite_0InternalBehavior/GetEventFailed, operation=EvtInfo_INV_IAC_W_RNG_HI.GetEventFailed
        OpEventGetEventFailed_GetEventFailed_Event_INV_IAC_W_RNG_HI: start-on-event=DemSatellite_0InternalBehavior/GetEventFailed, operation=Event_INV_IAC_W_RNG_HI.GetEventFailed
        OpEventGetEventFailed_GetEventFailed_EvtInfo_PS_ECUSUPPLY_HIGH: start-on-event=DemSatellite_0InternalBehavior/GetEventFailed, operation=EvtInfo_PS_ECUSUPPLY_HIGH.GetEventFailed
        OpEventGetEventFailed_GetEventFailed_Event_PS_ECUSUPPLY_HIGH: start-on-event=DemSatellite_0InternalBehavior/GetEventFailed, operation=Event_PS_ECUSUPPLY_HIGH.GetEventFailed
        OpEventGetEventFailed_GetEventFailed_EvtInfo_VCEvEcmPropFr05Tioutd: start-on-event=DemSatellite_0InternalBehavior/GetEventFailed, operation=EvtInfo_VCEvEcmPropFr05Tioutd.GetEventFailed
        OpEventGetEventFailed_GetEventFailed_Event_VCEvEcmPropFr05Tioutd: start-on-event=DemSatellite_0InternalBehavior/GetEventFailed, operation=Event_VCEvEcmPropFr05Tioutd.GetEventFailed
        OpEventGetEventFailed_GetEventFailed_EvtInfo_PS_ECUSUPPLY_LOW: start-on-event=DemSatellite_0InternalBehavior/GetEventFailed, operation=EvtInfo_PS_ECUSUPPLY_LOW.GetEventFailed
        OpEventGetEventFailed_GetEventFailed_Event_PS_ECUSUPPLY_LOW: start-on-event=DemSatellite_0InternalBehavior/GetEventFailed, operation=Event_PS_ECUSUPPLY_LOW.GetEventFailed
        OpEventGetEventFailed_GetEventFailed_EvtInfo_VcEvChkSumHvSysRlySts: start-on-event=DemSatellite_0InternalBehavior/GetEventFailed, operation=EvtInfo_VcEvChkSumHvSysRlySts.GetEventFailed
        OpEventGetEventFailed_GetEventFailed_Event_VcEvChkSumHvSysRlySts: start-on-event=DemSatellite_0InternalBehavior/GetEventFailed, operation=Event_VcEvChkSumHvSysRlySts.GetEventFailed
        OpEventGetEventFailed_GetEventFailed_EvtInfo_VcEvMonMode: start-on-event=DemSatellite_0InternalBehavior/GetEventFailed, operation=EvtInfo_VcEvMonMode.GetEventFailed
        OpEventGetEventFailed_GetEventFailed_Event_VcEvMonMode: start-on-event=DemSatellite_0InternalBehavior/GetEventFailed, operation=Event_VcEvMonMode.GetEventFailed
        OpEventGetEventFailed_GetEventFailed_EvtInfo_INV_IAC_OC_SWP: start-on-event=DemSatellite_0InternalBehavior/GetEventFailed, operation=EvtInfo_INV_IAC_OC_SWP.GetEventFailed
        OpEventGetEventFailed_GetEventFailed_Event_INV_IAC_OC_SWP: start-on-event=DemSatellite_0InternalBehavior/GetEventFailed, operation=Event_INV_IAC_OC_SWP.GetEventFailed
        OpEventGetEventFailed_GetEventFailed_EvtInfo_INV_IMMO_AUTHFAIL: start-on-event=DemSatellite_0InternalBehavior/GetEventFailed, operation=EvtInfo_INV_IMMO_AUTHFAIL.GetEventFailed
        OpEventGetEventFailed_GetEventFailed_Event_INV_IMMO_AUTHFAIL: start-on-event=DemSatellite_0InternalBehavior/GetEventFailed, operation=Event_INV_IMMO_AUTHFAIL.GetEventFailed
        OpEventGetEventFailed_GetEventFailed_EvtInfo_PA_OpenCirc_FLT: start-on-event=DemSatellite_0InternalBehavior/GetEventFailed, operation=EvtInfo_PA_OpenCirc_FLT.GetEventFailed
        OpEventGetEventFailed_GetEventFailed_Event_PA_OpenCirc_FLT: start-on-event=DemSatellite_0InternalBehavior/GetEventFailed, operation=Event_PA_OpenCirc_FLT.GetEventFailed
        OpEventGetEventFailed_GetEventFailed_EvtInfo_INV_IAC_V_ELEC_HI: start-on-event=DemSatellite_0InternalBehavior/GetEventFailed, operation=EvtInfo_INV_IAC_V_ELEC_HI.GetEventFailed
        OpEventGetEventFailed_GetEventFailed_Event_INV_IAC_V_ELEC_HI: start-on-event=DemSatellite_0InternalBehavior/GetEventFailed, operation=Event_INV_IAC_V_ELEC_HI.GetEventFailed
        OpEventGetEventFailed_GetEventFailed_EvtInfo_VCEvEcmPropFr04Tioutd: start-on-event=DemSatellite_0InternalBehavior/GetEventFailed, operation=EvtInfo_VCEvEcmPropFr04Tioutd.GetEventFailed
        OpEventGetEventFailed_GetEventFailed_Event_VCEvEcmPropFr04Tioutd: start-on-event=DemSatellite_0InternalBehavior/GetEventFailed, operation=Event_VCEvEcmPropFr04Tioutd.GetEventFailed
        OpEventGetEventFailed_GetEventFailed_EvtInfo_VcEvMonTrqActPlaus: start-on-event=DemSatellite_0InternalBehavior/GetEventFailed, operation=EvtInfo_VcEvMonTrqActPlaus.GetEventFailed
        OpEventGetEventFailed_GetEventFailed_Event_VcEvMonTrqActPlaus: start-on-event=DemSatellite_0InternalBehavior/GetEventFailed, operation=Event_VcEvMonTrqActPlaus.GetEventFailed
        OpEventGetEventFailed_GetEventFailed_EvtInfo_VcEvMonTrqAct: start-on-event=DemSatellite_0InternalBehavior/GetEventFailed, operation=EvtInfo_VcEvMonTrqAct.GetEventFailed
        OpEventGetEventFailed_GetEventFailed_Event_VcEvMonTrqAct: start-on-event=DemSatellite_0InternalBehavior/GetEventFailed, operation=Event_VcEvMonTrqAct.GetEventFailed
        OpEventGetEventFailed_GetEventFailed_EvtInfo_INV_RSLVR_COS_ELEC_LO: start-on-event=DemSatellite_0InternalBehavior/GetEventFailed, operation=EvtInfo_INV_RSLVR_COS_ELEC_LO.GetEventFailed
        OpEventGetEventFailed_GetEventFailed_Event_INV_RSLVR_COS_ELEC_LO: start-on-event=DemSatellite_0InternalBehavior/GetEventFailed, operation=Event_INV_RSLVR_COS_ELEC_LO.GetEventFailed
        OpEventGetEventFailed_GetEventFailed_EvtInfo_INV_COOLT_INLET_TEMP_HWP: start-on-event=DemSatellite_0InternalBehavior/GetEventFailed, operation=EvtInfo_INV_COOLT_INLET_TEMP_HWP.GetEventFailed
        OpEventGetEventFailed_GetEventFailed_Event_INV_COOLT_INLET_TEMP_HWP: start-on-event=DemSatellite_0InternalBehavior/GetEventFailed, operation=Event_INV_COOLT_INLET_TEMP_HWP.GetEventFailed
        OpEventGetEventFailed_GetEventFailed_EvtInfo_VCEvEcmPropFr11Tioutd: start-on-event=DemSatellite_0InternalBehavior/GetEventFailed, operation=EvtInfo_VCEvEcmPropFr11Tioutd.GetEventFailed
        OpEventGetEventFailed_GetEventFailed_Event_VCEvEcmPropFr11Tioutd: start-on-event=DemSatellite_0InternalBehavior/GetEventFailed, operation=Event_VCEvEcmPropFr11Tioutd.GetEventFailed
        OpEventGetEventFailed_GetEventFailed_EvtInfo_PS_KL30_RNG_HI: start-on-event=DemSatellite_0InternalBehavior/GetEventFailed, operation=EvtInfo_PS_KL30_RNG_HI.GetEventFailed
        OpEventGetEventFailed_GetEventFailed_Event_PS_KL30_RNG_HI: start-on-event=DemSatellite_0InternalBehavior/GetEventFailed, operation=Event_PS_KL30_RNG_HI.GetEventFailed
        OpEventGetEventFailed_GetEventFailed_EvtInfo_INV_IAC_OC_HWP: start-on-event=DemSatellite_0InternalBehavior/GetEventFailed, operation=EvtInfo_INV_IAC_OC_HWP.GetEventFailed
        OpEventGetEventFailed_GetEventFailed_Event_INV_IAC_OC_HWP: start-on-event=DemSatellite_0InternalBehavior/GetEventFailed, operation=Event_INV_IAC_OC_HWP.GetEventFailed
        OpEventGetEventFailed_GetEventFailed_EvtInfo_INV_RSLVR_COS_RNG_HI: start-on-event=DemSatellite_0InternalBehavior/GetEventFailed, operation=EvtInfo_INV_RSLVR_COS_RNG_HI.GetEventFailed
        OpEventGetEventFailed_GetEventFailed_Event_INV_RSLVR_COS_RNG_HI: start-on-event=DemSatellite_0InternalBehavior/GetEventFailed, operation=Event_INV_RSLVR_COS_RNG_HI.GetEventFailed
        OpEventGetEventFailed_GetEventFailed_EvtInfo_INV_IAC_U_ELEC_HI: start-on-event=DemSatellite_0InternalBehavior/GetEventFailed, operation=EvtInfo_INV_IAC_U_ELEC_HI.GetEventFailed
        OpEventGetEventFailed_GetEventFailed_Event_INV_IAC_U_ELEC_HI: start-on-event=DemSatellite_0InternalBehavior/GetEventFailed, operation=Event_INV_IAC_U_ELEC_HI.GetEventFailed
        OpEventGetEventFailed_GetEventFailed_EvtInfo_INV_IAC_V_RNG_LO: start-on-event=DemSatellite_0InternalBehavior/GetEventFailed, operation=EvtInfo_INV_IAC_V_RNG_LO.GetEventFailed
        OpEventGetEventFailed_GetEventFailed_Event_INV_IAC_V_RNG_LO: start-on-event=DemSatellite_0InternalBehavior/GetEventFailed, operation=Event_INV_IAC_V_RNG_LO.GetEventFailed
        OpEventGetEventFailed_GetEventFailed_EvtInfo_INV_IAC_U_RNG_HI: start-on-event=DemSatellite_0InternalBehavior/GetEventFailed, operation=EvtInfo_INV_IAC_U_RNG_HI.GetEventFailed
        OpEventGetEventFailed_GetEventFailed_Event_INV_IAC_U_RNG_HI: start-on-event=DemSatellite_0InternalBehavior/GetEventFailed, operation=Event_INV_IAC_U_RNG_HI.GetEventFailed
        OpEventGetEventFailed_GetEventFailed_EvtInfo_VCEvEcmPropFr25Tioutd: start-on-event=DemSatellite_0InternalBehavior/GetEventFailed, operation=EvtInfo_VCEvEcmPropFr25Tioutd.GetEventFailed
        OpEventGetEventFailed_GetEventFailed_Event_VCEvEcmPropFr25Tioutd: start-on-event=DemSatellite_0InternalBehavior/GetEventFailed, operation=Event_VCEvEcmPropFr25Tioutd.GetEventFailed
        OpEventGetEventFailed_GetEventFailed_EvtInfo_INV_IGBT_TEMP_W_RNG_LO: start-on-event=DemSatellite_0InternalBehavior/GetEventFailed, operation=EvtInfo_INV_IGBT_TEMP_W_RNG_LO.GetEventFailed
        OpEventGetEventFailed_GetEventFailed_Event_INV_IGBT_TEMP_W_RNG_LO: start-on-event=DemSatellite_0InternalBehavior/GetEventFailed, operation=Event_INV_IGBT_TEMP_W_RNG_LO.GetEventFailed
        OpEventGetEventFailed_GetEventFailed_EvtInfo_PSnsr_RNG_NOK: start-on-event=DemSatellite_0InternalBehavior/GetEventFailed, operation=EvtInfo_PSnsr_RNG_NOK.GetEventFailed
        OpEventGetEventFailed_GetEventFailed_Event_PSnsr_RNG_NOK: start-on-event=DemSatellite_0InternalBehavior/GetEventFailed, operation=Event_PSnsr_RNG_NOK.GetEventFailed
        OpEventGetEventFailed_GetEventFailed_EvtInfo_INV_RSLVR_COS_RNG_NOK: start-on-event=DemSatellite_0InternalBehavior/GetEventFailed, operation=EvtInfo_INV_RSLVR_COS_RNG_NOK.GetEventFailed
        OpEventGetEventFailed_GetEventFailed_Event_INV_RSLVR_COS_RNG_NOK: start-on-event=DemSatellite_0InternalBehavior/GetEventFailed, operation=Event_INV_RSLVR_COS_RNG_NOK.GetEventFailed
        OpEventGetEventFailed_GetEventFailed_EvtInfo_PS_DRVB_Fault: start-on-event=DemSatellite_0InternalBehavior/GetEventFailed, operation=EvtInfo_PS_DRVB_Fault.GetEventFailed
        OpEventGetEventFailed_GetEventFailed_Event_PS_DRVB_Fault: start-on-event=DemSatellite_0InternalBehavior/GetEventFailed, operation=Event_PS_DRVB_Fault.GetEventFailed
        OpEventGetEventFailed_GetEventFailed_EvtInfo_INV_CU_TEMP1_RNG_NOK: start-on-event=DemSatellite_0InternalBehavior/GetEventFailed, operation=EvtInfo_INV_CU_TEMP1_RNG_NOK.GetEventFailed
        OpEventGetEventFailed_GetEventFailed_Event_INV_CU_TEMP1_RNG_NOK: start-on-event=DemSatellite_0InternalBehavior/GetEventFailed, operation=Event_INV_CU_TEMP1_RNG_NOK.GetEventFailed
        OpEventGetEventFailed_GetEventFailed_EvtInfo_VcEvCntr: start-on-event=DemSatellite_0InternalBehavior/GetEventFailed, operation=EvtInfo_VcEvCntr.GetEventFailed
        OpEventGetEventFailed_GetEventFailed_Event_VcEvCntr: start-on-event=DemSatellite_0InternalBehavior/GetEventFailed, operation=Event_VcEvCntr.GetEventFailed
        OpEventGetEventFailed_GetEventFailed_EvtInfo_INV_RSLVR_SIN_AMP: start-on-event=DemSatellite_0InternalBehavior/GetEventFailed, operation=EvtInfo_INV_RSLVR_SIN_AMP.GetEventFailed
        OpEventGetEventFailed_GetEventFailed_Event_INV_RSLVR_SIN_AMP: start-on-event=DemSatellite_0InternalBehavior/GetEventFailed, operation=Event_INV_RSLVR_SIN_AMP.GetEventFailed
        OpEventGetEventFailed_GetEventFailed_EvtInfo_INV_UHVDC_2_RNG_HI: start-on-event=DemSatellite_0InternalBehavior/GetEventFailed, operation=EvtInfo_INV_UHVDC_2_RNG_HI.GetEventFailed
        OpEventGetEventFailed_GetEventFailed_Event_INV_UHVDC_2_RNG_HI: start-on-event=DemSatellite_0InternalBehavior/GetEventFailed, operation=Event_INV_UHVDC_2_RNG_HI.GetEventFailed
        OpEventGetEventFailed_GetEventFailed_EvtInfo_INV_IGBT_TEMP_U_GRDT: start-on-event=DemSatellite_0InternalBehavior/GetEventFailed, operation=EvtInfo_INV_IGBT_TEMP_U_GRDT.GetEventFailed
        OpEventGetEventFailed_GetEventFailed_Event_INV_IGBT_TEMP_U_GRDT: start-on-event=DemSatellite_0InternalBehavior/GetEventFailed, operation=Event_INV_IGBT_TEMP_U_GRDT.GetEventFailed
        OpEventGetEventFailed_GetEventFailed_EvtInfo_MON_TQ_PLAUS_PWR_MDL: start-on-event=DemSatellite_0InternalBehavior/GetEventFailed, operation=EvtInfo_MON_TQ_PLAUS_PWR_MDL.GetEventFailed
        OpEventGetEventFailed_GetEventFailed_Event_MON_TQ_PLAUS_PWR_MDL: start-on-event=DemSatellite_0InternalBehavior/GetEventFailed, operation=Event_MON_TQ_PLAUS_PWR_MDL.GetEventFailed
        OpEventGetEventFailed_GetEventFailed_EvtInfo_INV_IGBT_TEMP_W_PLAUS: start-on-event=DemSatellite_0InternalBehavior/GetEventFailed, operation=EvtInfo_INV_IGBT_TEMP_W_PLAUS.GetEventFailed
        OpEventGetEventFailed_GetEventFailed_Event_INV_IGBT_TEMP_W_PLAUS: start-on-event=DemSatellite_0InternalBehavior/GetEventFailed, operation=Event_INV_IGBT_TEMP_W_PLAUS.GetEventFailed
        OpEventGetEventFailed_GetEventFailed_EvtInfo_PS_BLDC_UV_FLT: start-on-event=DemSatellite_0InternalBehavior/GetEventFailed, operation=EvtInfo_PS_BLDC_UV_FLT.GetEventFailed
        OpEventGetEventFailed_GetEventFailed_Event_PS_BLDC_UV_FLT: start-on-event=DemSatellite_0InternalBehavior/GetEventFailed, operation=Event_PS_BLDC_UV_FLT.GetEventFailed
        OpEventGetEventFailed_GetEventFailed_EvtInfo_INV_IAC_V_OFFS: start-on-event=DemSatellite_0InternalBehavior/GetEventFailed, operation=EvtInfo_INV_IAC_V_OFFS.GetEventFailed
        OpEventGetEventFailed_GetEventFailed_Event_INV_IAC_V_OFFS: start-on-event=DemSatellite_0InternalBehavior/GetEventFailed, operation=Event_INV_IAC_V_OFFS.GetEventFailed
        OpEventGetEventFailed_GetEventFailed_EvtInfo_INV_RSLVR_EXCT_FREQ_RNG_NOK: start-on-event=DemSatellite_0InternalBehavior/GetEventFailed, operation=EvtInfo_INV_RSLVR_EXCT_FREQ_RNG_NOK.GetEventFailed
        OpEventGetEventFailed_GetEventFailed_Event_INV_RSLVR_EXCT_FREQ_RNG_NOK: start-on-event=DemSatellite_0InternalBehavior/GetEventFailed, operation=Event_INV_RSLVR_EXCT_FREQ_RNG_NOK.GetEventFailed
        OpEventGetEventFailed_GetEventFailed_EvtInfo_PS_KL30_RNG_LO: start-on-event=DemSatellite_0InternalBehavior/GetEventFailed, operation=EvtInfo_PS_KL30_RNG_LO.GetEventFailed
        OpEventGetEventFailed_GetEventFailed_Event_PS_KL30_RNG_LO: start-on-event=DemSatellite_0InternalBehavior/GetEventFailed, operation=Event_PS_KL30_RNG_LO.GetEventFailed
        OpEventGetEventFailed_GetEventFailed_EvtInfo_INV_RSLVR_COS_RNG_LO: start-on-event=DemSatellite_0InternalBehavior/GetEventFailed, operation=EvtInfo_INV_RSLVR_COS_RNG_LO.GetEventFailed
        OpEventGetEventFailed_GetEventFailed_Event_INV_RSLVR_COS_RNG_LO: start-on-event=DemSatellite_0InternalBehavior/GetEventFailed, operation=Event_INV_RSLVR_COS_RNG_LO.GetEventFailed
        OpEventGetEventFailed_GetEventFailed_EvtInfo_PSnsr_ELE_FLT: start-on-event=DemSatellite_0InternalBehavior/GetEventFailed, operation=EvtInfo_PSnsr_ELE_FLT.GetEventFailed
        OpEventGetEventFailed_GetEventFailed_Event_PSnsr_ELE_FLT: start-on-event=DemSatellite_0InternalBehavior/GetEventFailed, operation=Event_PSnsr_ELE_FLT.GetEventFailed
        OpEventGetEventFailed_GetEventFailed_EvtInfo_INV_RSLVR_SIN_COS_PLAUS_AMP: start-on-event=DemSatellite_0InternalBehavior/GetEventFailed, operation=EvtInfo_INV_RSLVR_SIN_COS_PLAUS_AMP.GetEventFailed
        OpEventGetEventFailed_GetEventFailed_Event_INV_RSLVR_SIN_COS_PLAUS_AMP: start-on-event=DemSatellite_0InternalBehavior/GetEventFailed, operation=Event_INV_RSLVR_SIN_COS_PLAUS_AMP.GetEventFailed
        OpEventGetEventFailed_GetEventFailed_EvtInfo_INV_IAC_U_ELEC_LO: start-on-event=DemSatellite_0InternalBehavior/GetEventFailed, operation=EvtInfo_INV_IAC_U_ELEC_LO.GetEventFailed
        OpEventGetEventFailed_GetEventFailed_Event_INV_IAC_U_ELEC_LO: start-on-event=DemSatellite_0InternalBehavior/GetEventFailed, operation=Event_INV_IAC_U_ELEC_LO.GetEventFailed
        OpEventGetEventFailed_GetEventFailed_EvtInfo_INV_RSLVR_EXCT_ELEC_HI: start-on-event=DemSatellite_0InternalBehavior/GetEventFailed, operation=EvtInfo_INV_RSLVR_EXCT_ELEC_HI.GetEventFailed
        OpEventGetEventFailed_GetEventFailed_Event_INV_RSLVR_EXCT_ELEC_HI: start-on-event=DemSatellite_0InternalBehavior/GetEventFailed, operation=Event_INV_RSLVR_EXCT_ELEC_HI.GetEventFailed
        OpEventGetEventFailed_GetEventFailed_EvtInfo_INV_IAC_U_RNG_LO: start-on-event=DemSatellite_0InternalBehavior/GetEventFailed, operation=EvtInfo_INV_IAC_U_RNG_LO.GetEventFailed
        OpEventGetEventFailed_GetEventFailed_Event_INV_IAC_U_RNG_LO: start-on-event=DemSatellite_0InternalBehavior/GetEventFailed, operation=Event_INV_IAC_U_RNG_LO.GetEventFailed
        OpEventGetEventFailed_GetEventFailed_EvtInfo_INV_IAC_V_RNG_HI: start-on-event=DemSatellite_0InternalBehavior/GetEventFailed, operation=EvtInfo_INV_IAC_V_RNG_HI.GetEventFailed
        OpEventGetEventFailed_GetEventFailed_Event_INV_IAC_V_RNG_HI: start-on-event=DemSatellite_0InternalBehavior/GetEventFailed, operation=Event_INV_IAC_V_RNG_HI.GetEventFailed
        OpEventGetEventFailed_GetEventFailed_EvtInfo_INV_IGBT_TEMP_U_PLAUS: start-on-event=DemSatellite_0InternalBehavior/GetEventFailed, operation=EvtInfo_INV_IGBT_TEMP_U_PLAUS.GetEventFailed
        OpEventGetEventFailed_GetEventFailed_Event_INV_IGBT_TEMP_U_PLAUS: start-on-event=DemSatellite_0InternalBehavior/GetEventFailed, operation=Event_INV_IGBT_TEMP_U_PLAUS.GetEventFailed
        OpEventGetEventFailed_GetEventFailed_EvtInfo_INV_RSLVR_OFFS_DFT: start-on-event=DemSatellite_0InternalBehavior/GetEventFailed, operation=EvtInfo_INV_RSLVR_OFFS_DFT.GetEventFailed
        OpEventGetEventFailed_GetEventFailed_Event_INV_RSLVR_OFFS_DFT: start-on-event=DemSatellite_0InternalBehavior/GetEventFailed, operation=Event_INV_RSLVR_OFFS_DFT.GetEventFailed
        OpEventGetEventFailed_GetEventFailed_EvtInfo_Ga_MoveOverThd: start-on-event=DemSatellite_0InternalBehavior/GetEventFailed, operation=EvtInfo_Ga_MoveOverThd.GetEventFailed
        OpEventGetEventFailed_GetEventFailed_Event_Ga_MoveOverThd: start-on-event=DemSatellite_0InternalBehavior/GetEventFailed, operation=Event_Ga_MoveOverThd.GetEventFailed
        OpEventGetEventFailed_GetEventFailed_EvtInfo_VcEvMonIPH: start-on-event=DemSatellite_0InternalBehavior/GetEventFailed, operation=EvtInfo_VcEvMonIPH.GetEventFailed
        OpEventGetEventFailed_GetEventFailed_Event_VcEvMonIPH: start-on-event=DemSatellite_0InternalBehavior/GetEventFailed, operation=Event_VcEvMonIPH.GetEventFailed
        OpEventGetEventFailed_GetEventFailed_EvtInfo_INV_RSLVR_HW_FLT: start-on-event=DemSatellite_0InternalBehavior/GetEventFailed, operation=EvtInfo_INV_RSLVR_HW_FLT.GetEventFailed
        OpEventGetEventFailed_GetEventFailed_Event_INV_RSLVR_HW_FLT: start-on-event=DemSatellite_0InternalBehavior/GetEventFailed, operation=Event_INV_RSLVR_HW_FLT.GetEventFailed
        OpEventGetEventFailed_GetEventFailed_EvtInfo_INV_RSLVR_SIN_ELEC_LO: start-on-event=DemSatellite_0InternalBehavior/GetEventFailed, operation=EvtInfo_INV_RSLVR_SIN_ELEC_LO.GetEventFailed
        OpEventGetEventFailed_GetEventFailed_Event_INV_RSLVR_SIN_ELEC_LO: start-on-event=DemSatellite_0InternalBehavior/GetEventFailed, operation=Event_INV_RSLVR_SIN_ELEC_LO.GetEventFailed
        OpEventGetEventFailed_GetEventFailed_EvtInfo_INV_IAC_W_AMP: start-on-event=DemSatellite_0InternalBehavior/GetEventFailed, operation=EvtInfo_INV_IAC_W_AMP.GetEventFailed
        OpEventGetEventFailed_GetEventFailed_Event_INV_IAC_W_AMP: start-on-event=DemSatellite_0InternalBehavior/GetEventFailed, operation=Event_INV_IAC_W_AMP.GetEventFailed
        OpEventGetEventFailed_GetEventFailed_EvtInfo_VCC_OverVoltage: start-on-event=DemSatellite_0InternalBehavior/GetEventFailed, operation=EvtInfo_VCC_OverVoltage.GetEventFailed
        OpEventGetEventFailed_GetEventFailed_Event_VCC_OverVoltage: start-on-event=DemSatellite_0InternalBehavior/GetEventFailed, operation=Event_VCC_OverVoltage.GetEventFailed
        OpEventGetEventFailed_GetEventFailed_EvtInfo_PS_BLDC_OV_FLT: start-on-event=DemSatellite_0InternalBehavior/GetEventFailed, operation=EvtInfo_PS_BLDC_OV_FLT.GetEventFailed
        OpEventGetEventFailed_GetEventFailed_Event_PS_BLDC_OV_FLT: start-on-event=DemSatellite_0InternalBehavior/GetEventFailed, operation=Event_PS_BLDC_OV_FLT.GetEventFailed
        OpEventGetEventFailed_GetEventFailed_EvtInfo_AURIX_EEPROM_FLT: start-on-event=DemSatellite_0InternalBehavior/GetEventFailed, operation=EvtInfo_AURIX_EEPROM_FLT.GetEventFailed
        OpEventGetEventFailed_GetEventFailed_Event_AURIX_EEPROM_FLT: start-on-event=DemSatellite_0InternalBehavior/GetEventFailed, operation=Event_AURIX_EEPROM_FLT.GetEventFailed
        OpEventGetEventFailed_GetEventFailed_EvtInfo_FS_MONITIOR_ASC_FW_FLT: start-on-event=DemSatellite_0InternalBehavior/GetEventFailed, operation=EvtInfo_FS_MONITIOR_ASC_FW_FLT.GetEventFailed
        OpEventGetEventFailed_GetEventFailed_Event_FS_MONITIOR_ASC_FW_FLT: start-on-event=DemSatellite_0InternalBehavior/GetEventFailed, operation=Event_FS_MONITIOR_ASC_FW_FLT.GetEventFailed
        OpEventGetEventFailed_GetEventFailed_EvtInfo_VCEvSrsPropFr02Tioutd: start-on-event=DemSatellite_0InternalBehavior/GetEventFailed, operation=EvtInfo_VCEvSrsPropFr02Tioutd.GetEventFailed
        OpEventGetEventFailed_GetEventFailed_Event_VCEvSrsPropFr02Tioutd: start-on-event=DemSatellite_0InternalBehavior/GetEventFailed, operation=Event_VCEvSrsPropFr02Tioutd.GetEventFailed
        OpEventGetEventFailed_GetEventFailed_EvtInfo_VcEvMonErrMode: start-on-event=DemSatellite_0InternalBehavior/GetEventFailed, operation=EvtInfo_VcEvMonErrMode.GetEventFailed
        OpEventGetEventFailed_GetEventFailed_Event_VcEvMonErrMode: start-on-event=DemSatellite_0InternalBehavior/GetEventFailed, operation=Event_VcEvMonErrMode.GetEventFailed
        OpEventGetEventFailed_GetEventFailed_EvtInfo_AURIX_RST_MPL: start-on-event=DemSatellite_0InternalBehavior/GetEventFailed, operation=EvtInfo_AURIX_RST_MPL.GetEventFailed
        OpEventGetEventFailed_GetEventFailed_Event_AURIX_RST_MPL: start-on-event=DemSatellite_0InternalBehavior/GetEventFailed, operation=Event_AURIX_RST_MPL.GetEventFailed
        OpEventGetEventFailed_GetEventFailed_EvtInfo_VcEvNodeMisECM: start-on-event=DemSatellite_0InternalBehavior/GetEventFailed, operation=EvtInfo_VcEvNodeMisECM.GetEventFailed
        OpEventGetEventFailed_GetEventFailed_Event_VcEvNodeMisECM: start-on-event=DemSatellite_0InternalBehavior/GetEventFailed, operation=Event_VcEvNodeMisECM.GetEventFailed
        OpEventGetEventFailed_GetEventFailed_EvtInfo_PS_KL30_PLAUS: start-on-event=DemSatellite_0InternalBehavior/GetEventFailed, operation=EvtInfo_PS_KL30_PLAUS.GetEventFailed
        OpEventGetEventFailed_GetEventFailed_Event_PS_KL30_PLAUS: start-on-event=DemSatellite_0InternalBehavior/GetEventFailed, operation=Event_PS_KL30_PLAUS.GetEventFailed
        OpEventGetEventFailed_GetEventFailed_EvtInfo_INV_IAC_W_ELEC_HI: start-on-event=DemSatellite_0InternalBehavior/GetEventFailed, operation=EvtInfo_INV_IAC_W_ELEC_HI.GetEventFailed
        OpEventGetEventFailed_GetEventFailed_Event_INV_IAC_W_ELEC_HI: start-on-event=DemSatellite_0InternalBehavior/GetEventFailed, operation=Event_INV_IAC_W_ELEC_HI.GetEventFailed
        OpEventGetEventFailed_GetEventFailed_EvtInfo_VCEvVddmPropFr19Tioutd: start-on-event=DemSatellite_0InternalBehavior/GetEventFailed, operation=EvtInfo_VCEvVddmPropFr19Tioutd.GetEventFailed
        OpEventGetEventFailed_GetEventFailed_Event_VCEvVddmPropFr19Tioutd: start-on-event=DemSatellite_0InternalBehavior/GetEventFailed, operation=Event_VCEvVddmPropFr19Tioutd.GetEventFailed
        OpEventGetEventFailed_GetEventFailed_EvtInfo_INV_TEMP_DCHA_HW: start-on-event=DemSatellite_0InternalBehavior/GetEventFailed, operation=EvtInfo_INV_TEMP_DCHA_HW.GetEventFailed
        OpEventGetEventFailed_GetEventFailed_Event_INV_TEMP_DCHA_HW: start-on-event=DemSatellite_0InternalBehavior/GetEventFailed, operation=Event_INV_TEMP_DCHA_HW.GetEventFailed
        OpEventGetEventFailed_GetEventFailed_EvtInfo_VcEvPropCANGlbTiOutd: start-on-event=DemSatellite_0InternalBehavior/GetEventFailed, operation=EvtInfo_VcEvPropCANGlbTiOutd.GetEventFailed
        OpEventGetEventFailed_GetEventFailed_Event_VcEvPropCANGlbTiOutd: start-on-event=DemSatellite_0InternalBehavior/GetEventFailed, operation=Event_VcEvPropCANGlbTiOutd.GetEventFailed
        OpEventGetEventFailed_GetEventFailed_EvtInfo_INV_EM_STATOR_TEMP2_RNG_NOK: start-on-event=DemSatellite_0InternalBehavior/GetEventFailed, operation=EvtInfo_INV_EM_STATOR_TEMP2_RNG_NOK.GetEventFailed
        OpEventGetEventFailed_GetEventFailed_Event_INV_EM_STATOR_TEMP2_RNG_NOK: start-on-event=DemSatellite_0InternalBehavior/GetEventFailed, operation=Event_INV_EM_STATOR_TEMP2_RNG_NOK.GetEventFailed
        OpEventGetEventFailed_GetEventFailed_EvtInfo_INV_UHVDC_OV_HWP: start-on-event=DemSatellite_0InternalBehavior/GetEventFailed, operation=EvtInfo_INV_UHVDC_OV_HWP.GetEventFailed
        OpEventGetEventFailed_GetEventFailed_Event_INV_UHVDC_OV_HWP: start-on-event=DemSatellite_0InternalBehavior/GetEventFailed, operation=Event_INV_UHVDC_OV_HWP.GetEventFailed
        OpEventGetEventFailed_GetEventFailed_EvtInfo_Ga_FindEngleAngleFailed: start-on-event=DemSatellite_0InternalBehavior/GetEventFailed, operation=EvtInfo_Ga_FindEngleAngleFailed.GetEventFailed
        OpEventGetEventFailed_GetEventFailed_Event_Ga_FindEngleAngleFailed: start-on-event=DemSatellite_0InternalBehavior/GetEventFailed, operation=Event_Ga_FindEngleAngleFailed.GetEventFailed
        OpEventGetEventFailed_GetEventFailed_EvtInfo_VcEvMonTrqCmp: start-on-event=DemSatellite_0InternalBehavior/GetEventFailed, operation=EvtInfo_VcEvMonTrqCmp.GetEventFailed
        OpEventGetEventFailed_GetEventFailed_Event_VcEvMonTrqCmp: start-on-event=DemSatellite_0InternalBehavior/GetEventFailed, operation=Event_VcEvMonTrqCmp.GetEventFailed
        OpEventGetEventFailed_GetEventFailed_EvtInfo_INV_IGBT_TEMP_V_RNG_LO: start-on-event=DemSatellite_0InternalBehavior/GetEventFailed, operation=EvtInfo_INV_IGBT_TEMP_V_RNG_LO.GetEventFailed
        OpEventGetEventFailed_GetEventFailed_Event_INV_IGBT_TEMP_V_RNG_LO: start-on-event=DemSatellite_0InternalBehavior/GetEventFailed, operation=Event_INV_IGBT_TEMP_V_RNG_LO.GetEventFailed
        OpEventGetEventFailed_GetEventFailed_EvtInfo_INV_CONTROL_LIMIT: start-on-event=DemSatellite_0InternalBehavior/GetEventFailed, operation=EvtInfo_INV_CONTROL_LIMIT.GetEventFailed
        OpEventGetEventFailed_GetEventFailed_Event_INV_CONTROL_LIMIT: start-on-event=DemSatellite_0InternalBehavior/GetEventFailed, operation=Event_INV_CONTROL_LIMIT.GetEventFailed
        OpEventGetEventFailed_GetEventFailed_EvtInfo_COM_CarConfigErr: start-on-event=DemSatellite_0InternalBehavior/GetEventFailed, operation=EvtInfo_COM_CarConfigErr.GetEventFailed
        OpEventGetEventFailed_GetEventFailed_Event_COM_CarConfigErr: start-on-event=DemSatellite_0InternalBehavior/GetEventFailed, operation=Event_COM_CarConfigErr.GetEventFailed
        OpEventGetEventFailed_GetEventFailed_EvtInfo_VCEvEcmPropFr08Tioutd: start-on-event=DemSatellite_0InternalBehavior/GetEventFailed, operation=EvtInfo_VCEvEcmPropFr08Tioutd.GetEventFailed
        OpEventGetEventFailed_GetEventFailed_Event_VCEvEcmPropFr08Tioutd: start-on-event=DemSatellite_0InternalBehavior/GetEventFailed, operation=Event_VCEvEcmPropFr08Tioutd.GetEventFailed
        OpEventGetEventFailed_GetEventFailed_EvtInfo_CU_TEMP1_RNG_LO: start-on-event=DemSatellite_0InternalBehavior/GetEventFailed, operation=EvtInfo_CU_TEMP1_RNG_LO.GetEventFailed
        OpEventGetEventFailed_GetEventFailed_Event_CU_TEMP1_RNG_LO: start-on-event=DemSatellite_0InternalBehavior/GetEventFailed, operation=Event_CU_TEMP1_RNG_LO.GetEventFailed
        OpEventGetEventFailed_GetEventFailed_EvtInfo_INV_EM_STATOR_TEMP2_RNG_SWT: start-on-event=DemSatellite_0InternalBehavior/GetEventFailed, operation=EvtInfo_INV_EM_STATOR_TEMP2_RNG_SWT.GetEventFailed
        OpEventGetEventFailed_GetEventFailed_Event_INV_EM_STATOR_TEMP2_RNG_SWT: start-on-event=DemSatellite_0InternalBehavior/GetEventFailed, operation=Event_INV_EM_STATOR_TEMP2_RNG_SWT.GetEventFailed
        OpEventGetEventFailed_GetEventFailed_EvtInfo_GA_BLDC_POS_FLT: start-on-event=DemSatellite_0InternalBehavior/GetEventFailed, operation=EvtInfo_GA_BLDC_POS_FLT.GetEventFailed
        OpEventGetEventFailed_GetEventFailed_Event_GA_BLDC_POS_FLT: start-on-event=DemSatellite_0InternalBehavior/GetEventFailed, operation=Event_GA_BLDC_POS_FLT.GetEventFailed
        OpEventGetEventFailed_GetEventFailed_EvtInfo_PS_WhlSnsr_FLT: start-on-event=DemSatellite_0InternalBehavior/GetEventFailed, operation=EvtInfo_PS_WhlSnsr_FLT.GetEventFailed
        OpEventGetEventFailed_GetEventFailed_Event_PS_WhlSnsr_FLT: start-on-event=DemSatellite_0InternalBehavior/GetEventFailed, operation=Event_PS_WhlSnsr_FLT.GetEventFailed
        OpEventGetEventFailed_GetEventFailed_EvtInfo_INV_EM_STATOR_TEMP_RNG_LO: start-on-event=DemSatellite_0InternalBehavior/GetEventFailed, operation=EvtInfo_INV_EM_STATOR_TEMP_RNG_LO.GetEventFailed
        OpEventGetEventFailed_GetEventFailed_Event_INV_EM_STATOR_TEMP_RNG_LO: start-on-event=DemSatellite_0InternalBehavior/GetEventFailed, operation=Event_INV_EM_STATOR_TEMP_RNG_LO.GetEventFailed
        OpEventGetEventFailed_GetEventFailed_EvtInfo_INV_RSLVR_SIN_ELEC_HI: start-on-event=DemSatellite_0InternalBehavior/GetEventFailed, operation=EvtInfo_INV_RSLVR_SIN_ELEC_HI.GetEventFailed
        OpEventGetEventFailed_GetEventFailed_Event_INV_RSLVR_SIN_ELEC_HI: start-on-event=DemSatellite_0InternalBehavior/GetEventFailed, operation=Event_INV_RSLVR_SIN_ELEC_HI.GetEventFailed
        OpEventGetEventFailed_GetEventFailed_EvtInfo_INV_RSLVR_SIN_COS_PLAUS: start-on-event=DemSatellite_0InternalBehavior/GetEventFailed, operation=EvtInfo_INV_RSLVR_SIN_COS_PLAUS.GetEventFailed
        OpEventGetEventFailed_GetEventFailed_Event_INV_RSLVR_SIN_COS_PLAUS: start-on-event=DemSatellite_0InternalBehavior/GetEventFailed, operation=Event_INV_RSLVR_SIN_COS_PLAUS.GetEventFailed
        OpEventGetEventFailed_GetEventFailed_EvtInfo_INV_RSLVR_COS_AMP: start-on-event=DemSatellite_0InternalBehavior/GetEventFailed, operation=EvtInfo_INV_RSLVR_COS_AMP.GetEventFailed
        OpEventGetEventFailed_GetEventFailed_Event_INV_RSLVR_COS_AMP: start-on-event=DemSatellite_0InternalBehavior/GetEventFailed, operation=Event_INV_RSLVR_COS_AMP.GetEventFailed
        OpEventGetEventFailed_GetEventFailed_EvtInfo_INV_GATE_DRVR_BOT_HWP: start-on-event=DemSatellite_0InternalBehavior/GetEventFailed, operation=EvtInfo_INV_GATE_DRVR_BOT_HWP.GetEventFailed
        OpEventGetEventFailed_GetEventFailed_Event_INV_GATE_DRVR_BOT_HWP: start-on-event=DemSatellite_0InternalBehavior/GetEventFailed, operation=Event_INV_GATE_DRVR_BOT_HWP.GetEventFailed
        OpEventGetEventFailed_GetEventFailed_EvtInfo_Eg_HallVolWrong: start-on-event=DemSatellite_0InternalBehavior/GetEventFailed, operation=EvtInfo_Eg_HallVolWrong.GetEventFailed
        OpEventGetEventFailed_GetEventFailed_Event_Eg_HallVolWrong: start-on-event=DemSatellite_0InternalBehavior/GetEventFailed, operation=Event_Eg_HallVolWrong.GetEventFailed
        OpEventGetEventFailed_GetEventFailed_EvtInfo_INV_RSLVR_EXCT_RNG_NOK: start-on-event=DemSatellite_0InternalBehavior/GetEventFailed, operation=EvtInfo_INV_RSLVR_EXCT_RNG_NOK.GetEventFailed
        OpEventGetEventFailed_GetEventFailed_Event_INV_RSLVR_EXCT_RNG_NOK: start-on-event=DemSatellite_0InternalBehavior/GetEventFailed, operation=Event_INV_RSLVR_EXCT_RNG_NOK.GetEventFailed
        OpEventGetEventFailed_GetEventFailed_EvtInfo_PA_OpenCirc: start-on-event=DemSatellite_0InternalBehavior/GetEventFailed, operation=EvtInfo_PA_OpenCirc.GetEventFailed
        OpEventGetEventFailed_GetEventFailed_Event_PA_OpenCirc: start-on-event=DemSatellite_0InternalBehavior/GetEventFailed, operation=Event_PA_OpenCirc.GetEventFailed
        OpEventGetEventFailed_GetEventFailed_EvtInfo_INV_RSLVR_COS_ELEC_HI: start-on-event=DemSatellite_0InternalBehavior/GetEventFailed, operation=EvtInfo_INV_RSLVR_COS_ELEC_HI.GetEventFailed
        OpEventGetEventFailed_GetEventFailed_Event_INV_RSLVR_COS_ELEC_HI: start-on-event=DemSatellite_0InternalBehavior/GetEventFailed, operation=Event_INV_RSLVR_COS_ELEC_HI.GetEventFailed
        OpEventGetEventFailed_GetEventFailed_EvtInfo_VcEvCntrHvSysRlySts: start-on-event=DemSatellite_0InternalBehavior/GetEventFailed, operation=EvtInfo_VcEvCntrHvSysRlySts.GetEventFailed
        OpEventGetEventFailed_GetEventFailed_Event_VcEvCntrHvSysRlySts: start-on-event=DemSatellite_0InternalBehavior/GetEventFailed, operation=Event_VcEvCntrHvSysRlySts.GetEventFailed
        OpEventGetEventFailed_GetEventFailed_EvtInfo_CRASH_DTC: start-on-event=DemSatellite_0InternalBehavior/GetEventFailed, operation=EvtInfo_CRASH_DTC.GetEventFailed
        OpEventGetEventFailed_GetEventFailed_Event_CRASH_DTC: start-on-event=DemSatellite_0InternalBehavior/GetEventFailed, operation=Event_CRASH_DTC.GetEventFailed
        OpEventGetEventFailed_GetEventFailed_EvtInfo_INV_IGBT_TEMP_W_RNG_HI: start-on-event=DemSatellite_0InternalBehavior/GetEventFailed, operation=EvtInfo_INV_IGBT_TEMP_W_RNG_HI.GetEventFailed
        OpEventGetEventFailed_GetEventFailed_Event_INV_IGBT_TEMP_W_RNG_HI: start-on-event=DemSatellite_0InternalBehavior/GetEventFailed, operation=Event_INV_IGBT_TEMP_W_RNG_HI.GetEventFailed
        OpEventGetEventFailed_GetEventFailed_EvtInfo_VCEvBecmPropFr02Tioutd: start-on-event=DemSatellite_0InternalBehavior/GetEventFailed, operation=EvtInfo_VCEvBecmPropFr02Tioutd.GetEventFailed
        OpEventGetEventFailed_GetEventFailed_Event_VCEvBecmPropFr02Tioutd: start-on-event=DemSatellite_0InternalBehavior/GetEventFailed, operation=Event_VCEvBecmPropFr02Tioutd.GetEventFailed
        OpEventGetEventFailed_GetEventFailed_EvtInfo_INV_IGBT_TEMP_W_GRDT: start-on-event=DemSatellite_0InternalBehavior/GetEventFailed, operation=EvtInfo_INV_IGBT_TEMP_W_GRDT.GetEventFailed
        OpEventGetEventFailed_GetEventFailed_Event_INV_IGBT_TEMP_W_GRDT: start-on-event=DemSatellite_0InternalBehavior/GetEventFailed, operation=Event_INV_IGBT_TEMP_W_GRDT.GetEventFailed
        OpEventGetEventFailed_GetEventFailed_EvtInfo_EXT_UC_SPI_FLT: start-on-event=DemSatellite_0InternalBehavior/GetEventFailed, operation=EvtInfo_EXT_UC_SPI_FLT.GetEventFailed
        OpEventGetEventFailed_GetEventFailed_Event_EXT_UC_SPI_FLT: start-on-event=DemSatellite_0InternalBehavior/GetEventFailed, operation=Event_EXT_UC_SPI_FLT.GetEventFailed
        OpEventGetEventFailed_GetEventFailed_EvtInfo_INV_IAC_V_ELEC_HWP_001: start-on-event=DemSatellite_0InternalBehavior/GetEventFailed, operation=EvtInfo_INV_IAC_V_ELEC_HWP_001.GetEventFailed
        OpEventGetEventFailed_GetEventFailed_Event_INV_IAC_V_ELEC_HWP_001: start-on-event=DemSatellite_0InternalBehavior/GetEventFailed, operation=Event_INV_IAC_V_ELEC_HWP_001.GetEventFailed
        OpEventGetEventFailed_GetEventFailed_EvtInfo_VcEvChkSumWhlMotSysTqAllwd: start-on-event=DemSatellite_0InternalBehavior/GetEventFailed, operation=EvtInfo_VcEvChkSumWhlMotSysTqAllwd.GetEventFailed
        OpEventGetEventFailed_GetEventFailed_Event_VcEvChkSumWhlMotSysTqAllwd: start-on-event=DemSatellite_0InternalBehavior/GetEventFailed, operation=Event_VcEvChkSumWhlMotSysTqAllwd.GetEventFailed
        OpEventGetEventFailed_GetEventFailed_EvtInfo_FS_MONITIOR_ASC_FLT: start-on-event=DemSatellite_0InternalBehavior/GetEventFailed, operation=EvtInfo_FS_MONITIOR_ASC_FLT.GetEventFailed
        OpEventGetEventFailed_GetEventFailed_Event_FS_MONITIOR_ASC_FLT: start-on-event=DemSatellite_0InternalBehavior/GetEventFailed, operation=Event_FS_MONITIOR_ASC_FLT.GetEventFailed
        OpEventGetEventFailed_GetEventFailed_EvtInfo_INV_IAC_V_AMP: start-on-event=DemSatellite_0InternalBehavior/GetEventFailed, operation=EvtInfo_INV_IAC_V_AMP.GetEventFailed
        OpEventGetEventFailed_GetEventFailed_Event_INV_IAC_V_AMP: start-on-event=DemSatellite_0InternalBehavior/GetEventFailed, operation=Event_INV_IAC_V_AMP.GetEventFailed
        OpEventGetEventFailed_GetEventFailed_EvtInfo_INV_IAC_W_ELEC_LO: start-on-event=DemSatellite_0InternalBehavior/GetEventFailed, operation=EvtInfo_INV_IAC_W_ELEC_LO.GetEventFailed
        OpEventGetEventFailed_GetEventFailed_Event_INV_IAC_W_ELEC_LO: start-on-event=DemSatellite_0InternalBehavior/GetEventFailed, operation=Event_INV_IAC_W_ELEC_LO.GetEventFailed
        OpEventGetEventFailed_GetEventFailed_EvtInfo_VCEvVddmPropFr08Tioutd_001: start-on-event=DemSatellite_0InternalBehavior/GetEventFailed, operation=EvtInfo_VCEvVddmPropFr08Tioutd_001.GetEventFailed
        OpEventGetEventFailed_GetEventFailed_Event_VCEvVddmPropFr08Tioutd_001: start-on-event=DemSatellite_0InternalBehavior/GetEventFailed, operation=Event_VCEvVddmPropFr08Tioutd_001.GetEventFailed
        OpEventGetEventFailed_GetEventFailed_EvtInfo_PS_P12_RES_FLT: start-on-event=DemSatellite_0InternalBehavior/GetEventFailed, operation=EvtInfo_PS_P12_RES_FLT.GetEventFailed
        OpEventGetEventFailed_GetEventFailed_Event_PS_P12_RES_FLT: start-on-event=DemSatellite_0InternalBehavior/GetEventFailed, operation=Event_PS_P12_RES_FLT.GetEventFailed
        OpEventGetEventFailed_GetEventFailed_EvtInfo_INV_RSLVR_SIN_RNG_LO: start-on-event=DemSatellite_0InternalBehavior/GetEventFailed, operation=EvtInfo_INV_RSLVR_SIN_RNG_LO.GetEventFailed
        OpEventGetEventFailed_GetEventFailed_Event_INV_RSLVR_SIN_RNG_LO: start-on-event=DemSatellite_0InternalBehavior/GetEventFailed, operation=Event_INV_RSLVR_SIN_RNG_LO.GetEventFailed
        OpEventGetEventFailed_GetEventFailed_EvtInfo_CU_TEMP_HW_FLT: start-on-event=DemSatellite_0InternalBehavior/GetEventFailed, operation=EvtInfo_CU_TEMP_HW_FLT.GetEventFailed
        OpEventGetEventFailed_GetEventFailed_Event_CU_TEMP_HW_FLT: start-on-event=DemSatellite_0InternalBehavior/GetEventFailed, operation=Event_CU_TEMP_HW_FLT.GetEventFailed
        OpEventGetEventFailed_GetEventFailed_EvtInfo_VCEvEcmPropFr02MgmFr00Tioutd: start-on-event=DemSatellite_0InternalBehavior/GetEventFailed, operation=EvtInfo_VCEvEcmPropFr02MgmFr00Tioutd.GetEventFailed
        OpEventGetEventFailed_GetEventFailed_Event_VCEvEcmPropFr02MgmFr00Tioutd: start-on-event=DemSatellite_0InternalBehavior/GetEventFailed, operation=Event_VCEvEcmPropFr02MgmFr00Tioutd.GetEventFailed
        OpEventGetEventFailed_GetEventFailed_EvtInfo_PS_KL15_RNG_HI: start-on-event=DemSatellite_0InternalBehavior/GetEventFailed, operation=EvtInfo_PS_KL15_RNG_HI.GetEventFailed
        OpEventGetEventFailed_GetEventFailed_Event_PS_KL15_RNG_HI: start-on-event=DemSatellite_0InternalBehavior/GetEventFailed, operation=Event_PS_KL15_RNG_HI.GetEventFailed
        OpEventGetEventFailed_GetEventFailed_EvtInfo_VCEvVddmPropFr17Tioutd: start-on-event=DemSatellite_0InternalBehavior/GetEventFailed, operation=EvtInfo_VCEvVddmPropFr17Tioutd.GetEventFailed
        OpEventGetEventFailed_GetEventFailed_Event_VCEvVddmPropFr17Tioutd: start-on-event=DemSatellite_0InternalBehavior/GetEventFailed, operation=Event_VCEvVddmPropFr17Tioutd.GetEventFailed
        OpEventGetEventFailed_GetEventFailed_EvtInfo_VcEvChkSumCrashStsSafe: start-on-event=DemSatellite_0InternalBehavior/GetEventFailed, operation=EvtInfo_VcEvChkSumCrashStsSafe.GetEventFailed
        OpEventGetEventFailed_GetEventFailed_Event_VcEvChkSumCrashStsSafe: start-on-event=DemSatellite_0InternalBehavior/GetEventFailed, operation=Event_VcEvChkSumCrashStsSafe.GetEventFailed
        OpEventGetEventFailed_GetEventFailed_EvtInfo_DiagC_ClutchService: start-on-event=DemSatellite_0InternalBehavior/GetEventFailed, operation=EvtInfo_DiagC_ClutchService.GetEventFailed
        OpEventGetEventFailed_GetEventFailed_Event_DiagC_ClutchService: start-on-event=DemSatellite_0InternalBehavior/GetEventFailed, operation=Event_DiagC_ClutchService.GetEventFailed
        OpEventGetEventFailed_GetEventFailed_EvtInfo_INV_EM_STATOR_TEMP_RNG_HI: start-on-event=DemSatellite_0InternalBehavior/GetEventFailed, operation=EvtInfo_INV_EM_STATOR_TEMP_RNG_HI.GetEventFailed
        OpEventGetEventFailed_GetEventFailed_Event_INV_EM_STATOR_TEMP_RNG_HI: start-on-event=DemSatellite_0InternalBehavior/GetEventFailed, operation=Event_INV_EM_STATOR_TEMP_RNG_HI.GetEventFailed
        OpEventGetEventFailed_GetEventFailed_EvtInfo_INV_RSLVR_OFFS_OUT_RANG: start-on-event=DemSatellite_0InternalBehavior/GetEventFailed, operation=EvtInfo_INV_RSLVR_OFFS_OUT_RANG.GetEventFailed
        OpEventGetEventFailed_GetEventFailed_Event_INV_RSLVR_OFFS_OUT_RANG: start-on-event=DemSatellite_0InternalBehavior/GetEventFailed, operation=Event_INV_RSLVR_OFFS_OUT_RANG.GetEventFailed
        OpEventGetEventFailed_GetEventFailed_EvtInfo_INV_EM_STATOR_TEMP2_RNG_LO: start-on-event=DemSatellite_0InternalBehavior/GetEventFailed, operation=EvtInfo_INV_EM_STATOR_TEMP2_RNG_LO.GetEventFailed
        OpEventGetEventFailed_GetEventFailed_Event_INV_EM_STATOR_TEMP2_RNG_LO: start-on-event=DemSatellite_0InternalBehavior/GetEventFailed, operation=Event_INV_EM_STATOR_TEMP2_RNG_LO.GetEventFailed
        OpEventGetEventFailed_GetEventFailed_EvtInfo_VcEvMonISAR: start-on-event=DemSatellite_0InternalBehavior/GetEventFailed, operation=EvtInfo_VcEvMonISAR.GetEventFailed
        OpEventGetEventFailed_GetEventFailed_Event_VcEvMonISAR: start-on-event=DemSatellite_0InternalBehavior/GetEventFailed, operation=Event_VcEvMonISAR.GetEventFailed
        OpEventGetEventFailed_GetEventFailed_EvtInfo_GA_BLDC_FLT: start-on-event=DemSatellite_0InternalBehavior/GetEventFailed, operation=EvtInfo_GA_BLDC_FLT.GetEventFailed
        OpEventGetEventFailed_GetEventFailed_Event_GA_BLDC_FLT: start-on-event=DemSatellite_0InternalBehavior/GetEventFailed, operation=Event_GA_BLDC_FLT.GetEventFailed
        OpEventGetEventFailed_GetEventFailed_EvtInfo_INV_RSLVR_EXCT_ELEC_OPEN: start-on-event=DemSatellite_0InternalBehavior/GetEventFailed, operation=EvtInfo_INV_RSLVR_EXCT_ELEC_OPEN.GetEventFailed
        OpEventGetEventFailed_GetEventFailed_Event_INV_RSLVR_EXCT_ELEC_OPEN: start-on-event=DemSatellite_0InternalBehavior/GetEventFailed, operation=Event_INV_RSLVR_EXCT_ELEC_OPEN.GetEventFailed
        OpEventGetEventFailed_GetEventFailed_EvtInfo_INV_RSLVR_EXCT_PLAUS: start-on-event=DemSatellite_0InternalBehavior/GetEventFailed, operation=EvtInfo_INV_RSLVR_EXCT_PLAUS.GetEventFailed
        OpEventGetEventFailed_GetEventFailed_Event_INV_RSLVR_EXCT_PLAUS: start-on-event=DemSatellite_0InternalBehavior/GetEventFailed, operation=Event_INV_RSLVR_EXCT_PLAUS.GetEventFailed
        OpEventGetEventFailed_GetEventFailed_EvtInfo_PS_P15_U_FLT: start-on-event=DemSatellite_0InternalBehavior/GetEventFailed, operation=EvtInfo_PS_P15_U_FLT.GetEventFailed
        OpEventGetEventFailed_GetEventFailed_Event_PS_P15_U_FLT: start-on-event=DemSatellite_0InternalBehavior/GetEventFailed, operation=Event_PS_P15_U_FLT.GetEventFailed
        OpEventGetEventFailed_GetEventFailed_EvtInfo_INV_EM_STATOR_TEMP_RNG_SWT: start-on-event=DemSatellite_0InternalBehavior/GetEventFailed, operation=EvtInfo_INV_EM_STATOR_TEMP_RNG_SWT.GetEventFailed
        OpEventGetEventFailed_GetEventFailed_Event_INV_EM_STATOR_TEMP_RNG_SWT: start-on-event=DemSatellite_0InternalBehavior/GetEventFailed, operation=Event_INV_EM_STATOR_TEMP_RNG_SWT.GetEventFailed
        OpEventGetEventFailed_GetEventFailed_EvtInfo_INV_UHVDC_OV_SWP: start-on-event=DemSatellite_0InternalBehavior/GetEventFailed, operation=EvtInfo_INV_UHVDC_OV_SWP.GetEventFailed
        OpEventGetEventFailed_GetEventFailed_Event_INV_UHVDC_OV_SWP: start-on-event=DemSatellite_0InternalBehavior/GetEventFailed, operation=Event_INV_UHVDC_OV_SWP.GetEventFailed
        OpEventGetEventFailed_GetEventFailed_EvtInfo_AURIX_HW_FLT: start-on-event=DemSatellite_0InternalBehavior/GetEventFailed, operation=EvtInfo_AURIX_HW_FLT.GetEventFailed
        OpEventGetEventFailed_GetEventFailed_Event_AURIX_HW_FLT: start-on-event=DemSatellite_0InternalBehavior/GetEventFailed, operation=Event_AURIX_HW_FLT.GetEventFailed
        OpEventGetEventFailed_GetEventFailed_EvtInfo_INV_GATE_DRVR_TOP_HWP: start-on-event=DemSatellite_0InternalBehavior/GetEventFailed, operation=EvtInfo_INV_GATE_DRVR_TOP_HWP.GetEventFailed
        OpEventGetEventFailed_GetEventFailed_Event_INV_GATE_DRVR_TOP_HWP: start-on-event=DemSatellite_0InternalBehavior/GetEventFailed, operation=Event_INV_GATE_DRVR_TOP_HWP.GetEventFailed
        OpEventGetEventFailed_GetEventFailed_EvtInfo_INV_ACTV_DCHA_HW: start-on-event=DemSatellite_0InternalBehavior/GetEventFailed, operation=EvtInfo_INV_ACTV_DCHA_HW.GetEventFailed
        OpEventGetEventFailed_GetEventFailed_Event_INV_ACTV_DCHA_HW: start-on-event=DemSatellite_0InternalBehavior/GetEventFailed, operation=Event_INV_ACTV_DCHA_HW.GetEventFailed

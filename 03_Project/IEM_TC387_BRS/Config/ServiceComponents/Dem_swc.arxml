[part 5 of 6: package /MICROSAR/Dem_swc/ComponentTypes]
AUTOSAR XML (schema 4-2-2)
package /MICROSAR/Dem_swc/ComponentTypes  (continued)
  service sw component type DemSatellite_0: category=SERVICE_COMPONENT  (continued)
    behavior DemSatellite_0InternalBehavior: handle-termination-and-restart=NO-SUPPORT, included-data-type-set=data-type=[Dem_EventIdType, Dem_RatioIdType, Dem_EventStatusType, Dem_UdsStatusByteType, Dem_DTCFormatType, Dem_InitMonitorReasonType, Dem_OperationCycleStateType, Dem_DTCStatusMaskType, Dem_IndicatorStatusType, Dem_MaxDataValueType, Dem_DTCKindType, Dem_DTCGroupType, Dem_IumprDenomCondIdType, Dem_IumprDenomCondStatusType, Dem_DebounceResetStatusType, Dem_DebouncingStateType, Dem_IumprReadinessGroupType, Dem_DTRControlType, Dem_DTCSeverityType, Dem_MonitorStatusType]  (continued)
      4521 x operation invoked event:  (continued)
        OpEventGetEventExtendedDataRecordEx_GetEventExtendedDataRecordEx_EvtInfo_INV_IAC_U_ELEC_LO: start-on-event=DemSatellite_0InternalBehavior/GetEventExtendedDataRecordEx, operation=EvtInfo_INV_IAC_U_ELEC_LO.GetEventExtendedDataRecordEx
        OpEventGetEventExtendedDataRecordEx_GetEventExtendedDataRecordEx_Event_INV_IAC_U_ELEC_LO: start-on-event=DemSatellite_0InternalBehavior/GetEventExtendedDataRecordEx, operation=Event_INV_IAC_U_ELEC_LO.GetEventExtendedDataRecordEx
        OpEventGetEventExtendedDataRecordEx_GetEventExtendedDataRecordEx_EvtInfo_INV_RSLVR_EXCT_ELEC_HI: start-on-event=DemSatellite_0InternalBehavior/GetEventExtendedDataRecordEx, operation=EvtInfo_INV_RSLVR_EXCT_ELEC_HI.GetEventExtendedDataRecordEx
        OpEventGetEventExtendedDataRecordEx_GetEventExtendedDataRecordEx_Event_INV_RSLVR_EXCT_ELEC_HI: start-on-event=DemSatellite_0InternalBehavior/GetEventExtendedDataRecordEx, operation=Event_INV_RSLVR_EXCT_ELEC_HI.GetEventExtendedDataRecordEx
        OpEventGetEventExtendedDataRecordEx_GetEventExtendedDataRecordEx_EvtInfo_INV_IAC_U_RNG_LO: start-on-event=DemSatellite_0InternalBehavior/GetEventExtendedDataRecordEx, operation=EvtInfo_INV_IAC_U_RNG_LO.GetEventExtendedDataRecordEx
        OpEventGetEventExtendedDataRecordEx_GetEventExtendedDataRecordEx_Event_INV_IAC_U_RNG_LO: start-on-event=DemSatellite_0InternalBehavior/GetEventExtendedDataRecordEx, operation=Event_INV_IAC_U_RNG_LO.GetEventExtendedDataRecordEx
        OpEventGetEventExtendedDataRecordEx_GetEventExtendedDataRecordEx_EvtInfo_INV_IAC_V_RNG_HI: start-on-event=DemSatellite_0InternalBehavior/GetEventExtendedDataRecordEx, operation=EvtInfo_INV_IAC_V_RNG_HI.GetEventExtendedDataRecordEx
        OpEventGetEventExtendedDataRecordEx_GetEventExtendedDataRecordEx_Event_INV_IAC_V_RNG_HI: start-on-event=DemSatellite_0InternalBehavior/GetEventExtendedDataRecordEx, operation=Event_INV_IAC_V_RNG_HI.GetEventExtendedDataRecordEx
        OpEventGetEventExtendedDataRecordEx_GetEventExtendedDataRecordEx_EvtInfo_INV_IGBT_TEMP_U_PLAUS: start-on-event=DemSatellite_0InternalBehavior/GetEventExtendedDataRecordEx, operation=EvtInfo_INV_IGBT_TEMP_U_PLAUS.GetEventExtendedDataRecordEx
        OpEventGetEventExtendedDataRecordEx_GetEventExtendedDataRecordEx_Event_INV_IGBT_TEMP_U_PLAUS: start-on-event=DemSatellite_0InternalBehavior/GetEventExtendedDataRecordEx, operation=Event_INV_IGBT_TEMP_U_PLAUS.GetEventExtendedDataRecordEx
        OpEventGetEventExtendedDataRecordEx_GetEventExtendedDataRecordEx_EvtInfo_INV_RSLVR_OFFS_DFT: start-on-event=DemSatellite_0InternalBehavior/GetEventExtendedDataRecordEx, operation=EvtInfo_INV_RSLVR_OFFS_DFT.GetEventExtendedDataRecordEx
        OpEventGetEventExtendedDataRecordEx_GetEventExtendedDataRecordEx_Event_INV_RSLVR_OFFS_DFT: start-on-event=DemSatellite_0InternalBehavior/GetEventExtendedDataRecordEx, operation=Event_INV_RSLVR_OFFS_DFT.GetEventExtendedDataRecordEx
        OpEventGetEventExtendedDataRecordEx_GetEventExtendedDataRecordEx_EvtInfo_Ga_MoveOverThd: start-on-event=DemSatellite_0InternalBehavior/GetEventExtendedDataRecordEx, operation=EvtInfo_Ga_MoveOverThd.GetEventExtendedDataRecordEx
        OpEventGetEventExtendedDataRecordEx_GetEventExtendedDataRecordEx_Event_Ga_MoveOverThd: start-on-event=DemSatellite_0InternalBehavior/GetEventExtendedDataRecordEx, operation=Event_Ga_MoveOverThd.GetEventExtendedDataRecordEx
        OpEventGetEventExtendedDataRecordEx_GetEventExtendedDataRecordEx_EvtInfo_VcEvMonIPH: start-on-event=DemSatellite_0InternalBehavior/GetEventExtendedDataRecordEx, operation=EvtInfo_VcEvMonIPH.GetEventExtendedDataRecordEx
        OpEventGetEventExtendedDataRecordEx_GetEventExtendedDataRecordEx_Event_VcEvMonIPH: start-on-event=DemSatellite_0InternalBehavior/GetEventExtendedDataRecordEx, operation=Event_VcEvMonIPH.GetEventExtendedDataRecordEx
        OpEventGetEventExtendedDataRecordEx_GetEventExtendedDataRecordEx_EvtInfo_INV_RSLVR_HW_FLT: start-on-event=DemSatellite_0InternalBehavior/GetEventExtendedDataRecordEx, operation=EvtInfo_INV_RSLVR_HW_FLT.GetEventExtendedDataRecordEx
        OpEventGetEventExtendedDataRecordEx_GetEventExtendedDataRecordEx_Event_INV_RSLVR_HW_FLT: start-on-event=DemSatellite_0InternalBehavior/GetEventExtendedDataRecordEx, operation=Event_INV_RSLVR_HW_FLT.GetEventExtendedDataRecordEx
        OpEventGetEventExtendedDataRecordEx_GetEventExtendedDataRecordEx_EvtInfo_INV_RSLVR_SIN_ELEC_LO: start-on-event=DemSatellite_0InternalBehavior/GetEventExtendedDataRecordEx, operation=EvtInfo_INV_RSLVR_SIN_ELEC_LO.GetEventExtendedDataRecordEx
        OpEventGetEventExtendedDataRecordEx_GetEventExtendedDataRecordEx_Event_INV_RSLVR_SIN_ELEC_LO: start-on-event=DemSatellite_0InternalBehavior/GetEventExtendedDataRecordEx, operation=Event_INV_RSLVR_SIN_ELEC_LO.GetEventExtendedDataRecordEx
        OpEventGetEventExtendedDataRecordEx_GetEventExtendedDataRecordEx_EvtInfo_INV_IAC_W_AMP: start-on-event=DemSatellite_0InternalBehavior/GetEventExtendedDataRecordEx, operation=EvtInfo_INV_IAC_W_AMP.GetEventExtendedDataRecordEx
        OpEventGetEventExtendedDataRecordEx_GetEventExtendedDataRecordEx_Event_INV_IAC_W_AMP: start-on-event=DemSatellite_0InternalBehavior/GetEventExtendedDataRecordEx, operation=Event_INV_IAC_W_AMP.GetEventExtendedDataRecordEx
        OpEventGetEventExtendedDataRecordEx_GetEventExtendedDataRecordEx_EvtInfo_VCC_OverVoltage: start-on-event=DemSatellite_0InternalBehavior/GetEventExtendedDataRecordEx, operation=EvtInfo_VCC_OverVoltage.GetEventExtendedDataRecordEx
        OpEventGetEventExtendedDataRecordEx_GetEventExtendedDataRecordEx_Event_VCC_OverVoltage: start-on-event=DemSatellite_0InternalBehavior/GetEventExtendedDataRecordEx, operation=Event_VCC_OverVoltage.GetEventExtendedDataRecordEx
        OpEventGetEventExtendedDataRecordEx_GetEventExtendedDataRecordEx_EvtInfo_PS_BLDC_OV_FLT: start-on-event=DemSatellite_0InternalBehavior/GetEventExtendedDataRecordEx, operation=EvtInfo_PS_BLDC_OV_FLT.GetEventExtendedDataRecordEx
        OpEventGetEventExtendedDataRecordEx_GetEventExtendedDataRecordEx_Event_PS_BLDC_OV_FLT: start-on-event=DemSatellite_0InternalBehavior/GetEventExtendedDataRecordEx, operation=Event_PS_BLDC_OV_FLT.GetEventExtendedDataRecordEx
        OpEventGetEventExtendedDataRecordEx_GetEventExtendedDataRecordEx_EvtInfo_AURIX_EEPROM_FLT: start-on-event=DemSatellite_0InternalBehavior/GetEventExtendedDataRecordEx, operation=EvtInfo_AURIX_EEPROM_FLT.GetEventExtendedDataRecordEx
        OpEventGetEventExtendedDataRecordEx_GetEventExtendedDataRecordEx_Event_AURIX_EEPROM_FLT: start-on-event=DemSatellite_0InternalBehavior/GetEventExtendedDataRecordEx, operation=Event_AURIX_EEPROM_FLT.GetEventExtendedDataRecordEx
        OpEventGetEventExtendedDataRecordEx_GetEventExtendedDataRecordEx_EvtInfo_FS_MONITIOR_ASC_FW_FLT: start-on-event=DemSatellite_0InternalBehavior/GetEventExtendedDataRecordEx, operation=EvtInfo_FS_MONITIOR_ASC_FW_FLT.GetEventExtendedDataRecordEx
        OpEventGetEventExtendedDataRecordEx_GetEventExtendedDataRecordEx_Event_FS_MONITIOR_ASC_FW_FLT: start-on-event=DemSatellite_0InternalBehavior/GetEventExtendedDataRecordEx, operation=Event_FS_MONITIOR_ASC_FW_FLT.GetEventExtendedDataRecordEx
        OpEventGetEventExtendedDataRecordEx_GetEventExtendedDataRecordEx_EvtInfo_VCEvSrsPropFr02Tioutd: start-on-event=DemSatellite_0InternalBehavior/GetEventExtendedDataRecordEx, operation=EvtInfo_VCEvSrsPropFr02Tioutd.GetEventExtendedDataRecordEx
        OpEventGetEventExtendedDataRecordEx_GetEventExtendedDataRecordEx_Event_VCEvSrsPropFr02Tioutd: start-on-event=DemSatellite_0InternalBehavior/GetEventExtendedDataRecordEx, operation=Event_VCEvSrsPropFr02Tioutd.GetEventExtendedDataRecordEx
        OpEventGetEventExtendedDataRecordEx_GetEventExtendedDataRecordEx_EvtInfo_VcEvMonErrMode: start-on-event=DemSatellite_0InternalBehavior/GetEventExtendedDataRecordEx, operation=EvtInfo_VcEvMonErrMode.GetEventExtendedDataRecordEx
        OpEventGetEventExtendedDataRecordEx_GetEventExtendedDataRecordEx_Event_VcEvMonErrMode: start-on-event=DemSatellite_0InternalBehavior/GetEventExtendedDataRecordEx, operation=Event_VcEvMonErrMode.GetEventExtendedDataRecordEx
        OpEventGetEventExtendedDataRecordEx_GetEventExtendedDataRecordEx_EvtInfo_AURIX_RST_MPL: start-on-event=DemSatellite_0InternalBehavior/GetEventExtendedDataRecordEx, operation=EvtInfo_AURIX_RST_MPL.GetEventExtendedDataRecordEx
        OpEventGetEventExtendedDataRecordEx_GetEventExtendedDataRecordEx_Event_AURIX_RST_MPL: start-on-event=DemSatellite_0InternalBehavior/GetEventExtendedDataRecordEx, operation=Event_AURIX_RST_MPL.GetEventExtendedDataRecordEx
        OpEventGetEventExtendedDataRecordEx_GetEventExtendedDataRecordEx_EvtInfo_VcEvNodeMisECM: start-on-event=DemSatellite_0InternalBehavior/GetEventExtendedDataRecordEx, operation=EvtInfo_VcEvNodeMisECM.GetEventExtendedDataRecordEx
        OpEventGetEventExtendedDataRecordEx_GetEventExtendedDataRecordEx_Event_VcEvNodeMisECM: start-on-event=DemSatellite_0InternalBehavior/GetEventExtendedDataRecordEx, operation=Event_VcEvNodeMisECM.GetEventExtendedDataRecordEx
        OpEventGetEventExtendedDataRecordEx_GetEventExtendedDataRecordEx_EvtInfo_PS_KL30_PLAUS: start-on-event=DemSatellite_0InternalBehavior/GetEventExtendedDataRecordEx, operation=EvtInfo_PS_KL30_PLAUS.GetEventExtendedDataRecordEx
        OpEventGetEventExtendedDataRecordEx_GetEventExtendedDataRecordEx_Event_PS_KL30_PLAUS: start-on-event=DemSatellite_0InternalBehavior/GetEventExtendedDataRecordEx, operation=Event_PS_KL30_PLAUS.GetEventExtendedDataRecordEx
        OpEventGetEventExtendedDataRecordEx_GetEventExtendedDataRecordEx_EvtInfo_INV_IAC_W_ELEC_HI: start-on-event=DemSatellite_0InternalBehavior/GetEventExtendedDataRecordEx, operation=EvtInfo_INV_IAC_W_ELEC_HI.GetEventExtendedDataRecordEx
        OpEventGetEventExtendedDataRecordEx_GetEventExtendedDataRecordEx_Event_INV_IAC_W_ELEC_HI: start-on-event=DemSatellite_0InternalBehavior/GetEventExtendedDataRecordEx, operation=Event_INV_IAC_W_ELEC_HI.GetEventExtendedDataRecordEx
        OpEventGetEventExtendedDataRecordEx_GetEventExtendedDataRecordEx_EvtInfo_VCEvVddmPropFr19Tioutd: start-on-event=DemSatellite_0InternalBehavior/GetEventExtendedDataRecordEx, operation=EvtInfo_VCEvVddmPropFr19Tioutd.GetEventExtendedDataRecordEx
        OpEventGetEventExtendedDataRecordEx_GetEventExtendedDataRecordEx_Event_VCEvVddmPropFr19Tioutd: start-on-event=DemSatellite_0InternalBehavior/GetEventExtendedDataRecordEx, operation=Event_VCEvVddmPropFr19Tioutd.GetEventExtendedDataRecordEx
        OpEventGetEventExtendedDataRecordEx_GetEventExtendedDataRecordEx_EvtInfo_INV_TEMP_DCHA_HW: start-on-event=DemSatellite_0InternalBehavior/GetEventExtendedDataRecordEx, operation=EvtInfo_INV_TEMP_DCHA_HW.GetEventExtendedDataRecordEx
        OpEventGetEventExtendedDataRecordEx_GetEventExtendedDataRecordEx_Event_INV_TEMP_DCHA_HW: start-on-event=DemSatellite_0InternalBehavior/GetEventExtendedDataRecordEx, operation=Event_INV_TEMP_DCHA_HW.GetEventExtendedDataRecordEx
        OpEventGetEventExtendedDataRecordEx_GetEventExtendedDataRecordEx_EvtInfo_VcEvPropCANGlbTiOutd: start-on-event=DemSatellite_0InternalBehavior/GetEventExtendedDataRecordEx, operation=EvtInfo_VcEvPropCANGlbTiOutd.GetEventExtendedDataRecordEx
        OpEventGetEventExtendedDataRecordEx_GetEventExtendedDataRecordEx_Event_VcEvPropCANGlbTiOutd: start-on-event=DemSatellite_0InternalBehavior/GetEventExtendedDataRecordEx, operation=Event_VcEvPropCANGlbTiOutd.GetEventExtendedDataRecordEx
        OpEventGetEventExtendedDataRecordEx_GetEventExtendedDataRecordEx_EvtInfo_INV_EM_STATOR_TEMP2_RNG_NOK: start-on-event=DemSatellite_0InternalBehavior/GetEventExtendedDataRecordEx, operation=EvtInfo_INV_EM_STATOR_TEMP2_RNG_NOK.GetEventExtendedDataRecordEx
        OpEventGetEventExtendedDataRecordEx_GetEventExtendedDataRecordEx_Event_INV_EM_STATOR_TEMP2_RNG_NOK: start-on-event=DemSatellite_0InternalBehavior/GetEventExtendedDataRecordEx, operation=Event_INV_EM_STATOR_TEMP2_RNG_NOK.GetEventExtendedDataRecordEx
        OpEventGetEventExtendedDataRecordEx_GetEventExtendedDataRecordEx_EvtInfo_INV_UHVDC_OV_HWP: start-on-event=DemSatellite_0InternalBehavior/GetEventExtendedDataRecordEx, operation=EvtInfo_INV_UHVDC_OV_HWP.GetEventExtendedDataRecordEx
        OpEventGetEventExtendedDataRecordEx_GetEventExtendedDataRecordEx_Event_INV_UHVDC_OV_HWP: start-on-event=DemSatellite_0InternalBehavior/GetEventExtendedDataRecordEx, operation=Event_INV_UHVDC_OV_HWP.GetEventExtendedDataRecordEx
        OpEventGetEventExtendedDataRecordEx_GetEventExtendedDataRecordEx_EvtInfo_Ga_FindEngleAngleFailed: start-on-event=DemSatellite_0InternalBehavior/GetEventExtendedDataRecordEx, operation=EvtInfo_Ga_FindEngleAngleFailed.GetEventExtendedDataRecordEx
        OpEventGetEventExtendedDataRecordEx_GetEventExtendedDataRecordEx_Event_Ga_FindEngleAngleFailed: start-on-event=DemSatellite_0InternalBehavior/GetEventExtendedDataRecordEx, operation=Event_Ga_FindEngleAngleFailed.GetEventExtendedDataRecordEx
        OpEventGetEventExtendedDataRecordEx_GetEventExtendedDataRecordEx_EvtInfo_VcEvMonTrqCmp: start-on-event=DemSatellite_0InternalBehavior/GetEventExtendedDataRecordEx, operation=EvtInfo_VcEvMonTrqCmp.GetEventExtendedDataRecordEx
        OpEventGetEventExtendedDataRecordEx_GetEventExtendedDataRecordEx_Event_VcEvMonTrqCmp: start-on-event=DemSatellite_0InternalBehavior/GetEventExtendedDataRecordEx, operation=Event_VcEvMonTrqCmp.GetEventExtendedDataRecordEx
        OpEventGetEventExtendedDataRecordEx_GetEventExtendedDataRecordEx_EvtInfo_INV_IGBT_TEMP_V_RNG_LO: start-on-event=DemSatellite_0InternalBehavior/GetEventExtendedDataRecordEx, operation=EvtInfo_INV_IGBT_TEMP_V_RNG_LO.GetEventExtendedDataRecordEx
        OpEventGetEventExtendedDataRecordEx_GetEventExtendedDataRecordEx_Event_INV_IGBT_TEMP_V_RNG_LO: start-on-event=DemSatellite_0InternalBehavior/GetEventExtendedDataRecordEx, operation=Event_INV_IGBT_TEMP_V_RNG_LO.GetEventExtendedDataRecordEx
        OpEventGetEventExtendedDataRecordEx_GetEventExtendedDataRecordEx_EvtInfo_INV_CONTROL_LIMIT: start-on-event=DemSatellite_0InternalBehavior/GetEventExtendedDataRecordEx, operation=EvtInfo_INV_CONTROL_LIMIT.GetEventExtendedDataRecordEx
        OpEventGetEventExtendedDataRecordEx_GetEventExtendedDataRecordEx_Event_INV_CONTROL_LIMIT: start-on-event=DemSatellite_0InternalBehavior/GetEventExtendedDataRecordEx, operation=Event_INV_CONTROL_LIMIT.GetEventExtendedDataRecordEx
        OpEventGetEventExtendedDataRecordEx_GetEventExtendedDataRecordEx_EvtInfo_COM_CarConfigErr: start-on-event=DemSatellite_0InternalBehavior/GetEventExtendedDataRecordEx, operation=EvtInfo_COM_CarConfigErr.GetEventExtendedDataRecordEx
        OpEventGetEventExtendedDataRecordEx_GetEventExtendedDataRecordEx_Event_COM_CarConfigErr: start-on-event=DemSatellite_0InternalBehavior/GetEventExtendedDataRecordEx, operation=Event_COM_CarConfigErr.GetEventExtendedDataRecordEx
        OpEventGetEventExtendedDataRecordEx_GetEventExtendedDataRecordEx_EvtInfo_VCEvEcmPropFr08Tioutd: start-on-event=DemSatellite_0InternalBehavior/GetEventExtendedDataRecordEx, operation=EvtInfo_VCEvEcmPropFr08Tioutd.GetEventExtendedDataRecordEx
        OpEventGetEventExtendedDataRecordEx_GetEventExtendedDataRecordEx_Event_VCEvEcmPropFr08Tioutd: start-on-event=DemSatellite_0InternalBehavior/GetEventExtendedDataRecordEx, operation=Event_VCEvEcmPropFr08Tioutd.GetEventExtendedDataRecordEx
        OpEventGetEventExtendedDataRecordEx_GetEventExtendedDataRecordEx_EvtInfo_CU_TEMP1_RNG_LO: start-on-event=DemSatellite_0InternalBehavior/GetEventExtendedDataRecordEx, operation=EvtInfo_CU_TEMP1_RNG_LO.GetEventExtendedDataRecordEx
        OpEventGetEventExtendedDataRecordEx_GetEventExtendedDataRecordEx_Event_CU_TEMP1_RNG_LO: start-on-event=DemSatellite_0InternalBehavior/GetEventExtendedDataRecordEx, operation=Event_CU_TEMP1_RNG_LO.GetEventExtendedDataRecordEx
        OpEventGetEventExtendedDataRecordEx_GetEventExtendedDataRecordEx_EvtInfo_INV_EM_STATOR_TEMP2_RNG_SWT: start-on-event=DemSatellite_0InternalBehavior/GetEventExtendedDataRecordEx, operation=EvtInfo_INV_EM_STATOR_TEMP2_RNG_SWT.GetEventExtendedDataRecordEx
        OpEventGetEventExtendedDataRecordEx_GetEventExtendedDataRecordEx_Event_INV_EM_STATOR_TEMP2_RNG_SWT: start-on-event=DemSatellite_0InternalBehavior/GetEventExtendedDataRecordEx, operation=Event_INV_EM_STATOR_TEMP2_RNG_SWT.GetEventExtendedDataRecordEx
        OpEventGetEventExtendedDataRecordEx_GetEventExtendedDataRecordEx_EvtInfo_GA_BLDC_POS_FLT: start-on-event=DemSatellite_0InternalBehavior/GetEventExtendedDataRecordEx, operation=EvtInfo_GA_BLDC_POS_FLT.GetEventExtendedDataRecordEx
        OpEventGetEventExtendedDataRecordEx_GetEventExtendedDataRecordEx_Event_GA_BLDC_POS_FLT: start-on-event=DemSatellite_0InternalBehavior/GetEventExtendedDataRecordEx, operation=Event_GA_BLDC_POS_FLT.GetEventExtendedDataRecordEx
        OpEventGetEventExtendedDataRecordEx_GetEventExtendedDataRecordEx_EvtInfo_PS_WhlSnsr_FLT: start-on-event=DemSatellite_0InternalBehavior/GetEventExtendedDataRecordEx, operation=EvtInfo_PS_WhlSnsr_FLT.GetEventExtendedDataRecordEx
        OpEventGetEventExtendedDataRecordEx_GetEventExtendedDataRecordEx_Event_PS_WhlSnsr_FLT: start-on-event=DemSatellite_0InternalBehavior/GetEventExtendedDataRecordEx, operation=Event_PS_WhlSnsr_FLT.GetEventExtendedDataRecordEx
        OpEventGetEventExtendedDataRecordEx_GetEventExtendedDataRecordEx_EvtInfo_INV_EM_STATOR_TEMP_RNG_LO: start-on-event=DemSatellite_0InternalBehavior/GetEventExtendedDataRecordEx, operation=EvtInfo_INV_EM_STATOR_TEMP_RNG_LO.GetEventExtendedDataRecordEx
        OpEventGetEventExtendedDataRecordEx_GetEventExtendedDataRecordEx_Event_INV_EM_STATOR_TEMP_RNG_LO: start-on-event=DemSatellite_0InternalBehavior/GetEventExtendedDataRecordEx, operation=Event_INV_EM_STATOR_TEMP_RNG_LO.GetEventExtendedDataRecordEx
        OpEventGetEventExtendedDataRecordEx_GetEventExtendedDataRecordEx_EvtInfo_INV_RSLVR_SIN_ELEC_HI: start-on-event=DemSatellite_0InternalBehavior/GetEventExtendedDataRecordEx, operation=EvtInfo_INV_RSLVR_SIN_ELEC_HI.GetEventExtendedDataRecordEx
        OpEventGetEventExtendedDataRecordEx_GetEventExtendedDataRecordEx_Event_INV_RSLVR_SIN_ELEC_HI: start-on-event=DemSatellite_0InternalBehavior/GetEventExtendedDataRecordEx, operation=Event_INV_RSLVR_SIN_ELEC_HI.GetEventExtendedDataRecordEx
        OpEventGetEventExtendedDataRecordEx_GetEventExtendedDataRecordEx_EvtInfo_INV_RSLVR_SIN_COS_PLAUS: start-on-event=DemSatellite_0InternalBehavior/GetEventExtendedDataRecordEx, operation=EvtInfo_INV_RSLVR_SIN_COS_PLAUS.GetEventExtendedDataRecordEx
        OpEventGetEventExtendedDataRecordEx_GetEventExtendedDataRecordEx_Event_INV_RSLVR_SIN_COS_PLAUS: start-on-event=DemSatellite_0InternalBehavior/GetEventExtendedDataRecordEx, operation=Event_INV_RSLVR_SIN_COS_PLAUS.GetEventExtendedDataRecordEx
        OpEventGetEventExtendedDataRecordEx_GetEventExtendedDataRecordEx_EvtInfo_INV_RSLVR_COS_AMP: start-on-event=DemSatellite_0InternalBehavior/GetEventExtendedDataRecordEx, operation=EvtInfo_INV_RSLVR_COS_AMP.GetEventExtendedDataRecordEx
        OpEventGetEventExtendedDataRecordEx_GetEventExtendedDataRecordEx_Event_INV_RSLVR_COS_AMP: start-on-event=DemSatellite_0InternalBehavior/GetEventExtendedDataRecordEx, operation=Event_INV_RSLVR_COS_AMP.GetEventExtendedDataRecordEx
        OpEventGetEventExtendedDataRecordEx_GetEventExtendedDataRecordEx_EvtInfo_INV_GATE_DRVR_BOT_HWP: start-on-event=DemSatellite_0InternalBehavior/GetEventExtendedDataRecordEx, operation=EvtInfo_INV_GATE_DRVR_BOT_HWP.GetEventExtendedDataRecordEx
        OpEventGetEventExtendedDataRecordEx_GetEventExtendedDataRecordEx_Event_INV_GATE_DRVR_BOT_HWP: start-on-event=DemSatellite_0InternalBehavior/GetEventExtendedDataRecordEx, operation=Event_INV_GATE_DRVR_BOT_HWP.GetEventExtendedDataRecordEx
        OpEventGetEventExtendedDataRecordEx_GetEventExtendedDataRecordEx_EvtInfo_Eg_HallVolWrong: start-on-event=DemSatellite_0InternalBehavior/GetEventExtendedDataRecordEx, operation=EvtInfo_Eg_HallVolWrong.GetEventExtendedDataRecordEx
        OpEventGetEventExtendedDataRecordEx_GetEventExtendedDataRecordEx_Event_Eg_HallVolWrong: start-on-event=DemSatellite_0InternalBehavior/GetEventExtendedDataRecordEx, operation=Event_Eg_HallVolWrong.GetEventExtendedDataRecordEx
        OpEventGetEventExtendedDataRecordEx_GetEventExtendedDataRecordEx_EvtInfo_INV_RSLVR_EXCT_RNG_NOK: start-on-event=DemSatellite_0InternalBehavior/GetEventExtendedDataRecordEx, operation=EvtInfo_INV_RSLVR_EXCT_RNG_NOK.GetEventExtendedDataRecordEx
        OpEventGetEventExtendedDataRecordEx_GetEventExtendedDataRecordEx_Event_INV_RSLVR_EXCT_RNG_NOK: start-on-event=DemSatellite_0InternalBehavior/GetEventExtendedDataRecordEx, operation=Event_INV_RSLVR_EXCT_RNG_NOK.GetEventExtendedDataRecordEx
        OpEventGetEventExtendedDataRecordEx_GetEventExtendedDataRecordEx_EvtInfo_PA_OpenCirc: start-on-event=DemSatellite_0InternalBehavior/GetEventExtendedDataRecordEx, operation=EvtInfo_PA_OpenCirc.GetEventExtendedDataRecordEx
        OpEventGetEventExtendedDataRecordEx_GetEventExtendedDataRecordEx_Event_PA_OpenCirc: start-on-event=DemSatellite_0InternalBehavior/GetEventExtendedDataRecordEx, operation=Event_PA_OpenCirc.GetEventExtendedDataRecordEx
        OpEventGetEventExtendedDataRecordEx_GetEventExtendedDataRecordEx_EvtInfo_INV_RSLVR_COS_ELEC_HI: start-on-event=DemSatellite_0InternalBehavior/GetEventExtendedDataRecordEx, operation=EvtInfo_INV_RSLVR_COS_ELEC_HI.GetEventExtendedDataRecordEx
        OpEventGetEventExtendedDataRecordEx_GetEventExtendedDataRecordEx_Event_INV_RSLVR_COS_ELEC_HI: start-on-event=DemSatellite_0InternalBehavior/GetEventExtendedDataRecordEx, operation=Event_INV_RSLVR_COS_ELEC_HI.GetEventExtendedDataRecordEx
        OpEventGetEventExtendedDataRecordEx_GetEventExtendedDataRecordEx_EvtInfo_VcEvCntrHvSysRlySts: start-on-event=DemSatellite_0InternalBehavior/GetEventExtendedDataRecordEx, operation=EvtInfo_VcEvCntrHvSysRlySts.GetEventExtendedDataRecordEx
        OpEventGetEventExtendedDataRecordEx_GetEventExtendedDataRecordEx_Event_VcEvCntrHvSysRlySts: start-on-event=DemSatellite_0InternalBehavior/GetEventExtendedDataRecordEx, operation=Event_VcEvCntrHvSysRlySts.GetEventExtendedDataRecordEx
        OpEventGetEventExtendedDataRecordEx_GetEventExtendedDataRecordEx_EvtInfo_CRASH_DTC: start-on-event=DemSatellite_0InternalBehavior/GetEventExtendedDataRecordEx, operation=EvtInfo_CRASH_DTC.GetEventExtendedDataRecordEx
        OpEventGetEventExtendedDataRecordEx_GetEventExtendedDataRecordEx_Event_CRASH_DTC: start-on-event=DemSatellite_0InternalBehavior/GetEventExtendedDataRecordEx, operation=Event_CRASH_DTC.GetEventExtendedDataRecordEx
        OpEventGetEventExtendedDataRecordEx_GetEventExtendedDataRecordEx_EvtInfo_INV_IGBT_TEMP_W_RNG_HI: start-on-event=DemSatellite_0InternalBehavior/GetEventExtendedDataRecordEx, operation=EvtInfo_INV_IGBT_TEMP_W_RNG_HI.GetEventExtendedDataRecordEx
        OpEventGetEventExtendedDataRecordEx_GetEventExtendedDataRecordEx_Event_INV_IGBT_TEMP_W_RNG_HI: start-on-event=DemSatellite_0InternalBehavior/GetEventExtendedDataRecordEx, operation=Event_INV_IGBT_TEMP_W_RNG_HI.GetEventExtendedDataRecordEx
        OpEventGetEventExtendedDataRecordEx_GetEventExtendedDataRecordEx_EvtInfo_VCEvBecmPropFr02Tioutd: start-on-event=DemSatellite_0InternalBehavior/GetEventExtendedDataRecordEx, operation=EvtInfo_VCEvBecmPropFr02Tioutd.GetEventExtendedDataRecordEx
        OpEventGetEventExtendedDataRecordEx_GetEventExtendedDataRecordEx_Event_VCEvBecmPropFr02Tioutd: start-on-event=DemSatellite_0InternalBehavior/GetEventExtendedDataRecordEx, operation=Event_VCEvBecmPropFr02Tioutd.GetEventExtendedDataRecordEx
        OpEventGetEventExtendedDataRecordEx_GetEventExtendedDataRecordEx_EvtInfo_INV_IGBT_TEMP_W_GRDT: start-on-event=DemSatellite_0InternalBehavior/GetEventExtendedDataRecordEx, operation=EvtInfo_INV_IGBT_TEMP_W_GRDT.GetEventExtendedDataRecordEx
        OpEventGetEventExtendedDataRecordEx_GetEventExtendedDataRecordEx_Event_INV_IGBT_TEMP_W_GRDT: start-on-event=DemSatellite_0InternalBehavior/GetEventExtendedDataRecordEx, operation=Event_INV_IGBT_TEMP_W_GRDT.GetEventExtendedDataRecordEx
        OpEventGetEventExtendedDataRecordEx_GetEventExtendedDataRecordEx_EvtInfo_EXT_UC_SPI_FLT: start-on-event=DemSatellite_0InternalBehavior/GetEventExtendedDataRecordEx, operation=EvtInfo_EXT_UC_SPI_FLT.GetEventExtendedDataRecordEx
        OpEventGetEventExtendedDataRecordEx_GetEventExtendedDataRecordEx_Event_EXT_UC_SPI_FLT: start-on-event=DemSatellite_0InternalBehavior/GetEventExtendedDataRecordEx, operation=Event_EXT_UC_SPI_FLT.GetEventExtendedDataRecordEx
        OpEventGetEventExtendedDataRecordEx_GetEventExtendedDataRecordEx_EvtInfo_INV_IAC_V_ELEC_HWP_001: start-on-event=DemSatellite_0InternalBehavior/GetEventExtendedDataRecordEx, operation=EvtInfo_INV_IAC_V_ELEC_HWP_001.GetEventExtendedDataRecordEx
        OpEventGetEventExtendedDataRecordEx_GetEventExtendedDataRecordEx_Event_INV_IAC_V_ELEC_HWP_001: start-on-event=DemSatellite_0InternalBehavior/GetEventExtendedDataRecordEx, operation=Event_INV_IAC_V_ELEC_HWP_001.GetEventExtendedDataRecordEx
        OpEventGetEventExtendedDataRecordEx_GetEventExtendedDataRecordEx_EvtInfo_VcEvChkSumWhlMotSysTqAllwd: start-on-event=DemSatellite_0InternalBehavior/GetEventExtendedDataRecordEx, operation=EvtInfo_VcEvChkSumWhlMotSysTqAllwd.GetEventExtendedDataRecordEx
        OpEventGetEventExtendedDataRecordEx_GetEventExtendedDataRecordEx_Event_VcEvChkSumWhlMotSysTqAllwd: start-on-event=DemSatellite_0InternalBehavior/GetEventExtendedDataRecordEx, operation=Event_VcEvChkSumWhlMotSysTqAllwd.GetEventExtendedDataRecordEx
        OpEventGetEventExtendedDataRecordEx_GetEventExtendedDataRecordEx_EvtInfo_FS_MONITIOR_ASC_FLT: start-on-event=DemSatellite_0InternalBehavior/GetEventExtendedDataRecordEx, operation=EvtInfo_FS_MONITIOR_ASC_FLT.GetEventExtendedDataRecordEx
        OpEventGetEventExtendedDataRecordEx_GetEventExtendedDataRecordEx_Event_FS_MONITIOR_ASC_FLT: start-on-event=DemSatellite_0InternalBehavior/GetEventExtendedDataRecordEx, operation=Event_FS_MONITIOR_ASC_FLT.GetEventExtendedDataRecordEx
        OpEventGetEventExtendedDataRecordEx_GetEventExtendedDataRecordEx_EvtInfo_INV_IAC_V_AMP: start-on-event=DemSatellite_0InternalBehavior/GetEventExtendedDataRecordEx, operation=EvtInfo_INV_IAC_V_AMP.GetEventExtendedDataRecordEx
        OpEventGetEventExtendedDataRecordEx_GetEventExtendedDataRecordEx_Event_INV_IAC_V_AMP: start-on-event=DemSatellite_0InternalBehavior/GetEventExtendedDataRecordEx, operation=Event_INV_IAC_V_AMP.GetEventExtendedDataRecordEx
        OpEventGetEventExtendedDataRecordEx_GetEventExtendedDataRecordEx_EvtInfo_INV_IAC_W_ELEC_LO: start-on-event=DemSatellite_0InternalBehavior/GetEventExtendedDataRecordEx, operation=EvtInfo_INV_IAC_W_ELEC_LO.GetEventExtendedDataRecordEx
        OpEventGetEventExtendedDataRecordEx_GetEventExtendedDataRecordEx_Event_INV_IAC_W_ELEC_LO: start-on-event=DemSatellite_0InternalBehavior/GetEventExtendedDataRecordEx, operation=Event_INV_IAC_W_ELEC_LO.GetEventExtendedDataRecordEx
        OpEventGetEventExtendedDataRecordEx_GetEventExtendedDataRecordEx_EvtInfo_VCEvVddmPropFr08Tioutd_001: start-on-event=DemSatellite_0InternalBehavior/GetEventExtendedDataRecordEx, operation=EvtInfo_VCEvVddmPropFr08Tioutd_001.GetEventExtendedDataRecordEx
        OpEventGetEventExtendedDataRecordEx_GetEventExtendedDataRecordEx_Event_VCEvVddmPropFr08Tioutd_001: start-on-event=DemSatellite_0InternalBehavior/GetEventExtendedDataRecordEx, operation=Event_VCEvVddmPropFr08Tioutd_001.GetEventExtendedDataRecordEx
        OpEventGetEventExtendedDataRecordEx_GetEventExtendedDataRecordEx_EvtInfo_PS_P12_RES_FLT: start-on-event=DemSatellite_0InternalBehavior/GetEventExtendedDataRecordEx, operation=EvtInfo_PS_P12_RES_FLT.GetEventExtendedDataRecordEx
        OpEventGetEventExtendedDataRecordEx_GetEventExtendedDataRecordEx_Event_PS_P12_RES_FLT: start-on-event=DemSatellite_0InternalBehavior/GetEventExtendedDataRecordEx, operation=Event_PS_P12_RES_FLT.GetEventExtendedDataRecordEx
        OpEventGetEventExtendedDataRecordEx_GetEventExtendedDataRecordEx_EvtInfo_INV_RSLVR_SIN_RNG_LO: start-on-event=DemSatellite_0InternalBehavior/GetEventExtendedDataRecordEx, operation=EvtInfo_INV_RSLVR_SIN_RNG_LO.GetEventExtendedDataRecordEx
        OpEventGetEventExtendedDataRecordEx_GetEventExtendedDataRecordEx_Event_INV_RSLVR_SIN_RNG_LO: start-on-event=DemSatellite_0InternalBehavior/GetEventExtendedDataRecordEx, operation=Event_INV_RSLVR_SIN_RNG_LO.GetEventExtendedDataRecordEx
        OpEventGetEventExtendedDataRecordEx_GetEventExtendedDataRecordEx_EvtInfo_CU_TEMP_HW_FLT: start-on-event=DemSatellite_0InternalBehavior/GetEventExtendedDataRecordEx, operation=EvtInfo_CU_TEMP_HW_FLT.GetEventExtendedDataRecordEx
        OpEventGetEventExtendedDataRecordEx_GetEventExtendedDataRecordEx_Event_CU_TEMP_HW_FLT: start-on-event=DemSatellite_0InternalBehavior/GetEventExtendedDataRecordEx, operation=Event_CU_TEMP_HW_FLT.GetEventExtendedDataRecordEx
        OpEventGetEventExtendedDataRecordEx_GetEventExtendedDataRecordEx_EvtInfo_VCEvEcmPropFr02MgmFr00Tioutd: start-on-event=DemSatellite_0InternalBehavior/GetEventExtendedDataRecordEx, operation=EvtInfo_VCEvEcmPropFr02MgmFr00Tioutd.GetEventExtendedDataRecordEx
        OpEventGetEventExtendedDataRecordEx_GetEventExtendedDataRecordEx_Event_VCEvEcmPropFr02MgmFr00Tioutd: start-on-event=DemSatellite_0InternalBehavior/GetEventExtendedDataRecordEx, operation=Event_VCEvEcmPropFr02MgmFr00Tioutd.GetEventExtendedDataRecordEx
        OpEventGetEventExtendedDataRecordEx_GetEventExtendedDataRecordEx_EvtInfo_PS_KL15_RNG_HI: start-on-event=DemSatellite_0InternalBehavior/GetEventExtendedDataRecordEx, operation=EvtInfo_PS_KL15_RNG_HI.GetEventExtendedDataRecordEx
        OpEventGetEventExtendedDataRecordEx_GetEventExtendedDataRecordEx_Event_PS_KL15_RNG_HI: start-on-event=DemSatellite_0InternalBehavior/GetEventExtendedDataRecordEx, operation=Event_PS_KL15_RNG_HI.GetEventExtendedDataRecordEx
        OpEventGetEventExtendedDataRecordEx_GetEventExtendedDataRecordEx_EvtInfo_VCEvVddmPropFr17Tioutd: start-on-event=DemSatellite_0InternalBehavior/GetEventExtendedDataRecordEx, operation=EvtInfo_VCEvVddmPropFr17Tioutd.GetEventExtendedDataRecordEx
        OpEventGetEventExtendedDataRecordEx_GetEventExtendedDataRecordEx_Event_VCEvVddmPropFr17Tioutd: start-on-event=DemSatellite_0InternalBehavior/GetEventExtendedDataRecordEx, operation=Event_VCEvVddmPropFr17Tioutd.GetEventExtendedDataRecordEx
        OpEventGetEventExtendedDataRecordEx_GetEventExtendedDataRecordEx_EvtInfo_VcEvChkSumCrashStsSafe: start-on-event=DemSatellite_0InternalBehavior/GetEventExtendedDataRecordEx, operation=EvtInfo_VcEvChkSumCrashStsSafe.GetEventExtendedDataRecordEx
        OpEventGetEventExtendedDataRecordEx_GetEventExtendedDataRecordEx_Event_VcEvChkSumCrashStsSafe: start-on-event=DemSatellite_0InternalBehavior/GetEventExtendedDataRecordEx, operation=Event_VcEvChkSumCrashStsSafe.GetEventExtendedDataRecordEx
        OpEventGetEventExtendedDataRecordEx_GetEventExtendedDataRecordEx_EvtInfo_DiagC_ClutchService: start-on-event=DemSatellite_0InternalBehavior/GetEventExtendedDataRecordEx, operation=EvtInfo_DiagC_ClutchService.GetEventExtendedDataRecordEx
        OpEventGetEventExtendedDataRecordEx_GetEventExtendedDataRecordEx_Event_DiagC_ClutchService: start-on-event=DemSatellite_0InternalBehavior/GetEventExtendedDataRecordEx, operation=Event_DiagC_ClutchService.GetEventExtendedDataRecordEx
        OpEventGetEventExtendedDataRecordEx_GetEventExtendedDataRecordEx_EvtInfo_INV_EM_STATOR_TEMP_RNG_HI: start-on-event=DemSatellite_0InternalBehavior/GetEventExtendedDataRecordEx, operation=EvtInfo_INV_EM_STATOR_TEMP_RNG_HI.GetEventExtendedDataRecordEx
        OpEventGetEventExtendedDataRecordEx_GetEventExtendedDataRecordEx_Event_INV_EM_STATOR_TEMP_RNG_HI: start-on-event=DemSatellite_0InternalBehavior/GetEventExtendedDataRecordEx, operation=Event_INV_EM_STATOR_TEMP_RNG_HI.GetEventExtendedDataRecordEx
        OpEventGetEventExtendedDataRecordEx_GetEventExtendedDataRecordEx_EvtInfo_INV_RSLVR_OFFS_OUT_RANG: start-on-event=DemSatellite_0InternalBehavior/GetEventExtendedDataRecordEx, operation=EvtInfo_INV_RSLVR_OFFS_OUT_RANG.GetEventExtendedDataRecordEx
        OpEventGetEventExtendedDataRecordEx_GetEventExtendedDataRecordEx_Event_INV_RSLVR_OFFS_OUT_RANG: start-on-event=DemSatellite_0InternalBehavior/GetEventExtendedDataRecordEx, operation=Event_INV_RSLVR_OFFS_OUT_RANG.GetEventExtendedDataRecordEx
        OpEventGetEventExtendedDataRecordEx_GetEventExtendedDataRecordEx_EvtInfo_INV_EM_STATOR_TEMP2_RNG_LO: start-on-event=DemSatellite_0InternalBehavior/GetEventExtendedDataRecordEx, operation=EvtInfo_INV_EM_STATOR_TEMP2_RNG_LO.GetEventExtendedDataRecordEx
        OpEventGetEventExtendedDataRecordEx_GetEventExtendedDataRecordEx_Event_INV_EM_STATOR_TEMP2_RNG_LO: start-on-event=DemSatellite_0InternalBehavior/GetEventExtendedDataRecordEx, operation=Event_INV_EM_STATOR_TEMP2_RNG_LO.GetEventExtendedDataRecordEx
        OpEventGetEventExtendedDataRecordEx_GetEventExtendedDataRecordEx_EvtInfo_VcEvMonISAR: start-on-event=DemSatellite_0InternalBehavior/GetEventExtendedDataRecordEx, operation=EvtInfo_VcEvMonISAR.GetEventExtendedDataRecordEx
        OpEventGetEventExtendedDataRecordEx_GetEventExtendedDataRecordEx_Event_VcEvMonISAR: start-on-event=DemSatellite_0InternalBehavior/GetEventExtendedDataRecordEx, operation=Event_VcEvMonISAR.GetEventExtendedDataRecordEx
        OpEventGetEventExtendedDataRecordEx_GetEventExtendedDataRecordEx_EvtInfo_GA_BLDC_FLT: start-on-event=DemSatellite_0InternalBehavior/GetEventExtendedDataRecordEx, operation=EvtInfo_GA_BLDC_FLT.GetEventExtendedDataRecordEx
        OpEventGetEventExtendedDataRecordEx_GetEventExtendedDataRecordEx_Event_GA_BLDC_FLT: start-on-event=DemSatellite_0InternalBehavior/GetEventExtendedDataRecordEx, operation=Event_GA_BLDC_FLT.GetEventExtendedDataRecordEx
        OpEventGetEventExtendedDataRecordEx_GetEventExtendedDataRecordEx_EvtInfo_INV_RSLVR_EXCT_ELEC_OPEN: start-on-event=DemSatellite_0InternalBehavior/GetEventExtendedDataRecordEx, operation=EvtInfo_INV_RSLVR_EXCT_ELEC_OPEN.GetEventExtendedDataRecordEx
        OpEventGetEventExtendedDataRecordEx_GetEventExtendedDataRecordEx_Event_INV_RSLVR_EXCT_ELEC_OPEN: start-on-event=DemSatellite_0InternalBehavior/GetEventExtendedDataRecordEx, operation=Event_INV_RSLVR_EXCT_ELEC_OPEN.GetEventExtendedDataRecordEx
        OpEventGetEventExtendedDataRecordEx_GetEventExtendedDataRecordEx_EvtInfo_INV_RSLVR_EXCT_PLAUS: start-on-event=DemSatellite_0InternalBehavior/GetEventExtendedDataRecordEx, operation=EvtInfo_INV_RSLVR_EXCT_PLAUS.GetEventExtendedDataRecordEx
        OpEventGetEventExtendedDataRecordEx_GetEventExtendedDataRecordEx_Event_INV_RSLVR_EXCT_PLAUS: start-on-event=DemSatellite_0InternalBehavior/GetEventExtendedDataRecordEx, operation=Event_INV_RSLVR_EXCT_PLAUS.GetEventExtendedDataRecordEx
        OpEventGetEventExtendedDataRecordEx_GetEventExtendedDataRecordEx_EvtInfo_PS_P15_U_FLT: start-on-event=DemSatellite_0InternalBehavior/GetEventExtendedDataRecordEx, operation=EvtInfo_PS_P15_U_FLT.GetEventExtendedDataRecordEx
        OpEventGetEventExtendedDataRecordEx_GetEventExtendedDataRecordEx_Event_PS_P15_U_FLT: start-on-event=DemSatellite_0InternalBehavior/GetEventExtendedDataRecordEx, operation=Event_PS_P15_U_FLT.GetEventExtendedDataRecordEx
        OpEventGetEventExtendedDataRecordEx_GetEventExtendedDataRecordEx_EvtInfo_INV_EM_STATOR_TEMP_RNG_SWT: start-on-event=DemSatellite_0InternalBehavior/GetEventExtendedDataRecordEx, operation=EvtInfo_INV_EM_STATOR_TEMP_RNG_SWT.GetEventExtendedDataRecordEx
        OpEventGetEventExtendedDataRecordEx_GetEventExtendedDataRecordEx_Event_INV_EM_STATOR_TEMP_RNG_SWT: start-on-event=DemSatellite_0InternalBehavior/GetEventExtendedDataRecordEx, operation=Event_INV_EM_STATOR_TEMP_RNG_SWT.GetEventExtendedDataRecordEx
        OpEventGetEventExtendedDataRecordEx_GetEventExtendedDataRecordEx_EvtInfo_INV_UHVDC_OV_SWP: start-on-event=DemSatellite_0InternalBehavior/GetEventExtendedDataRecordEx, operation=EvtInfo_INV_UHVDC_OV_SWP.GetEventExtendedDataRecordEx
        OpEventGetEventExtendedDataRecordEx_GetEventExtendedDataRecordEx_Event_INV_UHVDC_OV_SWP: start-on-event=DemSatellite_0InternalBehavior/GetEventExtendedDataRecordEx, operation=Event_INV_UHVDC_OV_SWP.GetEventExtendedDataRecordEx
        OpEventGetEventExtendedDataRecordEx_GetEventExtendedDataRecordEx_EvtInfo_AURIX_HW_FLT: start-on-event=DemSatellite_0InternalBehavior/GetEventExtendedDataRecordEx, operation=EvtInfo_AURIX_HW_FLT.GetEventExtendedDataRecordEx
        OpEventGetEventExtendedDataRecordEx_GetEventExtendedDataRecordEx_Event_AURIX_HW_FLT: start-on-event=DemSatellite_0InternalBehavior/GetEventExtendedDataRecordEx, operation=Event_AURIX_HW_FLT.GetEventExtendedDataRecordEx
        OpEventGetEventExtendedDataRecordEx_GetEventExtendedDataRecordEx_EvtInfo_INV_GATE_DRVR_TOP_HWP: start-on-event=DemSatellite_0InternalBehavior/GetEventExtendedDataRecordEx, operation=EvtInfo_INV_GATE_DRVR_TOP_HWP.GetEventExtendedDataRecordEx
        OpEventGetEventExtendedDataRecordEx_GetEventExtendedDataRecordEx_Event_INV_GATE_DRVR_TOP_HWP: start-on-event=DemSatellite_0InternalBehavior/GetEventExtendedDataRecordEx, operation=Event_INV_GATE_DRVR_TOP_HWP.GetEventExtendedDataRecordEx
        OpEventGetEventExtendedDataRecordEx_GetEventExtendedDataRecordEx_EvtInfo_INV_ACTV_DCHA_HW: start-on-event=DemSatellite_0InternalBehavior/GetEventExtendedDataRecordEx, operation=EvtInfo_INV_ACTV_DCHA_HW.GetEventExtendedDataRecordEx
        OpEventGetEventExtendedDataRecordEx_GetEventExtendedDataRecordEx_Event_INV_ACTV_DCHA_HW: start-on-event=DemSatellite_0InternalBehavior/GetEventExtendedDataRecordEx, operation=Event_INV_ACTV_DCHA_HW.GetEventExtendedDataRecordEx
        OpEventGetEventExtendedDataRecordEx_GetEventExtendedDataRecordEx_EvtInfo_INV_IGBT_TEMP_HWP: start-on-event=DemSatellite_0InternalBehavior/GetEventExtendedDataRecordEx, operation=EvtInfo_INV_IGBT_TEMP_HWP.GetEventExtendedDataRecordEx
        OpEventGetEventExtendedDataRecordEx_GetEventExtendedDataRecordEx_Event_INV_IGBT_TEMP_HWP: start-on-event=DemSatellite_0InternalBehavior/GetEventExtendedDataRecordEx, operation=Event_INV_IGBT_TEMP_HWP.GetEventExtendedDataRecordEx
        OpEventGetEventExtendedDataRecordEx_GetEventExtendedDataRecordEx_EvtInfo_INV_RSLVR_SIN_ELEC_FLT: start-on-event=DemSatellite_0InternalBehavior/GetEventExtendedDataRecordEx, operation=EvtInfo_INV_RSLVR_SIN_ELEC_FLT.GetEventExtendedDataRecordEx
        OpEventGetEventExtendedDataRecordEx_GetEventExtendedDataRecordEx_Event_INV_RSLVR_SIN_ELEC_FLT: start-on-event=DemSatellite_0InternalBehavior/GetEventExtendedDataRecordEx, operation=Event_INV_RSLVR_SIN_ELEC_FLT.GetEventExtendedDataRecordEx
        OpEventGetEventExtendedDataRecordEx_GetEventExtendedDataRecordEx_EvtInfo_CU_TEMP2_RNG_HI: start-on-event=DemSatellite_0InternalBehavior/GetEventExtendedDataRecordEx, operation=EvtInfo_CU_TEMP2_RNG_HI.GetEventExtendedDataRecordEx
        OpEventGetEventExtendedDataRecordEx_GetEventExtendedDataRecordEx_Event_CU_TEMP2_RNG_HI: start-on-event=DemSatellite_0InternalBehavior/GetEventExtendedDataRecordEx, operation=Event_CU_TEMP2_RNG_HI.GetEventExtendedDataRecordEx
        OpEventGetEventExtendedDataRecordEx_GetEventExtendedDataRecordEx_EvtInfo_INV_IAC_PHA_LOSS_MPL: start-on-event=DemSatellite_0InternalBehavior/GetEventExtendedDataRecordEx, operation=EvtInfo_INV_IAC_PHA_LOSS_MPL.GetEventExtendedDataRecordEx
        OpEventGetEventExtendedDataRecordEx_GetEventExtendedDataRecordEx_Event_INV_IAC_PHA_LOSS_MPL: start-on-event=DemSatellite_0InternalBehavior/GetEventExtendedDataRecordEx, operation=Event_INV_IAC_PHA_LOSS_MPL.GetEventExtendedDataRecordEx
        OpEventGetEventExtendedDataRecordEx_GetEventExtendedDataRecordEx_EvtInfo_INV_IAC_U_AMP: start-on-event=DemSatellite_0InternalBehavior/GetEventExtendedDataRecordEx, operation=EvtInfo_INV_IAC_U_AMP.GetEventExtendedDataRecordEx
        OpEventGetEventExtendedDataRecordEx_GetEventExtendedDataRecordEx_Event_INV_IAC_U_AMP: start-on-event=DemSatellite_0InternalBehavior/GetEventExtendedDataRecordEx, operation=Event_INV_IAC_U_AMP.GetEventExtendedDataRecordEx
        OpEventGetEventExtendedDataRecordEx_GetEventExtendedDataRecordEx_EvtInfo_PSnsr_GRADT_Flt: start-on-event=DemSatellite_0InternalBehavior/GetEventExtendedDataRecordEx, operation=EvtInfo_PSnsr_GRADT_Flt.GetEventExtendedDataRecordEx
        OpEventGetEventExtendedDataRecordEx_GetEventExtendedDataRecordEx_Event_PSnsr_GRADT_Flt: start-on-event=DemSatellite_0InternalBehavior/GetEventExtendedDataRecordEx, operation=Event_PSnsr_GRADT_Flt.GetEventExtendedDataRecordEx
        OpEventGetEventExtendedDataRecordEx_GetEventExtendedDataRecordEx_EvtInfo_AURIX_WATHDOG_FLT: start-on-event=DemSatellite_0InternalBehavior/GetEventExtendedDataRecordEx, operation=EvtInfo_AURIX_WATHDOG_FLT.GetEventExtendedDataRecordEx
        OpEventGetEventExtendedDataRecordEx_GetEventExtendedDataRecordEx_Event_AURIX_WATHDOG_FLT: start-on-event=DemSatellite_0InternalBehavior/GetEventExtendedDataRecordEx, operation=Event_AURIX_WATHDOG_FLT.GetEventExtendedDataRecordEx
        OpEventGetEventExtendedDataRecordEx_GetEventExtendedDataRecordEx_EvtInfo_VcEvNodeMisBECM: start-on-event=DemSatellite_0InternalBehavior/GetEventExtendedDataRecordEx, operation=EvtInfo_VcEvNodeMisBECM.GetEventExtendedDataRecordEx
        OpEventGetEventExtendedDataRecordEx_GetEventExtendedDataRecordEx_Event_VcEvNodeMisBECM: start-on-event=DemSatellite_0InternalBehavior/GetEventExtendedDataRecordEx, operation=Event_VcEvNodeMisBECM.GetEventExtendedDataRecordEx
        OpEventGetEventExtendedDataRecordEx_GetEventExtendedDataRecordEx_EvtInfo_INV_UHVDC_UV_HWP: start-on-event=DemSatellite_0InternalBehavior/GetEventExtendedDataRecordEx, operation=EvtInfo_INV_UHVDC_UV_HWP.GetEventExtendedDataRecordEx
        OpEventGetEventExtendedDataRecordEx_GetEventExtendedDataRecordEx_Event_INV_UHVDC_UV_HWP: start-on-event=DemSatellite_0InternalBehavior/GetEventExtendedDataRecordEx, operation=Event_INV_UHVDC_UV_HWP.GetEventExtendedDataRecordEx
        OpEventGetEventExtendedDataRecordEx_GetEventExtendedDataRecordEx_EvtInfo_VcEvMonESpd: start-on-event=DemSatellite_0InternalBehavior/GetEventExtendedDataRecordEx, operation=EvtInfo_VcEvMonESpd.GetEventExtendedDataRecordEx
        OpEventGetEventExtendedDataRecordEx_GetEventExtendedDataRecordEx_Event_VcEvMonESpd: start-on-event=DemSatellite_0InternalBehavior/GetEventExtendedDataRecordEx, operation=Event_VcEvMonESpd.GetEventExtendedDataRecordEx
        OpEventGetEventExtendedDataRecordEx_GetEventExtendedDataRecordEx_EvtInfo_COM_NotConfig: start-on-event=DemSatellite_0InternalBehavior/GetEventExtendedDataRecordEx, operation=EvtInfo_COM_NotConfig.GetEventExtendedDataRecordEx
        OpEventGetEventExtendedDataRecordEx_GetEventExtendedDataRecordEx_Event_COM_NotConfig: start-on-event=DemSatellite_0InternalBehavior/GetEventExtendedDataRecordEx, operation=Event_COM_NotConfig.GetEventExtendedDataRecordEx
        OpEventGetEventExtendedDataRecordEx_GetEventExtendedDataRecordEx_EvtInfo_INV_RSLVR_SIN_RNG_HI: start-on-event=DemSatellite_0InternalBehavior/GetEventExtendedDataRecordEx, operation=EvtInfo_INV_RSLVR_SIN_RNG_HI.GetEventExtendedDataRecordEx
        OpEventGetEventExtendedDataRecordEx_GetEventExtendedDataRecordEx_Event_INV_RSLVR_SIN_RNG_HI: start-on-event=DemSatellite_0InternalBehavior/GetEventExtendedDataRecordEx, operation=Event_INV_RSLVR_SIN_RNG_HI.GetEventExtendedDataRecordEx
        OpEventGetEventExtendedDataRecordEx_GetEventExtendedDataRecordEx_EvtInfo_INV_IGBT_TEMP_U_RNG_HI: start-on-event=DemSatellite_0InternalBehavior/GetEventExtendedDataRecordEx, operation=EvtInfo_INV_IGBT_TEMP_U_RNG_HI.GetEventExtendedDataRecordEx
        OpEventGetEventExtendedDataRecordEx_GetEventExtendedDataRecordEx_Event_INV_IGBT_TEMP_U_RNG_HI: start-on-event=DemSatellite_0InternalBehavior/GetEventExtendedDataRecordEx, operation=Event_INV_IGBT_TEMP_U_RNG_HI.GetEventExtendedDataRecordEx
        OpEventGetEventExtendedDataRecordEx_GetEventExtendedDataRecordEx_EvtInfo_VcEvMonMode_001: start-on-event=DemSatellite_0InternalBehavior/GetEventExtendedDataRecordEx, operation=EvtInfo_VcEvMonMode_001.GetEventExtendedDataRecordEx
        OpEventGetEventExtendedDataRecordEx_GetEventExtendedDataRecordEx_Event_VcEvMonMode_001: start-on-event=DemSatellite_0InternalBehavior/GetEventExtendedDataRecordEx, operation=Event_VcEvMonMode_001.GetEventExtendedDataRecordEx
        OpEventGetEventExtendedDataRecordEx_GetEventExtendedDataRecordEx_EvtInfo_PA_ACTION_FLT: start-on-event=DemSatellite_0InternalBehavior/GetEventExtendedDataRecordEx, operation=EvtInfo_PA_ACTION_FLT.GetEventExtendedDataRecordEx
        OpEventGetEventExtendedDataRecordEx_GetEventExtendedDataRecordEx_Event_PA_ACTION_FLT: start-on-event=DemSatellite_0InternalBehavior/GetEventExtendedDataRecordEx, operation=Event_PA_ACTION_FLT.GetEventExtendedDataRecordEx
        OpEventGetEventExtendedDataRecordEx_GetEventExtendedDataRecordEx_EvtInfo_INV_IAC_V_ELEC_HWP: start-on-event=DemSatellite_0InternalBehavior/GetEventExtendedDataRecordEx, operation=EvtInfo_INV_IAC_V_ELEC_HWP.GetEventExtendedDataRecordEx
        OpEventGetEventExtendedDataRecordEx_GetEventExtendedDataRecordEx_Event_INV_IAC_V_ELEC_HWP: start-on-event=DemSatellite_0InternalBehavior/GetEventExtendedDataRecordEx, operation=Event_INV_IAC_V_ELEC_HWP.GetEventExtendedDataRecordEx
        OpEventGetEventExtendedDataRecordEx_GetEventExtendedDataRecordEx_EvtInfo_CU_TEMP_HW_FLT_001: start-on-event=DemSatellite_0InternalBehavior/GetEventExtendedDataRecordEx, operation=EvtInfo_CU_TEMP_HW_FLT_001.GetEventExtendedDataRecordEx
        OpEventGetEventExtendedDataRecordEx_GetEventExtendedDataRecordEx_Event_CU_TEMP_HW_FLT_001: start-on-event=DemSatellite_0InternalBehavior/GetEventExtendedDataRecordEx, operation=Event_CU_TEMP_HW_FLT_001.GetEventExtendedDataRecordEx
        OpEventGetEventExtendedDataRecordEx_GetEventExtendedDataRecordEx_EvtInfo_VCC_UnderVoltage: start-on-event=DemSatellite_0InternalBehavior/GetEventExtendedDataRecordEx, operation=EvtInfo_VCC_UnderVoltage.GetEventExtendedDataRecordEx
        OpEventGetEventExtendedDataRecordEx_GetEventExtendedDataRecordEx_Event_VCC_UnderVoltage: start-on-event=DemSatellite_0InternalBehavior/GetEventExtendedDataRecordEx, operation=Event_VCC_UnderVoltage.GetEventExtendedDataRecordEx
        OpEventGetEventExtendedDataRecordEx_GetEventExtendedDataRecordEx_EvtInfo_VcEvTsttrPlaus: start-on-event=DemSatellite_0InternalBehavior/GetEventExtendedDataRecordEx, operation=EvtInfo_VcEvTsttrPlaus.GetEventExtendedDataRecordEx
        OpEventGetEventExtendedDataRecordEx_GetEventExtendedDataRecordEx_Event_VcEvTsttrPlaus: start-on-event=DemSatellite_0InternalBehavior/GetEventExtendedDataRecordEx, operation=Event_VcEvTsttrPlaus.GetEventExtendedDataRecordEx
        OpEventGetEventExtendedDataRecordEx_GetEventExtendedDataRecordEx_EvtInfo_INV_RSLVR_EXCT_ELEC_FLT: start-on-event=DemSatellite_0InternalBehavior/GetEventExtendedDataRecordEx, operation=EvtInfo_INV_RSLVR_EXCT_ELEC_FLT.GetEventExtendedDataRecordEx
        OpEventGetEventExtendedDataRecordEx_GetEventExtendedDataRecordEx_Event_INV_RSLVR_EXCT_ELEC_FLT: start-on-event=DemSatellite_0InternalBehavior/GetEventExtendedDataRecordEx, operation=Event_INV_RSLVR_EXCT_ELEC_FLT.GetEventExtendedDataRecordEx
        OpEventGetEventExtendedDataRecordEx_GetEventExtendedDataRecordEx_EvtInfo_INV_RSLVR_EXCT_RNG_LO: start-on-event=DemSatellite_0InternalBehavior/GetEventExtendedDataRecordEx, operation=EvtInfo_INV_RSLVR_EXCT_RNG_LO.GetEventExtendedDataRecordEx
        OpEventGetEventExtendedDataRecordEx_GetEventExtendedDataRecordEx_Event_INV_RSLVR_EXCT_RNG_LO: start-on-event=DemSatellite_0InternalBehavior/GetEventExtendedDataRecordEx, operation=Event_INV_RSLVR_EXCT_RNG_LO.GetEventExtendedDataRecordEx
        OpEventGetEventExtendedDataRecordEx_GetEventExtendedDataRecordEx_EvtInfo_INV_EM_STATOR_TEMP2_RNG_HI: start-on-event=DemSatellite_0InternalBehavior/GetEventExtendedDataRecordEx, operation=EvtInfo_INV_EM_STATOR_TEMP2_RNG_HI.GetEventExtendedDataRecordEx
        OpEventGetEventExtendedDataRecordEx_GetEventExtendedDataRecordEx_Event_INV_EM_STATOR_TEMP2_RNG_HI: start-on-event=DemSatellite_0InternalBehavior/GetEventExtendedDataRecordEx, operation=Event_INV_EM_STATOR_TEMP2_RNG_HI.GetEventExtendedDataRecordEx
        OpEventGetEventExtendedDataRecordEx_GetEventExtendedDataRecordEx_EvtInfo_INV_SHUT_OFF_PAH_START_UP: start-on-event=DemSatellite_0InternalBehavior/GetEventExtendedDataRecordEx, operation=EvtInfo_INV_SHUT_OFF_PAH_START_UP.GetEventExtendedDataRecordEx
        OpEventGetEventExtendedDataRecordEx_GetEventExtendedDataRecordEx_Event_INV_SHUT_OFF_PAH_START_UP: start-on-event=DemSatellite_0InternalBehavior/GetEventExtendedDataRecordEx, operation=Event_INV_SHUT_OFF_PAH_START_UP.GetEventExtendedDataRecordEx
        OpEventGetEventExtendedDataRecordEx_GetEventExtendedDataRecordEx_EvtInfo_VCEvVddmPropFr08Tioutd: start-on-event=DemSatellite_0InternalBehavior/GetEventExtendedDataRecordEx, operation=EvtInfo_VCEvVddmPropFr08Tioutd.GetEventExtendedDataRecordEx
        OpEventGetEventExtendedDataRecordEx_GetEventExtendedDataRecordEx_Event_VCEvVddmPropFr08Tioutd: start-on-event=DemSatellite_0InternalBehavior/GetEventExtendedDataRecordEx, operation=Event_VCEvVddmPropFr08Tioutd.GetEventExtendedDataRecordEx
        OpEventGetEventExtendedDataRecordEx_GetEventExtendedDataRecordEx_EvtInfo_INV_RSLVR_EXCT_OC_HWP_001: start-on-event=DemSatellite_0InternalBehavior/GetEventExtendedDataRecordEx, operation=EvtInfo_INV_RSLVR_EXCT_OC_HWP_001.GetEventExtendedDataRecordEx
        OpEventGetEventExtendedDataRecordEx_GetEventExtendedDataRecordEx_Event_INV_RSLVR_EXCT_OC_HWP_001: start-on-event=DemSatellite_0InternalBehavior/GetEventExtendedDataRecordEx, operation=Event_INV_RSLVR_EXCT_OC_HWP_001.GetEventExtendedDataRecordEx
        OpEventGetEventExtendedDataRecordEx_GetEventExtendedDataRecordEx_EvtInfo_INV_RSLVR_EXCT_OC_HWP_002: start-on-event=DemSatellite_0InternalBehavior/GetEventExtendedDataRecordEx, operation=EvtInfo_INV_RSLVR_EXCT_OC_HWP_002.GetEventExtendedDataRecordEx
        OpEventGetEventExtendedDataRecordEx_GetEventExtendedDataRecordEx_Event_INV_RSLVR_EXCT_OC_HWP_002: start-on-event=DemSatellite_0InternalBehavior/GetEventExtendedDataRecordEx, operation=Event_INV_RSLVR_EXCT_OC_HWP_002.GetEventExtendedDataRecordEx
        OpEventGetEventExtendedDataRecordEx_GetEventExtendedDataRecordEx_EvtInfo_INV_EM_STATOR_TEMP_ELE_FLT: start-on-event=DemSatellite_0InternalBehavior/GetEventExtendedDataRecordEx, operation=EvtInfo_INV_EM_STATOR_TEMP_ELE_FLT.GetEventExtendedDataRecordEx
        OpEventGetEventExtendedDataRecordEx_GetEventExtendedDataRecordEx_Event_INV_EM_STATOR_TEMP_ELE_FLT: start-on-event=DemSatellite_0InternalBehavior/GetEventExtendedDataRecordEx, operation=Event_INV_EM_STATOR_TEMP_ELE_FLT.GetEventExtendedDataRecordEx
        OpEventGetEventExtendedDataRecordEx_GetEventExtendedDataRecordEx_EvtInfo_INV_INTERLOCK_FLT: start-on-event=DemSatellite_0InternalBehavior/GetEventExtendedDataRecordEx, operation=EvtInfo_INV_INTERLOCK_FLT.GetEventExtendedDataRecordEx
        OpEventGetEventExtendedDataRecordEx_GetEventExtendedDataRecordEx_Event_INV_INTERLOCK_FLT: start-on-event=DemSatellite_0InternalBehavior/GetEventExtendedDataRecordEx, operation=Event_INV_INTERLOCK_FLT.GetEventExtendedDataRecordEx
        OpEventGetEventExtendedDataRecordEx_GetEventExtendedDataRecordEx_EvtInfo_Ga_ZeroFindDistanFailure: start-on-event=DemSatellite_0InternalBehavior/GetEventExtendedDataRecordEx, operation=EvtInfo_Ga_ZeroFindDistanFailure.GetEventExtendedDataRecordEx
        OpEventGetEventExtendedDataRecordEx_GetEventExtendedDataRecordEx_Event_Ga_ZeroFindDistanFailure: start-on-event=DemSatellite_0InternalBehavior/GetEventExtendedDataRecordEx, operation=Event_Ga_ZeroFindDistanFailure.GetEventExtendedDataRecordEx
        OpEventGetEventExtendedDataRecordEx_GetEventExtendedDataRecordEx_EvtInfo_PLOCK_Current_RNG_OUT: start-on-event=DemSatellite_0InternalBehavior/GetEventExtendedDataRecordEx, operation=EvtInfo_PLOCK_Current_RNG_OUT.GetEventExtendedDataRecordEx
        OpEventGetEventExtendedDataRecordEx_GetEventExtendedDataRecordEx_Event_PLOCK_Current_RNG_OUT: start-on-event=DemSatellite_0InternalBehavior/GetEventExtendedDataRecordEx, operation=Event_PLOCK_Current_RNG_OUT.GetEventExtendedDataRecordEx
        OpEventGetEventExtendedDataRecordEx_GetEventExtendedDataRecordEx_EvtInfo_VCEvVddmPropFr05Tioutd: start-on-event=DemSatellite_0InternalBehavior/GetEventExtendedDataRecordEx, operation=EvtInfo_VCEvVddmPropFr05Tioutd.GetEventExtendedDataRecordEx
        OpEventGetEventExtendedDataRecordEx_GetEventExtendedDataRecordEx_Event_VCEvVddmPropFr05Tioutd: start-on-event=DemSatellite_0InternalBehavior/GetEventExtendedDataRecordEx, operation=Event_VCEvVddmPropFr05Tioutd.GetEventExtendedDataRecordEx
        OpEventGetEventExtendedDataRecordEx_GetEventExtendedDataRecordEx_EvtInfo_INV_IGBT_TEMP_V_GRDT: start-on-event=DemSatellite_0InternalBehavior/GetEventExtendedDataRecordEx, operation=EvtInfo_INV_IGBT_TEMP_V_GRDT.GetEventExtendedDataRecordEx
        OpEventGetEventExtendedDataRecordEx_GetEventExtendedDataRecordEx_Event_INV_IGBT_TEMP_V_GRDT: start-on-event=DemSatellite_0InternalBehavior/GetEventExtendedDataRecordEx, operation=Event_INV_IGBT_TEMP_V_GRDT.GetEventExtendedDataRecordEx
        OpEventGetEventExtendedDataRecordEx_GetEventExtendedDataRecordEx_EvtInfo_PS_5V_Fault: start-on-event=DemSatellite_0InternalBehavior/GetEventExtendedDataRecordEx, operation=EvtInfo_PS_5V_Fault.GetEventExtendedDataRecordEx
        OpEventGetEventExtendedDataRecordEx_GetEventExtendedDataRecordEx_Event_PS_5V_Fault: start-on-event=DemSatellite_0InternalBehavior/GetEventExtendedDataRecordEx, operation=Event_PS_5V_Fault.GetEventExtendedDataRecordEx
        OpEventGetEventExtendedDataRecordEx_GetEventExtendedDataRecordEx_EvtInfo_VcEvCntrCrashStsSafe: start-on-event=DemSatellite_0InternalBehavior/GetEventExtendedDataRecordEx, operation=EvtInfo_VcEvCntrCrashStsSafe.GetEventExtendedDataRecordEx
        OpEventGetEventExtendedDataRecordEx_GetEventExtendedDataRecordEx_Event_VcEvCntrCrashStsSafe: start-on-event=DemSatellite_0InternalBehavior/GetEventExtendedDataRecordEx, operation=Event_VcEvCntrCrashStsSafe.GetEventExtendedDataRecordEx
        OpEventGetEventExtendedDataRecordEx_GetEventExtendedDataRecordEx_EvtInfo_INV_EM_STATOR_TEMP_GRDT: start-on-event=DemSatellite_0InternalBehavior/GetEventExtendedDataRecordEx, operation=EvtInfo_INV_EM_STATOR_TEMP_GRDT.GetEventExtendedDataRecordEx
        OpEventGetEventExtendedDataRecordEx_GetEventExtendedDataRecordEx_Event_INV_EM_STATOR_TEMP_GRDT: start-on-event=DemSatellite_0InternalBehavior/GetEventExtendedDataRecordEx, operation=Event_INV_EM_STATOR_TEMP_GRDT.GetEventExtendedDataRecordEx
        OpEventGetEventExtendedDataRecordEx_GetEventExtendedDataRecordEx_EvtInfo_PS_P15_V_FLT: start-on-event=DemSatellite_0InternalBehavior/GetEventExtendedDataRecordEx, operation=EvtInfo_PS_P15_V_FLT.GetEventExtendedDataRecordEx
        OpEventGetEventExtendedDataRecordEx_GetEventExtendedDataRecordEx_Event_PS_P15_V_FLT: start-on-event=DemSatellite_0InternalBehavior/GetEventExtendedDataRecordEx, operation=Event_PS_P15_V_FLT.GetEventExtendedDataRecordEx
        OpEventGetEventExtendedDataRecordEx_GetEventExtendedDataRecordEx_EvtInfo_INV_EM_STATOR_TEMP_RNG_NOK: start-on-event=DemSatellite_0InternalBehavior/GetEventExtendedDataRecordEx, operation=EvtInfo_INV_EM_STATOR_TEMP_RNG_NOK.GetEventExtendedDataRecordEx
        OpEventGetEventExtendedDataRecordEx_GetEventExtendedDataRecordEx_Event_INV_EM_STATOR_TEMP_RNG_NOK: start-on-event=DemSatellite_0InternalBehavior/GetEventExtendedDataRecordEx, operation=Event_INV_EM_STATOR_TEMP_RNG_NOK.GetEventExtendedDataRecordEx
        OpEventGetEventExtendedDataRecordEx_GetEventExtendedDataRecordEx_EvtInfo_INV_RSLVR_SIN_RNG_NOK: start-on-event=DemSatellite_0InternalBehavior/GetEventExtendedDataRecordEx, operation=EvtInfo_INV_RSLVR_SIN_RNG_NOK.GetEventExtendedDataRecordEx
        OpEventGetEventExtendedDataRecordEx_GetEventExtendedDataRecordEx_Event_INV_RSLVR_SIN_RNG_NOK: start-on-event=DemSatellite_0InternalBehavior/GetEventExtendedDataRecordEx, operation=Event_INV_RSLVR_SIN_RNG_NOK.GetEventExtendedDataRecordEx
        OpEventGetEventExtendedDataRecordEx_GetEventExtendedDataRecordEx_EvtInfo_INV_IAC_U_OFFS: start-on-event=DemSatellite_0InternalBehavior/GetEventExtendedDataRecordEx, operation=EvtInfo_INV_IAC_U_OFFS.GetEventExtendedDataRecordEx
        OpEventGetEventExtendedDataRecordEx_GetEventExtendedDataRecordEx_Event_INV_IAC_U_OFFS: start-on-event=DemSatellite_0InternalBehavior/GetEventExtendedDataRecordEx, operation=Event_INV_IAC_U_OFFS.GetEventExtendedDataRecordEx
        OpEventGetEventExtendedDataRecordEx_GetEventExtendedDataRecordEx_EvtInfo_PS_KL30_BACKUP_FLT: start-on-event=DemSatellite_0InternalBehavior/GetEventExtendedDataRecordEx, operation=EvtInfo_PS_KL30_BACKUP_FLT.GetEventExtendedDataRecordEx
        OpEventGetEventExtendedDataRecordEx_GetEventExtendedDataRecordEx_Event_PS_KL30_BACKUP_FLT: start-on-event=DemSatellite_0InternalBehavior/GetEventExtendedDataRecordEx, operation=Event_PS_KL30_BACKUP_FLT.GetEventExtendedDataRecordEx
        OpEventGetEventExtendedDataRecordEx_GetEventExtendedDataRecordEx_EvtInfo_INV_IGBT_TEMP_U_RNG_LO: start-on-event=DemSatellite_0InternalBehavior/GetEventExtendedDataRecordEx, operation=EvtInfo_INV_IGBT_TEMP_U_RNG_LO.GetEventExtendedDataRecordEx
        OpEventGetEventExtendedDataRecordEx_GetEventExtendedDataRecordEx_Event_INV_IGBT_TEMP_U_RNG_LO: start-on-event=DemSatellite_0InternalBehavior/GetEventExtendedDataRecordEx, operation=Event_INV_IGBT_TEMP_U_RNG_LO.GetEventExtendedDataRecordEx
        OpEventGetEventExtendedDataRecordEx_GetEventExtendedDataRecordEx_EvtInfo_INV_EM_STATOR_TEMP_HWP: start-on-event=DemSatellite_0InternalBehavior/GetEventExtendedDataRecordEx, operation=EvtInfo_INV_EM_STATOR_TEMP_HWP.GetEventExtendedDataRecordEx
        OpEventGetEventExtendedDataRecordEx_GetEventExtendedDataRecordEx_Event_INV_EM_STATOR_TEMP_HWP: start-on-event=DemSatellite_0InternalBehavior/GetEventExtendedDataRecordEx, operation=Event_INV_EM_STATOR_TEMP_HWP.GetEventExtendedDataRecordEx
        OpEventGetEventExtendedDataRecordEx_GetEventExtendedDataRecordEx_EvtInfo_CU_TEMP1_RNG_HI: start-on-event=DemSatellite_0InternalBehavior/GetEventExtendedDataRecordEx, operation=EvtInfo_CU_TEMP1_RNG_HI.GetEventExtendedDataRecordEx
        OpEventGetEventExtendedDataRecordEx_GetEventExtendedDataRecordEx_Event_CU_TEMP1_RNG_HI: start-on-event=DemSatellite_0InternalBehavior/GetEventExtendedDataRecordEx, operation=Event_CU_TEMP1_RNG_HI.GetEventExtendedDataRecordEx
        OpEventGetEventExtendedDataRecordEx_GetEventExtendedDataRecordEx_EvtInfo_INV_IGBT_TEMP_V_RNG_HI: start-on-event=DemSatellite_0InternalBehavior/GetEventExtendedDataRecordEx, operation=EvtInfo_INV_IGBT_TEMP_V_RNG_HI.GetEventExtendedDataRecordEx
        OpEventGetEventExtendedDataRecordEx_GetEventExtendedDataRecordEx_Event_INV_IGBT_TEMP_V_RNG_HI: start-on-event=DemSatellite_0InternalBehavior/GetEventExtendedDataRecordEx, operation=Event_INV_IGBT_TEMP_V_RNG_HI.GetEventExtendedDataRecordEx
        OpEventGetEventExtendedDataRecordEx_GetEventExtendedDataRecordEx_EvtInfo_VcEvNodeMisVDDM: start-on-event=DemSatellite_0InternalBehavior/GetEventExtendedDataRecordEx, operation=EvtInfo_VcEvNodeMisVDDM.GetEventExtendedDataRecordEx
        OpEventGetEventExtendedDataRecordEx_GetEventExtendedDataRecordEx_Event_VcEvNodeMisVDDM: start-on-event=DemSatellite_0InternalBehavior/GetEventExtendedDataRecordEx, operation=Event_VcEvNodeMisVDDM.GetEventExtendedDataRecordEx
        OpEventGetEventExtendedDataRecordEx_GetEventExtendedDataRecordEx_EvtInfo_INV_UHVDC_PLAUS: start-on-event=DemSatellite_0InternalBehavior/GetEventExtendedDataRecordEx, operation=EvtInfo_INV_UHVDC_PLAUS.GetEventExtendedDataRecordEx
        OpEventGetEventExtendedDataRecordEx_GetEventExtendedDataRecordEx_Event_INV_UHVDC_PLAUS: start-on-event=DemSatellite_0InternalBehavior/GetEventExtendedDataRecordEx, operation=Event_INV_UHVDC_PLAUS.GetEventExtendedDataRecordEx
        OpEventGetEventExtendedDataRecordEx_GetEventExtendedDataRecordEx_EvtInfo_INV_QUIESCENT_FLT: start-on-event=DemSatellite_0InternalBehavior/GetEventExtendedDataRecordEx, operation=EvtInfo_INV_QUIESCENT_FLT.GetEventExtendedDataRecordEx
        OpEventGetEventExtendedDataRecordEx_GetEventExtendedDataRecordEx_Event_INV_QUIESCENT_FLT: start-on-event=DemSatellite_0InternalBehavior/GetEventExtendedDataRecordEx, operation=Event_INV_QUIESCENT_FLT.GetEventExtendedDataRecordEx
        OpEventGetEventExtendedDataRecordEx_GetEventExtendedDataRecordEx_EvtInfo_INV_RSLVR_EXCT_RNG_HI: start-on-event=DemSatellite_0InternalBehavior/GetEventExtendedDataRecordEx, operation=EvtInfo_INV_RSLVR_EXCT_RNG_HI.GetEventExtendedDataRecordEx
        OpEventGetEventExtendedDataRecordEx_GetEventExtendedDataRecordEx_Event_INV_RSLVR_EXCT_RNG_HI: start-on-event=DemSatellite_0InternalBehavior/GetEventExtendedDataRecordEx, operation=Event_INV_RSLVR_EXCT_RNG_HI.GetEventExtendedDataRecordEx
        OpEventGetEventExtendedDataRecordEx_GetEventExtendedDataRecordEx_GeneralEvtInfo: start-on-event=DemSatellite_0InternalBehavior/GetEventExtendedDataRecordEx, operation=GeneralEvtInfo.GetEventExtendedDataRecordEx
        OpEventGetEventEnableCondition_GetEventEnableCondition_EvtInfo_VCEvBecmPropFr01Tioutd: start-on-event=DemSatellite_0InternalBehavior/GetEventEnableCondition, operation=EvtInfo_VCEvBecmPropFr01Tioutd.GetEventEnableCondition
        OpEventGetEventEnableCondition_GetEventEnableCondition_EvtInfo_INV_CU_TEMP2_RNG_NOK: start-on-event=DemSatellite_0InternalBehavior/GetEventEnableCondition, operation=EvtInfo_INV_CU_TEMP2_RNG_NOK.GetEventEnableCondition
        OpEventGetEventEnableCondition_GetEventEnableCondition_EvtInfo_INV_IMMO_NOKEY: start-on-event=DemSatellite_0InternalBehavior/GetEventEnableCondition, operation=EvtInfo_INV_IMMO_NOKEY.GetEventEnableCondition
        OpEventGetEventEnableCondition_GetEventEnableCondition_EvtInfo_INV_RSLVR_EXCT_OC_HWP: start-on-event=DemSatellite_0InternalBehavior/GetEventEnableCondition, operation=EvtInfo_INV_RSLVR_EXCT_OC_HWP.GetEventEnableCondition
        OpEventGetEventEnableCondition_GetEventEnableCondition_EvtInfo_PS_P15_W_FLT: start-on-event=DemSatellite_0InternalBehavior/GetEventEnableCondition, operation=EvtInfo_PS_P15_W_FLT.GetEventEnableCondition
        OpEventGetEventEnableCondition_GetEventEnableCondition_EvtInfo_INV_IAC_PLAUS_SUM: start-on-event=DemSatellite_0InternalBehavior/GetEventEnableCondition, operation=EvtInfo_INV_IAC_PLAUS_SUM.GetEventEnableCondition
        OpEventGetEventEnableCondition_GetEventEnableCondition_EvtInfo_PA_ELE_FLT: start-on-event=DemSatellite_0InternalBehavior/GetEventEnableCondition, operation=EvtInfo_PA_ELE_FLT.GetEventEnableCondition
        OpEventGetEventEnableCondition_GetEventEnableCondition_EvtInfo_CU_TEMP_GRDT: start-on-event=DemSatellite_0InternalBehavior/GetEventEnableCondition, operation=EvtInfo_CU_TEMP_GRDT.GetEventEnableCondition
        OpEventGetEventEnableCondition_GetEventEnableCondition_EvtInfo_INV_IGBT_TEMP_V_PLAUS: start-on-event=DemSatellite_0InternalBehavior/GetEventEnableCondition, operation=EvtInfo_INV_IGBT_TEMP_V_PLAUS.GetEventEnableCondition
        OpEventGetEventEnableCondition_GetEventEnableCondition_EvtInfo_Ga_GAEngageFailure: start-on-event=DemSatellite_0InternalBehavior/GetEventEnableCondition, operation=EvtInfo_Ga_GAEngageFailure.GetEventEnableCondition
        OpEventGetEventEnableCondition_GetEventEnableCondition_EvtInfo_INV_IAC_W_RNG_LO: start-on-event=DemSatellite_0InternalBehavior/GetEventEnableCondition, operation=EvtInfo_INV_IAC_W_RNG_LO.GetEventEnableCondition
        OpEventGetEventEnableCondition_GetEventEnableCondition_EvtInfo_PS_WhlSnsr_Vltg_FLT: start-on-event=DemSatellite_0InternalBehavior/GetEventEnableCondition, operation=EvtInfo_PS_WhlSnsr_Vltg_FLT.GetEventEnableCondition
        OpEventGetEventEnableCondition_GetEventEnableCondition_EvtInfo_VCEvEcmPropFr02Tioutd: start-on-event=DemSatellite_0InternalBehavior/GetEventEnableCondition, operation=EvtInfo_VCEvEcmPropFr02Tioutd.GetEventEnableCondition
        OpEventGetEventEnableCondition_GetEventEnableCondition_EvtInfo_Ga_TmSpdSyncFailed: start-on-event=DemSatellite_0InternalBehavior/GetEventEnableCondition, operation=EvtInfo_Ga_TmSpdSyncFailed.GetEventEnableCondition
        OpEventGetEventEnableCondition_GetEventEnableCondition_EvtInfo_INV_RSLVR_EXCT_ELEC_LO: start-on-event=DemSatellite_0InternalBehavior/GetEventEnableCondition, operation=EvtInfo_INV_RSLVR_EXCT_ELEC_LO.GetEventEnableCondition
        OpEventGetEventEnableCondition_GetEventEnableCondition_EvtInfo_VCEvEcmPropXevFr06Tioutd: start-on-event=DemSatellite_0InternalBehavior/GetEventEnableCondition, operation=EvtInfo_VCEvEcmPropXevFr06Tioutd.GetEventEnableCondition
        OpEventGetEventEnableCondition_GetEventEnableCondition_EvtInfo_VcEvCntrWhlMotSysTqAllwd: start-on-event=DemSatellite_0InternalBehavior/GetEventEnableCondition, operation=EvtInfo_VcEvCntrWhlMotSysTqAllwd.GetEventEnableCondition
        OpEventGetEventEnableCondition_GetEventEnableCondition_EvtInfo_INV_UHVDC_1_ELEC_HI: start-on-event=DemSatellite_0InternalBehavior/GetEventEnableCondition, operation=EvtInfo_INV_UHVDC_1_ELEC_HI.GetEventEnableCondition
        OpEventGetEventEnableCondition_GetEventEnableCondition_EvtInfo_INV_EM_STATOR_TEMP2_ELE_FLT: start-on-event=DemSatellite_0InternalBehavior/GetEventEnableCondition, operation=EvtInfo_INV_EM_STATOR_TEMP2_ELE_FLT.GetEventEnableCondition
        OpEventGetEventEnableCondition_GetEventEnableCondition_EvtInfo_AURIX_RST_SNG: start-on-event=DemSatellite_0InternalBehavior/GetEventEnableCondition, operation=EvtInfo_AURIX_RST_SNG.GetEventEnableCondition
        OpEventGetEventEnableCondition_GetEventEnableCondition_EvtInfo_VCEvEcmPropFr24MgmFr01Tioutd: start-on-event=DemSatellite_0InternalBehavior/GetEventEnableCondition, operation=EvtInfo_VCEvEcmPropFr24MgmFr01Tioutd.GetEventEnableCondition
        OpEventGetEventEnableCondition_GetEventEnableCondition_EvtInfo_INV_RSLVR_COS_ELEC_OPEN: start-on-event=DemSatellite_0InternalBehavior/GetEventEnableCondition, operation=EvtInfo_INV_RSLVR_COS_ELEC_OPEN.GetEventEnableCondition
        OpEventGetEventEnableCondition_GetEventEnableCondition_EvtInfo_INV_IAC_V_ELEC_LO: start-on-event=DemSatellite_0InternalBehavior/GetEventEnableCondition, operation=EvtInfo_INV_IAC_V_ELEC_LO.GetEventEnableCondition
        OpEventGetEventEnableCondition_GetEventEnableCondition_EvtInfo_INV_IAC_W_OFFS: start-on-event=DemSatellite_0InternalBehavior/GetEventEnableCondition, operation=EvtInfo_INV_IAC_W_OFFS.GetEventEnableCondition
        OpEventGetEventEnableCondition_GetEventEnableCondition_EvtInfo_INV_EM_STATOR_TEMP2_GRDT: start-on-event=DemSatellite_0InternalBehavior/GetEventEnableCondition, operation=EvtInfo_INV_EM_STATOR_TEMP2_GRDT.GetEventEnableCondition
        OpEventGetEventEnableCondition_GetEventEnableCondition_EvtInfo_INV_EM_OVRSPD_HWP: start-on-event=DemSatellite_0InternalBehavior/GetEventEnableCondition, operation=EvtInfo_INV_EM_OVRSPD_HWP.GetEventEnableCondition
        OpEventGetEventEnableCondition_GetEventEnableCondition_EvtInfo_CU_TEMP_HWP: start-on-event=DemSatellite_0InternalBehavior/GetEventEnableCondition, operation=EvtInfo_CU_TEMP_HWP.GetEventEnableCondition
        OpEventGetEventEnableCondition_GetEventEnableCondition_EvtInfo_INV_UHVDC_1_RNG_HI: start-on-event=DemSatellite_0InternalBehavior/GetEventEnableCondition, operation=EvtInfo_INV_UHVDC_1_RNG_HI.GetEventEnableCondition
        OpEventGetEventEnableCondition_GetEventEnableCondition_EvtInfo_VcEvEMPerfPlaus: start-on-event=DemSatellite_0InternalBehavior/GetEventEnableCondition, operation=EvtInfo_VcEvEMPerfPlaus.GetEventEnableCondition
        OpEventGetEventEnableCondition_GetEventEnableCondition_EvtInfo_VCEvVddmPropFr18Tioutd: start-on-event=DemSatellite_0InternalBehavior/GetEventEnableCondition, operation=EvtInfo_VCEvVddmPropFr18Tioutd.GetEventEnableCondition
        OpEventGetEventEnableCondition_GetEventEnableCondition_EvtInfo_INV_IAC_U_ELEC_HWP: start-on-event=DemSatellite_0InternalBehavior/GetEventEnableCondition, operation=EvtInfo_INV_IAC_U_ELEC_HWP.GetEventEnableCondition
        OpEventGetEventEnableCondition_GetEventEnableCondition_EvtInfo_VCEvVddmPropFr15Tioutd: start-on-event=DemSatellite_0InternalBehavior/GetEventEnableCondition, operation=EvtInfo_VCEvVddmPropFr15Tioutd.GetEventEnableCondition
        OpEventGetEventEnableCondition_GetEventEnableCondition_EvtInfo_Ga_GADisengageFailure: start-on-event=DemSatellite_0InternalBehavior/GetEventEnableCondition, operation=EvtInfo_Ga_GADisengageFailure.GetEventEnableCondition
        OpEventGetEventEnableCondition_GetEventEnableCondition_EvtInfo_CU_TEMP2_RNG_LO: start-on-event=DemSatellite_0InternalBehavior/GetEventEnableCondition, operation=EvtInfo_CU_TEMP2_RNG_LO.GetEventEnableCondition
        OpEventGetEventEnableCondition_GetEventEnableCondition_EvtInfo_INV_RSLVR_SIN_ELEC_OPEN: start-on-event=DemSatellite_0InternalBehavior/GetEventEnableCondition, operation=EvtInfo_INV_RSLVR_SIN_ELEC_OPEN.GetEventEnableCondition
        OpEventGetEventEnableCondition_GetEventEnableCondition_EvtInfo_VcEvChkSum: start-on-event=DemSatellite_0InternalBehavior/GetEventEnableCondition, operation=EvtInfo_VcEvChkSum.GetEventEnableCondition
        OpEventGetEventEnableCondition_GetEventEnableCondition_EvtInfo_PS_P5_UC_FLT: start-on-event=DemSatellite_0InternalBehavior/GetEventEnableCondition, operation=EvtInfo_PS_P5_UC_FLT.GetEventEnableCondition
        OpEventGetEventEnableCondition_GetEventEnableCondition_EvtInfo_INV_RSLVR_COS_ELEC_FLT: start-on-event=DemSatellite_0InternalBehavior/GetEventEnableCondition, operation=EvtInfo_INV_RSLVR_COS_ELEC_FLT.GetEventEnableCondition
        OpEventGetEventEnableCondition_GetEventEnableCondition_EvtInfo_INV_IAC_W_RNG_HI: start-on-event=DemSatellite_0InternalBehavior/GetEventEnableCondition, operation=EvtInfo_INV_IAC_W_RNG_HI.GetEventEnableCondition
        OpEventGetEventEnableCondition_GetEventEnableCondition_EvtInfo_PS_ECUSUPPLY_HIGH: start-on-event=DemSatellite_0InternalBehavior/GetEventEnableCondition, operation=EvtInfo_PS_ECUSUPPLY_HIGH.GetEventEnableCondition
        OpEventGetEventEnableCondition_GetEventEnableCondition_EvtInfo_VCEvEcmPropFr05Tioutd: start-on-event=DemSatellite_0InternalBehavior/GetEventEnableCondition, operation=EvtInfo_VCEvEcmPropFr05Tioutd.GetEventEnableCondition
        OpEventGetEventEnableCondition_GetEventEnableCondition_EvtInfo_PS_ECUSUPPLY_LOW: start-on-event=DemSatellite_0InternalBehavior/GetEventEnableCondition, operation=EvtInfo_PS_ECUSUPPLY_LOW.GetEventEnableCondition
        OpEventGetEventEnableCondition_GetEventEnableCondition_EvtInfo_VcEvChkSumHvSysRlySts: start-on-event=DemSatellite_0InternalBehavior/GetEventEnableCondition, operation=EvtInfo_VcEvChkSumHvSysRlySts.GetEventEnableCondition
        OpEventGetEventEnableCondition_GetEventEnableCondition_EvtInfo_VcEvMonMode: start-on-event=DemSatellite_0InternalBehavior/GetEventEnableCondition, operation=EvtInfo_VcEvMonMode.GetEventEnableCondition
        OpEventGetEventEnableCondition_GetEventEnableCondition_EvtInfo_INV_IAC_OC_SWP: start-on-event=DemSatellite_0InternalBehavior/GetEventEnableCondition, operation=EvtInfo_INV_IAC_OC_SWP.GetEventEnableCondition
        OpEventGetEventEnableCondition_GetEventEnableCondition_EvtInfo_INV_IMMO_AUTHFAIL: start-on-event=DemSatellite_0InternalBehavior/GetEventEnableCondition, operation=EvtInfo_INV_IMMO_AUTHFAIL.GetEventEnableCondition
        OpEventGetEventEnableCondition_GetEventEnableCondition_EvtInfo_PA_OpenCirc_FLT: start-on-event=DemSatellite_0InternalBehavior/GetEventEnableCondition, operation=EvtInfo_PA_OpenCirc_FLT.GetEventEnableCondition
        OpEventGetEventEnableCondition_GetEventEnableCondition_EvtInfo_INV_IAC_V_ELEC_HI: start-on-event=DemSatellite_0InternalBehavior/GetEventEnableCondition, operation=EvtInfo_INV_IAC_V_ELEC_HI.GetEventEnableCondition
        OpEventGetEventEnableCondition_GetEventEnableCondition_EvtInfo_VCEvEcmPropFr04Tioutd: start-on-event=DemSatellite_0InternalBehavior/GetEventEnableCondition, operation=EvtInfo_VCEvEcmPropFr04Tioutd.GetEventEnableCondition
        OpEventGetEventEnableCondition_GetEventEnableCondition_EvtInfo_VcEvMonTrqActPlaus: start-on-event=DemSatellite_0InternalBehavior/GetEventEnableCondition, operation=EvtInfo_VcEvMonTrqActPlaus.GetEventEnableCondition
        OpEventGetEventEnableCondition_GetEventEnableCondition_EvtInfo_VcEvMonTrqAct: start-on-event=DemSatellite_0InternalBehavior/GetEventEnableCondition, operation=EvtInfo_VcEvMonTrqAct.GetEventEnableCondition
        OpEventGetEventEnableCondition_GetEventEnableCondition_EvtInfo_INV_RSLVR_COS_ELEC_LO: start-on-event=DemSatellite_0InternalBehavior/GetEventEnableCondition, operation=EvtInfo_INV_RSLVR_COS_ELEC_LO.GetEventEnableCondition
        OpEventGetEventEnableCondition_GetEventEnableCondition_EvtInfo_INV_COOLT_INLET_TEMP_HWP: start-on-event=DemSatellite_0InternalBehavior/GetEventEnableCondition, operation=EvtInfo_INV_COOLT_INLET_TEMP_HWP.GetEventEnableCondition
        OpEventGetEventEnableCondition_GetEventEnableCondition_EvtInfo_VCEvEcmPropFr11Tioutd: start-on-event=DemSatellite_0InternalBehavior/GetEventEnableCondition, operation=EvtInfo_VCEvEcmPropFr11Tioutd.GetEventEnableCondition
        OpEventGetEventEnableCondition_GetEventEnableCondition_EvtInfo_PS_KL30_RNG_HI: start-on-event=DemSatellite_0InternalBehavior/GetEventEnableCondition, operation=EvtInfo_PS_KL30_RNG_HI.GetEventEnableCondition
        OpEventGetEventEnableCondition_GetEventEnableCondition_EvtInfo_INV_IAC_OC_HWP: start-on-event=DemSatellite_0InternalBehavior/GetEventEnableCondition, operation=EvtInfo_INV_IAC_OC_HWP.GetEventEnableCondition
        OpEventGetEventEnableCondition_GetEventEnableCondition_EvtInfo_INV_RSLVR_COS_RNG_HI: start-on-event=DemSatellite_0InternalBehavior/GetEventEnableCondition, operation=EvtInfo_INV_RSLVR_COS_RNG_HI.GetEventEnableCondition
        OpEventGetEventEnableCondition_GetEventEnableCondition_EvtInfo_INV_IAC_U_ELEC_HI: start-on-event=DemSatellite_0InternalBehavior/GetEventEnableCondition, operation=EvtInfo_INV_IAC_U_ELEC_HI.GetEventEnableCondition
        OpEventGetEventEnableCondition_GetEventEnableCondition_EvtInfo_INV_IAC_V_RNG_LO: start-on-event=DemSatellite_0InternalBehavior/GetEventEnableCondition, operation=EvtInfo_INV_IAC_V_RNG_LO.GetEventEnableCondition
        OpEventGetEventEnableCondition_GetEventEnableCondition_EvtInfo_INV_IAC_U_RNG_HI: start-on-event=DemSatellite_0InternalBehavior/GetEventEnableCondition, operation=EvtInfo_INV_IAC_U_RNG_HI.GetEventEnableCondition
        OpEventGetEventEnableCondition_GetEventEnableCondition_EvtInfo_VCEvEcmPropFr25Tioutd: start-on-event=DemSatellite_0InternalBehavior/GetEventEnableCondition, operation=EvtInfo_VCEvEcmPropFr25Tioutd.GetEventEnableCondition
        OpEventGetEventEnableCondition_GetEventEnableCondition_EvtInfo_INV_IGBT_TEMP_W_RNG_LO: start-on-event=DemSatellite_0InternalBehavior/GetEventEnableCondition, operation=EvtInfo_INV_IGBT_TEMP_W_RNG_LO.GetEventEnableCondition
        OpEventGetEventEnableCondition_GetEventEnableCondition_EvtInfo_PSnsr_RNG_NOK: start-on-event=DemSatellite_0InternalBehavior/GetEventEnableCondition, operation=EvtInfo_PSnsr_RNG_NOK.GetEventEnableCondition
        OpEventGetEventEnableCondition_GetEventEnableCondition_EvtInfo_INV_RSLVR_COS_RNG_NOK: start-on-event=DemSatellite_0InternalBehavior/GetEventEnableCondition, operation=EvtInfo_INV_RSLVR_COS_RNG_NOK.GetEventEnableCondition
        OpEventGetEventEnableCondition_GetEventEnableCondition_EvtInfo_PS_DRVB_Fault: start-on-event=DemSatellite_0InternalBehavior/GetEventEnableCondition, operation=EvtInfo_PS_DRVB_Fault.GetEventEnableCondition
        OpEventGetEventEnableCondition_GetEventEnableCondition_EvtInfo_INV_CU_TEMP1_RNG_NOK: start-on-event=DemSatellite_0InternalBehavior/GetEventEnableCondition, operation=EvtInfo_INV_CU_TEMP1_RNG_NOK.GetEventEnableCondition
        OpEventGetEventEnableCondition_GetEventEnableCondition_EvtInfo_VcEvCntr: start-on-event=DemSatellite_0InternalBehavior/GetEventEnableCondition, operation=EvtInfo_VcEvCntr.GetEventEnableCondition
        OpEventGetEventEnableCondition_GetEventEnableCondition_EvtInfo_INV_RSLVR_SIN_AMP: start-on-event=DemSatellite_0InternalBehavior/GetEventEnableCondition, operation=EvtInfo_INV_RSLVR_SIN_AMP.GetEventEnableCondition
        OpEventGetEventEnableCondition_GetEventEnableCondition_EvtInfo_INV_UHVDC_2_RNG_HI: start-on-event=DemSatellite_0InternalBehavior/GetEventEnableCondition, operation=EvtInfo_INV_UHVDC_2_RNG_HI.GetEventEnableCondition
        OpEventGetEventEnableCondition_GetEventEnableCondition_EvtInfo_INV_IGBT_TEMP_U_GRDT: start-on-event=DemSatellite_0InternalBehavior/GetEventEnableCondition, operation=EvtInfo_INV_IGBT_TEMP_U_GRDT.GetEventEnableCondition
        OpEventGetEventEnableCondition_GetEventEnableCondition_EvtInfo_MON_TQ_PLAUS_PWR_MDL: start-on-event=DemSatellite_0InternalBehavior/GetEventEnableCondition, operation=EvtInfo_MON_TQ_PLAUS_PWR_MDL.GetEventEnableCondition
        OpEventGetEventEnableCondition_GetEventEnableCondition_EvtInfo_INV_IGBT_TEMP_W_PLAUS: start-on-event=DemSatellite_0InternalBehavior/GetEventEnableCondition, operation=EvtInfo_INV_IGBT_TEMP_W_PLAUS.GetEventEnableCondition
        OpEventGetEventEnableCondition_GetEventEnableCondition_EvtInfo_PS_BLDC_UV_FLT: start-on-event=DemSatellite_0InternalBehavior/GetEventEnableCondition, operation=EvtInfo_PS_BLDC_UV_FLT.GetEventEnableCondition
        OpEventGetEventEnableCondition_GetEventEnableCondition_EvtInfo_INV_IAC_V_OFFS: start-on-event=DemSatellite_0InternalBehavior/GetEventEnableCondition, operation=EvtInfo_INV_IAC_V_OFFS.GetEventEnableCondition
        OpEventGetEventEnableCondition_GetEventEnableCondition_EvtInfo_INV_RSLVR_EXCT_FREQ_RNG_NOK: start-on-event=DemSatellite_0InternalBehavior/GetEventEnableCondition, operation=EvtInfo_INV_RSLVR_EXCT_FREQ_RNG_NOK.GetEventEnableCondition
        OpEventGetEventEnableCondition_GetEventEnableCondition_EvtInfo_PS_KL30_RNG_LO: start-on-event=DemSatellite_0InternalBehavior/GetEventEnableCondition, operation=EvtInfo_PS_KL30_RNG_LO.GetEventEnableCondition
        OpEventGetEventEnableCondition_GetEventEnableCondition_EvtInfo_INV_RSLVR_COS_RNG_LO: start-on-event=DemSatellite_0InternalBehavior/GetEventEnableCondition, operation=EvtInfo_INV_RSLVR_COS_RNG_LO.GetEventEnableCondition
        OpEventGetEventEnableCondition_GetEventEnableCondition_EvtInfo_PSnsr_ELE_FLT: start-on-event=DemSatellite_0InternalBehavior/GetEventEnableCondition, operation=EvtInfo_PSnsr_ELE_FLT.GetEventEnableCondition
        OpEventGetEventEnableCondition_GetEventEnableCondition_EvtInfo_INV_RSLVR_SIN_COS_PLAUS_AMP: start-on-event=DemSatellite_0InternalBehavior/GetEventEnableCondition, operation=EvtInfo_INV_RSLVR_SIN_COS_PLAUS_AMP.GetEventEnableCondition
        OpEventGetEventEnableCondition_GetEventEnableCondition_EvtInfo_INV_IAC_U_ELEC_LO: start-on-event=DemSatellite_0InternalBehavior/GetEventEnableCondition, operation=EvtInfo_INV_IAC_U_ELEC_LO.GetEventEnableCondition
        OpEventGetEventEnableCondition_GetEventEnableCondition_EvtInfo_INV_RSLVR_EXCT_ELEC_HI: start-on-event=DemSatellite_0InternalBehavior/GetEventEnableCondition, operation=EvtInfo_INV_RSLVR_EXCT_ELEC_HI.GetEventEnableCondition
        OpEventGetEventEnableCondition_GetEventEnableCondition_EvtInfo_INV_IAC_U_RNG_LO: start-on-event=DemSatellite_0InternalBehavior/GetEventEnableCondition, operation=EvtInfo_INV_IAC_U_RNG_LO.GetEventEnableCondition
        OpEventGetEventEnableCondition_GetEventEnableCondition_EvtInfo_INV_IAC_V_RNG_HI: start-on-event=DemSatellite_0InternalBehavior/GetEventEnableCondition, operation=EvtInfo_INV_IAC_V_RNG_HI.GetEventEnableCondition
        OpEventGetEventEnableCondition_GetEventEnableCondition_EvtInfo_INV_IGBT_TEMP_U_PLAUS: start-on-event=DemSatellite_0InternalBehavior/GetEventEnableCondition, operation=EvtInfo_INV_IGBT_TEMP_U_PLAUS.GetEventEnableCondition
        OpEventGetEventEnableCondition_GetEventEnableCondition_EvtInfo_INV_RSLVR_OFFS_DFT: start-on-event=DemSatellite_0InternalBehavior/GetEventEnableCondition, operation=EvtInfo_INV_RSLVR_OFFS_DFT.GetEventEnableCondition
        OpEventGetEventEnableCondition_GetEventEnableCondition_EvtInfo_Ga_MoveOverThd: start-on-event=DemSatellite_0InternalBehavior/GetEventEnableCondition, operation=EvtInfo_Ga_MoveOverThd.GetEventEnableCondition
        OpEventGetEventEnableCondition_GetEventEnableCondition_EvtInfo_VcEvMonIPH: start-on-event=DemSatellite_0InternalBehavior/GetEventEnableCondition, operation=EvtInfo_VcEvMonIPH.GetEventEnableCondition
        OpEventGetEventEnableCondition_GetEventEnableCondition_EvtInfo_INV_RSLVR_HW_FLT: start-on-event=DemSatellite_0InternalBehavior/GetEventEnableCondition, operation=EvtInfo_INV_RSLVR_HW_FLT.GetEventEnableCondition
        OpEventGetEventEnableCondition_GetEventEnableCondition_EvtInfo_INV_RSLVR_SIN_ELEC_LO: start-on-event=DemSatellite_0InternalBehavior/GetEventEnableCondition, operation=EvtInfo_INV_RSLVR_SIN_ELEC_LO.GetEventEnableCondition
        OpEventGetEventEnableCondition_GetEventEnableCondition_EvtInfo_INV_IAC_W_AMP: start-on-event=DemSatellite_0InternalBehavior/GetEventEnableCondition, operation=EvtInfo_INV_IAC_W_AMP.GetEventEnableCondition
        OpEventGetEventEnableCondition_GetEventEnableCondition_EvtInfo_VCC_OverVoltage: start-on-event=DemSatellite_0InternalBehavior/GetEventEnableCondition, operation=EvtInfo_VCC_OverVoltage.GetEventEnableCondition
        OpEventGetEventEnableCondition_GetEventEnableCondition_EvtInfo_PS_BLDC_OV_FLT: start-on-event=DemSatellite_0InternalBehavior/GetEventEnableCondition, operation=EvtInfo_PS_BLDC_OV_FLT.GetEventEnableCondition
        OpEventGetEventEnableCondition_GetEventEnableCondition_EvtInfo_AURIX_EEPROM_FLT: start-on-event=DemSatellite_0InternalBehavior/GetEventEnableCondition, operation=EvtInfo_AURIX_EEPROM_FLT.GetEventEnableCondition
        OpEventGetEventEnableCondition_GetEventEnableCondition_EvtInfo_FS_MONITIOR_ASC_FW_FLT: start-on-event=DemSatellite_0InternalBehavior/GetEventEnableCondition, operation=EvtInfo_FS_MONITIOR_ASC_FW_FLT.GetEventEnableCondition
        OpEventGetEventEnableCondition_GetEventEnableCondition_EvtInfo_VCEvSrsPropFr02Tioutd: start-on-event=DemSatellite_0InternalBehavior/GetEventEnableCondition, operation=EvtInfo_VCEvSrsPropFr02Tioutd.GetEventEnableCondition
        OpEventGetEventEnableCondition_GetEventEnableCondition_EvtInfo_VcEvMonErrMode: start-on-event=DemSatellite_0InternalBehavior/GetEventEnableCondition, operation=EvtInfo_VcEvMonErrMode.GetEventEnableCondition
        OpEventGetEventEnableCondition_GetEventEnableCondition_EvtInfo_AURIX_RST_MPL: start-on-event=DemSatellite_0InternalBehavior/GetEventEnableCondition, operation=EvtInfo_AURIX_RST_MPL.GetEventEnableCondition
        OpEventGetEventEnableCondition_GetEventEnableCondition_EvtInfo_VcEvNodeMisECM: start-on-event=DemSatellite_0InternalBehavior/GetEventEnableCondition, operation=EvtInfo_VcEvNodeMisECM.GetEventEnableCondition
        OpEventGetEventEnableCondition_GetEventEnableCondition_EvtInfo_PS_KL30_PLAUS: start-on-event=DemSatellite_0InternalBehavior/GetEventEnableCondition, operation=EvtInfo_PS_KL30_PLAUS.GetEventEnableCondition
        OpEventGetEventEnableCondition_GetEventEnableCondition_EvtInfo_INV_IAC_W_ELEC_HI: start-on-event=DemSatellite_0InternalBehavior/GetEventEnableCondition, operation=EvtInfo_INV_IAC_W_ELEC_HI.GetEventEnableCondition
        OpEventGetEventEnableCondition_GetEventEnableCondition_EvtInfo_VCEvVddmPropFr19Tioutd: start-on-event=DemSatellite_0InternalBehavior/GetEventEnableCondition, operation=EvtInfo_VCEvVddmPropFr19Tioutd.GetEventEnableCondition
        OpEventGetEventEnableCondition_GetEventEnableCondition_EvtInfo_INV_TEMP_DCHA_HW: start-on-event=DemSatellite_0InternalBehavior/GetEventEnableCondition, operation=EvtInfo_INV_TEMP_DCHA_HW.GetEventEnableCondition
        OpEventGetEventEnableCondition_GetEventEnableCondition_EvtInfo_VcEvPropCANGlbTiOutd: start-on-event=DemSatellite_0InternalBehavior/GetEventEnableCondition, operation=EvtInfo_VcEvPropCANGlbTiOutd.GetEventEnableCondition
        OpEventGetEventEnableCondition_GetEventEnableCondition_EvtInfo_INV_EM_STATOR_TEMP2_RNG_NOK: start-on-event=DemSatellite_0InternalBehavior/GetEventEnableCondition, operation=EvtInfo_INV_EM_STATOR_TEMP2_RNG_NOK.GetEventEnableCondition
        OpEventGetEventEnableCondition_GetEventEnableCondition_EvtInfo_INV_UHVDC_OV_HWP: start-on-event=DemSatellite_0InternalBehavior/GetEventEnableCondition, operation=EvtInfo_INV_UHVDC_OV_HWP.GetEventEnableCondition
        OpEventGetEventEnableCondition_GetEventEnableCondition_EvtInfo_Ga_FindEngleAngleFailed: start-on-event=DemSatellite_0InternalBehavior/GetEventEnableCondition, operation=EvtInfo_Ga_FindEngleAngleFailed.GetEventEnableCondition
        OpEventGetEventEnableCondition_GetEventEnableCondition_EvtInfo_VcEvMonTrqCmp: start-on-event=DemSatellite_0InternalBehavior/GetEventEnableCondition, operation=EvtInfo_VcEvMonTrqCmp.GetEventEnableCondition
        OpEventGetEventEnableCondition_GetEventEnableCondition_EvtInfo_INV_IGBT_TEMP_V_RNG_LO: start-on-event=DemSatellite_0InternalBehavior/GetEventEnableCondition, operation=EvtInfo_INV_IGBT_TEMP_V_RNG_LO.GetEventEnableCondition
        OpEventGetEventEnableCondition_GetEventEnableCondition_EvtInfo_INV_CONTROL_LIMIT: start-on-event=DemSatellite_0InternalBehavior/GetEventEnableCondition, operation=EvtInfo_INV_CONTROL_LIMIT.GetEventEnableCondition
        OpEventGetEventEnableCondition_GetEventEnableCondition_EvtInfo_COM_CarConfigErr: start-on-event=DemSatellite_0InternalBehavior/GetEventEnableCondition, operation=EvtInfo_COM_CarConfigErr.GetEventEnableCondition
        OpEventGetEventEnableCondition_GetEventEnableCondition_EvtInfo_VCEvEcmPropFr08Tioutd: start-on-event=DemSatellite_0InternalBehavior/GetEventEnableCondition, operation=EvtInfo_VCEvEcmPropFr08Tioutd.GetEventEnableCondition
        OpEventGetEventEnableCondition_GetEventEnableCondition_EvtInfo_CU_TEMP1_RNG_LO: start-on-event=DemSatellite_0InternalBehavior/GetEventEnableCondition, operation=EvtInfo_CU_TEMP1_RNG_LO.GetEventEnableCondition
        OpEventGetEventEnableCondition_GetEventEnableCondition_EvtInfo_INV_EM_STATOR_TEMP2_RNG_SWT: start-on-event=DemSatellite_0InternalBehavior/GetEventEnableCondition, operation=EvtInfo_INV_EM_STATOR_TEMP2_RNG_SWT.GetEventEnableCondition
        OpEventGetEventEnableCondition_GetEventEnableCondition_EvtInfo_GA_BLDC_POS_FLT: start-on-event=DemSatellite_0InternalBehavior/GetEventEnableCondition, operation=EvtInfo_GA_BLDC_POS_FLT.GetEventEnableCondition
        OpEventGetEventEnableCondition_GetEventEnableCondition_EvtInfo_PS_WhlSnsr_FLT: start-on-event=DemSatellite_0InternalBehavior/GetEventEnableCondition, operation=EvtInfo_PS_WhlSnsr_FLT.GetEventEnableCondition
        OpEventGetEventEnableCondition_GetEventEnableCondition_EvtInfo_INV_EM_STATOR_TEMP_RNG_LO: start-on-event=DemSatellite_0InternalBehavior/GetEventEnableCondition, operation=EvtInfo_INV_EM_STATOR_TEMP_RNG_LO.GetEventEnableCondition
        OpEventGetEventEnableCondition_GetEventEnableCondition_EvtInfo_INV_RSLVR_SIN_ELEC_HI: start-on-event=DemSatellite_0InternalBehavior/GetEventEnableCondition, operation=EvtInfo_INV_RSLVR_SIN_ELEC_HI.GetEventEnableCondition
        OpEventGetEventEnableCondition_GetEventEnableCondition_EvtInfo_INV_RSLVR_SIN_COS_PLAUS: start-on-event=DemSatellite_0InternalBehavior/GetEventEnableCondition, operation=EvtInfo_INV_RSLVR_SIN_COS_PLAUS.GetEventEnableCondition
        OpEventGetEventEnableCondition_GetEventEnableCondition_EvtInfo_INV_RSLVR_COS_AMP: start-on-event=DemSatellite_0InternalBehavior/GetEventEnableCondition, operation=EvtInfo_INV_RSLVR_COS_AMP.GetEventEnableCondition
        OpEventGetEventEnableCondition_GetEventEnableCondition_EvtInfo_INV_GATE_DRVR_BOT_HWP: start-on-event=DemSatellite_0InternalBehavior/GetEventEnableCondition, operation=EvtInfo_INV_GATE_DRVR_BOT_HWP.GetEventEnableCondition
        OpEventGetEventEnableCondition_GetEventEnableCondition_EvtInfo_Eg_HallVolWrong: start-on-event=DemSatellite_0InternalBehavior/GetEventEnableCondition, operation=EvtInfo_Eg_HallVolWrong.GetEventEnableCondition
        OpEventGetEventEnableCondition_GetEventEnableCondition_EvtInfo_INV_RSLVR_EXCT_RNG_NOK: start-on-event=DemSatellite_0InternalBehavior/GetEventEnableCondition, operation=EvtInfo_INV_RSLVR_EXCT_RNG_NOK.GetEventEnableCondition
        OpEventGetEventEnableCondition_GetEventEnableCondition_EvtInfo_PA_OpenCirc: start-on-event=DemSatellite_0InternalBehavior/GetEventEnableCondition, operation=EvtInfo_PA_OpenCirc.GetEventEnableCondition
        OpEventGetEventEnableCondition_GetEventEnableCondition_EvtInfo_INV_RSLVR_COS_ELEC_HI: start-on-event=DemSatellite_0InternalBehavior/GetEventEnableCondition, operation=EvtInfo_INV_RSLVR_COS_ELEC_HI.GetEventEnableCondition
        OpEventGetEventEnableCondition_GetEventEnableCondition_EvtInfo_VcEvCntrHvSysRlySts: start-on-event=DemSatellite_0InternalBehavior/GetEventEnableCondition, operation=EvtInfo_VcEvCntrHvSysRlySts.GetEventEnableCondition
        OpEventGetEventEnableCondition_GetEventEnableCondition_EvtInfo_CRASH_DTC: start-on-event=DemSatellite_0InternalBehavior/GetEventEnableCondition, operation=EvtInfo_CRASH_DTC.GetEventEnableCondition
        OpEventGetEventEnableCondition_GetEventEnableCondition_EvtInfo_INV_IGBT_TEMP_W_RNG_HI: start-on-event=DemSatellite_0InternalBehavior/GetEventEnableCondition, operation=EvtInfo_INV_IGBT_TEMP_W_RNG_HI.GetEventEnableCondition
        OpEventGetEventEnableCondition_GetEventEnableCondition_EvtInfo_VCEvBecmPropFr02Tioutd: start-on-event=DemSatellite_0InternalBehavior/GetEventEnableCondition, operation=EvtInfo_VCEvBecmPropFr02Tioutd.GetEventEnableCondition
        OpEventGetEventEnableCondition_GetEventEnableCondition_EvtInfo_INV_IGBT_TEMP_W_GRDT: start-on-event=DemSatellite_0InternalBehavior/GetEventEnableCondition, operation=EvtInfo_INV_IGBT_TEMP_W_GRDT.GetEventEnableCondition
        OpEventGetEventEnableCondition_GetEventEnableCondition_EvtInfo_EXT_UC_SPI_FLT: start-on-event=DemSatellite_0InternalBehavior/GetEventEnableCondition, operation=EvtInfo_EXT_UC_SPI_FLT.GetEventEnableCondition
        OpEventGetEventEnableCondition_GetEventEnableCondition_EvtInfo_INV_IAC_V_ELEC_HWP_001: start-on-event=DemSatellite_0InternalBehavior/GetEventEnableCondition, operation=EvtInfo_INV_IAC_V_ELEC_HWP_001.GetEventEnableCondition
        OpEventGetEventEnableCondition_GetEventEnableCondition_EvtInfo_VcEvChkSumWhlMotSysTqAllwd: start-on-event=DemSatellite_0InternalBehavior/GetEventEnableCondition, operation=EvtInfo_VcEvChkSumWhlMotSysTqAllwd.GetEventEnableCondition
        OpEventGetEventEnableCondition_GetEventEnableCondition_EvtInfo_FS_MONITIOR_ASC_FLT: start-on-event=DemSatellite_0InternalBehavior/GetEventEnableCondition, operation=EvtInfo_FS_MONITIOR_ASC_FLT.GetEventEnableCondition
        OpEventGetEventEnableCondition_GetEventEnableCondition_EvtInfo_INV_IAC_V_AMP: start-on-event=DemSatellite_0InternalBehavior/GetEventEnableCondition, operation=EvtInfo_INV_IAC_V_AMP.GetEventEnableCondition
        OpEventGetEventEnableCondition_GetEventEnableCondition_EvtInfo_INV_IAC_W_ELEC_LO: start-on-event=DemSatellite_0InternalBehavior/GetEventEnableCondition, operation=EvtInfo_INV_IAC_W_ELEC_LO.GetEventEnableCondition
        OpEventGetEventEnableCondition_GetEventEnableCondition_EvtInfo_VCEvVddmPropFr08Tioutd_001: start-on-event=DemSatellite_0InternalBehavior/GetEventEnableCondition, operation=EvtInfo_VCEvVddmPropFr08Tioutd_001.GetEventEnableCondition
        OpEventGetEventEnableCondition_GetEventEnableCondition_EvtInfo_PS_P12_RES_FLT: start-on-event=DemSatellite_0InternalBehavior/GetEventEnableCondition, operation=EvtInfo_PS_P12_RES_FLT.GetEventEnableCondition
        OpEventGetEventEnableCondition_GetEventEnableCondition_EvtInfo_INV_RSLVR_SIN_RNG_LO: start-on-event=DemSatellite_0InternalBehavior/GetEventEnableCondition, operation=EvtInfo_INV_RSLVR_SIN_RNG_LO.GetEventEnableCondition
        OpEventGetEventEnableCondition_GetEventEnableCondition_EvtInfo_CU_TEMP_HW_FLT: start-on-event=DemSatellite_0InternalBehavior/GetEventEnableCondition, operation=EvtInfo_CU_TEMP_HW_FLT.GetEventEnableCondition
        OpEventGetEventEnableCondition_GetEventEnableCondition_EvtInfo_VCEvEcmPropFr02MgmFr00Tioutd: start-on-event=DemSatellite_0InternalBehavior/GetEventEnableCondition, operation=EvtInfo_VCEvEcmPropFr02MgmFr00Tioutd.GetEventEnableCondition
        OpEventGetEventEnableCondition_GetEventEnableCondition_EvtInfo_PS_KL15_RNG_HI: start-on-event=DemSatellite_0InternalBehavior/GetEventEnableCondition, operation=EvtInfo_PS_KL15_RNG_HI.GetEventEnableCondition
        OpEventGetEventEnableCondition_GetEventEnableCondition_EvtInfo_VCEvVddmPropFr17Tioutd: start-on-event=DemSatellite_0InternalBehavior/GetEventEnableCondition, operation=EvtInfo_VCEvVddmPropFr17Tioutd.GetEventEnableCondition
        OpEventGetEventEnableCondition_GetEventEnableCondition_EvtInfo_VcEvChkSumCrashStsSafe: start-on-event=DemSatellite_0InternalBehavior/GetEventEnableCondition, operation=EvtInfo_VcEvChkSumCrashStsSafe.GetEventEnableCondition
        OpEventGetEventEnableCondition_GetEventEnableCondition_EvtInfo_DiagC_ClutchService: start-on-event=DemSatellite_0InternalBehavior/GetEventEnableCondition, operation=EvtInfo_DiagC_ClutchService.GetEventEnableCondition
        OpEventGetEventEnableCondition_GetEventEnableCondition_EvtInfo_INV_EM_STATOR_TEMP_RNG_HI: start-on-event=DemSatellite_0InternalBehavior/GetEventEnableCondition, operation=EvtInfo_INV_EM_STATOR_TEMP_RNG_HI.GetEventEnableCondition
        OpEventGetEventEnableCondition_GetEventEnableCondition_EvtInfo_INV_RSLVR_OFFS_OUT_RANG: start-on-event=DemSatellite_0InternalBehavior/GetEventEnableCondition, operation=EvtInfo_INV_RSLVR_OFFS_OUT_RANG.GetEventEnableCondition
        OpEventGetEventEnableCondition_GetEventEnableCondition_EvtInfo_INV_EM_STATOR_TEMP2_RNG_LO: start-on-event=DemSatellite_0InternalBehavior/GetEventEnableCondition, operation=EvtInfo_INV_EM_STATOR_TEMP2_RNG_LO.GetEventEnableCondition
        OpEventGetEventEnableCondition_GetEventEnableCondition_EvtInfo_VcEvMonISAR: start-on-event=DemSatellite_0InternalBehavior/GetEventEnableCondition, operation=EvtInfo_VcEvMonISAR.GetEventEnableCondition
        OpEventGetEventEnableCondition_GetEventEnableCondition_EvtInfo_GA_BLDC_FLT: start-on-event=DemSatellite_0InternalBehavior/GetEventEnableCondition, operation=EvtInfo_GA_BLDC_FLT.GetEventEnableCondition
        OpEventGetEventEnableCondition_GetEventEnableCondition_EvtInfo_INV_RSLVR_EXCT_ELEC_OPEN: start-on-event=DemSatellite_0InternalBehavior/GetEventEnableCondition, operation=EvtInfo_INV_RSLVR_EXCT_ELEC_OPEN.GetEventEnableCondition
        OpEventGetEventEnableCondition_GetEventEnableCondition_EvtInfo_INV_RSLVR_EXCT_PLAUS: start-on-event=DemSatellite_0InternalBehavior/GetEventEnableCondition, operation=EvtInfo_INV_RSLVR_EXCT_PLAUS.GetEventEnableCondition
        OpEventGetEventEnableCondition_GetEventEnableCondition_EvtInfo_PS_P15_U_FLT: start-on-event=DemSatellite_0InternalBehavior/GetEventEnableCondition, operation=EvtInfo_PS_P15_U_FLT.GetEventEnableCondition
        OpEventGetEventEnableCondition_GetEventEnableCondition_EvtInfo_INV_EM_STATOR_TEMP_RNG_SWT: start-on-event=DemSatellite_0InternalBehavior/GetEventEnableCondition, operation=EvtInfo_INV_EM_STATOR_TEMP_RNG_SWT.GetEventEnableCondition
        OpEventGetEventEnableCondition_GetEventEnableCondition_EvtInfo_INV_UHVDC_OV_SWP: start-on-event=DemSatellite_0InternalBehavior/GetEventEnableCondition, operation=EvtInfo_INV_UHVDC_OV_SWP.GetEventEnableCondition
        OpEventGetEventEnableCondition_GetEventEnableCondition_EvtInfo_AURIX_HW_FLT: start-on-event=DemSatellite_0InternalBehavior/GetEventEnableCondition, operation=EvtInfo_AURIX_HW_FLT.GetEventEnableCondition
        OpEventGetEventEnableCondition_GetEventEnableCondition_EvtInfo_INV_GATE_DRVR_TOP_HWP: start-on-event=DemSatellite_0InternalBehavior/GetEventEnableCondition, operation=EvtInfo_INV_GATE_DRVR_TOP_HWP.GetEventEnableCondition
        OpEventGetEventEnableCondition_GetEventEnableCondition_EvtInfo_INV_ACTV_DCHA_HW: start-on-event=DemSatellite_0InternalBehavior/GetEventEnableCondition, operation=EvtInfo_INV_ACTV_DCHA_HW.GetEventEnableCondition
        OpEventGetEventEnableCondition_GetEventEnableCondition_EvtInfo_INV_IGBT_TEMP_HWP: start-on-event=DemSatellite_0InternalBehavior/GetEventEnableCondition, operation=EvtInfo_INV_IGBT_TEMP_HWP.GetEventEnableCondition
        OpEventGetEventEnableCondition_GetEventEnableCondition_EvtInfo_INV_RSLVR_SIN_ELEC_FLT: start-on-event=DemSatellite_0InternalBehavior/GetEventEnableCondition, operation=EvtInfo_INV_RSLVR_SIN_ELEC_FLT.GetEventEnableCondition
        OpEventGetEventEnableCondition_GetEventEnableCondition_EvtInfo_CU_TEMP2_RNG_HI: start-on-event=DemSatellite_0InternalBehavior/GetEventEnableCondition, operation=EvtInfo_CU_TEMP2_RNG_HI.GetEventEnableCondition
        OpEventGetEventEnableCondition_GetEventEnableCondition_EvtInfo_INV_IAC_PHA_LOSS_MPL: start-on-event=DemSatellite_0InternalBehavior/GetEventEnableCondition, operation=EvtInfo_INV_IAC_PHA_LOSS_MPL.GetEventEnableCondition
        OpEventGetEventEnableCondition_GetEventEnableCondition_EvtInfo_INV_IAC_U_AMP: start-on-event=DemSatellite_0InternalBehavior/GetEventEnableCondition, operation=EvtInfo_INV_IAC_U_AMP.GetEventEnableCondition
        OpEventGetEventEnableCondition_GetEventEnableCondition_EvtInfo_PSnsr_GRADT_Flt: start-on-event=DemSatellite_0InternalBehavior/GetEventEnableCondition, operation=EvtInfo_PSnsr_GRADT_Flt.GetEventEnableCondition
        OpEventGetEventEnableCondition_GetEventEnableCondition_EvtInfo_AURIX_WATHDOG_FLT: start-on-event=DemSatellite_0InternalBehavior/GetEventEnableCondition, operation=EvtInfo_AURIX_WATHDOG_FLT.GetEventEnableCondition
        OpEventGetEventEnableCondition_GetEventEnableCondition_EvtInfo_VcEvNodeMisBECM: start-on-event=DemSatellite_0InternalBehavior/GetEventEnableCondition, operation=EvtInfo_VcEvNodeMisBECM.GetEventEnableCondition
        OpEventGetEventEnableCondition_GetEventEnableCondition_EvtInfo_INV_UHVDC_UV_HWP: start-on-event=DemSatellite_0InternalBehavior/GetEventEnableCondition, operation=EvtInfo_INV_UHVDC_UV_HWP.GetEventEnableCondition
        OpEventGetEventEnableCondition_GetEventEnableCondition_EvtInfo_VcEvMonESpd: start-on-event=DemSatellite_0InternalBehavior/GetEventEnableCondition, operation=EvtInfo_VcEvMonESpd.GetEventEnableCondition
        OpEventGetEventEnableCondition_GetEventEnableCondition_EvtInfo_COM_NotConfig: start-on-event=DemSatellite_0InternalBehavior/GetEventEnableCondition, operation=EvtInfo_COM_NotConfig.GetEventEnableCondition
        OpEventGetEventEnableCondition_GetEventEnableCondition_EvtInfo_INV_RSLVR_SIN_RNG_HI: start-on-event=DemSatellite_0InternalBehavior/GetEventEnableCondition, operation=EvtInfo_INV_RSLVR_SIN_RNG_HI.GetEventEnableCondition
        OpEventGetEventEnableCondition_GetEventEnableCondition_EvtInfo_INV_IGBT_TEMP_U_RNG_HI: start-on-event=DemSatellite_0InternalBehavior/GetEventEnableCondition, operation=EvtInfo_INV_IGBT_TEMP_U_RNG_HI.GetEventEnableCondition
        OpEventGetEventEnableCondition_GetEventEnableCondition_EvtInfo_VcEvMonMode_001: start-on-event=DemSatellite_0InternalBehavior/GetEventEnableCondition, operation=EvtInfo_VcEvMonMode_001.GetEventEnableCondition
        OpEventGetEventEnableCondition_GetEventEnableCondition_EvtInfo_PA_ACTION_FLT: start-on-event=DemSatellite_0InternalBehavior/GetEventEnableCondition, operation=EvtInfo_PA_ACTION_FLT.GetEventEnableCondition
        OpEventGetEventEnableCondition_GetEventEnableCondition_EvtInfo_INV_IAC_V_ELEC_HWP: start-on-event=DemSatellite_0InternalBehavior/GetEventEnableCondition, operation=EvtInfo_INV_IAC_V_ELEC_HWP.GetEventEnableCondition
        OpEventGetEventEnableCondition_GetEventEnableCondition_EvtInfo_CU_TEMP_HW_FLT_001: start-on-event=DemSatellite_0InternalBehavior/GetEventEnableCondition, operation=EvtInfo_CU_TEMP_HW_FLT_001.GetEventEnableCondition
        OpEventGetEventEnableCondition_GetEventEnableCondition_EvtInfo_VCC_UnderVoltage: start-on-event=DemSatellite_0InternalBehavior/GetEventEnableCondition, operation=EvtInfo_VCC_UnderVoltage.GetEventEnableCondition
        OpEventGetEventEnableCondition_GetEventEnableCondition_EvtInfo_VcEvTsttrPlaus: start-on-event=DemSatellite_0InternalBehavior/GetEventEnableCondition, operation=EvtInfo_VcEvTsttrPlaus.GetEventEnableCondition
        OpEventGetEventEnableCondition_GetEventEnableCondition_EvtInfo_INV_RSLVR_EXCT_ELEC_FLT: start-on-event=DemSatellite_0InternalBehavior/GetEventEnableCondition, operation=EvtInfo_INV_RSLVR_EXCT_ELEC_FLT.GetEventEnableCondition
        OpEventGetEventEnableCondition_GetEventEnableCondition_EvtInfo_INV_RSLVR_EXCT_RNG_LO: start-on-event=DemSatellite_0InternalBehavior/GetEventEnableCondition, operation=EvtInfo_INV_RSLVR_EXCT_RNG_LO.GetEventEnableCondition
        OpEventGetEventEnableCondition_GetEventEnableCondition_EvtInfo_INV_EM_STATOR_TEMP2_RNG_HI: start-on-event=DemSatellite_0InternalBehavior/GetEventEnableCondition, operation=EvtInfo_INV_EM_STATOR_TEMP2_RNG_HI.GetEventEnableCondition
        OpEventGetEventEnableCondition_GetEventEnableCondition_EvtInfo_INV_SHUT_OFF_PAH_START_UP: start-on-event=DemSatellite_0InternalBehavior/GetEventEnableCondition, operation=EvtInfo_INV_SHUT_OFF_PAH_START_UP.GetEventEnableCondition
        OpEventGetEventEnableCondition_GetEventEnableCondition_EvtInfo_VCEvVddmPropFr08Tioutd: start-on-event=DemSatellite_0InternalBehavior/GetEventEnableCondition, operation=EvtInfo_VCEvVddmPropFr08Tioutd.GetEventEnableCondition
        OpEventGetEventEnableCondition_GetEventEnableCondition_EvtInfo_INV_RSLVR_EXCT_OC_HWP_001: start-on-event=DemSatellite_0InternalBehavior/GetEventEnableCondition, operation=EvtInfo_INV_RSLVR_EXCT_OC_HWP_001.GetEventEnableCondition
        OpEventGetEventEnableCondition_GetEventEnableCondition_EvtInfo_INV_RSLVR_EXCT_OC_HWP_002: start-on-event=DemSatellite_0InternalBehavior/GetEventEnableCondition, operation=EvtInfo_INV_RSLVR_EXCT_OC_HWP_002.GetEventEnableCondition
        OpEventGetEventEnableCondition_GetEventEnableCondition_EvtInfo_INV_EM_STATOR_TEMP_ELE_FLT: start-on-event=DemSatellite_0InternalBehavior/GetEventEnableCondition, operation=EvtInfo_INV_EM_STATOR_TEMP_ELE_FLT.GetEventEnableCondition
        OpEventGetEventEnableCondition_GetEventEnableCondition_EvtInfo_INV_INTERLOCK_FLT: start-on-event=DemSatellite_0InternalBehavior/GetEventEnableCondition, operation=EvtInfo_INV_INTERLOCK_FLT.GetEventEnableCondition
        OpEventGetEventEnableCondition_GetEventEnableCondition_EvtInfo_Ga_ZeroFindDistanFailure: start-on-event=DemSatellite_0InternalBehavior/GetEventEnableCondition, operation=EvtInfo_Ga_ZeroFindDistanFailure.GetEventEnableCondition
        OpEventGetEventEnableCondition_GetEventEnableCondition_EvtInfo_PLOCK_Current_RNG_OUT: start-on-event=DemSatellite_0InternalBehavior/GetEventEnableCondition, operation=EvtInfo_PLOCK_Current_RNG_OUT.GetEventEnableCondition
        OpEventGetEventEnableCondition_GetEventEnableCondition_EvtInfo_VCEvVddmPropFr05Tioutd: start-on-event=DemSatellite_0InternalBehavior/GetEventEnableCondition, operation=EvtInfo_VCEvVddmPropFr05Tioutd.GetEventEnableCondition
        OpEventGetEventEnableCondition_GetEventEnableCondition_EvtInfo_INV_IGBT_TEMP_V_GRDT: start-on-event=DemSatellite_0InternalBehavior/GetEventEnableCondition, operation=EvtInfo_INV_IGBT_TEMP_V_GRDT.GetEventEnableCondition
        OpEventGetEventEnableCondition_GetEventEnableCondition_EvtInfo_PS_5V_Fault: start-on-event=DemSatellite_0InternalBehavior/GetEventEnableCondition, operation=EvtInfo_PS_5V_Fault.GetEventEnableCondition
        OpEventGetEventEnableCondition_GetEventEnableCondition_EvtInfo_VcEvCntrCrashStsSafe: start-on-event=DemSatellite_0InternalBehavior/GetEventEnableCondition, operation=EvtInfo_VcEvCntrCrashStsSafe.GetEventEnableCondition
        OpEventGetEventEnableCondition_GetEventEnableCondition_EvtInfo_INV_EM_STATOR_TEMP_GRDT: start-on-event=DemSatellite_0InternalBehavior/GetEventEnableCondition, operation=EvtInfo_INV_EM_STATOR_TEMP_GRDT.GetEventEnableCondition
        OpEventGetEventEnableCondition_GetEventEnableCondition_EvtInfo_PS_P15_V_FLT: start-on-event=DemSatellite_0InternalBehavior/GetEventEnableCondition, operation=EvtInfo_PS_P15_V_FLT.GetEventEnableCondition
        OpEventGetEventEnableCondition_GetEventEnableCondition_EvtInfo_INV_EM_STATOR_TEMP_RNG_NOK: start-on-event=DemSatellite_0InternalBehavior/GetEventEnableCondition, operation=EvtInfo_INV_EM_STATOR_TEMP_RNG_NOK.GetEventEnableCondition
        OpEventGetEventEnableCondition_GetEventEnableCondition_EvtInfo_INV_RSLVR_SIN_RNG_NOK: start-on-event=DemSatellite_0InternalBehavior/GetEventEnableCondition, operation=EvtInfo_INV_RSLVR_SIN_RNG_NOK.GetEventEnableCondition
        OpEventGetEventEnableCondition_GetEventEnableCondition_EvtInfo_INV_IAC_U_OFFS: start-on-event=DemSatellite_0InternalBehavior/GetEventEnableCondition, operation=EvtInfo_INV_IAC_U_OFFS.GetEventEnableCondition
        OpEventGetEventEnableCondition_GetEventEnableCondition_EvtInfo_PS_KL30_BACKUP_FLT: start-on-event=DemSatellite_0InternalBehavior/GetEventEnableCondition, operation=EvtInfo_PS_KL30_BACKUP_FLT.GetEventEnableCondition
        OpEventGetEventEnableCondition_GetEventEnableCondition_EvtInfo_INV_IGBT_TEMP_U_RNG_LO: start-on-event=DemSatellite_0InternalBehavior/GetEventEnableCondition, operation=EvtInfo_INV_IGBT_TEMP_U_RNG_LO.GetEventEnableCondition
        OpEventGetEventEnableCondition_GetEventEnableCondition_EvtInfo_INV_EM_STATOR_TEMP_HWP: start-on-event=DemSatellite_0InternalBehavior/GetEventEnableCondition, operation=EvtInfo_INV_EM_STATOR_TEMP_HWP.GetEventEnableCondition
        OpEventGetEventEnableCondition_GetEventEnableCondition_EvtInfo_CU_TEMP1_RNG_HI: start-on-event=DemSatellite_0InternalBehavior/GetEventEnableCondition, operation=EvtInfo_CU_TEMP1_RNG_HI.GetEventEnableCondition
        OpEventGetEventEnableCondition_GetEventEnableCondition_EvtInfo_INV_IGBT_TEMP_V_RNG_HI: start-on-event=DemSatellite_0InternalBehavior/GetEventEnableCondition, operation=EvtInfo_INV_IGBT_TEMP_V_RNG_HI.GetEventEnableCondition
        OpEventGetEventEnableCondition_GetEventEnableCondition_EvtInfo_VcEvNodeMisVDDM: start-on-event=DemSatellite_0InternalBehavior/GetEventEnableCondition, operation=EvtInfo_VcEvNodeMisVDDM.GetEventEnableCondition
        OpEventGetEventEnableCondition_GetEventEnableCondition_EvtInfo_INV_UHVDC_PLAUS: start-on-event=DemSatellite_0InternalBehavior/GetEventEnableCondition, operation=EvtInfo_INV_UHVDC_PLAUS.GetEventEnableCondition
        OpEventGetEventEnableCondition_GetEventEnableCondition_EvtInfo_INV_QUIESCENT_FLT: start-on-event=DemSatellite_0InternalBehavior/GetEventEnableCondition, operation=EvtInfo_INV_QUIESCENT_FLT.GetEventEnableCondition
        OpEventGetEventEnableCondition_GetEventEnableCondition_EvtInfo_INV_RSLVR_EXCT_RNG_HI: start-on-event=DemSatellite_0InternalBehavior/GetEventEnableCondition, operation=EvtInfo_INV_RSLVR_EXCT_RNG_HI.GetEventEnableCondition
        OpEventGetEventEnableCondition_GetEventEnableCondition_GeneralEvtInfo: start-on-event=DemSatellite_0InternalBehavior/GetEventEnableCondition, operation=GeneralEvtInfo.GetEventEnableCondition
        OpEventGetDebouncingOfEvent_GetDebouncingOfEvent_EvtInfo_VCEvBecmPropFr01Tioutd: start-on-event=DemSatellite_0InternalBehavior/GetDebouncingOfEvent, operation=EvtInfo_VCEvBecmPropFr01Tioutd.GetDebouncingOfEvent
        OpEventGetDebouncingOfEvent_GetDebouncingOfEvent_EvtInfo_INV_CU_TEMP2_RNG_NOK: start-on-event=DemSatellite_0InternalBehavior/GetDebouncingOfEvent, operation=EvtInfo_INV_CU_TEMP2_RNG_NOK.GetDebouncingOfEvent
        OpEventGetDebouncingOfEvent_GetDebouncingOfEvent_EvtInfo_INV_IMMO_NOKEY: start-on-event=DemSatellite_0InternalBehavior/GetDebouncingOfEvent, operation=EvtInfo_INV_IMMO_NOKEY.GetDebouncingOfEvent
        OpEventGetDebouncingOfEvent_GetDebouncingOfEvent_EvtInfo_INV_RSLVR_EXCT_OC_HWP: start-on-event=DemSatellite_0InternalBehavior/GetDebouncingOfEvent, operation=EvtInfo_INV_RSLVR_EXCT_OC_HWP.GetDebouncingOfEvent
        OpEventGetDebouncingOfEvent_GetDebouncingOfEvent_EvtInfo_PS_P15_W_FLT: start-on-event=DemSatellite_0InternalBehavior/GetDebouncingOfEvent, operation=EvtInfo_PS_P15_W_FLT.GetDebouncingOfEvent
        OpEventGetDebouncingOfEvent_GetDebouncingOfEvent_EvtInfo_INV_IAC_PLAUS_SUM: start-on-event=DemSatellite_0InternalBehavior/GetDebouncingOfEvent, operation=EvtInfo_INV_IAC_PLAUS_SUM.GetDebouncingOfEvent
        OpEventGetDebouncingOfEvent_GetDebouncingOfEvent_EvtInfo_PA_ELE_FLT: start-on-event=DemSatellite_0InternalBehavior/GetDebouncingOfEvent, operation=EvtInfo_PA_ELE_FLT.GetDebouncingOfEvent
        OpEventGetDebouncingOfEvent_GetDebouncingOfEvent_EvtInfo_CU_TEMP_GRDT: start-on-event=DemSatellite_0InternalBehavior/GetDebouncingOfEvent, operation=EvtInfo_CU_TEMP_GRDT.GetDebouncingOfEvent
        OpEventGetDebouncingOfEvent_GetDebouncingOfEvent_EvtInfo_INV_IGBT_TEMP_V_PLAUS: start-on-event=DemSatellite_0InternalBehavior/GetDebouncingOfEvent, operation=EvtInfo_INV_IGBT_TEMP_V_PLAUS.GetDebouncingOfEvent
        OpEventGetDebouncingOfEvent_GetDebouncingOfEvent_EvtInfo_Ga_GAEngageFailure: start-on-event=DemSatellite_0InternalBehavior/GetDebouncingOfEvent, operation=EvtInfo_Ga_GAEngageFailure.GetDebouncingOfEvent
        OpEventGetDebouncingOfEvent_GetDebouncingOfEvent_EvtInfo_INV_IAC_W_RNG_LO: start-on-event=DemSatellite_0InternalBehavior/GetDebouncingOfEvent, operation=EvtInfo_INV_IAC_W_RNG_LO.GetDebouncingOfEvent
        OpEventGetDebouncingOfEvent_GetDebouncingOfEvent_EvtInfo_PS_WhlSnsr_Vltg_FLT: start-on-event=DemSatellite_0InternalBehavior/GetDebouncingOfEvent, operation=EvtInfo_PS_WhlSnsr_Vltg_FLT.GetDebouncingOfEvent
        OpEventGetDebouncingOfEvent_GetDebouncingOfEvent_EvtInfo_VCEvEcmPropFr02Tioutd: start-on-event=DemSatellite_0InternalBehavior/GetDebouncingOfEvent, operation=EvtInfo_VCEvEcmPropFr02Tioutd.GetDebouncingOfEvent
        OpEventGetDebouncingOfEvent_GetDebouncingOfEvent_EvtInfo_Ga_TmSpdSyncFailed: start-on-event=DemSatellite_0InternalBehavior/GetDebouncingOfEvent, operation=EvtInfo_Ga_TmSpdSyncFailed.GetDebouncingOfEvent
        OpEventGetDebouncingOfEvent_GetDebouncingOfEvent_EvtInfo_INV_RSLVR_EXCT_ELEC_LO: start-on-event=DemSatellite_0InternalBehavior/GetDebouncingOfEvent, operation=EvtInfo_INV_RSLVR_EXCT_ELEC_LO.GetDebouncingOfEvent
        OpEventGetDebouncingOfEvent_GetDebouncingOfEvent_EvtInfo_VCEvEcmPropXevFr06Tioutd: start-on-event=DemSatellite_0InternalBehavior/GetDebouncingOfEvent, operation=EvtInfo_VCEvEcmPropXevFr06Tioutd.GetDebouncingOfEvent
        OpEventGetDebouncingOfEvent_GetDebouncingOfEvent_EvtInfo_VcEvCntrWhlMotSysTqAllwd: start-on-event=DemSatellite_0InternalBehavior/GetDebouncingOfEvent, operation=EvtInfo_VcEvCntrWhlMotSysTqAllwd.GetDebouncingOfEvent
        OpEventGetDebouncingOfEvent_GetDebouncingOfEvent_EvtInfo_INV_UHVDC_1_ELEC_HI: start-on-event=DemSatellite_0InternalBehavior/GetDebouncingOfEvent, operation=EvtInfo_INV_UHVDC_1_ELEC_HI.GetDebouncingOfEvent
        OpEventGetDebouncingOfEvent_GetDebouncingOfEvent_EvtInfo_INV_EM_STATOR_TEMP2_ELE_FLT: start-on-event=DemSatellite_0InternalBehavior/GetDebouncingOfEvent, operation=EvtInfo_INV_EM_STATOR_TEMP2_ELE_FLT.GetDebouncingOfEvent
        OpEventGetDebouncingOfEvent_GetDebouncingOfEvent_EvtInfo_AURIX_RST_SNG: start-on-event=DemSatellite_0InternalBehavior/GetDebouncingOfEvent, operation=EvtInfo_AURIX_RST_SNG.GetDebouncingOfEvent
        OpEventGetDebouncingOfEvent_GetDebouncingOfEvent_EvtInfo_VCEvEcmPropFr24MgmFr01Tioutd: start-on-event=DemSatellite_0InternalBehavior/GetDebouncingOfEvent, operation=EvtInfo_VCEvEcmPropFr24MgmFr01Tioutd.GetDebouncingOfEvent
        OpEventGetDebouncingOfEvent_GetDebouncingOfEvent_EvtInfo_INV_RSLVR_COS_ELEC_OPEN: start-on-event=DemSatellite_0InternalBehavior/GetDebouncingOfEvent, operation=EvtInfo_INV_RSLVR_COS_ELEC_OPEN.GetDebouncingOfEvent
        OpEventGetDebouncingOfEvent_GetDebouncingOfEvent_EvtInfo_INV_IAC_V_ELEC_LO: start-on-event=DemSatellite_0InternalBehavior/GetDebouncingOfEvent, operation=EvtInfo_INV_IAC_V_ELEC_LO.GetDebouncingOfEvent
        OpEventGetDebouncingOfEvent_GetDebouncingOfEvent_EvtInfo_INV_IAC_W_OFFS: start-on-event=DemSatellite_0InternalBehavior/GetDebouncingOfEvent, operation=EvtInfo_INV_IAC_W_OFFS.GetDebouncingOfEvent
        OpEventGetDebouncingOfEvent_GetDebouncingOfEvent_EvtInfo_INV_EM_STATOR_TEMP2_GRDT: start-on-event=DemSatellite_0InternalBehavior/GetDebouncingOfEvent, operation=EvtInfo_INV_EM_STATOR_TEMP2_GRDT.GetDebouncingOfEvent
        OpEventGetDebouncingOfEvent_GetDebouncingOfEvent_EvtInfo_INV_EM_OVRSPD_HWP: start-on-event=DemSatellite_0InternalBehavior/GetDebouncingOfEvent, operation=EvtInfo_INV_EM_OVRSPD_HWP.GetDebouncingOfEvent
        OpEventGetDebouncingOfEvent_GetDebouncingOfEvent_EvtInfo_CU_TEMP_HWP: start-on-event=DemSatellite_0InternalBehavior/GetDebouncingOfEvent, operation=EvtInfo_CU_TEMP_HWP.GetDebouncingOfEvent
        OpEventGetDebouncingOfEvent_GetDebouncingOfEvent_EvtInfo_INV_UHVDC_1_RNG_HI: start-on-event=DemSatellite_0InternalBehavior/GetDebouncingOfEvent, operation=EvtInfo_INV_UHVDC_1_RNG_HI.GetDebouncingOfEvent
        OpEventGetDebouncingOfEvent_GetDebouncingOfEvent_EvtInfo_VcEvEMPerfPlaus: start-on-event=DemSatellite_0InternalBehavior/GetDebouncingOfEvent, operation=EvtInfo_VcEvEMPerfPlaus.GetDebouncingOfEvent
        OpEventGetDebouncingOfEvent_GetDebouncingOfEvent_EvtInfo_VCEvVddmPropFr18Tioutd: start-on-event=DemSatellite_0InternalBehavior/GetDebouncingOfEvent, operation=EvtInfo_VCEvVddmPropFr18Tioutd.GetDebouncingOfEvent
        OpEventGetDebouncingOfEvent_GetDebouncingOfEvent_EvtInfo_INV_IAC_U_ELEC_HWP: start-on-event=DemSatellite_0InternalBehavior/GetDebouncingOfEvent, operation=EvtInfo_INV_IAC_U_ELEC_HWP.GetDebouncingOfEvent
        OpEventGetDebouncingOfEvent_GetDebouncingOfEvent_EvtInfo_VCEvVddmPropFr15Tioutd: start-on-event=DemSatellite_0InternalBehavior/GetDebouncingOfEvent, operation=EvtInfo_VCEvVddmPropFr15Tioutd.GetDebouncingOfEvent
        OpEventGetDebouncingOfEvent_GetDebouncingOfEvent_EvtInfo_Ga_GADisengageFailure: start-on-event=DemSatellite_0InternalBehavior/GetDebouncingOfEvent, operation=EvtInfo_Ga_GADisengageFailure.GetDebouncingOfEvent
        OpEventGetDebouncingOfEvent_GetDebouncingOfEvent_EvtInfo_CU_TEMP2_RNG_LO: start-on-event=DemSatellite_0InternalBehavior/GetDebouncingOfEvent, operation=EvtInfo_CU_TEMP2_RNG_LO.GetDebouncingOfEvent
        OpEventGetDebouncingOfEvent_GetDebouncingOfEvent_EvtInfo_INV_RSLVR_SIN_ELEC_OPEN: start-on-event=DemSatellite_0InternalBehavior/GetDebouncingOfEvent, operation=EvtInfo_INV_RSLVR_SIN_ELEC_OPEN.GetDebouncingOfEvent
        OpEventGetDebouncingOfEvent_GetDebouncingOfEvent_EvtInfo_VcEvChkSum: start-on-event=DemSatellite_0InternalBehavior/GetDebouncingOfEvent, operation=EvtInfo_VcEvChkSum.GetDebouncingOfEvent
        OpEventGetDebouncingOfEvent_GetDebouncingOfEvent_EvtInfo_PS_P5_UC_FLT: start-on-event=DemSatellite_0InternalBehavior/GetDebouncingOfEvent, operation=EvtInfo_PS_P5_UC_FLT.GetDebouncingOfEvent
        OpEventGetDebouncingOfEvent_GetDebouncingOfEvent_EvtInfo_INV_RSLVR_COS_ELEC_FLT: start-on-event=DemSatellite_0InternalBehavior/GetDebouncingOfEvent, operation=EvtInfo_INV_RSLVR_COS_ELEC_FLT.GetDebouncingOfEvent
        OpEventGetDebouncingOfEvent_GetDebouncingOfEvent_EvtInfo_INV_IAC_W_RNG_HI: start-on-event=DemSatellite_0InternalBehavior/GetDebouncingOfEvent, operation=EvtInfo_INV_IAC_W_RNG_HI.GetDebouncingOfEvent
        OpEventGetDebouncingOfEvent_GetDebouncingOfEvent_EvtInfo_PS_ECUSUPPLY_HIGH: start-on-event=DemSatellite_0InternalBehavior/GetDebouncingOfEvent, operation=EvtInfo_PS_ECUSUPPLY_HIGH.GetDebouncingOfEvent
        OpEventGetDebouncingOfEvent_GetDebouncingOfEvent_EvtInfo_VCEvEcmPropFr05Tioutd: start-on-event=DemSatellite_0InternalBehavior/GetDebouncingOfEvent, operation=EvtInfo_VCEvEcmPropFr05Tioutd.GetDebouncingOfEvent
        OpEventGetDebouncingOfEvent_GetDebouncingOfEvent_EvtInfo_PS_ECUSUPPLY_LOW: start-on-event=DemSatellite_0InternalBehavior/GetDebouncingOfEvent, operation=EvtInfo_PS_ECUSUPPLY_LOW.GetDebouncingOfEvent
        OpEventGetDebouncingOfEvent_GetDebouncingOfEvent_EvtInfo_VcEvChkSumHvSysRlySts: start-on-event=DemSatellite_0InternalBehavior/GetDebouncingOfEvent, operation=EvtInfo_VcEvChkSumHvSysRlySts.GetDebouncingOfEvent
        OpEventGetDebouncingOfEvent_GetDebouncingOfEvent_EvtInfo_VcEvMonMode: start-on-event=DemSatellite_0InternalBehavior/GetDebouncingOfEvent, operation=EvtInfo_VcEvMonMode.GetDebouncingOfEvent
        OpEventGetDebouncingOfEvent_GetDebouncingOfEvent_EvtInfo_INV_IAC_OC_SWP: start-on-event=DemSatellite_0InternalBehavior/GetDebouncingOfEvent, operation=EvtInfo_INV_IAC_OC_SWP.GetDebouncingOfEvent
        OpEventGetDebouncingOfEvent_GetDebouncingOfEvent_EvtInfo_INV_IMMO_AUTHFAIL: start-on-event=DemSatellite_0InternalBehavior/GetDebouncingOfEvent, operation=EvtInfo_INV_IMMO_AUTHFAIL.GetDebouncingOfEvent
        OpEventGetDebouncingOfEvent_GetDebouncingOfEvent_EvtInfo_PA_OpenCirc_FLT: start-on-event=DemSatellite_0InternalBehavior/GetDebouncingOfEvent, operation=EvtInfo_PA_OpenCirc_FLT.GetDebouncingOfEvent
        OpEventGetDebouncingOfEvent_GetDebouncingOfEvent_EvtInfo_INV_IAC_V_ELEC_HI: start-on-event=DemSatellite_0InternalBehavior/GetDebouncingOfEvent, operation=EvtInfo_INV_IAC_V_ELEC_HI.GetDebouncingOfEvent
        OpEventGetDebouncingOfEvent_GetDebouncingOfEvent_EvtInfo_VCEvEcmPropFr04Tioutd: start-on-event=DemSatellite_0InternalBehavior/GetDebouncingOfEvent, operation=EvtInfo_VCEvEcmPropFr04Tioutd.GetDebouncingOfEvent
        OpEventGetDebouncingOfEvent_GetDebouncingOfEvent_EvtInfo_VcEvMonTrqActPlaus: start-on-event=DemSatellite_0InternalBehavior/GetDebouncingOfEvent, operation=EvtInfo_VcEvMonTrqActPlaus.GetDebouncingOfEvent
        OpEventGetDebouncingOfEvent_GetDebouncingOfEvent_EvtInfo_VcEvMonTrqAct: start-on-event=DemSatellite_0InternalBehavior/GetDebouncingOfEvent, operation=EvtInfo_VcEvMonTrqAct.GetDebouncingOfEvent
        OpEventGetDebouncingOfEvent_GetDebouncingOfEvent_EvtInfo_INV_RSLVR_COS_ELEC_LO: start-on-event=DemSatellite_0InternalBehavior/GetDebouncingOfEvent, operation=EvtInfo_INV_RSLVR_COS_ELEC_LO.GetDebouncingOfEvent
        OpEventGetDebouncingOfEvent_GetDebouncingOfEvent_EvtInfo_INV_COOLT_INLET_TEMP_HWP: start-on-event=DemSatellite_0InternalBehavior/GetDebouncingOfEvent, operation=EvtInfo_INV_COOLT_INLET_TEMP_HWP.GetDebouncingOfEvent
        OpEventGetDebouncingOfEvent_GetDebouncingOfEvent_EvtInfo_VCEvEcmPropFr11Tioutd: start-on-event=DemSatellite_0InternalBehavior/GetDebouncingOfEvent, operation=EvtInfo_VCEvEcmPropFr11Tioutd.GetDebouncingOfEvent
        OpEventGetDebouncingOfEvent_GetDebouncingOfEvent_EvtInfo_PS_KL30_RNG_HI: start-on-event=DemSatellite_0InternalBehavior/GetDebouncingOfEvent, operation=EvtInfo_PS_KL30_RNG_HI.GetDebouncingOfEvent
        OpEventGetDebouncingOfEvent_GetDebouncingOfEvent_EvtInfo_INV_IAC_OC_HWP: start-on-event=DemSatellite_0InternalBehavior/GetDebouncingOfEvent, operation=EvtInfo_INV_IAC_OC_HWP.GetDebouncingOfEvent
        OpEventGetDebouncingOfEvent_GetDebouncingOfEvent_EvtInfo_INV_RSLVR_COS_RNG_HI: start-on-event=DemSatellite_0InternalBehavior/GetDebouncingOfEvent, operation=EvtInfo_INV_RSLVR_COS_RNG_HI.GetDebouncingOfEvent
        OpEventGetDebouncingOfEvent_GetDebouncingOfEvent_EvtInfo_INV_IAC_U_ELEC_HI: start-on-event=DemSatellite_0InternalBehavior/GetDebouncingOfEvent, operation=EvtInfo_INV_IAC_U_ELEC_HI.GetDebouncingOfEvent
        OpEventGetDebouncingOfEvent_GetDebouncingOfEvent_EvtInfo_INV_IAC_V_RNG_LO: start-on-event=DemSatellite_0InternalBehavior/GetDebouncingOfEvent, operation=EvtInfo_INV_IAC_V_RNG_LO.GetDebouncingOfEvent
        OpEventGetDebouncingOfEvent_GetDebouncingOfEvent_EvtInfo_INV_IAC_U_RNG_HI: start-on-event=DemSatellite_0InternalBehavior/GetDebouncingOfEvent, operation=EvtInfo_INV_IAC_U_RNG_HI.GetDebouncingOfEvent
        OpEventGetDebouncingOfEvent_GetDebouncingOfEvent_EvtInfo_VCEvEcmPropFr25Tioutd: start-on-event=DemSatellite_0InternalBehavior/GetDebouncingOfEvent, operation=EvtInfo_VCEvEcmPropFr25Tioutd.GetDebouncingOfEvent
        OpEventGetDebouncingOfEvent_GetDebouncingOfEvent_EvtInfo_INV_IGBT_TEMP_W_RNG_LO: start-on-event=DemSatellite_0InternalBehavior/GetDebouncingOfEvent, operation=EvtInfo_INV_IGBT_TEMP_W_RNG_LO.GetDebouncingOfEvent
        OpEventGetDebouncingOfEvent_GetDebouncingOfEvent_EvtInfo_PSnsr_RNG_NOK: start-on-event=DemSatellite_0InternalBehavior/GetDebouncingOfEvent, operation=EvtInfo_PSnsr_RNG_NOK.GetDebouncingOfEvent
        OpEventGetDebouncingOfEvent_GetDebouncingOfEvent_EvtInfo_INV_RSLVR_COS_RNG_NOK: start-on-event=DemSatellite_0InternalBehavior/GetDebouncingOfEvent, operation=EvtInfo_INV_RSLVR_COS_RNG_NOK.GetDebouncingOfEvent
        OpEventGetDebouncingOfEvent_GetDebouncingOfEvent_EvtInfo_PS_DRVB_Fault: start-on-event=DemSatellite_0InternalBehavior/GetDebouncingOfEvent, operation=EvtInfo_PS_DRVB_Fault.GetDebouncingOfEvent
        OpEventGetDebouncingOfEvent_GetDebouncingOfEvent_EvtInfo_INV_CU_TEMP1_RNG_NOK: start-on-event=DemSatellite_0InternalBehavior/GetDebouncingOfEvent, operation=EvtInfo_INV_CU_TEMP1_RNG_NOK.GetDebouncingOfEvent
        OpEventGetDebouncingOfEvent_GetDebouncingOfEvent_EvtInfo_VcEvCntr: start-on-event=DemSatellite_0InternalBehavior/GetDebouncingOfEvent, operation=EvtInfo_VcEvCntr.GetDebouncingOfEvent
        OpEventGetDebouncingOfEvent_GetDebouncingOfEvent_EvtInfo_INV_RSLVR_SIN_AMP: start-on-event=DemSatellite_0InternalBehavior/GetDebouncingOfEvent, operation=EvtInfo_INV_RSLVR_SIN_AMP.GetDebouncingOfEvent
        OpEventGetDebouncingOfEvent_GetDebouncingOfEvent_EvtInfo_INV_UHVDC_2_RNG_HI: start-on-event=DemSatellite_0InternalBehavior/GetDebouncingOfEvent, operation=EvtInfo_INV_UHVDC_2_RNG_HI.GetDebouncingOfEvent
        OpEventGetDebouncingOfEvent_GetDebouncingOfEvent_EvtInfo_INV_IGBT_TEMP_U_GRDT: start-on-event=DemSatellite_0InternalBehavior/GetDebouncingOfEvent, operation=EvtInfo_INV_IGBT_TEMP_U_GRDT.GetDebouncingOfEvent
        OpEventGetDebouncingOfEvent_GetDebouncingOfEvent_EvtInfo_MON_TQ_PLAUS_PWR_MDL: start-on-event=DemSatellite_0InternalBehavior/GetDebouncingOfEvent, operation=EvtInfo_MON_TQ_PLAUS_PWR_MDL.GetDebouncingOfEvent
        OpEventGetDebouncingOfEvent_GetDebouncingOfEvent_EvtInfo_INV_IGBT_TEMP_W_PLAUS: start-on-event=DemSatellite_0InternalBehavior/GetDebouncingOfEvent, operation=EvtInfo_INV_IGBT_TEMP_W_PLAUS.GetDebouncingOfEvent
        OpEventGetDebouncingOfEvent_GetDebouncingOfEvent_EvtInfo_PS_BLDC_UV_FLT: start-on-event=DemSatellite_0InternalBehavior/GetDebouncingOfEvent, operation=EvtInfo_PS_BLDC_UV_FLT.GetDebouncingOfEvent
        OpEventGetDebouncingOfEvent_GetDebouncingOfEvent_EvtInfo_INV_IAC_V_OFFS: start-on-event=DemSatellite_0InternalBehavior/GetDebouncingOfEvent, operation=EvtInfo_INV_IAC_V_OFFS.GetDebouncingOfEvent
        OpEventGetDebouncingOfEvent_GetDebouncingOfEvent_EvtInfo_INV_RSLVR_EXCT_FREQ_RNG_NOK: start-on-event=DemSatellite_0InternalBehavior/GetDebouncingOfEvent, operation=EvtInfo_INV_RSLVR_EXCT_FREQ_RNG_NOK.GetDebouncingOfEvent
        OpEventGetDebouncingOfEvent_GetDebouncingOfEvent_EvtInfo_PS_KL30_RNG_LO: start-on-event=DemSatellite_0InternalBehavior/GetDebouncingOfEvent, operation=EvtInfo_PS_KL30_RNG_LO.GetDebouncingOfEvent
        OpEventGetDebouncingOfEvent_GetDebouncingOfEvent_EvtInfo_INV_RSLVR_COS_RNG_LO: start-on-event=DemSatellite_0InternalBehavior/GetDebouncingOfEvent, operation=EvtInfo_INV_RSLVR_COS_RNG_LO.GetDebouncingOfEvent
        OpEventGetDebouncingOfEvent_GetDebouncingOfEvent_EvtInfo_PSnsr_ELE_FLT: start-on-event=DemSatellite_0InternalBehavior/GetDebouncingOfEvent, operation=EvtInfo_PSnsr_ELE_FLT.GetDebouncingOfEvent
        OpEventGetDebouncingOfEvent_GetDebouncingOfEvent_EvtInfo_INV_RSLVR_SIN_COS_PLAUS_AMP: start-on-event=DemSatellite_0InternalBehavior/GetDebouncingOfEvent, operation=EvtInfo_INV_RSLVR_SIN_COS_PLAUS_AMP.GetDebouncingOfEvent
        OpEventGetDebouncingOfEvent_GetDebouncingOfEvent_EvtInfo_INV_IAC_U_ELEC_LO: start-on-event=DemSatellite_0InternalBehavior/GetDebouncingOfEvent, operation=EvtInfo_INV_IAC_U_ELEC_LO.GetDebouncingOfEvent
        OpEventGetDebouncingOfEvent_GetDebouncingOfEvent_EvtInfo_INV_RSLVR_EXCT_ELEC_HI: start-on-event=DemSatellite_0InternalBehavior/GetDebouncingOfEvent, operation=EvtInfo_INV_RSLVR_EXCT_ELEC_HI.GetDebouncingOfEvent
        OpEventGetDebouncingOfEvent_GetDebouncingOfEvent_EvtInfo_INV_IAC_U_RNG_LO: start-on-event=DemSatellite_0InternalBehavior/GetDebouncingOfEvent, operation=EvtInfo_INV_IAC_U_RNG_LO.GetDebouncingOfEvent
        OpEventGetDebouncingOfEvent_GetDebouncingOfEvent_EvtInfo_INV_IAC_V_RNG_HI: start-on-event=DemSatellite_0InternalBehavior/GetDebouncingOfEvent, operation=EvtInfo_INV_IAC_V_RNG_HI.GetDebouncingOfEvent
        OpEventGetDebouncingOfEvent_GetDebouncingOfEvent_EvtInfo_INV_IGBT_TEMP_U_PLAUS: start-on-event=DemSatellite_0InternalBehavior/GetDebouncingOfEvent, operation=EvtInfo_INV_IGBT_TEMP_U_PLAUS.GetDebouncingOfEvent
        OpEventGetDebouncingOfEvent_GetDebouncingOfEvent_EvtInfo_INV_RSLVR_OFFS_DFT: start-on-event=DemSatellite_0InternalBehavior/GetDebouncingOfEvent, operation=EvtInfo_INV_RSLVR_OFFS_DFT.GetDebouncingOfEvent
        OpEventGetDebouncingOfEvent_GetDebouncingOfEvent_EvtInfo_Ga_MoveOverThd: start-on-event=DemSatellite_0InternalBehavior/GetDebouncingOfEvent, operation=EvtInfo_Ga_MoveOverThd.GetDebouncingOfEvent
        OpEventGetDebouncingOfEvent_GetDebouncingOfEvent_EvtInfo_VcEvMonIPH: start-on-event=DemSatellite_0InternalBehavior/GetDebouncingOfEvent, operation=EvtInfo_VcEvMonIPH.GetDebouncingOfEvent
        OpEventGetDebouncingOfEvent_GetDebouncingOfEvent_EvtInfo_INV_RSLVR_HW_FLT: start-on-event=DemSatellite_0InternalBehavior/GetDebouncingOfEvent, operation=EvtInfo_INV_RSLVR_HW_FLT.GetDebouncingOfEvent
        OpEventGetDebouncingOfEvent_GetDebouncingOfEvent_EvtInfo_INV_RSLVR_SIN_ELEC_LO: start-on-event=DemSatellite_0InternalBehavior/GetDebouncingOfEvent, operation=EvtInfo_INV_RSLVR_SIN_ELEC_LO.GetDebouncingOfEvent
        OpEventGetDebouncingOfEvent_GetDebouncingOfEvent_EvtInfo_INV_IAC_W_AMP: start-on-event=DemSatellite_0InternalBehavior/GetDebouncingOfEvent, operation=EvtInfo_INV_IAC_W_AMP.GetDebouncingOfEvent
        OpEventGetDebouncingOfEvent_GetDebouncingOfEvent_EvtInfo_VCC_OverVoltage: start-on-event=DemSatellite_0InternalBehavior/GetDebouncingOfEvent, operation=EvtInfo_VCC_OverVoltage.GetDebouncingOfEvent
        OpEventGetDebouncingOfEvent_GetDebouncingOfEvent_EvtInfo_PS_BLDC_OV_FLT: start-on-event=DemSatellite_0InternalBehavior/GetDebouncingOfEvent, operation=EvtInfo_PS_BLDC_OV_FLT.GetDebouncingOfEvent
        OpEventGetDebouncingOfEvent_GetDebouncingOfEvent_EvtInfo_AURIX_EEPROM_FLT: start-on-event=DemSatellite_0InternalBehavior/GetDebouncingOfEvent, operation=EvtInfo_AURIX_EEPROM_FLT.GetDebouncingOfEvent
        OpEventGetDebouncingOfEvent_GetDebouncingOfEvent_EvtInfo_FS_MONITIOR_ASC_FW_FLT: start-on-event=DemSatellite_0InternalBehavior/GetDebouncingOfEvent, operation=EvtInfo_FS_MONITIOR_ASC_FW_FLT.GetDebouncingOfEvent
        OpEventGetDebouncingOfEvent_GetDebouncingOfEvent_EvtInfo_VCEvSrsPropFr02Tioutd: start-on-event=DemSatellite_0InternalBehavior/GetDebouncingOfEvent, operation=EvtInfo_VCEvSrsPropFr02Tioutd.GetDebouncingOfEvent
        OpEventGetDebouncingOfEvent_GetDebouncingOfEvent_EvtInfo_VcEvMonErrMode: start-on-event=DemSatellite_0InternalBehavior/GetDebouncingOfEvent, operation=EvtInfo_VcEvMonErrMode.GetDebouncingOfEvent
        OpEventGetDebouncingOfEvent_GetDebouncingOfEvent_EvtInfo_AURIX_RST_MPL: start-on-event=DemSatellite_0InternalBehavior/GetDebouncingOfEvent, operation=EvtInfo_AURIX_RST_MPL.GetDebouncingOfEvent
        OpEventGetDebouncingOfEvent_GetDebouncingOfEvent_EvtInfo_VcEvNodeMisECM: start-on-event=DemSatellite_0InternalBehavior/GetDebouncingOfEvent, operation=EvtInfo_VcEvNodeMisECM.GetDebouncingOfEvent
        OpEventGetDebouncingOfEvent_GetDebouncingOfEvent_EvtInfo_PS_KL30_PLAUS: start-on-event=DemSatellite_0InternalBehavior/GetDebouncingOfEvent, operation=EvtInfo_PS_KL30_PLAUS.GetDebouncingOfEvent
        OpEventGetDebouncingOfEvent_GetDebouncingOfEvent_EvtInfo_INV_IAC_W_ELEC_HI: start-on-event=DemSatellite_0InternalBehavior/GetDebouncingOfEvent, operation=EvtInfo_INV_IAC_W_ELEC_HI.GetDebouncingOfEvent
        OpEventGetDebouncingOfEvent_GetDebouncingOfEvent_EvtInfo_VCEvVddmPropFr19Tioutd: start-on-event=DemSatellite_0InternalBehavior/GetDebouncingOfEvent, operation=EvtInfo_VCEvVddmPropFr19Tioutd.GetDebouncingOfEvent
        OpEventGetDebouncingOfEvent_GetDebouncingOfEvent_EvtInfo_INV_TEMP_DCHA_HW: start-on-event=DemSatellite_0InternalBehavior/GetDebouncingOfEvent, operation=EvtInfo_INV_TEMP_DCHA_HW.GetDebouncingOfEvent
        OpEventGetDebouncingOfEvent_GetDebouncingOfEvent_EvtInfo_VcEvPropCANGlbTiOutd: start-on-event=DemSatellite_0InternalBehavior/GetDebouncingOfEvent, operation=EvtInfo_VcEvPropCANGlbTiOutd.GetDebouncingOfEvent
        OpEventGetDebouncingOfEvent_GetDebouncingOfEvent_EvtInfo_INV_EM_STATOR_TEMP2_RNG_NOK: start-on-event=DemSatellite_0InternalBehavior/GetDebouncingOfEvent, operation=EvtInfo_INV_EM_STATOR_TEMP2_RNG_NOK.GetDebouncingOfEvent
        OpEventGetDebouncingOfEvent_GetDebouncingOfEvent_EvtInfo_INV_UHVDC_OV_HWP: start-on-event=DemSatellite_0InternalBehavior/GetDebouncingOfEvent, operation=EvtInfo_INV_UHVDC_OV_HWP.GetDebouncingOfEvent
        OpEventGetDebouncingOfEvent_GetDebouncingOfEvent_EvtInfo_Ga_FindEngleAngleFailed: start-on-event=DemSatellite_0InternalBehavior/GetDebouncingOfEvent, operation=EvtInfo_Ga_FindEngleAngleFailed.GetDebouncingOfEvent
        OpEventGetDebouncingOfEvent_GetDebouncingOfEvent_EvtInfo_VcEvMonTrqCmp: start-on-event=DemSatellite_0InternalBehavior/GetDebouncingOfEvent, operation=EvtInfo_VcEvMonTrqCmp.GetDebouncingOfEvent
        OpEventGetDebouncingOfEvent_GetDebouncingOfEvent_EvtInfo_INV_IGBT_TEMP_V_RNG_LO: start-on-event=DemSatellite_0InternalBehavior/GetDebouncingOfEvent, operation=EvtInfo_INV_IGBT_TEMP_V_RNG_LO.GetDebouncingOfEvent
        OpEventGetDebouncingOfEvent_GetDebouncingOfEvent_EvtInfo_INV_CONTROL_LIMIT: start-on-event=DemSatellite_0InternalBehavior/GetDebouncingOfEvent, operation=EvtInfo_INV_CONTROL_LIMIT.GetDebouncingOfEvent
        OpEventGetDebouncingOfEvent_GetDebouncingOfEvent_EvtInfo_COM_CarConfigErr: start-on-event=DemSatellite_0InternalBehavior/GetDebouncingOfEvent, operation=EvtInfo_COM_CarConfigErr.GetDebouncingOfEvent
        OpEventGetDebouncingOfEvent_GetDebouncingOfEvent_EvtInfo_VCEvEcmPropFr08Tioutd: start-on-event=DemSatellite_0InternalBehavior/GetDebouncingOfEvent, operation=EvtInfo_VCEvEcmPropFr08Tioutd.GetDebouncingOfEvent
        OpEventGetDebouncingOfEvent_GetDebouncingOfEvent_EvtInfo_CU_TEMP1_RNG_LO: start-on-event=DemSatellite_0InternalBehavior/GetDebouncingOfEvent, operation=EvtInfo_CU_TEMP1_RNG_LO.GetDebouncingOfEvent
        OpEventGetDebouncingOfEvent_GetDebouncingOfEvent_EvtInfo_INV_EM_STATOR_TEMP2_RNG_SWT: start-on-event=DemSatellite_0InternalBehavior/GetDebouncingOfEvent, operation=EvtInfo_INV_EM_STATOR_TEMP2_RNG_SWT.GetDebouncingOfEvent
        OpEventGetDebouncingOfEvent_GetDebouncingOfEvent_EvtInfo_GA_BLDC_POS_FLT: start-on-event=DemSatellite_0InternalBehavior/GetDebouncingOfEvent, operation=EvtInfo_GA_BLDC_POS_FLT.GetDebouncingOfEvent
        OpEventGetDebouncingOfEvent_GetDebouncingOfEvent_EvtInfo_PS_WhlSnsr_FLT: start-on-event=DemSatellite_0InternalBehavior/GetDebouncingOfEvent, operation=EvtInfo_PS_WhlSnsr_FLT.GetDebouncingOfEvent
        OpEventGetDebouncingOfEvent_GetDebouncingOfEvent_EvtInfo_INV_EM_STATOR_TEMP_RNG_LO: start-on-event=DemSatellite_0InternalBehavior/GetDebouncingOfEvent, operation=EvtInfo_INV_EM_STATOR_TEMP_RNG_LO.GetDebouncingOfEvent
        OpEventGetDebouncingOfEvent_GetDebouncingOfEvent_EvtInfo_INV_RSLVR_SIN_ELEC_HI: start-on-event=DemSatellite_0InternalBehavior/GetDebouncingOfEvent, operation=EvtInfo_INV_RSLVR_SIN_ELEC_HI.GetDebouncingOfEvent
        OpEventGetDebouncingOfEvent_GetDebouncingOfEvent_EvtInfo_INV_RSLVR_SIN_COS_PLAUS: start-on-event=DemSatellite_0InternalBehavior/GetDebouncingOfEvent, operation=EvtInfo_INV_RSLVR_SIN_COS_PLAUS.GetDebouncingOfEvent
        OpEventGetDebouncingOfEvent_GetDebouncingOfEvent_EvtInfo_INV_RSLVR_COS_AMP: start-on-event=DemSatellite_0InternalBehavior/GetDebouncingOfEvent, operation=EvtInfo_INV_RSLVR_COS_AMP.GetDebouncingOfEvent
        OpEventGetDebouncingOfEvent_GetDebouncingOfEvent_EvtInfo_INV_GATE_DRVR_BOT_HWP: start-on-event=DemSatellite_0InternalBehavior/GetDebouncingOfEvent, operation=EvtInfo_INV_GATE_DRVR_BOT_HWP.GetDebouncingOfEvent
        OpEventGetDebouncingOfEvent_GetDebouncingOfEvent_EvtInfo_Eg_HallVolWrong: start-on-event=DemSatellite_0InternalBehavior/GetDebouncingOfEvent, operation=EvtInfo_Eg_HallVolWrong.GetDebouncingOfEvent
        OpEventGetDebouncingOfEvent_GetDebouncingOfEvent_EvtInfo_INV_RSLVR_EXCT_RNG_NOK: start-on-event=DemSatellite_0InternalBehavior/GetDebouncingOfEvent, operation=EvtInfo_INV_RSLVR_EXCT_RNG_NOK.GetDebouncingOfEvent
        OpEventGetDebouncingOfEvent_GetDebouncingOfEvent_EvtInfo_PA_OpenCirc: start-on-event=DemSatellite_0InternalBehavior/GetDebouncingOfEvent, operation=EvtInfo_PA_OpenCirc.GetDebouncingOfEvent
        OpEventGetDebouncingOfEvent_GetDebouncingOfEvent_EvtInfo_INV_RSLVR_COS_ELEC_HI: start-on-event=DemSatellite_0InternalBehavior/GetDebouncingOfEvent, operation=EvtInfo_INV_RSLVR_COS_ELEC_HI.GetDebouncingOfEvent
        OpEventGetDebouncingOfEvent_GetDebouncingOfEvent_EvtInfo_VcEvCntrHvSysRlySts: start-on-event=DemSatellite_0InternalBehavior/GetDebouncingOfEvent, operation=EvtInfo_VcEvCntrHvSysRlySts.GetDebouncingOfEvent
        OpEventGetDebouncingOfEvent_GetDebouncingOfEvent_EvtInfo_CRASH_DTC: start-on-event=DemSatellite_0InternalBehavior/GetDebouncingOfEvent, operation=EvtInfo_CRASH_DTC.GetDebouncingOfEvent
        OpEventGetDebouncingOfEvent_GetDebouncingOfEvent_EvtInfo_INV_IGBT_TEMP_W_RNG_HI: start-on-event=DemSatellite_0InternalBehavior/GetDebouncingOfEvent, operation=EvtInfo_INV_IGBT_TEMP_W_RNG_HI.GetDebouncingOfEvent
        OpEventGetDebouncingOfEvent_GetDebouncingOfEvent_EvtInfo_VCEvBecmPropFr02Tioutd: start-on-event=DemSatellite_0InternalBehavior/GetDebouncingOfEvent, operation=EvtInfo_VCEvBecmPropFr02Tioutd.GetDebouncingOfEvent
        OpEventGetDebouncingOfEvent_GetDebouncingOfEvent_EvtInfo_INV_IGBT_TEMP_W_GRDT: start-on-event=DemSatellite_0InternalBehavior/GetDebouncingOfEvent, operation=EvtInfo_INV_IGBT_TEMP_W_GRDT.GetDebouncingOfEvent
        OpEventGetDebouncingOfEvent_GetDebouncingOfEvent_EvtInfo_EXT_UC_SPI_FLT: start-on-event=DemSatellite_0InternalBehavior/GetDebouncingOfEvent, operation=EvtInfo_EXT_UC_SPI_FLT.GetDebouncingOfEvent
        OpEventGetDebouncingOfEvent_GetDebouncingOfEvent_EvtInfo_INV_IAC_V_ELEC_HWP_001: start-on-event=DemSatellite_0InternalBehavior/GetDebouncingOfEvent, operation=EvtInfo_INV_IAC_V_ELEC_HWP_001.GetDebouncingOfEvent
        OpEventGetDebouncingOfEvent_GetDebouncingOfEvent_EvtInfo_VcEvChkSumWhlMotSysTqAllwd: start-on-event=DemSatellite_0InternalBehavior/GetDebouncingOfEvent, operation=EvtInfo_VcEvChkSumWhlMotSysTqAllwd.GetDebouncingOfEvent
        OpEventGetDebouncingOfEvent_GetDebouncingOfEvent_EvtInfo_FS_MONITIOR_ASC_FLT: start-on-event=DemSatellite_0InternalBehavior/GetDebouncingOfEvent, operation=EvtInfo_FS_MONITIOR_ASC_FLT.GetDebouncingOfEvent
        OpEventGetDebouncingOfEvent_GetDebouncingOfEvent_EvtInfo_INV_IAC_V_AMP: start-on-event=DemSatellite_0InternalBehavior/GetDebouncingOfEvent, operation=EvtInfo_INV_IAC_V_AMP.GetDebouncingOfEvent
        OpEventGetDebouncingOfEvent_GetDebouncingOfEvent_EvtInfo_INV_IAC_W_ELEC_LO: start-on-event=DemSatellite_0InternalBehavior/GetDebouncingOfEvent, operation=EvtInfo_INV_IAC_W_ELEC_LO.GetDebouncingOfEvent
        OpEventGetDebouncingOfEvent_GetDebouncingOfEvent_EvtInfo_VCEvVddmPropFr08Tioutd_001: start-on-event=DemSatellite_0InternalBehavior/GetDebouncingOfEvent, operation=EvtInfo_VCEvVddmPropFr08Tioutd_001.GetDebouncingOfEvent
        OpEventGetDebouncingOfEvent_GetDebouncingOfEvent_EvtInfo_PS_P12_RES_FLT: start-on-event=DemSatellite_0InternalBehavior/GetDebouncingOfEvent, operation=EvtInfo_PS_P12_RES_FLT.GetDebouncingOfEvent
        OpEventGetDebouncingOfEvent_GetDebouncingOfEvent_EvtInfo_INV_RSLVR_SIN_RNG_LO: start-on-event=DemSatellite_0InternalBehavior/GetDebouncingOfEvent, operation=EvtInfo_INV_RSLVR_SIN_RNG_LO.GetDebouncingOfEvent
        OpEventGetDebouncingOfEvent_GetDebouncingOfEvent_EvtInfo_CU_TEMP_HW_FLT: start-on-event=DemSatellite_0InternalBehavior/GetDebouncingOfEvent, operation=EvtInfo_CU_TEMP_HW_FLT.GetDebouncingOfEvent
        OpEventGetDebouncingOfEvent_GetDebouncingOfEvent_EvtInfo_VCEvEcmPropFr02MgmFr00Tioutd: start-on-event=DemSatellite_0InternalBehavior/GetDebouncingOfEvent, operation=EvtInfo_VCEvEcmPropFr02MgmFr00Tioutd.GetDebouncingOfEvent
        OpEventGetDebouncingOfEvent_GetDebouncingOfEvent_EvtInfo_PS_KL15_RNG_HI: start-on-event=DemSatellite_0InternalBehavior/GetDebouncingOfEvent, operation=EvtInfo_PS_KL15_RNG_HI.GetDebouncingOfEvent
        OpEventGetDebouncingOfEvent_GetDebouncingOfEvent_EvtInfo_VCEvVddmPropFr17Tioutd: start-on-event=DemSatellite_0InternalBehavior/GetDebouncingOfEvent, operation=EvtInfo_VCEvVddmPropFr17Tioutd.GetDebouncingOfEvent
        OpEventGetDebouncingOfEvent_GetDebouncingOfEvent_EvtInfo_VcEvChkSumCrashStsSafe: start-on-event=DemSatellite_0InternalBehavior/GetDebouncingOfEvent, operation=EvtInfo_VcEvChkSumCrashStsSafe.GetDebouncingOfEvent
        OpEventGetDebouncingOfEvent_GetDebouncingOfEvent_EvtInfo_DiagC_ClutchService: start-on-event=DemSatellite_0InternalBehavior/GetDebouncingOfEvent, operation=EvtInfo_DiagC_ClutchService.GetDebouncingOfEvent
        OpEventGetDebouncingOfEvent_GetDebouncingOfEvent_EvtInfo_INV_EM_STATOR_TEMP_RNG_HI: start-on-event=DemSatellite_0InternalBehavior/GetDebouncingOfEvent, operation=EvtInfo_INV_EM_STATOR_TEMP_RNG_HI.GetDebouncingOfEvent
        OpEventGetDebouncingOfEvent_GetDebouncingOfEvent_EvtInfo_INV_RSLVR_OFFS_OUT_RANG: start-on-event=DemSatellite_0InternalBehavior/GetDebouncingOfEvent, operation=EvtInfo_INV_RSLVR_OFFS_OUT_RANG.GetDebouncingOfEvent
        OpEventGetDebouncingOfEvent_GetDebouncingOfEvent_EvtInfo_INV_EM_STATOR_TEMP2_RNG_LO: start-on-event=DemSatellite_0InternalBehavior/GetDebouncingOfEvent, operation=EvtInfo_INV_EM_STATOR_TEMP2_RNG_LO.GetDebouncingOfEvent
        OpEventGetDebouncingOfEvent_GetDebouncingOfEvent_EvtInfo_VcEvMonISAR: start-on-event=DemSatellite_0InternalBehavior/GetDebouncingOfEvent, operation=EvtInfo_VcEvMonISAR.GetDebouncingOfEvent
        OpEventGetDebouncingOfEvent_GetDebouncingOfEvent_EvtInfo_GA_BLDC_FLT: start-on-event=DemSatellite_0InternalBehavior/GetDebouncingOfEvent, operation=EvtInfo_GA_BLDC_FLT.GetDebouncingOfEvent
        OpEventGetDebouncingOfEvent_GetDebouncingOfEvent_EvtInfo_INV_RSLVR_EXCT_ELEC_OPEN: start-on-event=DemSatellite_0InternalBehavior/GetDebouncingOfEvent, operation=EvtInfo_INV_RSLVR_EXCT_ELEC_OPEN.GetDebouncingOfEvent
        OpEventGetDebouncingOfEvent_GetDebouncingOfEvent_EvtInfo_INV_RSLVR_EXCT_PLAUS: start-on-event=DemSatellite_0InternalBehavior/GetDebouncingOfEvent, operation=EvtInfo_INV_RSLVR_EXCT_PLAUS.GetDebouncingOfEvent
        OpEventGetDebouncingOfEvent_GetDebouncingOfEvent_EvtInfo_PS_P15_U_FLT: start-on-event=DemSatellite_0InternalBehavior/GetDebouncingOfEvent, operation=EvtInfo_PS_P15_U_FLT.GetDebouncingOfEvent
        OpEventGetDebouncingOfEvent_GetDebouncingOfEvent_EvtInfo_INV_EM_STATOR_TEMP_RNG_SWT: start-on-event=DemSatellite_0InternalBehavior/GetDebouncingOfEvent, operation=EvtInfo_INV_EM_STATOR_TEMP_RNG_SWT.GetDebouncingOfEvent
        OpEventGetDebouncingOfEvent_GetDebouncingOfEvent_EvtInfo_INV_UHVDC_OV_SWP: start-on-event=DemSatellite_0InternalBehavior/GetDebouncingOfEvent, operation=EvtInfo_INV_UHVDC_OV_SWP.GetDebouncingOfEvent
        OpEventGetDebouncingOfEvent_GetDebouncingOfEvent_EvtInfo_AURIX_HW_FLT: start-on-event=DemSatellite_0InternalBehavior/GetDebouncingOfEvent, operation=EvtInfo_AURIX_HW_FLT.GetDebouncingOfEvent
        OpEventGetDebouncingOfEvent_GetDebouncingOfEvent_EvtInfo_INV_GATE_DRVR_TOP_HWP: start-on-event=DemSatellite_0InternalBehavior/GetDebouncingOfEvent, operation=EvtInfo_INV_GATE_DRVR_TOP_HWP.GetDebouncingOfEvent
        OpEventGetDebouncingOfEvent_GetDebouncingOfEvent_EvtInfo_INV_ACTV_DCHA_HW: start-on-event=DemSatellite_0InternalBehavior/GetDebouncingOfEvent, operation=EvtInfo_INV_ACTV_DCHA_HW.GetDebouncingOfEvent
        OpEventGetDebouncingOfEvent_GetDebouncingOfEvent_EvtInfo_INV_IGBT_TEMP_HWP: start-on-event=DemSatellite_0InternalBehavior/GetDebouncingOfEvent, operation=EvtInfo_INV_IGBT_TEMP_HWP.GetDebouncingOfEvent
        OpEventGetDebouncingOfEvent_GetDebouncingOfEvent_EvtInfo_INV_RSLVR_SIN_ELEC_FLT: start-on-event=DemSatellite_0InternalBehavior/GetDebouncingOfEvent, operation=EvtInfo_INV_RSLVR_SIN_ELEC_FLT.GetDebouncingOfEvent
        OpEventGetDebouncingOfEvent_GetDebouncingOfEvent_EvtInfo_CU_TEMP2_RNG_HI: start-on-event=DemSatellite_0InternalBehavior/GetDebouncingOfEvent, operation=EvtInfo_CU_TEMP2_RNG_HI.GetDebouncingOfEvent
        OpEventGetDebouncingOfEvent_GetDebouncingOfEvent_EvtInfo_INV_IAC_PHA_LOSS_MPL: start-on-event=DemSatellite_0InternalBehavior/GetDebouncingOfEvent, operation=EvtInfo_INV_IAC_PHA_LOSS_MPL.GetDebouncingOfEvent
        OpEventGetDebouncingOfEvent_GetDebouncingOfEvent_EvtInfo_INV_IAC_U_AMP: start-on-event=DemSatellite_0InternalBehavior/GetDebouncingOfEvent, operation=EvtInfo_INV_IAC_U_AMP.GetDebouncingOfEvent
        OpEventGetDebouncingOfEvent_GetDebouncingOfEvent_EvtInfo_PSnsr_GRADT_Flt: start-on-event=DemSatellite_0InternalBehavior/GetDebouncingOfEvent, operation=EvtInfo_PSnsr_GRADT_Flt.GetDebouncingOfEvent
        OpEventGetDebouncingOfEvent_GetDebouncingOfEvent_EvtInfo_AURIX_WATHDOG_FLT: start-on-event=DemSatellite_0InternalBehavior/GetDebouncingOfEvent, operation=EvtInfo_AURIX_WATHDOG_FLT.GetDebouncingOfEvent
        OpEventGetDebouncingOfEvent_GetDebouncingOfEvent_EvtInfo_VcEvNodeMisBECM: start-on-event=DemSatellite_0InternalBehavior/GetDebouncingOfEvent, operation=EvtInfo_VcEvNodeMisBECM.GetDebouncingOfEvent
        OpEventGetDebouncingOfEvent_GetDebouncingOfEvent_EvtInfo_INV_UHVDC_UV_HWP: start-on-event=DemSatellite_0InternalBehavior/GetDebouncingOfEvent, operation=EvtInfo_INV_UHVDC_UV_HWP.GetDebouncingOfEvent
        OpEventGetDebouncingOfEvent_GetDebouncingOfEvent_EvtInfo_VcEvMonESpd: start-on-event=DemSatellite_0InternalBehavior/GetDebouncingOfEvent, operation=EvtInfo_VcEvMonESpd.GetDebouncingOfEvent
        OpEventGetDebouncingOfEvent_GetDebouncingOfEvent_EvtInfo_COM_NotConfig: start-on-event=DemSatellite_0InternalBehavior/GetDebouncingOfEvent, operation=EvtInfo_COM_NotConfig.GetDebouncingOfEvent
        OpEventGetDebouncingOfEvent_GetDebouncingOfEvent_EvtInfo_INV_RSLVR_SIN_RNG_HI: start-on-event=DemSatellite_0InternalBehavior/GetDebouncingOfEvent, operation=EvtInfo_INV_RSLVR_SIN_RNG_HI.GetDebouncingOfEvent
        OpEventGetDebouncingOfEvent_GetDebouncingOfEvent_EvtInfo_INV_IGBT_TEMP_U_RNG_HI: start-on-event=DemSatellite_0InternalBehavior/GetDebouncingOfEvent, operation=EvtInfo_INV_IGBT_TEMP_U_RNG_HI.GetDebouncingOfEvent
        OpEventGetDebouncingOfEvent_GetDebouncingOfEvent_EvtInfo_VcEvMonMode_001: start-on-event=DemSatellite_0InternalBehavior/GetDebouncingOfEvent, operation=EvtInfo_VcEvMonMode_001.GetDebouncingOfEvent
        OpEventGetDebouncingOfEvent_GetDebouncingOfEvent_EvtInfo_PA_ACTION_FLT: start-on-event=DemSatellite_0InternalBehavior/GetDebouncingOfEvent, operation=EvtInfo_PA_ACTION_FLT.GetDebouncingOfEvent
        OpEventGetDebouncingOfEvent_GetDebouncingOfEvent_EvtInfo_INV_IAC_V_ELEC_HWP: start-on-event=DemSatellite_0InternalBehavior/GetDebouncingOfEvent, operation=EvtInfo_INV_IAC_V_ELEC_HWP.GetDebouncingOfEvent
        OpEventGetDebouncingOfEvent_GetDebouncingOfEvent_EvtInfo_CU_TEMP_HW_FLT_001: start-on-event=DemSatellite_0InternalBehavior/GetDebouncingOfEvent, operation=EvtInfo_CU_TEMP_HW_FLT_001.GetDebouncingOfEvent
        OpEventGetDebouncingOfEvent_GetDebouncingOfEvent_EvtInfo_VCC_UnderVoltage: start-on-event=DemSatellite_0InternalBehavior/GetDebouncingOfEvent, operation=EvtInfo_VCC_UnderVoltage.GetDebouncingOfEvent
        OpEventGetDebouncingOfEvent_GetDebouncingOfEvent_EvtInfo_VcEvTsttrPlaus: start-on-event=DemSatellite_0InternalBehavior/GetDebouncingOfEvent, operation=EvtInfo_VcEvTsttrPlaus.GetDebouncingOfEvent
        OpEventGetDebouncingOfEvent_GetDebouncingOfEvent_EvtInfo_INV_RSLVR_EXCT_ELEC_FLT: start-on-event=DemSatellite_0InternalBehavior/GetDebouncingOfEvent, operation=EvtInfo_INV_RSLVR_EXCT_ELEC_FLT.GetDebouncingOfEvent
        OpEventGetDebouncingOfEvent_GetDebouncingOfEvent_EvtInfo_INV_RSLVR_EXCT_RNG_LO: start-on-event=DemSatellite_0InternalBehavior/GetDebouncingOfEvent, operation=EvtInfo_INV_RSLVR_EXCT_RNG_LO.GetDebouncingOfEvent
        OpEventGetDebouncingOfEvent_GetDebouncingOfEvent_EvtInfo_INV_EM_STATOR_TEMP2_RNG_HI: start-on-event=DemSatellite_0InternalBehavior/GetDebouncingOfEvent, operation=EvtInfo_INV_EM_STATOR_TEMP2_RNG_HI.GetDebouncingOfEvent
        OpEventGetDebouncingOfEvent_GetDebouncingOfEvent_EvtInfo_INV_SHUT_OFF_PAH_START_UP: start-on-event=DemSatellite_0InternalBehavior/GetDebouncingOfEvent, operation=EvtInfo_INV_SHUT_OFF_PAH_START_UP.GetDebouncingOfEvent
        OpEventGetDebouncingOfEvent_GetDebouncingOfEvent_EvtInfo_VCEvVddmPropFr08Tioutd: start-on-event=DemSatellite_0InternalBehavior/GetDebouncingOfEvent, operation=EvtInfo_VCEvVddmPropFr08Tioutd.GetDebouncingOfEvent
        OpEventGetDebouncingOfEvent_GetDebouncingOfEvent_EvtInfo_INV_RSLVR_EXCT_OC_HWP_001: start-on-event=DemSatellite_0InternalBehavior/GetDebouncingOfEvent, operation=EvtInfo_INV_RSLVR_EXCT_OC_HWP_001.GetDebouncingOfEvent
        OpEventGetDebouncingOfEvent_GetDebouncingOfEvent_EvtInfo_INV_RSLVR_EXCT_OC_HWP_002: start-on-event=DemSatellite_0InternalBehavior/GetDebouncingOfEvent, operation=EvtInfo_INV_RSLVR_EXCT_OC_HWP_002.GetDebouncingOfEvent
        OpEventGetDebouncingOfEvent_GetDebouncingOfEvent_EvtInfo_INV_EM_STATOR_TEMP_ELE_FLT: start-on-event=DemSatellite_0InternalBehavior/GetDebouncingOfEvent, operation=EvtInfo_INV_EM_STATOR_TEMP_ELE_FLT.GetDebouncingOfEvent
        OpEventGetDebouncingOfEvent_GetDebouncingOfEvent_EvtInfo_INV_INTERLOCK_FLT: start-on-event=DemSatellite_0InternalBehavior/GetDebouncingOfEvent, operation=EvtInfo_INV_INTERLOCK_FLT.GetDebouncingOfEvent
        OpEventGetDebouncingOfEvent_GetDebouncingOfEvent_EvtInfo_Ga_ZeroFindDistanFailure: start-on-event=DemSatellite_0InternalBehavior/GetDebouncingOfEvent, operation=EvtInfo_Ga_ZeroFindDistanFailure.GetDebouncingOfEvent
        OpEventGetDebouncingOfEvent_GetDebouncingOfEvent_EvtInfo_PLOCK_Current_RNG_OUT: start-on-event=DemSatellite_0InternalBehavior/GetDebouncingOfEvent, operation=EvtInfo_PLOCK_Current_RNG_OUT.GetDebouncingOfEvent
        OpEventGetDebouncingOfEvent_GetDebouncingOfEvent_EvtInfo_VCEvVddmPropFr05Tioutd: start-on-event=DemSatellite_0InternalBehavior/GetDebouncingOfEvent, operation=EvtInfo_VCEvVddmPropFr05Tioutd.GetDebouncingOfEvent
        OpEventGetDebouncingOfEvent_GetDebouncingOfEvent_EvtInfo_INV_IGBT_TEMP_V_GRDT: start-on-event=DemSatellite_0InternalBehavior/GetDebouncingOfEvent, operation=EvtInfo_INV_IGBT_TEMP_V_GRDT.GetDebouncingOfEvent
        OpEventGetDebouncingOfEvent_GetDebouncingOfEvent_EvtInfo_PS_5V_Fault: start-on-event=DemSatellite_0InternalBehavior/GetDebouncingOfEvent, operation=EvtInfo_PS_5V_Fault.GetDebouncingOfEvent
        OpEventGetDebouncingOfEvent_GetDebouncingOfEvent_EvtInfo_VcEvCntrCrashStsSafe: start-on-event=DemSatellite_0InternalBehavior/GetDebouncingOfEvent, operation=EvtInfo_VcEvCntrCrashStsSafe.GetDebouncingOfEvent
        OpEventGetDebouncingOfEvent_GetDebouncingOfEvent_EvtInfo_INV_EM_STATOR_TEMP_GRDT: start-on-event=DemSatellite_0InternalBehavior/GetDebouncingOfEvent, operation=EvtInfo_INV_EM_STATOR_TEMP_GRDT.GetDebouncingOfEvent
        OpEventGetDebouncingOfEvent_GetDebouncingOfEvent_EvtInfo_PS_P15_V_FLT: start-on-event=DemSatellite_0InternalBehavior/GetDebouncingOfEvent, operation=EvtInfo_PS_P15_V_FLT.GetDebouncingOfEvent
        OpEventGetDebouncingOfEvent_GetDebouncingOfEvent_EvtInfo_INV_EM_STATOR_TEMP_RNG_NOK: start-on-event=DemSatellite_0InternalBehavior/GetDebouncingOfEvent, operation=EvtInfo_INV_EM_STATOR_TEMP_RNG_NOK.GetDebouncingOfEvent
        OpEventGetDebouncingOfEvent_GetDebouncingOfEvent_EvtInfo_INV_RSLVR_SIN_RNG_NOK: start-on-event=DemSatellite_0InternalBehavior/GetDebouncingOfEvent, operation=EvtInfo_INV_RSLVR_SIN_RNG_NOK.GetDebouncingOfEvent
        OpEventGetDebouncingOfEvent_GetDebouncingOfEvent_EvtInfo_INV_IAC_U_OFFS: start-on-event=DemSatellite_0InternalBehavior/GetDebouncingOfEvent, operation=EvtInfo_INV_IAC_U_OFFS.GetDebouncingOfEvent
        OpEventGetDebouncingOfEvent_GetDebouncingOfEvent_EvtInfo_PS_KL30_BACKUP_FLT: start-on-event=DemSatellite_0InternalBehavior/GetDebouncingOfEvent, operation=EvtInfo_PS_KL30_BACKUP_FLT.GetDebouncingOfEvent
        OpEventGetDebouncingOfEvent_GetDebouncingOfEvent_EvtInfo_INV_IGBT_TEMP_U_RNG_LO: start-on-event=DemSatellite_0InternalBehavior/GetDebouncingOfEvent, operation=EvtInfo_INV_IGBT_TEMP_U_RNG_LO.GetDebouncingOfEvent
        OpEventGetDebouncingOfEvent_GetDebouncingOfEvent_EvtInfo_INV_EM_STATOR_TEMP_HWP: start-on-event=DemSatellite_0InternalBehavior/GetDebouncingOfEvent, operation=EvtInfo_INV_EM_STATOR_TEMP_HWP.GetDebouncingOfEvent
        OpEventGetDebouncingOfEvent_GetDebouncingOfEvent_EvtInfo_CU_TEMP1_RNG_HI: start-on-event=DemSatellite_0InternalBehavior/GetDebouncingOfEvent, operation=EvtInfo_CU_TEMP1_RNG_HI.GetDebouncingOfEvent
        OpEventGetDebouncingOfEvent_GetDebouncingOfEvent_EvtInfo_INV_IGBT_TEMP_V_RNG_HI: start-on-event=DemSatellite_0InternalBehavior/GetDebouncingOfEvent, operation=EvtInfo_INV_IGBT_TEMP_V_RNG_HI.GetDebouncingOfEvent
        OpEventGetDebouncingOfEvent_GetDebouncingOfEvent_EvtInfo_VcEvNodeMisVDDM: start-on-event=DemSatellite_0InternalBehavior/GetDebouncingOfEvent, operation=EvtInfo_VcEvNodeMisVDDM.GetDebouncingOfEvent
        OpEventGetDebouncingOfEvent_GetDebouncingOfEvent_EvtInfo_INV_UHVDC_PLAUS: start-on-event=DemSatellite_0InternalBehavior/GetDebouncingOfEvent, operation=EvtInfo_INV_UHVDC_PLAUS.GetDebouncingOfEvent
        OpEventGetDebouncingOfEvent_GetDebouncingOfEvent_EvtInfo_INV_QUIESCENT_FLT: start-on-event=DemSatellite_0InternalBehavior/GetDebouncingOfEvent, operation=EvtInfo_INV_QUIESCENT_FLT.GetDebouncingOfEvent
        OpEventGetDebouncingOfEvent_GetDebouncingOfEvent_EvtInfo_INV_RSLVR_EXCT_RNG_HI: start-on-event=DemSatellite_0InternalBehavior/GetDebouncingOfEvent, operation=EvtInfo_INV_RSLVR_EXCT_RNG_HI.GetDebouncingOfEvent
        OpEventGetDebouncingOfEvent_GetDebouncingOfEvent_GeneralEvtInfo: start-on-event=DemSatellite_0InternalBehavior/GetDebouncingOfEvent, operation=GeneralEvtInfo.GetDebouncingOfEvent
        OpEventGetMonitorStatus_GetMonitorStatus_EvtInfo_VCEvBecmPropFr01Tioutd: start-on-event=DemSatellite_0InternalBehavior/GetMonitorStatus, operation=EvtInfo_VCEvBecmPropFr01Tioutd.GetMonitorStatus
        OpEventGetMonitorStatus_GetMonitorStatus_EvtInfo_INV_CU_TEMP2_RNG_NOK: start-on-event=DemSatellite_0InternalBehavior/GetMonitorStatus, operation=EvtInfo_INV_CU_TEMP2_RNG_NOK.GetMonitorStatus
        OpEventGetMonitorStatus_GetMonitorStatus_EvtInfo_INV_IMMO_NOKEY: start-on-event=DemSatellite_0InternalBehavior/GetMonitorStatus, operation=EvtInfo_INV_IMMO_NOKEY.GetMonitorStatus
        OpEventGetMonitorStatus_GetMonitorStatus_EvtInfo_INV_RSLVR_EXCT_OC_HWP: start-on-event=DemSatellite_0InternalBehavior/GetMonitorStatus, operation=EvtInfo_INV_RSLVR_EXCT_OC_HWP.GetMonitorStatus
        OpEventGetMonitorStatus_GetMonitorStatus_EvtInfo_PS_P15_W_FLT: start-on-event=DemSatellite_0InternalBehavior/GetMonitorStatus, operation=EvtInfo_PS_P15_W_FLT.GetMonitorStatus
        OpEventGetMonitorStatus_GetMonitorStatus_EvtInfo_INV_IAC_PLAUS_SUM: start-on-event=DemSatellite_0InternalBehavior/GetMonitorStatus, operation=EvtInfo_INV_IAC_PLAUS_SUM.GetMonitorStatus
        OpEventGetMonitorStatus_GetMonitorStatus_EvtInfo_PA_ELE_FLT: start-on-event=DemSatellite_0InternalBehavior/GetMonitorStatus, operation=EvtInfo_PA_ELE_FLT.GetMonitorStatus
        OpEventGetMonitorStatus_GetMonitorStatus_EvtInfo_CU_TEMP_GRDT: start-on-event=DemSatellite_0InternalBehavior/GetMonitorStatus, operation=EvtInfo_CU_TEMP_GRDT.GetMonitorStatus
        OpEventGetMonitorStatus_GetMonitorStatus_EvtInfo_INV_IGBT_TEMP_V_PLAUS: start-on-event=DemSatellite_0InternalBehavior/GetMonitorStatus, operation=EvtInfo_INV_IGBT_TEMP_V_PLAUS.GetMonitorStatus
        OpEventGetMonitorStatus_GetMonitorStatus_EvtInfo_Ga_GAEngageFailure: start-on-event=DemSatellite_0InternalBehavior/GetMonitorStatus, operation=EvtInfo_Ga_GAEngageFailure.GetMonitorStatus
        OpEventGetMonitorStatus_GetMonitorStatus_EvtInfo_INV_IAC_W_RNG_LO: start-on-event=DemSatellite_0InternalBehavior/GetMonitorStatus, operation=EvtInfo_INV_IAC_W_RNG_LO.GetMonitorStatus
        OpEventGetMonitorStatus_GetMonitorStatus_EvtInfo_PS_WhlSnsr_Vltg_FLT: start-on-event=DemSatellite_0InternalBehavior/GetMonitorStatus, operation=EvtInfo_PS_WhlSnsr_Vltg_FLT.GetMonitorStatus
        OpEventGetMonitorStatus_GetMonitorStatus_EvtInfo_VCEvEcmPropFr02Tioutd: start-on-event=DemSatellite_0InternalBehavior/GetMonitorStatus, operation=EvtInfo_VCEvEcmPropFr02Tioutd.GetMonitorStatus
        OpEventGetMonitorStatus_GetMonitorStatus_EvtInfo_Ga_TmSpdSyncFailed: start-on-event=DemSatellite_0InternalBehavior/GetMonitorStatus, operation=EvtInfo_Ga_TmSpdSyncFailed.GetMonitorStatus
        OpEventGetMonitorStatus_GetMonitorStatus_EvtInfo_INV_RSLVR_EXCT_ELEC_LO: start-on-event=DemSatellite_0InternalBehavior/GetMonitorStatus, operation=EvtInfo_INV_RSLVR_EXCT_ELEC_LO.GetMonitorStatus
        OpEventGetMonitorStatus_GetMonitorStatus_EvtInfo_VCEvEcmPropXevFr06Tioutd: start-on-event=DemSatellite_0InternalBehavior/GetMonitorStatus, operation=EvtInfo_VCEvEcmPropXevFr06Tioutd.GetMonitorStatus
        OpEventGetMonitorStatus_GetMonitorStatus_EvtInfo_VcEvCntrWhlMotSysTqAllwd: start-on-event=DemSatellite_0InternalBehavior/GetMonitorStatus, operation=EvtInfo_VcEvCntrWhlMotSysTqAllwd.GetMonitorStatus
        OpEventGetMonitorStatus_GetMonitorStatus_EvtInfo_INV_UHVDC_1_ELEC_HI: start-on-event=DemSatellite_0InternalBehavior/GetMonitorStatus, operation=EvtInfo_INV_UHVDC_1_ELEC_HI.GetMonitorStatus
        OpEventGetMonitorStatus_GetMonitorStatus_EvtInfo_INV_EM_STATOR_TEMP2_ELE_FLT: start-on-event=DemSatellite_0InternalBehavior/GetMonitorStatus, operation=EvtInfo_INV_EM_STATOR_TEMP2_ELE_FLT.GetMonitorStatus
        OpEventGetMonitorStatus_GetMonitorStatus_EvtInfo_AURIX_RST_SNG: start-on-event=DemSatellite_0InternalBehavior/GetMonitorStatus, operation=EvtInfo_AURIX_RST_SNG.GetMonitorStatus
        OpEventGetMonitorStatus_GetMonitorStatus_EvtInfo_VCEvEcmPropFr24MgmFr01Tioutd: start-on-event=DemSatellite_0InternalBehavior/GetMonitorStatus, operation=EvtInfo_VCEvEcmPropFr24MgmFr01Tioutd.GetMonitorStatus
        OpEventGetMonitorStatus_GetMonitorStatus_EvtInfo_INV_RSLVR_COS_ELEC_OPEN: start-on-event=DemSatellite_0InternalBehavior/GetMonitorStatus, operation=EvtInfo_INV_RSLVR_COS_ELEC_OPEN.GetMonitorStatus
        OpEventGetMonitorStatus_GetMonitorStatus_EvtInfo_INV_IAC_V_ELEC_LO: start-on-event=DemSatellite_0InternalBehavior/GetMonitorStatus, operation=EvtInfo_INV_IAC_V_ELEC_LO.GetMonitorStatus
        OpEventGetMonitorStatus_GetMonitorStatus_EvtInfo_INV_IAC_W_OFFS: start-on-event=DemSatellite_0InternalBehavior/GetMonitorStatus, operation=EvtInfo_INV_IAC_W_OFFS.GetMonitorStatus
        OpEventGetMonitorStatus_GetMonitorStatus_EvtInfo_INV_EM_STATOR_TEMP2_GRDT: start-on-event=DemSatellite_0InternalBehavior/GetMonitorStatus, operation=EvtInfo_INV_EM_STATOR_TEMP2_GRDT.GetMonitorStatus
        OpEventGetMonitorStatus_GetMonitorStatus_EvtInfo_INV_EM_OVRSPD_HWP: start-on-event=DemSatellite_0InternalBehavior/GetMonitorStatus, operation=EvtInfo_INV_EM_OVRSPD_HWP.GetMonitorStatus
        OpEventGetMonitorStatus_GetMonitorStatus_EvtInfo_CU_TEMP_HWP: start-on-event=DemSatellite_0InternalBehavior/GetMonitorStatus, operation=EvtInfo_CU_TEMP_HWP.GetMonitorStatus
        OpEventGetMonitorStatus_GetMonitorStatus_EvtInfo_INV_UHVDC_1_RNG_HI: start-on-event=DemSatellite_0InternalBehavior/GetMonitorStatus, operation=EvtInfo_INV_UHVDC_1_RNG_HI.GetMonitorStatus
        OpEventGetMonitorStatus_GetMonitorStatus_EvtInfo_VcEvEMPerfPlaus: start-on-event=DemSatellite_0InternalBehavior/GetMonitorStatus, operation=EvtInfo_VcEvEMPerfPlaus.GetMonitorStatus
        OpEventGetMonitorStatus_GetMonitorStatus_EvtInfo_VCEvVddmPropFr18Tioutd: start-on-event=DemSatellite_0InternalBehavior/GetMonitorStatus, operation=EvtInfo_VCEvVddmPropFr18Tioutd.GetMonitorStatus
        OpEventGetMonitorStatus_GetMonitorStatus_EvtInfo_INV_IAC_U_ELEC_HWP: start-on-event=DemSatellite_0InternalBehavior/GetMonitorStatus, operation=EvtInfo_INV_IAC_U_ELEC_HWP.GetMonitorStatus
        OpEventGetMonitorStatus_GetMonitorStatus_EvtInfo_VCEvVddmPropFr15Tioutd: start-on-event=DemSatellite_0InternalBehavior/GetMonitorStatus, operation=EvtInfo_VCEvVddmPropFr15Tioutd.GetMonitorStatus
        OpEventGetMonitorStatus_GetMonitorStatus_EvtInfo_Ga_GADisengageFailure: start-on-event=DemSatellite_0InternalBehavior/GetMonitorStatus, operation=EvtInfo_Ga_GADisengageFailure.GetMonitorStatus
        OpEventGetMonitorStatus_GetMonitorStatus_EvtInfo_CU_TEMP2_RNG_LO: start-on-event=DemSatellite_0InternalBehavior/GetMonitorStatus, operation=EvtInfo_CU_TEMP2_RNG_LO.GetMonitorStatus
        OpEventGetMonitorStatus_GetMonitorStatus_EvtInfo_INV_RSLVR_SIN_ELEC_OPEN: start-on-event=DemSatellite_0InternalBehavior/GetMonitorStatus, operation=EvtInfo_INV_RSLVR_SIN_ELEC_OPEN.GetMonitorStatus
        OpEventGetMonitorStatus_GetMonitorStatus_EvtInfo_VcEvChkSum: start-on-event=DemSatellite_0InternalBehavior/GetMonitorStatus, operation=EvtInfo_VcEvChkSum.GetMonitorStatus
        OpEventGetMonitorStatus_GetMonitorStatus_EvtInfo_PS_P5_UC_FLT: start-on-event=DemSatellite_0InternalBehavior/GetMonitorStatus, operation=EvtInfo_PS_P5_UC_FLT.GetMonitorStatus
        OpEventGetMonitorStatus_GetMonitorStatus_EvtInfo_INV_RSLVR_COS_ELEC_FLT: start-on-event=DemSatellite_0InternalBehavior/GetMonitorStatus, operation=EvtInfo_INV_RSLVR_COS_ELEC_FLT.GetMonitorStatus
        OpEventGetMonitorStatus_GetMonitorStatus_EvtInfo_INV_IAC_W_RNG_HI: start-on-event=DemSatellite_0InternalBehavior/GetMonitorStatus, operation=EvtInfo_INV_IAC_W_RNG_HI.GetMonitorStatus
        OpEventGetMonitorStatus_GetMonitorStatus_EvtInfo_PS_ECUSUPPLY_HIGH: start-on-event=DemSatellite_0InternalBehavior/GetMonitorStatus, operation=EvtInfo_PS_ECUSUPPLY_HIGH.GetMonitorStatus
        OpEventGetMonitorStatus_GetMonitorStatus_EvtInfo_VCEvEcmPropFr05Tioutd: start-on-event=DemSatellite_0InternalBehavior/GetMonitorStatus, operation=EvtInfo_VCEvEcmPropFr05Tioutd.GetMonitorStatus
        OpEventGetMonitorStatus_GetMonitorStatus_EvtInfo_PS_ECUSUPPLY_LOW: start-on-event=DemSatellite_0InternalBehavior/GetMonitorStatus, operation=EvtInfo_PS_ECUSUPPLY_LOW.GetMonitorStatus
        OpEventGetMonitorStatus_GetMonitorStatus_EvtInfo_VcEvChkSumHvSysRlySts: start-on-event=DemSatellite_0InternalBehavior/GetMonitorStatus, operation=EvtInfo_VcEvChkSumHvSysRlySts.GetMonitorStatus
        OpEventGetMonitorStatus_GetMonitorStatus_EvtInfo_VcEvMonMode: start-on-event=DemSatellite_0InternalBehavior/GetMonitorStatus, operation=EvtInfo_VcEvMonMode.GetMonitorStatus
        OpEventGetMonitorStatus_GetMonitorStatus_EvtInfo_INV_IAC_OC_SWP: start-on-event=DemSatellite_0InternalBehavior/GetMonitorStatus, operation=EvtInfo_INV_IAC_OC_SWP.GetMonitorStatus
        OpEventGetMonitorStatus_GetMonitorStatus_EvtInfo_INV_IMMO_AUTHFAIL: start-on-event=DemSatellite_0InternalBehavior/GetMonitorStatus, operation=EvtInfo_INV_IMMO_AUTHFAIL.GetMonitorStatus
        OpEventGetMonitorStatus_GetMonitorStatus_EvtInfo_PA_OpenCirc_FLT: start-on-event=DemSatellite_0InternalBehavior/GetMonitorStatus, operation=EvtInfo_PA_OpenCirc_FLT.GetMonitorStatus
        OpEventGetMonitorStatus_GetMonitorStatus_EvtInfo_INV_IAC_V_ELEC_HI: start-on-event=DemSatellite_0InternalBehavior/GetMonitorStatus, operation=EvtInfo_INV_IAC_V_ELEC_HI.GetMonitorStatus
        OpEventGetMonitorStatus_GetMonitorStatus_EvtInfo_VCEvEcmPropFr04Tioutd: start-on-event=DemSatellite_0InternalBehavior/GetMonitorStatus, operation=EvtInfo_VCEvEcmPropFr04Tioutd.GetMonitorStatus
        OpEventGetMonitorStatus_GetMonitorStatus_EvtInfo_VcEvMonTrqActPlaus: start-on-event=DemSatellite_0InternalBehavior/GetMonitorStatus, operation=EvtInfo_VcEvMonTrqActPlaus.GetMonitorStatus
        OpEventGetMonitorStatus_GetMonitorStatus_EvtInfo_VcEvMonTrqAct: start-on-event=DemSatellite_0InternalBehavior/GetMonitorStatus, operation=EvtInfo_VcEvMonTrqAct.GetMonitorStatus
        OpEventGetMonitorStatus_GetMonitorStatus_EvtInfo_INV_RSLVR_COS_ELEC_LO: start-on-event=DemSatellite_0InternalBehavior/GetMonitorStatus, operation=EvtInfo_INV_RSLVR_COS_ELEC_LO.GetMonitorStatus
        OpEventGetMonitorStatus_GetMonitorStatus_EvtInfo_INV_COOLT_INLET_TEMP_HWP: start-on-event=DemSatellite_0InternalBehavior/GetMonitorStatus, operation=EvtInfo_INV_COOLT_INLET_TEMP_HWP.GetMonitorStatus
        OpEventGetMonitorStatus_GetMonitorStatus_EvtInfo_VCEvEcmPropFr11Tioutd: start-on-event=DemSatellite_0InternalBehavior/GetMonitorStatus, operation=EvtInfo_VCEvEcmPropFr11Tioutd.GetMonitorStatus
        OpEventGetMonitorStatus_GetMonitorStatus_EvtInfo_PS_KL30_RNG_HI: start-on-event=DemSatellite_0InternalBehavior/GetMonitorStatus, operation=EvtInfo_PS_KL30_RNG_HI.GetMonitorStatus
        OpEventGetMonitorStatus_GetMonitorStatus_EvtInfo_INV_IAC_OC_HWP: start-on-event=DemSatellite_0InternalBehavior/GetMonitorStatus, operation=EvtInfo_INV_IAC_OC_HWP.GetMonitorStatus
        OpEventGetMonitorStatus_GetMonitorStatus_EvtInfo_INV_RSLVR_COS_RNG_HI: start-on-event=DemSatellite_0InternalBehavior/GetMonitorStatus, operation=EvtInfo_INV_RSLVR_COS_RNG_HI.GetMonitorStatus
        OpEventGetMonitorStatus_GetMonitorStatus_EvtInfo_INV_IAC_U_ELEC_HI: start-on-event=DemSatellite_0InternalBehavior/GetMonitorStatus, operation=EvtInfo_INV_IAC_U_ELEC_HI.GetMonitorStatus
        OpEventGetMonitorStatus_GetMonitorStatus_EvtInfo_INV_IAC_V_RNG_LO: start-on-event=DemSatellite_0InternalBehavior/GetMonitorStatus, operation=EvtInfo_INV_IAC_V_RNG_LO.GetMonitorStatus
        OpEventGetMonitorStatus_GetMonitorStatus_EvtInfo_INV_IAC_U_RNG_HI: start-on-event=DemSatellite_0InternalBehavior/GetMonitorStatus, operation=EvtInfo_INV_IAC_U_RNG_HI.GetMonitorStatus
        OpEventGetMonitorStatus_GetMonitorStatus_EvtInfo_VCEvEcmPropFr25Tioutd: start-on-event=DemSatellite_0InternalBehavior/GetMonitorStatus, operation=EvtInfo_VCEvEcmPropFr25Tioutd.GetMonitorStatus
        OpEventGetMonitorStatus_GetMonitorStatus_EvtInfo_INV_IGBT_TEMP_W_RNG_LO: start-on-event=DemSatellite_0InternalBehavior/GetMonitorStatus, operation=EvtInfo_INV_IGBT_TEMP_W_RNG_LO.GetMonitorStatus
        OpEventGetMonitorStatus_GetMonitorStatus_EvtInfo_PSnsr_RNG_NOK: start-on-event=DemSatellite_0InternalBehavior/GetMonitorStatus, operation=EvtInfo_PSnsr_RNG_NOK.GetMonitorStatus
        OpEventGetMonitorStatus_GetMonitorStatus_EvtInfo_INV_RSLVR_COS_RNG_NOK: start-on-event=DemSatellite_0InternalBehavior/GetMonitorStatus, operation=EvtInfo_INV_RSLVR_COS_RNG_NOK.GetMonitorStatus
        OpEventGetMonitorStatus_GetMonitorStatus_EvtInfo_PS_DRVB_Fault: start-on-event=DemSatellite_0InternalBehavior/GetMonitorStatus, operation=EvtInfo_PS_DRVB_Fault.GetMonitorStatus
        OpEventGetMonitorStatus_GetMonitorStatus_EvtInfo_INV_CU_TEMP1_RNG_NOK: start-on-event=DemSatellite_0InternalBehavior/GetMonitorStatus, operation=EvtInfo_INV_CU_TEMP1_RNG_NOK.GetMonitorStatus
        OpEventGetMonitorStatus_GetMonitorStatus_EvtInfo_VcEvCntr: start-on-event=DemSatellite_0InternalBehavior/GetMonitorStatus, operation=EvtInfo_VcEvCntr.GetMonitorStatus
        OpEventGetMonitorStatus_GetMonitorStatus_EvtInfo_INV_RSLVR_SIN_AMP: start-on-event=DemSatellite_0InternalBehavior/GetMonitorStatus, operation=EvtInfo_INV_RSLVR_SIN_AMP.GetMonitorStatus
        OpEventGetMonitorStatus_GetMonitorStatus_EvtInfo_INV_UHVDC_2_RNG_HI: start-on-event=DemSatellite_0InternalBehavior/GetMonitorStatus, operation=EvtInfo_INV_UHVDC_2_RNG_HI.GetMonitorStatus
        OpEventGetMonitorStatus_GetMonitorStatus_EvtInfo_INV_IGBT_TEMP_U_GRDT: start-on-event=DemSatellite_0InternalBehavior/GetMonitorStatus, operation=EvtInfo_INV_IGBT_TEMP_U_GRDT.GetMonitorStatus
        OpEventGetMonitorStatus_GetMonitorStatus_EvtInfo_MON_TQ_PLAUS_PWR_MDL: start-on-event=DemSatellite_0InternalBehavior/GetMonitorStatus, operation=EvtInfo_MON_TQ_PLAUS_PWR_MDL.GetMonitorStatus
        OpEventGetMonitorStatus_GetMonitorStatus_EvtInfo_INV_IGBT_TEMP_W_PLAUS: start-on-event=DemSatellite_0InternalBehavior/GetMonitorStatus, operation=EvtInfo_INV_IGBT_TEMP_W_PLAUS.GetMonitorStatus
        OpEventGetMonitorStatus_GetMonitorStatus_EvtInfo_PS_BLDC_UV_FLT: start-on-event=DemSatellite_0InternalBehavior/GetMonitorStatus, operation=EvtInfo_PS_BLDC_UV_FLT.GetMonitorStatus
        OpEventGetMonitorStatus_GetMonitorStatus_EvtInfo_INV_IAC_V_OFFS: start-on-event=DemSatellite_0InternalBehavior/GetMonitorStatus, operation=EvtInfo_INV_IAC_V_OFFS.GetMonitorStatus
        OpEventGetMonitorStatus_GetMonitorStatus_EvtInfo_INV_RSLVR_EXCT_FREQ_RNG_NOK: start-on-event=DemSatellite_0InternalBehavior/GetMonitorStatus, operation=EvtInfo_INV_RSLVR_EXCT_FREQ_RNG_NOK.GetMonitorStatus
        OpEventGetMonitorStatus_GetMonitorStatus_EvtInfo_PS_KL30_RNG_LO: start-on-event=DemSatellite_0InternalBehavior/GetMonitorStatus, operation=EvtInfo_PS_KL30_RNG_LO.GetMonitorStatus
        OpEventGetMonitorStatus_GetMonitorStatus_EvtInfo_INV_RSLVR_COS_RNG_LO: start-on-event=DemSatellite_0InternalBehavior/GetMonitorStatus, operation=EvtInfo_INV_RSLVR_COS_RNG_LO.GetMonitorStatus
        OpEventGetMonitorStatus_GetMonitorStatus_EvtInfo_PSnsr_ELE_FLT: start-on-event=DemSatellite_0InternalBehavior/GetMonitorStatus, operation=EvtInfo_PSnsr_ELE_FLT.GetMonitorStatus
        OpEventGetMonitorStatus_GetMonitorStatus_EvtInfo_INV_RSLVR_SIN_COS_PLAUS_AMP: start-on-event=DemSatellite_0InternalBehavior/GetMonitorStatus, operation=EvtInfo_INV_RSLVR_SIN_COS_PLAUS_AMP.GetMonitorStatus
        OpEventGetMonitorStatus_GetMonitorStatus_EvtInfo_INV_IAC_U_ELEC_LO: start-on-event=DemSatellite_0InternalBehavior/GetMonitorStatus, operation=EvtInfo_INV_IAC_U_ELEC_LO.GetMonitorStatus
        OpEventGetMonitorStatus_GetMonitorStatus_EvtInfo_INV_RSLVR_EXCT_ELEC_HI: start-on-event=DemSatellite_0InternalBehavior/GetMonitorStatus, operation=EvtInfo_INV_RSLVR_EXCT_ELEC_HI.GetMonitorStatus
        OpEventGetMonitorStatus_GetMonitorStatus_EvtInfo_INV_IAC_U_RNG_LO: start-on-event=DemSatellite_0InternalBehavior/GetMonitorStatus, operation=EvtInfo_INV_IAC_U_RNG_LO.GetMonitorStatus
        OpEventGetMonitorStatus_GetMonitorStatus_EvtInfo_INV_IAC_V_RNG_HI: start-on-event=DemSatellite_0InternalBehavior/GetMonitorStatus, operation=EvtInfo_INV_IAC_V_RNG_HI.GetMonitorStatus
        OpEventGetMonitorStatus_GetMonitorStatus_EvtInfo_INV_IGBT_TEMP_U_PLAUS: start-on-event=DemSatellite_0InternalBehavior/GetMonitorStatus, operation=EvtInfo_INV_IGBT_TEMP_U_PLAUS.GetMonitorStatus
        OpEventGetMonitorStatus_GetMonitorStatus_EvtInfo_INV_RSLVR_OFFS_DFT: start-on-event=DemSatellite_0InternalBehavior/GetMonitorStatus, operation=EvtInfo_INV_RSLVR_OFFS_DFT.GetMonitorStatus
        OpEventGetMonitorStatus_GetMonitorStatus_EvtInfo_Ga_MoveOverThd: start-on-event=DemSatellite_0InternalBehavior/GetMonitorStatus, operation=EvtInfo_Ga_MoveOverThd.GetMonitorStatus
        OpEventGetMonitorStatus_GetMonitorStatus_EvtInfo_VcEvMonIPH: start-on-event=DemSatellite_0InternalBehavior/GetMonitorStatus, operation=EvtInfo_VcEvMonIPH.GetMonitorStatus
        OpEventGetMonitorStatus_GetMonitorStatus_EvtInfo_INV_RSLVR_HW_FLT: start-on-event=DemSatellite_0InternalBehavior/GetMonitorStatus, operation=EvtInfo_INV_RSLVR_HW_FLT.GetMonitorStatus
        OpEventGetMonitorStatus_GetMonitorStatus_EvtInfo_INV_RSLVR_SIN_ELEC_LO: start-on-event=DemSatellite_0InternalBehavior/GetMonitorStatus, operation=EvtInfo_INV_RSLVR_SIN_ELEC_LO.GetMonitorStatus
        OpEventGetMonitorStatus_GetMonitorStatus_EvtInfo_INV_IAC_W_AMP: start-on-event=DemSatellite_0InternalBehavior/GetMonitorStatus, operation=EvtInfo_INV_IAC_W_AMP.GetMonitorStatus
        OpEventGetMonitorStatus_GetMonitorStatus_EvtInfo_VCC_OverVoltage: start-on-event=DemSatellite_0InternalBehavior/GetMonitorStatus, operation=EvtInfo_VCC_OverVoltage.GetMonitorStatus
        OpEventGetMonitorStatus_GetMonitorStatus_EvtInfo_PS_BLDC_OV_FLT: start-on-event=DemSatellite_0InternalBehavior/GetMonitorStatus, operation=EvtInfo_PS_BLDC_OV_FLT.GetMonitorStatus
        OpEventGetMonitorStatus_GetMonitorStatus_EvtInfo_AURIX_EEPROM_FLT: start-on-event=DemSatellite_0InternalBehavior/GetMonitorStatus, operation=EvtInfo_AURIX_EEPROM_FLT.GetMonitorStatus
        OpEventGetMonitorStatus_GetMonitorStatus_EvtInfo_FS_MONITIOR_ASC_FW_FLT: start-on-event=DemSatellite_0InternalBehavior/GetMonitorStatus, operation=EvtInfo_FS_MONITIOR_ASC_FW_FLT.GetMonitorStatus
        OpEventGetMonitorStatus_GetMonitorStatus_EvtInfo_VCEvSrsPropFr02Tioutd: start-on-event=DemSatellite_0InternalBehavior/GetMonitorStatus, operation=EvtInfo_VCEvSrsPropFr02Tioutd.GetMonitorStatus
        OpEventGetMonitorStatus_GetMonitorStatus_EvtInfo_VcEvMonErrMode: start-on-event=DemSatellite_0InternalBehavior/GetMonitorStatus, operation=EvtInfo_VcEvMonErrMode.GetMonitorStatus
        OpEventGetMonitorStatus_GetMonitorStatus_EvtInfo_AURIX_RST_MPL: start-on-event=DemSatellite_0InternalBehavior/GetMonitorStatus, operation=EvtInfo_AURIX_RST_MPL.GetMonitorStatus
        OpEventGetMonitorStatus_GetMonitorStatus_EvtInfo_VcEvNodeMisECM: start-on-event=DemSatellite_0InternalBehavior/GetMonitorStatus, operation=EvtInfo_VcEvNodeMisECM.GetMonitorStatus
        OpEventGetMonitorStatus_GetMonitorStatus_EvtInfo_PS_KL30_PLAUS: start-on-event=DemSatellite_0InternalBehavior/GetMonitorStatus, operation=EvtInfo_PS_KL30_PLAUS.GetMonitorStatus
        OpEventGetMonitorStatus_GetMonitorStatus_EvtInfo_INV_IAC_W_ELEC_HI: start-on-event=DemSatellite_0InternalBehavior/GetMonitorStatus, operation=EvtInfo_INV_IAC_W_ELEC_HI.GetMonitorStatus
        OpEventGetMonitorStatus_GetMonitorStatus_EvtInfo_VCEvVddmPropFr19Tioutd: start-on-event=DemSatellite_0InternalBehavior/GetMonitorStatus, operation=EvtInfo_VCEvVddmPropFr19Tioutd.GetMonitorStatus
        OpEventGetMonitorStatus_GetMonitorStatus_EvtInfo_INV_TEMP_DCHA_HW: start-on-event=DemSatellite_0InternalBehavior/GetMonitorStatus, operation=EvtInfo_INV_TEMP_DCHA_HW.GetMonitorStatus
        OpEventGetMonitorStatus_GetMonitorStatus_EvtInfo_VcEvPropCANGlbTiOutd: start-on-event=DemSatellite_0InternalBehavior/GetMonitorStatus, operation=EvtInfo_VcEvPropCANGlbTiOutd.GetMonitorStatus
        OpEventGetMonitorStatus_GetMonitorStatus_EvtInfo_INV_EM_STATOR_TEMP2_RNG_NOK: start-on-event=DemSatellite_0InternalBehavior/GetMonitorStatus, operation=EvtInfo_INV_EM_STATOR_TEMP2_RNG_NOK.GetMonitorStatus
        OpEventGetMonitorStatus_GetMonitorStatus_EvtInfo_INV_UHVDC_OV_HWP: start-on-event=DemSatellite_0InternalBehavior/GetMonitorStatus, operation=EvtInfo_INV_UHVDC_OV_HWP.GetMonitorStatus
        OpEventGetMonitorStatus_GetMonitorStatus_EvtInfo_Ga_FindEngleAngleFailed: start-on-event=DemSatellite_0InternalBehavior/GetMonitorStatus, operation=EvtInfo_Ga_FindEngleAngleFailed.GetMonitorStatus
        OpEventGetMonitorStatus_GetMonitorStatus_EvtInfo_VcEvMonTrqCmp: start-on-event=DemSatellite_0InternalBehavior/GetMonitorStatus, operation=EvtInfo_VcEvMonTrqCmp.GetMonitorStatus
        OpEventGetMonitorStatus_GetMonitorStatus_EvtInfo_INV_IGBT_TEMP_V_RNG_LO: start-on-event=DemSatellite_0InternalBehavior/GetMonitorStatus, operation=EvtInfo_INV_IGBT_TEMP_V_RNG_LO.GetMonitorStatus
        OpEventGetMonitorStatus_GetMonitorStatus_EvtInfo_INV_CONTROL_LIMIT: start-on-event=DemSatellite_0InternalBehavior/GetMonitorStatus, operation=EvtInfo_INV_CONTROL_LIMIT.GetMonitorStatus
        OpEventGetMonitorStatus_GetMonitorStatus_EvtInfo_COM_CarConfigErr: start-on-event=DemSatellite_0InternalBehavior/GetMonitorStatus, operation=EvtInfo_COM_CarConfigErr.GetMonitorStatus
        OpEventGetMonitorStatus_GetMonitorStatus_EvtInfo_VCEvEcmPropFr08Tioutd: start-on-event=DemSatellite_0InternalBehavior/GetMonitorStatus, operation=EvtInfo_VCEvEcmPropFr08Tioutd.GetMonitorStatus
        OpEventGetMonitorStatus_GetMonitorStatus_EvtInfo_CU_TEMP1_RNG_LO: start-on-event=DemSatellite_0InternalBehavior/GetMonitorStatus, operation=EvtInfo_CU_TEMP1_RNG_LO.GetMonitorStatus
        OpEventGetMonitorStatus_GetMonitorStatus_EvtInfo_INV_EM_STATOR_TEMP2_RNG_SWT: start-on-event=DemSatellite_0InternalBehavior/GetMonitorStatus, operation=EvtInfo_INV_EM_STATOR_TEMP2_RNG_SWT.GetMonitorStatus
        OpEventGetMonitorStatus_GetMonitorStatus_EvtInfo_GA_BLDC_POS_FLT: start-on-event=DemSatellite_0InternalBehavior/GetMonitorStatus, operation=EvtInfo_GA_BLDC_POS_FLT.GetMonitorStatus
        OpEventGetMonitorStatus_GetMonitorStatus_EvtInfo_PS_WhlSnsr_FLT: start-on-event=DemSatellite_0InternalBehavior/GetMonitorStatus, operation=EvtInfo_PS_WhlSnsr_FLT.GetMonitorStatus
        OpEventGetMonitorStatus_GetMonitorStatus_EvtInfo_INV_EM_STATOR_TEMP_RNG_LO: start-on-event=DemSatellite_0InternalBehavior/GetMonitorStatus, operation=EvtInfo_INV_EM_STATOR_TEMP_RNG_LO.GetMonitorStatus
        OpEventGetMonitorStatus_GetMonitorStatus_EvtInfo_INV_RSLVR_SIN_ELEC_HI: start-on-event=DemSatellite_0InternalBehavior/GetMonitorStatus, operation=EvtInfo_INV_RSLVR_SIN_ELEC_HI.GetMonitorStatus
        OpEventGetMonitorStatus_GetMonitorStatus_EvtInfo_INV_RSLVR_SIN_COS_PLAUS: start-on-event=DemSatellite_0InternalBehavior/GetMonitorStatus, operation=EvtInfo_INV_RSLVR_SIN_COS_PLAUS.GetMonitorStatus
        OpEventGetMonitorStatus_GetMonitorStatus_EvtInfo_INV_RSLVR_COS_AMP: start-on-event=DemSatellite_0InternalBehavior/GetMonitorStatus, operation=EvtInfo_INV_RSLVR_COS_AMP.GetMonitorStatus
        OpEventGetMonitorStatus_GetMonitorStatus_EvtInfo_INV_GATE_DRVR_BOT_HWP: start-on-event=DemSatellite_0InternalBehavior/GetMonitorStatus, operation=EvtInfo_INV_GATE_DRVR_BOT_HWP.GetMonitorStatus
        OpEventGetMonitorStatus_GetMonitorStatus_EvtInfo_Eg_HallVolWrong: start-on-event=DemSatellite_0InternalBehavior/GetMonitorStatus, operation=EvtInfo_Eg_HallVolWrong.GetMonitorStatus
        OpEventGetMonitorStatus_GetMonitorStatus_EvtInfo_INV_RSLVR_EXCT_RNG_NOK: start-on-event=DemSatellite_0InternalBehavior/GetMonitorStatus, operation=EvtInfo_INV_RSLVR_EXCT_RNG_NOK.GetMonitorStatus
        OpEventGetMonitorStatus_GetMonitorStatus_EvtInfo_PA_OpenCirc: start-on-event=DemSatellite_0InternalBehavior/GetMonitorStatus, operation=EvtInfo_PA_OpenCirc.GetMonitorStatus
        OpEventGetMonitorStatus_GetMonitorStatus_EvtInfo_INV_RSLVR_COS_ELEC_HI: start-on-event=DemSatellite_0InternalBehavior/GetMonitorStatus, operation=EvtInfo_INV_RSLVR_COS_ELEC_HI.GetMonitorStatus
        OpEventGetMonitorStatus_GetMonitorStatus_EvtInfo_VcEvCntrHvSysRlySts: start-on-event=DemSatellite_0InternalBehavior/GetMonitorStatus, operation=EvtInfo_VcEvCntrHvSysRlySts.GetMonitorStatus
        OpEventGetMonitorStatus_GetMonitorStatus_EvtInfo_CRASH_DTC: start-on-event=DemSatellite_0InternalBehavior/GetMonitorStatus, operation=EvtInfo_CRASH_DTC.GetMonitorStatus
        OpEventGetMonitorStatus_GetMonitorStatus_EvtInfo_INV_IGBT_TEMP_W_RNG_HI: start-on-event=DemSatellite_0InternalBehavior/GetMonitorStatus, operation=EvtInfo_INV_IGBT_TEMP_W_RNG_HI.GetMonitorStatus
        OpEventGetMonitorStatus_GetMonitorStatus_EvtInfo_VCEvBecmPropFr02Tioutd: start-on-event=DemSatellite_0InternalBehavior/GetMonitorStatus, operation=EvtInfo_VCEvBecmPropFr02Tioutd.GetMonitorStatus
        OpEventGetMonitorStatus_GetMonitorStatus_EvtInfo_INV_IGBT_TEMP_W_GRDT: start-on-event=DemSatellite_0InternalBehavior/GetMonitorStatus, operation=EvtInfo_INV_IGBT_TEMP_W_GRDT.GetMonitorStatus
        OpEventGetMonitorStatus_GetMonitorStatus_EvtInfo_EXT_UC_SPI_FLT: start-on-event=DemSatellite_0InternalBehavior/GetMonitorStatus, operation=EvtInfo_EXT_UC_SPI_FLT.GetMonitorStatus
        OpEventGetMonitorStatus_GetMonitorStatus_EvtInfo_INV_IAC_V_ELEC_HWP_001: start-on-event=DemSatellite_0InternalBehavior/GetMonitorStatus, operation=EvtInfo_INV_IAC_V_ELEC_HWP_001.GetMonitorStatus
        OpEventGetMonitorStatus_GetMonitorStatus_EvtInfo_VcEvChkSumWhlMotSysTqAllwd: start-on-event=DemSatellite_0InternalBehavior/GetMonitorStatus, operation=EvtInfo_VcEvChkSumWhlMotSysTqAllwd.GetMonitorStatus
        OpEventGetMonitorStatus_GetMonitorStatus_EvtInfo_FS_MONITIOR_ASC_FLT: start-on-event=DemSatellite_0InternalBehavior/GetMonitorStatus, operation=EvtInfo_FS_MONITIOR_ASC_FLT.GetMonitorStatus
        OpEventGetMonitorStatus_GetMonitorStatus_EvtInfo_INV_IAC_V_AMP: start-on-event=DemSatellite_0InternalBehavior/GetMonitorStatus, operation=EvtInfo_INV_IAC_V_AMP.GetMonitorStatus
        OpEventGetMonitorStatus_GetMonitorStatus_EvtInfo_INV_IAC_W_ELEC_LO: start-on-event=DemSatellite_0InternalBehavior/GetMonitorStatus, operation=EvtInfo_INV_IAC_W_ELEC_LO.GetMonitorStatus
        OpEventGetMonitorStatus_GetMonitorStatus_EvtInfo_VCEvVddmPropFr08Tioutd_001: start-on-event=DemSatellite_0InternalBehavior/GetMonitorStatus, operation=EvtInfo_VCEvVddmPropFr08Tioutd_001.GetMonitorStatus
        OpEventGetMonitorStatus_GetMonitorStatus_EvtInfo_PS_P12_RES_FLT: start-on-event=DemSatellite_0InternalBehavior/GetMonitorStatus, operation=EvtInfo_PS_P12_RES_FLT.GetMonitorStatus
        OpEventGetMonitorStatus_GetMonitorStatus_EvtInfo_INV_RSLVR_SIN_RNG_LO: start-on-event=DemSatellite_0InternalBehavior/GetMonitorStatus, operation=EvtInfo_INV_RSLVR_SIN_RNG_LO.GetMonitorStatus
        OpEventGetMonitorStatus_GetMonitorStatus_EvtInfo_CU_TEMP_HW_FLT: start-on-event=DemSatellite_0InternalBehavior/GetMonitorStatus, operation=EvtInfo_CU_TEMP_HW_FLT.GetMonitorStatus
        OpEventGetMonitorStatus_GetMonitorStatus_EvtInfo_VCEvEcmPropFr02MgmFr00Tioutd: start-on-event=DemSatellite_0InternalBehavior/GetMonitorStatus, operation=EvtInfo_VCEvEcmPropFr02MgmFr00Tioutd.GetMonitorStatus
        OpEventGetMonitorStatus_GetMonitorStatus_EvtInfo_PS_KL15_RNG_HI: start-on-event=DemSatellite_0InternalBehavior/GetMonitorStatus, operation=EvtInfo_PS_KL15_RNG_HI.GetMonitorStatus
        OpEventGetMonitorStatus_GetMonitorStatus_EvtInfo_VCEvVddmPropFr17Tioutd: start-on-event=DemSatellite_0InternalBehavior/GetMonitorStatus, operation=EvtInfo_VCEvVddmPropFr17Tioutd.GetMonitorStatus
        OpEventGetMonitorStatus_GetMonitorStatus_EvtInfo_VcEvChkSumCrashStsSafe: start-on-event=DemSatellite_0InternalBehavior/GetMonitorStatus, operation=EvtInfo_VcEvChkSumCrashStsSafe.GetMonitorStatus
        OpEventGetMonitorStatus_GetMonitorStatus_EvtInfo_DiagC_ClutchService: start-on-event=DemSatellite_0InternalBehavior/GetMonitorStatus, operation=EvtInfo_DiagC_ClutchService.GetMonitorStatus
        OpEventGetMonitorStatus_GetMonitorStatus_EvtInfo_INV_EM_STATOR_TEMP_RNG_HI: start-on-event=DemSatellite_0InternalBehavior/GetMonitorStatus, operation=EvtInfo_INV_EM_STATOR_TEMP_RNG_HI.GetMonitorStatus
        OpEventGetMonitorStatus_GetMonitorStatus_EvtInfo_INV_RSLVR_OFFS_OUT_RANG: start-on-event=DemSatellite_0InternalBehavior/GetMonitorStatus, operation=EvtInfo_INV_RSLVR_OFFS_OUT_RANG.GetMonitorStatus
        OpEventGetMonitorStatus_GetMonitorStatus_EvtInfo_INV_EM_STATOR_TEMP2_RNG_LO: start-on-event=DemSatellite_0InternalBehavior/GetMonitorStatus, operation=EvtInfo_INV_EM_STATOR_TEMP2_RNG_LO.GetMonitorStatus
        OpEventGetMonitorStatus_GetMonitorStatus_EvtInfo_VcEvMonISAR: start-on-event=DemSatellite_0InternalBehavior/GetMonitorStatus, operation=EvtInfo_VcEvMonISAR.GetMonitorStatus
        OpEventGetMonitorStatus_GetMonitorStatus_EvtInfo_GA_BLDC_FLT: start-on-event=DemSatellite_0InternalBehavior/GetMonitorStatus, operation=EvtInfo_GA_BLDC_FLT.GetMonitorStatus
        OpEventGetMonitorStatus_GetMonitorStatus_EvtInfo_INV_RSLVR_EXCT_ELEC_OPEN: start-on-event=DemSatellite_0InternalBehavior/GetMonitorStatus, operation=EvtInfo_INV_RSLVR_EXCT_ELEC_OPEN.GetMonitorStatus
        OpEventGetMonitorStatus_GetMonitorStatus_EvtInfo_INV_RSLVR_EXCT_PLAUS: start-on-event=DemSatellite_0InternalBehavior/GetMonitorStatus, operation=EvtInfo_INV_RSLVR_EXCT_PLAUS.GetMonitorStatus
        OpEventGetMonitorStatus_GetMonitorStatus_EvtInfo_PS_P15_U_FLT: start-on-event=DemSatellite_0InternalBehavior/GetMonitorStatus, operation=EvtInfo_PS_P15_U_FLT.GetMonitorStatus
        OpEventGetMonitorStatus_GetMonitorStatus_EvtInfo_INV_EM_STATOR_TEMP_RNG_SWT: start-on-event=DemSatellite_0InternalBehavior/GetMonitorStatus, operation=EvtInfo_INV_EM_STATOR_TEMP_RNG_SWT.GetMonitorStatus
        OpEventGetMonitorStatus_GetMonitorStatus_EvtInfo_INV_UHVDC_OV_SWP: start-on-event=DemSatellite_0InternalBehavior/GetMonitorStatus, operation=EvtInfo_INV_UHVDC_OV_SWP.GetMonitorStatus
        OpEventGetMonitorStatus_GetMonitorStatus_EvtInfo_AURIX_HW_FLT: start-on-event=DemSatellite_0InternalBehavior/GetMonitorStatus, operation=EvtInfo_AURIX_HW_FLT.GetMonitorStatus
        OpEventGetMonitorStatus_GetMonitorStatus_EvtInfo_INV_GATE_DRVR_TOP_HWP: start-on-event=DemSatellite_0InternalBehavior/GetMonitorStatus, operation=EvtInfo_INV_GATE_DRVR_TOP_HWP.GetMonitorStatus
        OpEventGetMonitorStatus_GetMonitorStatus_EvtInfo_INV_ACTV_DCHA_HW: start-on-event=DemSatellite_0InternalBehavior/GetMonitorStatus, operation=EvtInfo_INV_ACTV_DCHA_HW.GetMonitorStatus
        OpEventGetMonitorStatus_GetMonitorStatus_EvtInfo_INV_IGBT_TEMP_HWP: start-on-event=DemSatellite_0InternalBehavior/GetMonitorStatus, operation=EvtInfo_INV_IGBT_TEMP_HWP.GetMonitorStatus
        OpEventGetMonitorStatus_GetMonitorStatus_EvtInfo_INV_RSLVR_SIN_ELEC_FLT: start-on-event=DemSatellite_0InternalBehavior/GetMonitorStatus, operation=EvtInfo_INV_RSLVR_SIN_ELEC_FLT.GetMonitorStatus
        OpEventGetMonitorStatus_GetMonitorStatus_EvtInfo_CU_TEMP2_RNG_HI: start-on-event=DemSatellite_0InternalBehavior/GetMonitorStatus, operation=EvtInfo_CU_TEMP2_RNG_HI.GetMonitorStatus
        OpEventGetMonitorStatus_GetMonitorStatus_EvtInfo_INV_IAC_PHA_LOSS_MPL: start-on-event=DemSatellite_0InternalBehavior/GetMonitorStatus, operation=EvtInfo_INV_IAC_PHA_LOSS_MPL.GetMonitorStatus
        OpEventGetMonitorStatus_GetMonitorStatus_EvtInfo_INV_IAC_U_AMP: start-on-event=DemSatellite_0InternalBehavior/GetMonitorStatus, operation=EvtInfo_INV_IAC_U_AMP.GetMonitorStatus
        OpEventGetMonitorStatus_GetMonitorStatus_EvtInfo_PSnsr_GRADT_Flt: start-on-event=DemSatellite_0InternalBehavior/GetMonitorStatus, operation=EvtInfo_PSnsr_GRADT_Flt.GetMonitorStatus
        OpEventGetMonitorStatus_GetMonitorStatus_EvtInfo_AURIX_WATHDOG_FLT: start-on-event=DemSatellite_0InternalBehavior/GetMonitorStatus, operation=EvtInfo_AURIX_WATHDOG_FLT.GetMonitorStatus
        OpEventGetMonitorStatus_GetMonitorStatus_EvtInfo_VcEvNodeMisBECM: start-on-event=DemSatellite_0InternalBehavior/GetMonitorStatus, operation=EvtInfo_VcEvNodeMisBECM.GetMonitorStatus
        OpEventGetMonitorStatus_GetMonitorStatus_EvtInfo_INV_UHVDC_UV_HWP: start-on-event=DemSatellite_0InternalBehavior/GetMonitorStatus, operation=EvtInfo_INV_UHVDC_UV_HWP.GetMonitorStatus
        OpEventGetMonitorStatus_GetMonitorStatus_EvtInfo_VcEvMonESpd: start-on-event=DemSatellite_0InternalBehavior/GetMonitorStatus, operation=EvtInfo_VcEvMonESpd.GetMonitorStatus
        OpEventGetMonitorStatus_GetMonitorStatus_EvtInfo_COM_NotConfig: start-on-event=DemSatellite_0InternalBehavior/GetMonitorStatus, operation=EvtInfo_COM_NotConfig.GetMonitorStatus
        OpEventGetMonitorStatus_GetMonitorStatus_EvtInfo_INV_RSLVR_SIN_RNG_HI: start-on-event=DemSatellite_0InternalBehavior/GetMonitorStatus, operation=EvtInfo_INV_RSLVR_SIN_RNG_HI.GetMonitorStatus
        OpEventGetMonitorStatus_GetMonitorStatus_EvtInfo_INV_IGBT_TEMP_U_RNG_HI: start-on-event=DemSatellite_0InternalBehavior/GetMonitorStatus, operation=EvtInfo_INV_IGBT_TEMP_U_RNG_HI.GetMonitorStatus
        OpEventGetMonitorStatus_GetMonitorStatus_EvtInfo_VcEvMonMode_001: start-on-event=DemSatellite_0InternalBehavior/GetMonitorStatus, operation=EvtInfo_VcEvMonMode_001.GetMonitorStatus
        OpEventGetMonitorStatus_GetMonitorStatus_EvtInfo_PA_ACTION_FLT: start-on-event=DemSatellite_0InternalBehavior/GetMonitorStatus, operation=EvtInfo_PA_ACTION_FLT.GetMonitorStatus
        OpEventGetMonitorStatus_GetMonitorStatus_EvtInfo_INV_IAC_V_ELEC_HWP: start-on-event=DemSatellite_0InternalBehavior/GetMonitorStatus, operation=EvtInfo_INV_IAC_V_ELEC_HWP.GetMonitorStatus
        OpEventGetMonitorStatus_GetMonitorStatus_EvtInfo_CU_TEMP_HW_FLT_001: start-on-event=DemSatellite_0InternalBehavior/GetMonitorStatus, operation=EvtInfo_CU_TEMP_HW_FLT_001.GetMonitorStatus
        OpEventGetMonitorStatus_GetMonitorStatus_EvtInfo_VCC_UnderVoltage: start-on-event=DemSatellite_0InternalBehavior/GetMonitorStatus, operation=EvtInfo_VCC_UnderVoltage.GetMonitorStatus
        OpEventGetMonitorStatus_GetMonitorStatus_EvtInfo_VcEvTsttrPlaus: start-on-event=DemSatellite_0InternalBehavior/GetMonitorStatus, operation=EvtInfo_VcEvTsttrPlaus.GetMonitorStatus
        OpEventGetMonitorStatus_GetMonitorStatus_EvtInfo_INV_RSLVR_EXCT_ELEC_FLT: start-on-event=DemSatellite_0InternalBehavior/GetMonitorStatus, operation=EvtInfo_INV_RSLVR_EXCT_ELEC_FLT.GetMonitorStatus
        OpEventGetMonitorStatus_GetMonitorStatus_EvtInfo_INV_RSLVR_EXCT_RNG_LO: start-on-event=DemSatellite_0InternalBehavior/GetMonitorStatus, operation=EvtInfo_INV_RSLVR_EXCT_RNG_LO.GetMonitorStatus
        OpEventGetMonitorStatus_GetMonitorStatus_EvtInfo_INV_EM_STATOR_TEMP2_RNG_HI: start-on-event=DemSatellite_0InternalBehavior/GetMonitorStatus, operation=EvtInfo_INV_EM_STATOR_TEMP2_RNG_HI.GetMonitorStatus
        OpEventGetMonitorStatus_GetMonitorStatus_EvtInfo_INV_SHUT_OFF_PAH_START_UP: start-on-event=DemSatellite_0InternalBehavior/GetMonitorStatus, operation=EvtInfo_INV_SHUT_OFF_PAH_START_UP.GetMonitorStatus
        OpEventGetMonitorStatus_GetMonitorStatus_EvtInfo_VCEvVddmPropFr08Tioutd: start-on-event=DemSatellite_0InternalBehavior/GetMonitorStatus, operation=EvtInfo_VCEvVddmPropFr08Tioutd.GetMonitorStatus
        OpEventGetMonitorStatus_GetMonitorStatus_EvtInfo_INV_RSLVR_EXCT_OC_HWP_001: start-on-event=DemSatellite_0InternalBehavior/GetMonitorStatus, operation=EvtInfo_INV_RSLVR_EXCT_OC_HWP_001.GetMonitorStatus
        OpEventGetMonitorStatus_GetMonitorStatus_EvtInfo_INV_RSLVR_EXCT_OC_HWP_002: start-on-event=DemSatellite_0InternalBehavior/GetMonitorStatus, operation=EvtInfo_INV_RSLVR_EXCT_OC_HWP_002.GetMonitorStatus
        OpEventGetMonitorStatus_GetMonitorStatus_EvtInfo_INV_EM_STATOR_TEMP_ELE_FLT: start-on-event=DemSatellite_0InternalBehavior/GetMonitorStatus, operation=EvtInfo_INV_EM_STATOR_TEMP_ELE_FLT.GetMonitorStatus
        OpEventGetMonitorStatus_GetMonitorStatus_EvtInfo_INV_INTERLOCK_FLT: start-on-event=DemSatellite_0InternalBehavior/GetMonitorStatus, operation=EvtInfo_INV_INTERLOCK_FLT.GetMonitorStatus
        OpEventGetMonitorStatus_GetMonitorStatus_EvtInfo_Ga_ZeroFindDistanFailure: start-on-event=DemSatellite_0InternalBehavior/GetMonitorStatus, operation=EvtInfo_Ga_ZeroFindDistanFailure.GetMonitorStatus
        OpEventGetMonitorStatus_GetMonitorStatus_EvtInfo_PLOCK_Current_RNG_OUT: start-on-event=DemSatellite_0InternalBehavior/GetMonitorStatus, operation=EvtInfo_PLOCK_Current_RNG_OUT.GetMonitorStatus
        OpEventGetMonitorStatus_GetMonitorStatus_EvtInfo_VCEvVddmPropFr05Tioutd: start-on-event=DemSatellite_0InternalBehavior/GetMonitorStatus, operation=EvtInfo_VCEvVddmPropFr05Tioutd.GetMonitorStatus
        OpEventGetMonitorStatus_GetMonitorStatus_EvtInfo_INV_IGBT_TEMP_V_GRDT: start-on-event=DemSatellite_0InternalBehavior/GetMonitorStatus, operation=EvtInfo_INV_IGBT_TEMP_V_GRDT.GetMonitorStatus
        OpEventGetMonitorStatus_GetMonitorStatus_EvtInfo_PS_5V_Fault: start-on-event=DemSatellite_0InternalBehavior/GetMonitorStatus, operation=EvtInfo_PS_5V_Fault.GetMonitorStatus
        OpEventGetMonitorStatus_GetMonitorStatus_EvtInfo_VcEvCntrCrashStsSafe: start-on-event=DemSatellite_0InternalBehavior/GetMonitorStatus, operation=EvtInfo_VcEvCntrCrashStsSafe.GetMonitorStatus
        OpEventGetMonitorStatus_GetMonitorStatus_EvtInfo_INV_EM_STATOR_TEMP_GRDT: start-on-event=DemSatellite_0InternalBehavior/GetMonitorStatus, operation=EvtInfo_INV_EM_STATOR_TEMP_GRDT.GetMonitorStatus
        OpEventGetMonitorStatus_GetMonitorStatus_EvtInfo_PS_P15_V_FLT: start-on-event=DemSatellite_0InternalBehavior/GetMonitorStatus, operation=EvtInfo_PS_P15_V_FLT.GetMonitorStatus
        OpEventGetMonitorStatus_GetMonitorStatus_EvtInfo_INV_EM_STATOR_TEMP_RNG_NOK: start-on-event=DemSatellite_0InternalBehavior/GetMonitorStatus, operation=EvtInfo_INV_EM_STATOR_TEMP_RNG_NOK.GetMonitorStatus
        OpEventGetMonitorStatus_GetMonitorStatus_EvtInfo_INV_RSLVR_SIN_RNG_NOK: start-on-event=DemSatellite_0InternalBehavior/GetMonitorStatus, operation=EvtInfo_INV_RSLVR_SIN_RNG_NOK.GetMonitorStatus
        OpEventGetMonitorStatus_GetMonitorStatus_EvtInfo_INV_IAC_U_OFFS: start-on-event=DemSatellite_0InternalBehavior/GetMonitorStatus, operation=EvtInfo_INV_IAC_U_OFFS.GetMonitorStatus
        OpEventGetMonitorStatus_GetMonitorStatus_EvtInfo_PS_KL30_BACKUP_FLT: start-on-event=DemSatellite_0InternalBehavior/GetMonitorStatus, operation=EvtInfo_PS_KL30_BACKUP_FLT.GetMonitorStatus
        OpEventGetMonitorStatus_GetMonitorStatus_EvtInfo_INV_IGBT_TEMP_U_RNG_LO: start-on-event=DemSatellite_0InternalBehavior/GetMonitorStatus, operation=EvtInfo_INV_IGBT_TEMP_U_RNG_LO.GetMonitorStatus
        OpEventGetMonitorStatus_GetMonitorStatus_EvtInfo_INV_EM_STATOR_TEMP_HWP: start-on-event=DemSatellite_0InternalBehavior/GetMonitorStatus, operation=EvtInfo_INV_EM_STATOR_TEMP_HWP.GetMonitorStatus
        OpEventGetMonitorStatus_GetMonitorStatus_EvtInfo_CU_TEMP1_RNG_HI: start-on-event=DemSatellite_0InternalBehavior/GetMonitorStatus, operation=EvtInfo_CU_TEMP1_RNG_HI.GetMonitorStatus
        OpEventGetMonitorStatus_GetMonitorStatus_EvtInfo_INV_IGBT_TEMP_V_RNG_HI: start-on-event=DemSatellite_0InternalBehavior/GetMonitorStatus, operation=EvtInfo_INV_IGBT_TEMP_V_RNG_HI.GetMonitorStatus
        OpEventGetMonitorStatus_GetMonitorStatus_EvtInfo_VcEvNodeMisVDDM: start-on-event=DemSatellite_0InternalBehavior/GetMonitorStatus, operation=EvtInfo_VcEvNodeMisVDDM.GetMonitorStatus
        OpEventGetMonitorStatus_GetMonitorStatus_EvtInfo_INV_UHVDC_PLAUS: start-on-event=DemSatellite_0InternalBehavior/GetMonitorStatus, operation=EvtInfo_INV_UHVDC_PLAUS.GetMonitorStatus
        OpEventGetMonitorStatus_GetMonitorStatus_EvtInfo_INV_QUIESCENT_FLT: start-on-event=DemSatellite_0InternalBehavior/GetMonitorStatus, operation=EvtInfo_INV_QUIESCENT_FLT.GetMonitorStatus
        OpEventGetMonitorStatus_GetMonitorStatus_EvtInfo_INV_RSLVR_EXCT_RNG_HI: start-on-event=DemSatellite_0InternalBehavior/GetMonitorStatus, operation=EvtInfo_INV_RSLVR_EXCT_RNG_HI.GetMonitorStatus
        OpEventGetMonitorStatus_GetMonitorStatus_GeneralEvtInfo: start-on-event=DemSatellite_0InternalBehavior/GetMonitorStatus, operation=GeneralEvtInfo.GetMonitorStatus
        OpEventSetEventStatus_SetEventStatus_Event_VCEvBecmPropFr01Tioutd: start-on-event=SetEventStatus, operation=Event_VCEvBecmPropFr01Tioutd.SetEventStatus
        OpEventSetEventStatus_SetEventStatus_Event_INV_CU_TEMP2_RNG_NOK: start-on-event=SetEventStatus, operation=Event_INV_CU_TEMP2_RNG_NOK.SetEventStatus
        OpEventSetEventStatus_SetEventStatus_Event_INV_IMMO_NOKEY: start-on-event=SetEventStatus, operation=Event_INV_IMMO_NOKEY.SetEventStatus
        OpEventSetEventStatus_SetEventStatus_Event_INV_RSLVR_EXCT_OC_HWP: start-on-event=SetEventStatus, operation=Event_INV_RSLVR_EXCT_OC_HWP.SetEventStatus
        OpEventSetEventStatus_SetEventStatus_Event_PS_P15_W_FLT: start-on-event=SetEventStatus, operation=Event_PS_P15_W_FLT.SetEventStatus
        OpEventSetEventStatus_SetEventStatus_Event_INV_IAC_PLAUS_SUM: start-on-event=SetEventStatus, operation=Event_INV_IAC_PLAUS_SUM.SetEventStatus
        OpEventSetEventStatus_SetEventStatus_Event_PA_ELE_FLT: start-on-event=SetEventStatus, operation=Event_PA_ELE_FLT.SetEventStatus
        OpEventSetEventStatus_SetEventStatus_Event_CU_TEMP_GRDT: start-on-event=SetEventStatus, operation=Event_CU_TEMP_GRDT.SetEventStatus
        OpEventSetEventStatus_SetEventStatus_Event_INV_IGBT_TEMP_V_PLAUS: start-on-event=SetEventStatus, operation=Event_INV_IGBT_TEMP_V_PLAUS.SetEventStatus
        OpEventSetEventStatus_SetEventStatus_Event_Ga_GAEngageFailure: start-on-event=SetEventStatus, operation=Event_Ga_GAEngageFailure.SetEventStatus
        OpEventSetEventStatus_SetEventStatus_Event_INV_IAC_W_RNG_LO: start-on-event=SetEventStatus, operation=Event_INV_IAC_W_RNG_LO.SetEventStatus
        OpEventSetEventStatus_SetEventStatus_Event_PS_WhlSnsr_Vltg_FLT: start-on-event=SetEventStatus, operation=Event_PS_WhlSnsr_Vltg_FLT.SetEventStatus
        OpEventSetEventStatus_SetEventStatus_Event_VCEvEcmPropFr02Tioutd: start-on-event=SetEventStatus, operation=Event_VCEvEcmPropFr02Tioutd.SetEventStatus
        OpEventSetEventStatus_SetEventStatus_Event_Ga_TmSpdSyncFailed: start-on-event=SetEventStatus, operation=Event_Ga_TmSpdSyncFailed.SetEventStatus
        OpEventSetEventStatus_SetEventStatus_Event_INV_RSLVR_EXCT_ELEC_LO: start-on-event=SetEventStatus, operation=Event_INV_RSLVR_EXCT_ELEC_LO.SetEventStatus
        OpEventSetEventStatus_SetEventStatus_Event_VCEvEcmPropXevFr06Tioutd: start-on-event=SetEventStatus, operation=Event_VCEvEcmPropXevFr06Tioutd.SetEventStatus
        OpEventSetEventStatus_SetEventStatus_Event_VcEvCntrWhlMotSysTqAllwd: start-on-event=SetEventStatus, operation=Event_VcEvCntrWhlMotSysTqAllwd.SetEventStatus
        OpEventSetEventStatus_SetEventStatus_Event_INV_UHVDC_1_ELEC_HI: start-on-event=SetEventStatus, operation=Event_INV_UHVDC_1_ELEC_HI.SetEventStatus
        OpEventSetEventStatus_SetEventStatus_Event_INV_EM_STATOR_TEMP2_ELE_FLT: start-on-event=SetEventStatus, operation=Event_INV_EM_STATOR_TEMP2_ELE_FLT.SetEventStatus
        OpEventSetEventStatus_SetEventStatus_Event_AURIX_RST_SNG: start-on-event=SetEventStatus, operation=Event_AURIX_RST_SNG.SetEventStatus
        OpEventSetEventStatus_SetEventStatus_Event_VCEvEcmPropFr24MgmFr01Tioutd: start-on-event=SetEventStatus, operation=Event_VCEvEcmPropFr24MgmFr01Tioutd.SetEventStatus
        OpEventSetEventStatus_SetEventStatus_Event_INV_RSLVR_COS_ELEC_OPEN: start-on-event=SetEventStatus, operation=Event_INV_RSLVR_COS_ELEC_OPEN.SetEventStatus
        OpEventSetEventStatus_SetEventStatus_Event_INV_IAC_V_ELEC_LO: start-on-event=SetEventStatus, operation=Event_INV_IAC_V_ELEC_LO.SetEventStatus
        OpEventSetEventStatus_SetEventStatus_Event_INV_IAC_W_OFFS: start-on-event=SetEventStatus, operation=Event_INV_IAC_W_OFFS.SetEventStatus
        OpEventSetEventStatus_SetEventStatus_Event_INV_EM_STATOR_TEMP2_GRDT: start-on-event=SetEventStatus, operation=Event_INV_EM_STATOR_TEMP2_GRDT.SetEventStatus
        OpEventSetEventStatus_SetEventStatus_Event_INV_EM_OVRSPD_HWP: start-on-event=SetEventStatus, operation=Event_INV_EM_OVRSPD_HWP.SetEventStatus
        OpEventSetEventStatus_SetEventStatus_Event_CU_TEMP_HWP: start-on-event=SetEventStatus, operation=Event_CU_TEMP_HWP.SetEventStatus
        OpEventSetEventStatus_SetEventStatus_Event_INV_UHVDC_1_RNG_HI: start-on-event=SetEventStatus, operation=Event_INV_UHVDC_1_RNG_HI.SetEventStatus
        OpEventSetEventStatus_SetEventStatus_Event_VcEvEMPerfPlaus: start-on-event=SetEventStatus, operation=Event_VcEvEMPerfPlaus.SetEventStatus
        OpEventSetEventStatus_SetEventStatus_Event_VCEvVddmPropFr18Tioutd: start-on-event=SetEventStatus, operation=Event_VCEvVddmPropFr18Tioutd.SetEventStatus
        OpEventSetEventStatus_SetEventStatus_Event_INV_IAC_U_ELEC_HWP: start-on-event=SetEventStatus, operation=Event_INV_IAC_U_ELEC_HWP.SetEventStatus
        OpEventSetEventStatus_SetEventStatus_Event_VCEvVddmPropFr15Tioutd: start-on-event=SetEventStatus, operation=Event_VCEvVddmPropFr15Tioutd.SetEventStatus
        OpEventSetEventStatus_SetEventStatus_Event_Ga_GADisengageFailure: start-on-event=SetEventStatus, operation=Event_Ga_GADisengageFailure.SetEventStatus
        OpEventSetEventStatus_SetEventStatus_Event_CU_TEMP2_RNG_LO: start-on-event=SetEventStatus, operation=Event_CU_TEMP2_RNG_LO.SetEventStatus
        OpEventSetEventStatus_SetEventStatus_Event_INV_RSLVR_SIN_ELEC_OPEN: start-on-event=SetEventStatus, operation=Event_INV_RSLVR_SIN_ELEC_OPEN.SetEventStatus
        OpEventSetEventStatus_SetEventStatus_Event_VcEvChkSum: start-on-event=SetEventStatus, operation=Event_VcEvChkSum.SetEventStatus

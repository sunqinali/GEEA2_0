AUTOSAR XML (schema 4-2-2)
package /MICROSAR/NvM_swc/ComponentTypes
  service sw component type NvM: category=SERVICE_COMPONENT
    behavior NvMInternalBehavior: handle-termination-and-restart=NO-SUPPORT
      timing event Timer_NvM_MainFunction: start-on-event=NvM_MainFunction, period=0.01
      runnable NvM_MainFunction
  swc implementation NvMImplementation: programming-language=C, behavior=NvMInternalBehavior

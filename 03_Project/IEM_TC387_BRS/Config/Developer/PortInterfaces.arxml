AUTOSAR XML (schema 00044)
package /Predefined_DEV/PortInterfaces
  43 x client server interface:
    NvMAdministration: is-service=true
      operation SetBlockProtection: possible-error=NvMAdministration/E_NOT_OK
        arg ProtectionEnabled: type=boolean, direction=IN, server-argument-impl-policy=USE-ARGUMENT-TYPE
      error E_NOT_OK: error-code=1
    NvMNotifyInitBlock: is-service=true
      operation InitBlock
    NvMNotifyJobFinished: is-service=true
      operation JobFinished
        arg ServiceId: type=NvM_ServiceIdType, direction=IN, server-argument-impl-policy=USE-ARGUMENT-TYPE
        arg JobResult: type=NvM_RequestResultType, direction=IN, server-argument-impl-policy=USE-ARGUMENT-TYPE
    NvMService: is-service=true
      operation GetErrorStatus: possible-error=NvMService/E_NOT_OK
        arg ErrorStatus: type=NvM_RequestResultType, direction=OUT, server-argument-impl-policy=USE-ARGUMENT-TYPE
      error E_NOT_OK: error-code=1
    NvMService_AC2: is-service=true
      operation GetErrorStatus: possible-error=NvMService_AC2/E_NOT_OK
        arg ErrorStatus: type=NvM_RequestResultType, direction=OUT, server-argument-impl-policy=USE-ARGUMENT-TYPE
      operation ReadBlock: possible-error=NvMService_AC2/E_NOT_OK
        arg DstPtr: type=dtRef_VOID, direction=IN, server-argument-impl-policy=USE-ARGUMENT-TYPE
      operation WriteBlock: possible-error=NvMService_AC2/E_NOT_OK
        arg SrcPtr: type=dtRef_const_VOID, direction=IN, server-argument-impl-policy=USE-ARGUMENT-TYPE
      error E_NOT_OK: error-code=1
    NvMService_AC2_Defs: is-service=true
      4 x operation, all with possible-error=NvMService_AC2_Defs/E_NOT_OK:
        GetErrorStatus
          arg ErrorStatus: type=NvM_RequestResultType, direction=OUT, server-argument-impl-policy=USE-ARGUMENT-TYPE
        ReadBlock
          arg DstPtr: type=dtRef_VOID, direction=IN, server-argument-impl-policy=USE-ARGUMENT-TYPE
        RestoreBlockDefaults
          arg DstPtr: type=dtRef_VOID, direction=IN, server-argument-impl-policy=USE-ARGUMENT-TYPE
        WriteBlock
          arg SrcPtr: type=dtRef_const_VOID, direction=IN, server-argument-impl-policy=USE-ARGUMENT-TYPE
      error E_NOT_OK: error-code=1
    NvMService_AC2_DS: is-service=true
      5 x operation, all with possible-error=NvMService_AC2_DS/E_NOT_OK:
        GetDataIndex
          arg DataIndex: type=uint8, direction=OUT, server-argument-impl-policy=USE-ARGUMENT-TYPE
        GetErrorStatus
          arg ErrorStatus: type=NvM_RequestResultType, direction=OUT, server-argument-impl-policy=USE-ARGUMENT-TYPE
        ReadBlock
          arg DstPtr: type=dtRef_VOID, direction=IN, server-argument-impl-policy=USE-ARGUMENT-TYPE
        SetDataIndex
          arg DataIndex: type=uint8, direction=IN, server-argument-impl-policy=USE-ARGUMENT-TYPE
        WriteBlock
          arg SrcPtr: type=dtRef_const_VOID, direction=IN, server-argument-impl-policy=USE-ARGUMENT-TYPE
      error E_NOT_OK: error-code=1
    NvMService_AC2_DS_Defs: is-service=true
      6 x operation, all with possible-error=NvMService_AC2_DS_Defs/E_NOT_OK:
        GetDataIndex
          arg DataIndex: type=uint8, direction=OUT, server-argument-impl-policy=USE-ARGUMENT-TYPE
        GetErrorStatus
          arg ErrorStatus: type=NvM_RequestResultType, direction=OUT, server-argument-impl-policy=USE-ARGUMENT-TYPE
        ReadBlock
          arg DstPtr: type=dtRef_VOID, direction=IN, server-argument-impl-policy=USE-ARGUMENT-TYPE
        RestoreBlockDefaults
          arg DstPtr: type=dtRef_VOID, direction=IN, server-argument-impl-policy=USE-ARGUMENT-TYPE
        SetDataIndex
          arg DataIndex: type=uint8, direction=IN, server-argument-impl-policy=USE-ARGUMENT-TYPE
        WriteBlock
          arg SrcPtr: type=dtRef_const_VOID, direction=IN, server-argument-impl-policy=USE-ARGUMENT-TYPE
      error E_NOT_OK: error-code=1
    NvMService_AC2_SRBS: is-service=true
      4 x operation, all with possible-error=NvMService_AC2_SRBS/E_NOT_OK:
        GetErrorStatus
          arg ErrorStatus: type=NvM_RequestResultType, direction=OUT, server-argument-impl-policy=USE-ARGUMENT-TYPE
        ReadBlock
          arg DstPtr: type=dtRef_VOID, direction=IN, server-argument-impl-policy=USE-ARGUMENT-TYPE
        SetRamBlockStatus
          arg RamBlockStatus: type=boolean, direction=IN, server-argument-impl-policy=USE-ARGUMENT-TYPE
        WriteBlock
          arg SrcPtr: type=dtRef_const_VOID, direction=IN, server-argument-impl-policy=USE-ARGUMENT-TYPE
      error E_NOT_OK: error-code=1
    NvMService_AC2_SRBS_Defs: is-service=true
      5 x operation, all with possible-error=NvMService_AC2_SRBS_Defs/E_NOT_OK:
        GetErrorStatus
          arg ErrorStatus: type=NvM_RequestResultType, direction=OUT, server-argument-impl-policy=USE-ARGUMENT-TYPE
        ReadBlock
          arg DstPtr: type=dtRef_VOID, direction=IN, server-argument-impl-policy=USE-ARGUMENT-TYPE
        RestoreBlockDefaults
          arg DstPtr: type=dtRef_VOID, direction=IN, server-argument-impl-policy=USE-ARGUMENT-TYPE
        SetRamBlockStatus
          arg RamBlockStatus: type=boolean, direction=IN, server-argument-impl-policy=USE-ARGUMENT-TYPE
        WriteBlock
          arg SrcPtr: type=dtRef_const_VOID, direction=IN, server-argument-impl-policy=USE-ARGUMENT-TYPE
      error E_NOT_OK: error-code=1
    NvMService_AC2_SRBS_DS: is-service=true
      6 x operation, all with possible-error=NvMService_AC2_SRBS_DS/E_NOT_OK:
        GetDataIndex
          arg DataIndex: type=uint8, direction=OUT, server-argument-impl-policy=USE-ARGUMENT-TYPE
        GetErrorStatus
          arg ErrorStatus: type=NvM_RequestResultType, direction=OUT, server-argument-impl-policy=USE-ARGUMENT-TYPE
        ReadBlock
          arg DstPtr: type=dtRef_VOID, direction=IN, server-argument-impl-policy=USE-ARGUMENT-TYPE
        SetDataIndex
          arg DataIndex: type=uint8, direction=IN, server-argument-impl-policy=USE-ARGUMENT-TYPE
        SetRamBlockStatus
          arg RamBlockStatus: type=boolean, direction=IN, server-argument-impl-policy=USE-ARGUMENT-TYPE
        WriteBlock
          arg SrcPtr: type=dtRef_const_VOID, direction=IN, server-argument-impl-policy=USE-ARGUMENT-TYPE
      error E_NOT_OK: error-code=1
    NvMService_AC2_SRBS_DS_Defs: is-service=true
      7 x operation, all with possible-error=NvMService_AC2_SRBS_DS_Defs/E_NOT_OK:
        GetDataIndex
          arg DataIndex: type=uint8, direction=OUT, server-argument-impl-policy=USE-ARGUMENT-TYPE
        GetErrorStatus
          arg ErrorStatus: type=NvM_RequestResultType, direction=OUT, server-argument-impl-policy=USE-ARGUMENT-TYPE
        ReadBlock
          arg DstPtr: type=dtRef_VOID, direction=IN, server-argument-impl-policy=USE-ARGUMENT-TYPE
        RestoreBlockDefaults
          arg DstPtr: type=dtRef_VOID, direction=IN, server-argument-impl-policy=USE-ARGUMENT-TYPE
        SetDataIndex
          arg DataIndex: type=uint8, direction=IN, server-argument-impl-policy=USE-ARGUMENT-TYPE
        SetRamBlockStatus
          arg RamBlockStatus: type=boolean, direction=IN, server-argument-impl-policy=USE-ARGUMENT-TYPE
        WriteBlock
          arg SrcPtr: type=dtRef_const_VOID, direction=IN, server-argument-impl-policy=USE-ARGUMENT-TYPE
      error E_NOT_OK: error-code=1
    NvMService_AC3: is-service=true
      5 x operation, all with possible-error=NvMService_AC3/E_NOT_OK:
        EraseBlock
        GetErrorStatus
          arg ErrorStatus: type=NvM_RequestResultType, direction=OUT, server-argument-impl-policy=USE-ARGUMENT-TYPE
        InvalidateNvBlock
        ReadBlock
          arg DstPtr: type=dtRef_VOID, direction=IN, server-argument-impl-policy=USE-ARGUMENT-TYPE
        WriteBlock
          arg SrcPtr: type=dtRef_const_VOID, direction=IN, server-argument-impl-policy=USE-ARGUMENT-TYPE
      error E_NOT_OK: error-code=1
    NvMService_AC3_Defs: is-service=true
      6 x operation, all with possible-error=NvMService_AC3_Defs/E_NOT_OK:
        EraseBlock
        GetErrorStatus
          arg ErrorStatus: type=NvM_RequestResultType, direction=OUT, server-argument-impl-policy=USE-ARGUMENT-TYPE
        InvalidateNvBlock
        ReadBlock
          arg DstPtr: type=dtRef_VOID, direction=IN, server-argument-impl-policy=USE-ARGUMENT-TYPE
        RestoreBlockDefaults
          arg DstPtr: type=dtRef_VOID, direction=IN, server-argument-impl-policy=USE-ARGUMENT-TYPE
        WriteBlock
          arg SrcPtr: type=dtRef_const_VOID, direction=IN, server-argument-impl-policy=USE-ARGUMENT-TYPE
      error E_NOT_OK: error-code=1
    NvMService_AC3_DS: is-service=true
      7 x operation, all with possible-error=NvMService_AC3_DS/E_NOT_OK:
        EraseBlock
        GetDataIndex
          arg DataIndex: type=uint8, direction=OUT, server-argument-impl-policy=USE-ARGUMENT-TYPE
        GetErrorStatus
          arg ErrorStatus: type=NvM_RequestResultType, direction=OUT, server-argument-impl-policy=USE-ARGUMENT-TYPE
        InvalidateNvBlock
        ReadBlock
          arg DstPtr: type=dtRef_VOID, direction=IN, server-argument-impl-policy=USE-ARGUMENT-TYPE
        SetDataIndex
          arg DataIndex: type=uint8, direction=IN, server-argument-impl-policy=USE-ARGUMENT-TYPE
        WriteBlock
          arg SrcPtr: type=dtRef_const_VOID, direction=IN, server-argument-impl-policy=USE-ARGUMENT-TYPE
      error E_NOT_OK: error-code=1
    NvMService_AC3_DS_Defs: is-service=true
      8 x operation, all with possible-error=NvMService_AC3_DS_Defs/E_NOT_OK:
        EraseBlock
        GetDataIndex
          arg DataIndex: type=uint8, direction=OUT, server-argument-impl-policy=USE-ARGUMENT-TYPE
        GetErrorStatus
          arg ErrorStatus: type=NvM_RequestResultType, direction=OUT, server-argument-impl-policy=USE-ARGUMENT-TYPE
        InvalidateNvBlock
        ReadBlock
          arg DstPtr: type=dtRef_VOID, direction=IN, server-argument-impl-policy=USE-ARGUMENT-TYPE
        RestoreBlockDefaults
          arg DstPtr: type=dtRef_VOID, direction=IN, server-argument-impl-policy=USE-ARGUMENT-TYPE
        SetDataIndex
          arg DataIndex: type=uint8, direction=IN, server-argument-impl-policy=USE-ARGUMENT-TYPE
        WriteBlock
          arg SrcPtr: type=dtRef_const_VOID, direction=IN, server-argument-impl-policy=USE-ARGUMENT-TYPE
      error E_NOT_OK: error-code=1
    NvMService_AC3_SRBS: is-service=true
      6 x operation, all with possible-error=NvMService_AC3_SRBS/E_NOT_OK:
        EraseBlock
        GetErrorStatus
          arg ErrorStatus: type=NvM_RequestResultType, direction=OUT, server-argument-impl-policy=USE-ARGUMENT-TYPE
        InvalidateNvBlock
        ReadBlock
          arg DstPtr: type=dtRef_VOID, direction=IN, server-argument-impl-policy=USE-ARGUMENT-TYPE
        SetRamBlockStatus
          arg RamBlockStatus: type=boolean, direction=IN, server-argument-impl-policy=USE-ARGUMENT-TYPE
        WriteBlock
          arg SrcPtr: type=dtRef_const_VOID, direction=IN, server-argument-impl-policy=USE-ARGUMENT-TYPE
      error E_NOT_OK: error-code=1
    NvMService_AC3_SRBS_Defs: is-service=true
      7 x operation, all with possible-error=NvMService_AC3_SRBS_Defs/E_NOT_OK:
        EraseBlock
        GetErrorStatus
          arg ErrorStatus: type=NvM_RequestResultType, direction=OUT, server-argument-impl-policy=USE-ARGUMENT-TYPE
        InvalidateNvBlock
        ReadBlock
          arg DstPtr: type=dtRef_VOID, direction=IN, server-argument-impl-policy=USE-ARGUMENT-TYPE
        RestoreBlockDefaults
          arg DstPtr: type=dtRef_VOID, direction=IN, server-argument-impl-policy=USE-ARGUMENT-TYPE
        SetRamBlockStatus
          arg RamBlockStatus: type=boolean, direction=IN, server-argument-impl-policy=USE-ARGUMENT-TYPE
        WriteBlock
          arg SrcPtr: type=dtRef_const_VOID, direction=IN, server-argument-impl-policy=USE-ARGUMENT-TYPE
      error E_NOT_OK: error-code=1
    NvMService_AC3_SRBS_DS: is-service=true
      8 x operation, all with possible-error=NvMService_AC3_SRBS_DS/E_NOT_OK:
        EraseBlock
        GetDataIndex
          arg DataIndex: type=uint8, direction=OUT, server-argument-impl-policy=USE-ARGUMENT-TYPE
        GetErrorStatus
          arg ErrorStatus: type=NvM_RequestResultType, direction=OUT, server-argument-impl-policy=USE-ARGUMENT-TYPE
        InvalidateNvBlock
        ReadBlock
          arg DstPtr: type=dtRef_VOID, direction=IN, server-argument-impl-policy=USE-ARGUMENT-TYPE
        SetDataIndex
          arg DataIndex: type=uint8, direction=IN, server-argument-impl-policy=USE-ARGUMENT-TYPE
        SetRamBlockStatus
          arg RamBlockStatus: type=boolean, direction=IN, server-argument-impl-policy=USE-ARGUMENT-TYPE
        WriteBlock
          arg SrcPtr: type=dtRef_const_VOID, direction=IN, server-argument-impl-policy=USE-ARGUMENT-TYPE
      error E_NOT_OK: error-code=1
    NvMService_AC3_SRBS_DS_Defs: is-service=true
      9 x operation, all with possible-error=NvMService_AC3_SRBS_DS_Defs/E_NOT_OK:
        EraseBlock
        GetDataIndex
          arg DataIndex: type=uint8, direction=OUT, server-argument-impl-policy=USE-ARGUMENT-TYPE
        GetErrorStatus
          arg ErrorStatus: type=NvM_RequestResultType, direction=OUT, server-argument-impl-policy=USE-ARGUMENT-TYPE
        InvalidateNvBlock
        ReadBlock
          arg DstPtr: type=dtRef_VOID, direction=IN, server-argument-impl-policy=USE-ARGUMENT-TYPE
        RestoreBlockDefaults
          arg DstPtr: type=dtRef_VOID, direction=IN, server-argument-impl-policy=USE-ARGUMENT-TYPE
        SetDataIndex
          arg DataIndex: type=uint8, direction=IN, server-argument-impl-policy=USE-ARGUMENT-TYPE
        SetRamBlockStatus
          arg RamBlockStatus: type=boolean, direction=IN, server-argument-impl-policy=USE-ARGUMENT-TYPE
        WriteBlock
          arg SrcPtr: type=dtRef_const_VOID, direction=IN, server-argument-impl-policy=USE-ARGUMENT-TYPE
      error E_NOT_OK: error-code=1
    NvMService_SRBS: is-service=true
      operation GetErrorStatus: possible-error=NvMService_SRBS/E_NOT_OK
        arg ErrorStatus: type=NvM_RequestResultType, direction=OUT, server-argument-impl-policy=USE-ARGUMENT-TYPE
      operation SetRamBlockStatus: possible-error=NvMService_SRBS/E_NOT_OK
        arg RamBlockStatus: type=boolean, direction=IN, server-argument-impl-policy=USE-ARGUMENT-TYPE
      error E_NOT_OK: error-code=1
    CallbackDTCStatusChange: is-service=true, service-kind=DIAGNOSTIC-EVENT-MANAGER
      operation DTCStatusChanged: possible-error=CallbackDTCStatusChange/E_NOT_OK
        arg DTC: type=uint32, direction=IN, server-argument-impl-policy=USE-ARGUMENT-TYPE
        arg DTCStatusOld: type=Dem_UdsStatusByteType, direction=IN, server-argument-impl-policy=USE-ARGUMENT-TYPE
        arg DTCStatusNew: type=Dem_UdsStatusByteType, direction=IN, server-argument-impl-policy=USE-ARGUMENT-TYPE
      error E_NOT_OK: error-code=1
    NvSWC_NvMAdministration
      operation SetBlockProtection: possible-error=NvSWC_NvMAdministration/E_NOT_OK
        arg ProtectionEnabled: type=boolean, direction=IN, server-argument-impl-policy=USE-ARGUMENT-TYPE
      error E_NOT_OK: error-code=1
    NvSWC_NvMNotifyInitBlock
      operation InitBlock
    NvSWC_NvMNotifyJobFinished
      operation JobFinished
        arg ServiceId: type=NvM_ServiceIdType, direction=IN, server-argument-impl-policy=USE-ARGUMENT-TYPE
        arg JobResult: type=NvM_RequestResultType, direction=IN, server-argument-impl-policy=USE-ARGUMENT-TYPE
    NvSWC_NvMService
      operation GetErrorStatus: possible-error=NvSWC_NvMService/E_NOT_OK
        arg ErrorStatus: type=NvM_RequestResultType, direction=OUT, server-argument-impl-policy=USE-ARGUMENT-TYPE
      error E_NOT_OK: error-code=1
    NvSWC_NvMService_AC2
      operation GetErrorStatus: possible-error=NvSWC_NvMService_AC2/E_NOT_OK
        arg ErrorStatus: type=NvM_RequestResultType, direction=OUT, server-argument-impl-policy=USE-ARGUMENT-TYPE
      operation ReadBlock: possible-error=NvSWC_NvMService_AC2/E_NOT_OK
        arg DstPtr: type=dtRef_VOID, direction=IN, server-argument-impl-policy=USE-ARGUMENT-TYPE
      operation WriteBlock: possible-error=NvSWC_NvMService_AC2/E_NOT_OK
        arg SrcPtr: type=dtRef_const_VOID, direction=IN, server-argument-impl-policy=USE-ARGUMENT-TYPE
      error E_NOT_OK: error-code=1
    NvSWC_NvMService_AC2_Defs
      4 x operation, all with possible-error=NvSWC_NvMService_AC2_Defs/E_NOT_OK:
        GetErrorStatus
          arg ErrorStatus: type=NvM_RequestResultType, direction=OUT, server-argument-impl-policy=USE-ARGUMENT-TYPE
        ReadBlock
          arg DstPtr: type=dtRef_VOID, direction=IN, server-argument-impl-policy=USE-ARGUMENT-TYPE
        RestoreBlockDefaults
          arg DstPtr: type=dtRef_VOID, direction=IN, server-argument-impl-policy=USE-ARGUMENT-TYPE
        WriteBlock
          arg SrcPtr: type=dtRef_const_VOID, direction=IN, server-argument-impl-policy=USE-ARGUMENT-TYPE
      error E_NOT_OK: error-code=1
    NvSWC_NvMService_AC2_DS
      5 x operation, all with possible-error=NvSWC_NvMService_AC2_DS/E_NOT_OK:
        GetDataIndex
          arg DataIndex: type=uint8, direction=OUT, server-argument-impl-policy=USE-ARGUMENT-TYPE
        GetErrorStatus
          arg ErrorStatus: type=NvM_RequestResultType, direction=OUT, server-argument-impl-policy=USE-ARGUMENT-TYPE
        ReadBlock
          arg DstPtr: type=dtRef_VOID, direction=IN, server-argument-impl-policy=USE-ARGUMENT-TYPE
        SetDataIndex
          arg DataIndex: type=uint8, direction=IN, server-argument-impl-policy=USE-ARGUMENT-TYPE
        WriteBlock
          arg SrcPtr: type=dtRef_const_VOID, direction=IN, server-argument-impl-policy=USE-ARGUMENT-TYPE
      error E_NOT_OK: error-code=1
    NvSWC_NvMService_AC2_DS_Defs
      6 x operation, all with possible-error=NvSWC_NvMService_AC2_DS_Defs/E_NOT_OK:
        GetDataIndex
          arg DataIndex: type=uint8, direction=OUT, server-argument-impl-policy=USE-ARGUMENT-TYPE
        GetErrorStatus
          arg ErrorStatus: type=NvM_RequestResultType, direction=OUT, server-argument-impl-policy=USE-ARGUMENT-TYPE
        ReadBlock
          arg DstPtr: type=dtRef_VOID, direction=IN, server-argument-impl-policy=USE-ARGUMENT-TYPE
        RestoreBlockDefaults
          arg DstPtr: type=dtRef_VOID, direction=IN, server-argument-impl-policy=USE-ARGUMENT-TYPE
        SetDataIndex
          arg DataIndex: type=uint8, direction=IN, server-argument-impl-policy=USE-ARGUMENT-TYPE
        WriteBlock
          arg SrcPtr: type=dtRef_const_VOID, direction=IN, server-argument-impl-policy=USE-ARGUMENT-TYPE
      error E_NOT_OK: error-code=1
    NvSWC_NvMService_AC2_SRBS
      4 x operation, all with possible-error=NvSWC_NvMService_AC2_SRBS/E_NOT_OK:
        GetErrorStatus
          arg ErrorStatus: type=NvM_RequestResultType, direction=OUT, server-argument-impl-policy=USE-ARGUMENT-TYPE
        ReadBlock
          arg DstPtr: type=dtRef_VOID, direction=IN, server-argument-impl-policy=USE-ARGUMENT-TYPE
        SetRamBlockStatus
          arg RamBlockStatus: type=boolean, direction=IN, server-argument-impl-policy=USE-ARGUMENT-TYPE
        WriteBlock
          arg SrcPtr: type=dtRef_const_VOID, direction=IN, server-argument-impl-policy=USE-ARGUMENT-TYPE
      error E_NOT_OK: error-code=1
    NvSWC_NvMService_AC2_SRBS_Defs
      5 x operation, all with possible-error=NvSWC_NvMService_AC2_SRBS_Defs/E_NOT_OK:
        GetErrorStatus
          arg ErrorStatus: type=NvM_RequestResultType, direction=OUT, server-argument-impl-policy=USE-ARGUMENT-TYPE
        ReadBlock
          arg DstPtr: type=dtRef_VOID, direction=IN, server-argument-impl-policy=USE-ARGUMENT-TYPE
        RestoreBlockDefaults
          arg DstPtr: type=dtRef_VOID, direction=IN, server-argument-impl-policy=USE-ARGUMENT-TYPE
        SetRamBlockStatus
          arg RamBlockStatus: type=boolean, direction=IN, server-argument-impl-policy=USE-ARGUMENT-TYPE
        WriteBlock
          arg SrcPtr: type=dtRef_const_VOID, direction=IN, server-argument-impl-policy=USE-ARGUMENT-TYPE
      error E_NOT_OK: error-code=1
    NvSWC_NvMService_AC2_SRBS_DS
      6 x operation, all with possible-error=NvSWC_NvMService_AC2_SRBS_DS/E_NOT_OK:
        GetDataIndex
          arg DataIndex: type=uint8, direction=OUT, server-argument-impl-policy=USE-ARGUMENT-TYPE
        GetErrorStatus
          arg ErrorStatus: type=NvM_RequestResultType, direction=OUT, server-argument-impl-policy=USE-ARGUMENT-TYPE
        ReadBlock
          arg DstPtr: type=dtRef_VOID, direction=IN, server-argument-impl-policy=USE-ARGUMENT-TYPE
        SetDataIndex
          arg DataIndex: type=uint8, direction=IN, server-argument-impl-policy=USE-ARGUMENT-TYPE
        SetRamBlockStatus
          arg RamBlockStatus: type=boolean, direction=IN, server-argument-impl-policy=USE-ARGUMENT-TYPE
        WriteBlock
          arg SrcPtr: type=dtRef_const_VOID, direction=IN, server-argument-impl-policy=USE-ARGUMENT-TYPE
      error E_NOT_OK: error-code=1
    NvSWC_NvMService_AC2_SRBS_DS_Defs
      7 x operation, all with possible-error=NvSWC_NvMService_AC2_SRBS_DS_Defs/E_NOT_OK:
        GetDataIndex
          arg DataIndex: type=uint8, direction=OUT, server-argument-impl-policy=USE-ARGUMENT-TYPE
        GetErrorStatus
          arg ErrorStatus: type=NvM_RequestResultType, direction=OUT, server-argument-impl-policy=USE-ARGUMENT-TYPE
        ReadBlock
          arg DstPtr: type=dtRef_VOID, direction=IN, server-argument-impl-policy=USE-ARGUMENT-TYPE
        RestoreBlockDefaults
          arg DstPtr: type=dtRef_VOID, direction=IN, server-argument-impl-policy=USE-ARGUMENT-TYPE
        SetDataIndex
          arg DataIndex: type=uint8, direction=IN, server-argument-impl-policy=USE-ARGUMENT-TYPE
        SetRamBlockStatus
          arg RamBlockStatus: type=boolean, direction=IN, server-argument-impl-policy=USE-ARGUMENT-TYPE
        WriteBlock
          arg SrcPtr: type=dtRef_const_VOID, direction=IN, server-argument-impl-policy=USE-ARGUMENT-TYPE
      error E_NOT_OK: error-code=1
    NvSWC_NvMService_AC3
      5 x operation, all with possible-error=NvSWC_NvMService_AC3/E_NOT_OK:
        EraseBlock
        GetErrorStatus
          arg ErrorStatus: type=NvM_RequestResultType, direction=OUT, server-argument-impl-policy=USE-ARGUMENT-TYPE
        InvalidateNvBlock
        ReadBlock
          arg DstPtr: type=dtRef_VOID, direction=IN, server-argument-impl-policy=USE-ARGUMENT-TYPE
        WriteBlock
          arg SrcPtr: type=dtRef_const_VOID, direction=IN, server-argument-impl-policy=USE-ARGUMENT-TYPE
      error E_NOT_OK: error-code=1
    NvSWC_NvMService_AC3_Defs
      6 x operation, all with possible-error=NvSWC_NvMService_AC3_Defs/E_NOT_OK:
        EraseBlock
        GetErrorStatus
          arg ErrorStatus: type=NvM_RequestResultType, direction=OUT, server-argument-impl-policy=USE-ARGUMENT-TYPE
        InvalidateNvBlock
        ReadBlock
          arg DstPtr: type=dtRef_VOID, direction=IN, server-argument-impl-policy=USE-ARGUMENT-TYPE
        RestoreBlockDefaults
          arg DstPtr: type=dtRef_VOID, direction=IN, server-argument-impl-policy=USE-ARGUMENT-TYPE
        WriteBlock
          arg SrcPtr: type=dtRef_const_VOID, direction=IN, server-argument-impl-policy=USE-ARGUMENT-TYPE
      error E_NOT_OK: error-code=1
    NvSWC_NvMService_AC3_DS
      7 x operation, all with possible-error=NvSWC_NvMService_AC3_DS/E_NOT_OK:
        EraseBlock
        GetDataIndex
          arg DataIndex: type=uint8, direction=OUT, server-argument-impl-policy=USE-ARGUMENT-TYPE
        GetErrorStatus
          arg ErrorStatus: type=NvM_RequestResultType, direction=OUT, server-argument-impl-policy=USE-ARGUMENT-TYPE
        InvalidateNvBlock
        ReadBlock
          arg DstPtr: type=dtRef_VOID, direction=IN, server-argument-impl-policy=USE-ARGUMENT-TYPE
        SetDataIndex
          arg DataIndex: type=uint8, direction=IN, server-argument-impl-policy=USE-ARGUMENT-TYPE
        WriteBlock
          arg SrcPtr: type=dtRef_const_VOID, direction=IN, server-argument-impl-policy=USE-ARGUMENT-TYPE
      error E_NOT_OK: error-code=1
    NvSWC_NvMService_AC3_DS_Defs
      8 x operation, all with possible-error=NvSWC_NvMService_AC3_DS_Defs/E_NOT_OK:
        EraseBlock
        GetDataIndex
          arg DataIndex: type=uint8, direction=OUT, server-argument-impl-policy=USE-ARGUMENT-TYPE
        GetErrorStatus
          arg ErrorStatus: type=NvM_RequestResultType, direction=OUT, server-argument-impl-policy=USE-ARGUMENT-TYPE
        InvalidateNvBlock
        ReadBlock
          arg DstPtr: type=dtRef_VOID, direction=IN, server-argument-impl-policy=USE-ARGUMENT-TYPE
        RestoreBlockDefaults
          arg DstPtr: type=dtRef_VOID, direction=IN, server-argument-impl-policy=USE-ARGUMENT-TYPE
        SetDataIndex
          arg DataIndex: type=uint8, direction=IN, server-argument-impl-policy=USE-ARGUMENT-TYPE
        WriteBlock
          arg SrcPtr: type=dtRef_const_VOID, direction=IN, server-argument-impl-policy=USE-ARGUMENT-TYPE
      error E_NOT_OK: error-code=1
    NvSWC_NvMService_AC3_SRBS
      6 x operation, all with possible-error=NvSWC_NvMService_AC3_SRBS/E_NOT_OK:
        EraseBlock
        GetErrorStatus
          arg ErrorStatus: type=NvM_RequestResultType, direction=OUT, server-argument-impl-policy=USE-ARGUMENT-TYPE
        InvalidateNvBlock
        ReadBlock
          arg DstPtr: type=dtRef_VOID, direction=IN, server-argument-impl-policy=USE-ARGUMENT-TYPE
        SetRamBlockStatus
          arg RamBlockStatus: type=boolean, direction=IN, server-argument-impl-policy=USE-ARGUMENT-TYPE
        WriteBlock
          arg SrcPtr: type=dtRef_const_VOID, direction=IN, server-argument-impl-policy=USE-ARGUMENT-TYPE
      error E_NOT_OK: error-code=1
    NvSWC_NvMService_AC3_SRBS_Defs
      7 x operation, all with possible-error=NvSWC_NvMService_AC3_SRBS_Defs/E_NOT_OK:
        EraseBlock
        GetErrorStatus
          arg ErrorStatus: type=NvM_RequestResultType, direction=OUT, server-argument-impl-policy=USE-ARGUMENT-TYPE
        InvalidateNvBlock
        ReadBlock
          arg DstPtr: type=dtRef_VOID, direction=IN, server-argument-impl-policy=USE-ARGUMENT-TYPE
        RestoreBlockDefaults
          arg DstPtr: type=dtRef_VOID, direction=IN, server-argument-impl-policy=USE-ARGUMENT-TYPE
        SetRamBlockStatus
          arg RamBlockStatus: type=boolean, direction=IN, server-argument-impl-policy=USE-ARGUMENT-TYPE
        WriteBlock
          arg SrcPtr: type=dtRef_const_VOID, direction=IN, server-argument-impl-policy=USE-ARGUMENT-TYPE
      error E_NOT_OK: error-code=1
    NvSWC_NvMService_AC3_SRBS_DS
      8 x operation, all with possible-error=NvSWC_NvMService_AC3_SRBS_DS/E_NOT_OK:
        EraseBlock
        GetDataIndex
          arg DataIndex: type=uint8, direction=OUT, server-argument-impl-policy=USE-ARGUMENT-TYPE
        GetErrorStatus
          arg ErrorStatus: type=NvM_RequestResultType, direction=OUT, server-argument-impl-policy=USE-ARGUMENT-TYPE
        InvalidateNvBlock
        ReadBlock
          arg DstPtr: type=dtRef_VOID, direction=IN, server-argument-impl-policy=USE-ARGUMENT-TYPE
        SetDataIndex
          arg DataIndex: type=uint8, direction=IN, server-argument-impl-policy=USE-ARGUMENT-TYPE
        SetRamBlockStatus
          arg RamBlockStatus: type=boolean, direction=IN, server-argument-impl-policy=USE-ARGUMENT-TYPE
        WriteBlock
          arg SrcPtr: type=dtRef_const_VOID, direction=IN, server-argument-impl-policy=USE-ARGUMENT-TYPE
      error E_NOT_OK: error-code=1
    NvSWC_NvMService_AC3_SRBS_DS_Defs
      9 x operation, all with possible-error=NvSWC_NvMService_AC3_SRBS_DS_Defs/E_NOT_OK:
        EraseBlock
        GetDataIndex
          arg DataIndex: type=uint8, direction=OUT, server-argument-impl-policy=USE-ARGUMENT-TYPE
        GetErrorStatus
          arg ErrorStatus: type=NvM_RequestResultType, direction=OUT, server-argument-impl-policy=USE-ARGUMENT-TYPE
        InvalidateNvBlock
        ReadBlock
          arg DstPtr: type=dtRef_VOID, direction=IN, server-argument-impl-policy=USE-ARGUMENT-TYPE
        RestoreBlockDefaults
          arg DstPtr: type=dtRef_VOID, direction=IN, server-argument-impl-policy=USE-ARGUMENT-TYPE
        SetDataIndex
          arg DataIndex: type=uint8, direction=IN, server-argument-impl-policy=USE-ARGUMENT-TYPE
        SetRamBlockStatus
          arg RamBlockStatus: type=boolean, direction=IN, server-argument-impl-policy=USE-ARGUMENT-TYPE
        WriteBlock
          arg SrcPtr: type=dtRef_const_VOID, direction=IN, server-argument-impl-policy=USE-ARGUMENT-TYPE
      error E_NOT_OK: error-code=1
    NvSWC_NvMService_SRBS
      operation GetErrorStatus: possible-error=NvSWC_NvMService_SRBS/E_NOT_OK
        arg ErrorStatus: type=NvM_RequestResultType, direction=OUT, server-argument-impl-policy=USE-ARGUMENT-TYPE
      operation SetRamBlockStatus: possible-error=NvSWC_NvMService_SRBS/E_NOT_OK
        arg RamBlockStatus: type=boolean, direction=IN, server-argument-impl-policy=USE-ARGUMENT-TYPE
      error E_NOT_OK: error-code=1
package /PortInterfaces
  64 x sender receiver interface:
    DmcStsRearToEsc_2
      data DmcStsRearToEsc: type=DmcStsToEsc_1
    ImobEngChk2_4
      data ImobEngChk2: type=ImobEngChk_2
    ImobEngSts2_4
      data ImobEngSts2: type=ImobSts_2
    IEMTestFr1_1
      data IEMTestFr1: type=DevDataTyp64_2
    IEMTestFr2_1
      data IEMTestFr2: type=DevDataTyp64_2
    IEMTestFr3_3
      data IEMTestFr3: type=DevDataTyp64_2
    WhlMotSysCoolgReq_4
      data WhlMotSysCoolgReq: type=HvCoolg1_2
    WhlMotSysInvrT_4
      data WhlMotSysInvrT: type=T3_2
    WhlMotSysMotT_3
      data WhlMotSysMotT: type=T3_2
    WhlMotSysCooltT_4
      data WhlMotSysCooltT: type=HvT1_3
    WhlMotSysHeatPwrMax_1
      data WhlMotSysHeatPwrMax: type=IsgHeatPwr_1
    WhlMotSysHeatFdBck_1
      data WhlMotSysHeatFdBck: type=WhlMotSysHeatFdBck_1
    WhlMotSysHeatPwrAct_1
      data WhlMotSysHeatPwrAct: type=IsgHeatPwr_1
    WhlMotSysModSts_5
      data WhlMotSysModSts: type=WhlMotSysModStsTyp2_2
    WhlMotSysLimnIndcn_3
      data WhlMotSysLimnIndcn: type=UInt16_2
    WhlMotClrRdyReq_4
      data WhlMotClrRdyReq: type=OnOff1_2
    WhlMotSysErrIndcnReq_4
      data WhlMotSysErrIndcnReq: type=OnOff1_2
    IemGeneric_12
      data IemGeneric: type=ElecDrvGen_4
    WhlMotSysIdc_5
      data WhlMotSysIdc: type=Ampr1_1
    WhlMotSysUdc_3
      data WhlMotSysUdc: type=HvU1_2
    WhlMotCooltFlowMinReq_2
      data WhlMotCooltFlowMinReq: type=CooltFlowForDtElec1_2
    WhlMotSysSpdAct_4
      data WhlMotSysSpdAct: type=IsgSpdWSgnTyp_2
    WhlMotSysTqAvl_4
      data WhlMotSysTqAvl: type=WhlMotSysTqAvl_2
    WhlMotSysTqEst_10
      data WhlMotSysTqEst: type=IsgTqActSafe2_4
    WhlMotSysSpdActSafe_1
      data WhlMotSysSpdActSafe: type=SpdSgnSafe_1
    PLockParkStsRe_1
      data PLockParkStsRe: type=ParkSts_1
    PLockFltIndcRe_1
      data PLockFltIndcRe: type=FltIndcn_1
    PLockFltLvlRe_1
      data PLockFltLvlRe: type=FltLvl_1
    WhlMotSysTqReq_2
      data WhlMotSysTqReq: type=HvTq1_2
    GearLvrIndcn_6
      data GearLvrIndcn: type=GearLvrIndcn2_2
    StcStsToDmc_3
      data StcStsToDmc: type=StcStsToDmc_1
    EscVariantToDmc_1
      data EscVariantToDmc: type=EscVariantToDmc_1
    CarTiGlb_5
      data CarTiGlb: type=CarTiGlb_2
    VehModMngtGlbSafe1_7
      data VehModMngtGlbSafe1: type=VehModMngtGlbSafe1_2
    VehBattU_8
      data VehBattU: type=SysU_4
    BkpOfDstTrvld_7
      data BkpOfDstTrvld: type=Len31_2
    VehCfgPrm_5
      data VehCfgPrm: type=VehCfgPrm_3
    VehCfgPrmExt_2
      data VehCfgPrmExt: type=VehCfgPrm_3
    ImobEngMgrReq2_4
      data ImobEngMgrReq2: type=ImobEngMgrReq_2
    EngSt1WdSts_4
      data EngSt1WdSts: type=EngSt1WdSts_1
    VehSpdLgt_15
      data VehSpdLgt: type=VehSpdLgtSafe1_3
    HvSysRlySts_8
      data HvSysRlySts: type=HvSysRlySts_1
    CooltFlowForDtElec_5
      data CooltFlowForDtElec: type=CooltFlow2_2
    CooltTSigForDtElec_5
      data CooltTSigForDtElec: type=CooltTHiResl_2
    WhlMotSysModReq_2
      data WhlMotSysModReq: type=WhlMotSysModStsTyp1_2
    WhlMotSysActvDampgModReq_2
      data WhlMotSysActvDampgModReq: type=WhlMotSysActvDampgModCodSts_2
    WhlMotSysPwrLimMax_2
      data WhlMotSysPwrLimMax: type=PrpsnPwrLimMax_2
    WhlMotSysPwrLimMin_2
      data WhlMotSysPwrLimMin: type=PrpsnPwrLimMin_2
    PrpsnFbLimnIndcn_2
      data PrpsnFbLimnIndcn: type=UInt4_2
    DrvgCyc_3
      data DrvgCyc: type=OnOff1_2
    RearHeatModEnad_2
      data RearHeatModEnad: type=FrntHeatModEnad_1
    RearHeatPwrAllwd_1
      data RearHeatPwrAllwd: type=IsgHeatPwr_1
    PtTqAtAxleMaxReq_2
      data PtTqAtAxleMaxReq: type=PtTqAtAxleReq_1
    VehMtnSt_10
      data VehMtnSt: type=VehMtnStSafe1_2
    CrashStsSafe_2
      data CrashStsSafe: type=CrashStsSafe_1
    WhlMotSysTqAllwd_7
      data WhlMotSysTqAllwd: type=WhlMotSysTqAllwd_3
    HvBattSoc_2
      data HvBattSoc: type=Perc7_2
    HvBattUDynMinLim_4
      data HvBattUDynMinLim: type=HvU1_2
    HvBattUDynMaxLim_4
      data HvBattUDynMaxLim: type=HvU1_2
    HvBattUDc_3
      data HvBattUDc: type=HvU1_2
    SpdRotlForWhlsAtAxleRe_7
      data SpdRotlForWhlsAtAxleRe: type=N1_2
    PLockParkReq_1
      data PLockParkReq: type=PLockParkRequest_1
    DCChrgnHndlSts_5
      data DCChrgnHndlSts: type=OnBdChrgrHndlSts_2
    OnBdChrgrHndlSts1_8
      data OnBdChrgrHndlSts1: type=OnBdChrgrHndlSts1_2

AUTOSAR XML (schema 00048)
package /ECUCompositionTypes
  composition sw component type ECU_Composition
package /EndToEndProtections
  end to end protection set EndToEndProtectionSet
package /Systems
  system IEM_TC387_BRS
    root-software-compositions:
      root sw composition prototype EcuSwComposition: software-composition=ECU_Composition

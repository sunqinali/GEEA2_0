AUTOSAR XML (schema 00048)
package /ActiveEcuC
  ecuc value collection ActiveEcuC: ecu-extract=SYSTEM
    ecuc-values:
      vBRS
      vLinkGen
      vBaseEnv
      Com
      Mcu
      Rte
      EcuM
      CanNm
      Os
      PduR
      Dem
      CanSM
      Dcm
      CanTp
      Nm
      Can
      CanIf
      Det
      ComM
      EcuC
      BswM
      vSet
      McalLib
      Port
      Spi
      ResourceM
      CanTrcv
      Fls
      Fee
      MemIf
      NvM
      Crc

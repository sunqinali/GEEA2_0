AUTOSAR XML (schema 4-2-2)
package /ActiveEcuC
  module config CanIf: implementation-config-variant=VARIANT-PRE-COMPILE, module-description=CanIf_Impl
    CanIfCtrlDrvCfg_7d254554 (CanIfCtrlDrvCfg): CanIfCtrlDrvTxCancellation=false, CanIfCtrlDrvInitHohConfigRef=CanIfInitHohCfg, CanIfCtrlDrvNameRef=CanGeneral
      PropulsionCAN_6c6185ef (CanIfCtrlCfg):
        CanIfCtrlId = 0
        CanIfCtrlWakeupSupport = false
        CanIfCtrlJ1939DynAddrSupport = DISABLED
        CanIfCtrlCanCtrlRef = PropulsionCAN_6c6185ef
        CanIfCtrlTrcvCfgRef = CanIfTrcvCfg_Tja1145
    CanIfDispatchCfg:
      CanIfDispatchUserCtrlBusOffName = CanSM_ControllerBusOff
      CanIfDispatchUserCtrlBusOffUL = CAN_SM
      CanIfDispatchUserCtrlModeIndicationName = CanSM_ControllerModeIndication
      CanIfDispatchUserCtrlModeIndicationUL = CAN_SM
      CanIfDispatchUserTrcvModeIndicationUL = CAN_SM
      CanIfDispatchUserTrcvModeIndicationName = CanSM_TransceiverModeIndication
      CanIfDispatchUserClearTrcvWufFlagIndicationUL = CAN_SM
      CanIfDispatchUserClearTrcvWufFlagIndicationName = CanSM_ClearTrcvWufFlagIndication
      CanIfDispatchUserCheckTrcvWakeFlagIndicationUL = CAN_SM
      CanIfDispatchUserCheckTrcvWakeFlagIndicationName = CanSM_CheckTransceiverWakeFlagIndication
      CanIfDispatchUserConfirmPnAvailabilityUL = CAN_SM
      CanIfDispatchUserConfirmPnAvailabilityName = CanSM_ConfirmPnAvailability
    CanIfInitCfg
      3 x CanIfRxPduCfg, all with CanIfRxPduCanIdType=STANDARD_NO_FD_CAN, CanIfRxPduDlc=8, CanIfRxPduUserRxIndicationName=PduR_CanIfRxIndication, CanIfRxPduUserRxIndicationUL=PDUR, CanIfRxPduReadData=false, CanIfRxPduReadNotifyStatus=false, CanIfRxPduDlcCheck=true, CanIfRxPduHrhIdRef=PropulsionCAN_IEM_751e9595_Rx:
        ECMPropSignalIPDU05_2f6d9a8f_Rx: CanIfRxPduCanId=132, CanIfRxPduId=27, CanIfRxPduRef=ECMPropSignalIPDU05_3c755f85_Rx
        BecmPropSignalIpdu01_76d31607_Rx: CanIfRxPduCanId=321, CanIfRxPduId=22, CanIfRxPduRef=BecmPropSignalIpdu01_e4f1b6c7_Rx
        CddObcPropSignalIPdu01_e083acac_Rx: CanIfRxPduCanId=536, CanIfRxPduId=14, CanIfRxPduRef=CddObcPropSignalIPdu01_1ee0577a_Rx
      IemPropSignalIPdu09_40f13570_Tx (CanIfTxPduCfg):
        CanIfTxPduCanId = 1126
        CanIfTxPduCanIdType = STANDARD_CAN
        CanIfTxPduDlc = 8
        CanIfTxPduUserTxConfirmationName = PduR_CanIfTxConfirmation
        CanIfTxPduUserTxConfirmationUL = PDUR
        CanIfTxPduId = 6
        CanIfTxPduReadNotifyStatus = false
        CanIfTxPduType = STATIC
        CanIfTxPduTruncation = true
        CanIfTxPduBufferRef = PropulsionCAN_c77d42b7
        CanIfTxPduRef = IemPropSignalIPdu09_aee91317_Tx
      5 x CanIfRxPduCfg, all with CanIfRxPduCanIdType=STANDARD_NO_FD_CAN, CanIfRxPduDlc=8, CanIfRxPduReadData=false, CanIfRxPduReadNotifyStatus=false, CanIfRxPduDlcCheck=true, CanIfRxPduHrhIdRef=PropulsionCAN_IEM_751e9595_Rx:
        VddmToIemPropDiagReqNpdu_0145b13a_Rx: CanIfRxPduCanId=1847, CanIfRxPduUserRxIndicationName=CanTp_RxIndication, CanIfRxPduUserRxIndicationType=PDUID_PDUINFOPTR, CanIfRxPduUserRxIndicationUL=CAN_TP, CanIfRxPduId=7, CanIfRxPduRef=VddmToIemPropDiagReqNpdu_b1f6d800_Rx
        ECMPropSignalIPDU02_51c8c183_Rx: CanIfRxPduCanId=102, CanIfRxPduUserRxIndicationName=PduR_CanIfRxIndication, CanIfRxPduUserRxIndicationUL=PDUR, CanIfRxPduId=29, CanIfRxPduRef=ECMPropSignalIPDU02_2a2da2a9_Rx
        VDDMPropSignalIPDU08_9fd219ec_Rx: CanIfRxPduCanId=65, CanIfRxPduUserRxIndicationName=PduR_CanIfRxIndication, CanIfRxPduUserRxIndicationUL=PDUR, CanIfRxPduId=32, CanIfRxPduRef=VDDMPropSignalIPDU08_146446f0_Rx
        EcmPropSignalIPDU08_d4897b05_Rx: CanIfRxPduCanId=369, CanIfRxPduUserRxIndicationName=PduR_CanIfRxIndication, CanIfRxPduUserRxIndicationUL=PDUR, CanIfRxPduId=18, CanIfRxPduRef=EcmPropSignalIPDU08_f2c9e4fc_Rx
        VgmToAllFuncJ1979OBDPropCanReqNpdu11_68e7dbfc_Rx: CanIfRxPduCanId=2015, CanIfRxPduUserRxIndicationName=CanTp_RxIndication, CanIfRxPduUserRxIndicationType=PDUID_PDUINFOPTR, CanIfRxPduUserRxIndicationUL=CAN_TP, CanIfRxPduId=6, CanIfRxPduRef=VgmToAllFuncJ1979OBDPropCanReqNpdu11_a7af92b3_Rx
      IemPropSignalIPdu04_8bf47ab4_Tx (CanIfTxPduCfg):
        CanIfTxPduCanId = 613
        CanIfTxPduCanIdType = STANDARD_CAN
        CanIfTxPduDlc = 8
        CanIfTxPduUserTxConfirmationName = PduR_CanIfTxConfirmation
        CanIfTxPduUserTxConfirmationUL = PDUR
        CanIfTxPduId = 12
        CanIfTxPduReadNotifyStatus = false
        CanIfTxPduType = STATIC
        CanIfTxPduTruncation = true
        CanIfTxPduBufferRef = PropulsionCAN_c77d42b7
        CanIfTxPduRef = IemPropSignalIPdu04_cfb0e928_Tx
      IemPropSignalIPdu07_bdbb8368_Tx (CanIfTxPduCfg):
        CanIfTxPduCanId = 643
        CanIfTxPduCanIdType = STANDARD_CAN
        CanIfTxPduDlc = 8
        CanIfTxPduUserTxConfirmationName = PduR_CanIfTxConfirmation
        CanIfTxPduUserTxConfirmationUL = PDUR
        CanIfTxPduId = 10
        CanIfTxPduReadNotifyStatus = false
        CanIfTxPduType = STATIC
        CanIfTxPduTruncation = true
        CanIfTxPduBufferRef = PropulsionCAN_c77d42b7
        CanIfTxPduRef = IemPropSignalIPdu07_8258e94f_Tx
      CanIfInitHohCfg: CanIfInitRefCfgSet=CanConfigSet
        PropulsionCAN_IEM_19020f5a_Tx (CanIfHthCfg): CanIfHthCanCtrlIdRef=PropulsionCAN_6c6185ef, CanIfHthIdSymRef=PropulsionCAN_IEM_19020f5a_Tx
        PropulsionCAN_IEM_751e9595_Rx (CanIfHrhCfg): CanIfHrhSoftwareFilter=true, CanIfHrhCanCtrlIdRef=PropulsionCAN_6c6185ef, CanIfHrhIdSymRef=PropulsionCAN_IEM_751e9595_Rx
      3 x CanIfRxPduCfg, all with CanIfRxPduCanIdType=STANDARD_NO_FD_CAN, CanIfRxPduDlc=8, CanIfRxPduUserRxIndicationName=PduR_CanIfRxIndication, CanIfRxPduUserRxIndicationUL=PDUR, CanIfRxPduReadData=false, CanIfRxPduReadNotifyStatus=false, CanIfRxPduDlcCheck=true, CanIfRxPduHrhIdRef=PropulsionCAN_IEM_751e9595_Rx:
        ECMPropSignalIPDU04_3d57323b_Rx: CanIfRxPduCanId=305, CanIfRxPduId=24, CanIfRxPduRef=ECMPropSignalIPDU04_b1fda267_Rx
        VDDMPropSignalIPDU05_c80f18fa_Rx: CanIfRxPduCanId=118, CanIfRxPduId=28, CanIfRxPduRef=VDDMPropSignalIPDU05_753dbccf_Rx
        EcmPropSignalIPDU11_9b78db2c_Rx: CanIfRxPduCanId=647, CanIfRxPduId=8, CanIfRxPduRef=EcmPropSignalIPDU11_86a9e821_Rx
      IemPropSignalIPdu02_e76b890c_Tx (CanIfTxPduCfg):
        CanIfTxPduCanId = 1125
        CanIfTxPduCanIdType = STANDARD_CAN
        CanIfTxPduDlc = 8
        CanIfTxPduUserTxConfirmationName = PduR_CanIfTxConfirmation
        CanIfTxPduUserTxConfirmationUL = PDUR
        CanIfTxPduId = 7
        CanIfTxPduReadNotifyStatus = false
        CanIfTxPduType = STATIC
        CanIfTxPduTruncation = true
        CanIfTxPduBufferRef = PropulsionCAN_c77d42b7
        CanIfTxPduRef = IemPropSignalIPdu02_5460e9e6_Tx
      6 x CanIfRxPduCfg, all with CanIfRxPduCanIdType=STANDARD_NO_FD_CAN, CanIfRxPduDlc=8, CanIfRxPduReadData=false, CanIfRxPduReadNotifyStatus=false, CanIfRxPduDlcCheck=true, CanIfRxPduHrhIdRef=PropulsionCAN_IEM_751e9595_Rx:
        VDDMPropSignalIPDU17_17078e45_Rx: CanIfRxPduCanId=354, CanIfRxPduUserRxIndicationName=PduR_CanIfRxIndication, CanIfRxPduUserRxIndicationUL=PDUR, CanIfRxPduId=19, CanIfRxPduRef=VDDMPropSignalIPDU17_fbd44ae3_Rx
        VddmBcmPropdTCSignalIPDU01_bdf43e36_Rx: CanIfRxPduCanId=302, CanIfRxPduUserRxIndicationName=PduR_CanIfRxIndication, CanIfRxPduUserRxIndicationUL=PDUR, CanIfRxPduId=25, CanIfRxPduRef=VddmBcmPropdTCSignalIPDU01_857b2e99_Rx
        EcmPropSignalIPDU28_97c4e73e_Rx: CanIfRxPduCanId=401, CanIfRxPduUserRxIndicationName=PduR_CanIfRxIndication, CanIfRxPduUserRxIndicationUL=PDUR, CanIfRxPduId=15, CanIfRxPduRef=EcmPropSignalIPDU28_6fdbf3ae_Rx
        EcmPropSignalIPdu25_ed472200_Rx: CanIfRxPduCanId=634, CanIfRxPduUserRxIndicationName=PduR_CanIfRxIndication, CanIfRxPduUserRxIndicationUL=PDUR, CanIfRxPduId=10, CanIfRxPduRef=EcmPropSignalIPdu25_89df781c_Rx
        VDDMPropSignalIPDU18_dfaf10c6_Rx: CanIfRxPduCanId=86, CanIfRxPduUserRxIndicationName=PduR_CanIfRxIndication, CanIfRxPduUserRxIndicationUL=PDUR, CanIfRxPduId=30, CanIfRxPduRef=VDDMPropSignalIPDU18_5aed4d59_Rx
        VgmToIemJ1979OBDPropCanReqNpdu11_a6f3d656_Rx: CanIfRxPduCanId=2019, CanIfRxPduUserRxIndicationName=CanTp_RxIndication, CanIfRxPduUserRxIndicationType=PDUID_PDUINFOPTR, CanIfRxPduUserRxIndicationUL=CAN_TP, CanIfRxPduId=5, CanIfRxPduRef=VgmToIemJ1979OBDPropCanReqNpdu11_0f26f145_Rx
      IemPropSignalIPdu08_52cb9dc4_Tx (CanIfTxPduCfg):
        CanIfTxPduCanId = 99
        CanIfTxPduCanIdType = STANDARD_CAN
        CanIfTxPduDlc = 8
        CanIfTxPduUserTxConfirmationName = PduR_CanIfTxConfirmation
        CanIfTxPduUserTxConfirmationUL = PDUR
        CanIfTxPduId = 16
        CanIfTxPduReadNotifyStatus = false
        CanIfTxPduType = STATIC
        CanIfTxPduTruncation = true
        CanIfTxPduBufferRef = PropulsionCAN_c77d42b7
        CanIfTxPduRef = IemPropSignalIPdu08_2361eef5_Tx
      PropulsionCAN_c77d42b7 (CanIfBufferCfg):
        CanIfBufferSize = 19
        CanIfTxBufferHandlingType = PRIO_BY_CANID
        CanIfTxBufferMappedTxPdus = 19
        CanIfTxBufferMaxPduLength = 8
        CanIfBufferHthRef = PropulsionCAN_IEM_19020f5a_Tx
      6 x CanIfRxPduCfg, all with CanIfRxPduCanIdType=STANDARD_NO_FD_CAN, CanIfRxPduDlc=8, CanIfRxPduUserRxIndicationName=PduR_CanIfRxIndication, CanIfRxPduUserRxIndicationUL=PDUR, CanIfRxPduReadData=false, CanIfRxPduReadNotifyStatus=false, CanIfRxPduDlcCheck=true, CanIfRxPduHrhIdRef=PropulsionCAN_IEM_751e9595_Rx:
        BecmPropSignalIpdu15_d3342646_Rx: CanIfRxPduCanId=323, CanIfRxPduId=21, CanIfRxPduRef=BecmPropSignalIpdu15_f1c84025_Rx
        SrsPropSignalIPdu02_67d0f726_Rx: CanIfRxPduCanId=53, CanIfRxPduId=33, CanIfRxPduRef=SrsPropSignalIPdu02_30ca6a16_Rx
        VDDMPropSignalIPDU11_6de828bb_Rx: CanIfRxPduCanId=313, CanIfRxPduId=23, CanIfRxPduRef=VDDMPropSignalIPDU11_60044a2d_Rx
        BecmPropSignalIpdu03_e9a68992_Rx: CanIfRxPduCanId=376, CanIfRxPduId=16, CanIfRxPduRef=BecmPropSignalIpdu03_24914b42_Rx
        VDDMPropSignalIPDU06_f578cb85_Rx: CanIfRxPduCanId=565, CanIfRxPduId=13, CanIfRxPduRef=VDDMPropSignalIPDU06_38d5bca8_Rx
        VDDMPropdTCSignalIPdu38_c1b9326a_Rx: CanIfRxPduCanId=282, CanIfRxPduId=26, CanIfRxPduRef=VDDMPropdTCSignalIPdu38_4bda4dd7_Rx
      3 x CanIfTxPduCfg, all with CanIfTxPduCanIdType=STANDARD_CAN, CanIfTxPduDlc=8, CanIfTxPduReadNotifyStatus=false, CanIfTxPduType=STATIC, CanIfTxPduTruncation=true, CanIfTxPduBufferRef=PropulsionCAN_c77d42b7:
        IemPropSignalIPdu06_af812bdc_Tx: CanIfTxPduCanId=626, CanIfTxPduUserTxConfirmationName=PduR_CanIfTxConfirmation, CanIfTxPduUserTxConfirmationUL=PDUR, CanIfTxPduId=11, CanIfTxPduRef=IemPropSignalIPdu06_0fd014ad_Tx
        IemPropNmPdu1_1cf32a7f_Tx: CanIfTxPduCanId=1308, CanIfTxPduUserTxConfirmationName=CanNm_TxConfirmation, CanIfTxPduUserTxConfirmationUL=CAN_NM, CanIfTxPduId=5, CanIfTxPduRef=IemPropNmPdu1_277f9a9b_Tx
        IemToVddmPropDiagResNpdu_1dd128ca_Tx: CanIfTxPduCanId=1591, CanIfTxPduUserTxConfirmationName=CanTp_TxConfirmation, CanIfTxPduUserTxConfirmationUL=CAN_TP, CanIfTxPduId=4, CanIfTxPduRef=IemToVddmPropDiagResNpdu_cef1039b_Tx
      VDDMPropSignalIPDU19_7dad5c2c_Rx (CanIfRxPduCfg):
        CanIfRxPduCanId = 645
        CanIfRxPduCanIdType = STANDARD_NO_FD_CAN
        CanIfRxPduDlc = 8
        CanIfRxPduUserRxIndicationName = PduR_CanIfRxIndication
        CanIfRxPduUserRxIndicationUL = PDUR
        CanIfRxPduId = 9
        CanIfRxPduReadData = false
        CanIfRxPduReadNotifyStatus = false
        CanIfRxPduDlcCheck = true
        CanIfRxPduHrhIdRef = PropulsionCAN_IEM_751e9595_Rx
        CanIfRxPduRef = VDDMPropSignalIPDU19_d765b0bb_Rx
      IemPropSignalIPdu16_3b1ed2aa_Tx (CanIfTxPduCfg):
        CanIfTxPduCanId = 272
        CanIfTxPduCanIdType = STANDARD_CAN
        CanIfTxPduDlc = 8
        CanIfTxPduUserTxConfirmationName = PduR_CanIfTxConfirmation
        CanIfTxPduUserTxConfirmationUL = PDUR
        CanIfTxPduId = 15
        CanIfTxPduReadNotifyStatus = false
        CanIfTxPduType = STATIC
        CanIfTxPduTruncation = true
        CanIfTxPduBufferRef = PropulsionCAN_c77d42b7
        CanIfTxPduRef = IemPropSignalIPdu16_41591f04_Tx
      BecmPropSignalIpdu02_4ba4c578_Rx (CanIfRxPduCfg):
        CanIfRxPduCanId = 373
        CanIfRxPduCanIdType = STANDARD_NO_FD_CAN
        CanIfRxPduDlc = 8
        CanIfRxPduUserRxIndicationName = PduR_CanIfRxIndication
        CanIfRxPduUserRxIndicationUL = PDUR
        CanIfRxPduId = 17
        CanIfRxPduReadData = false
        CanIfRxPduReadNotifyStatus = false
        CanIfRxPduDlcCheck = true
        CanIfRxPduHrhIdRef = PropulsionCAN_IEM_751e9595_Rx
        CanIfRxPduRef = BecmPropSignalIpdu02_a919b6a0_Rx
      ECMPropSignalIPDU06_d83cf7f3_Rx (CanIfRxPduCfg):
        CanIfRxPduCanId = 328
        CanIfRxPduCanIdType = STANDARD_NO_FD_CAN
        CanIfRxPduDlc = 8
        CanIfRxPduUserRxIndicationName = PduR_CanIfRxIndication
        CanIfRxPduUserRxIndicationUL = PDUR
        CanIfRxPduId = 20
        CanIfRxPduReadData = false
        CanIfRxPduReadNotifyStatus = false
        CanIfRxPduDlcCheck = true
        CanIfRxPduHrhIdRef = PropulsionCAN_IEM_751e9595_Rx
        CanIfRxPduRef = ECMPropSignalIPDU06_719d5fe2_Rx
      IemPropSignalIPdu12_2b75c431_Tx (CanIfTxPduCfg):
        CanIfTxPduCanId = 393
        CanIfTxPduCanIdType = STANDARD_CAN
        CanIfTxPduDlc = 8
        CanIfTxPduUserTxConfirmationName = PduR_CanIfTxConfirmation
        CanIfTxPduUserTxConfirmationUL = PDUR
        CanIfTxPduId = 14
        CanIfTxPduReadNotifyStatus = false
        CanIfTxPduType = STATIC
        CanIfTxPduTruncation = true
        CanIfTxPduBufferRef = PropulsionCAN_c77d42b7
        CanIfTxPduRef = IemPropSignalIPdu12_1ae9e24f_Tx
      VddmPropSignalIPdu26_dc850ebd_Rx (CanIfRxPduCfg):
        CanIfRxPduCanId = 566
        CanIfRxPduCanIdType = STANDARD_NO_FD_CAN
        CanIfRxPduDlc = 8
        CanIfRxPduUserRxIndicationName = PduR_CanIfRxIndication
        CanIfRxPduUserRxIndicationUL = PDUR
        CanIfRxPduId = 12
        CanIfRxPduReadData = false
        CanIfRxPduReadNotifyStatus = false
        CanIfRxPduDlcCheck = true
        CanIfRxPduHrhIdRef = PropulsionCAN_IEM_751e9595_Rx
        CanIfRxPduRef = VddmPropSignalIPdu26_893fed53_Rx
      3 x CanIfTxPduCfg, all with CanIfTxPduCanIdType=STANDARD_CAN, CanIfTxPduDlc=8, CanIfTxPduReadNotifyStatus=false, CanIfTxPduType=STATIC, CanIfTxPduTruncation=true, CanIfTxPduBufferRef=PropulsionCAN_c77d42b7:
        IemEduPropSignalIPdu02_69927b9a_Tx: CanIfTxPduCanId=96, CanIfTxPduUserTxConfirmationName=PduR_CanIfTxConfirmation, CanIfTxPduUserTxConfirmationUL=PDUR, CanIfTxPduId=17, CanIfTxPduRef=IemEduPropSignalIPdu02_ee254c80_Tx
        IemPropSignalIPdu01_d12470d0_Tx: CanIfTxPduCanId=1111, CanIfTxPduUserTxConfirmationName=PduR_CanIfTxConfirmation, CanIfTxPduUserTxConfirmationUL=PDUR, CanIfTxPduId=8, CanIfTxPduRef=IemPropSignalIPdu01_1988e981_Tx
        UudtIemNPdu2_85c005b2_Tx: CanIfTxPduCanId=1777, CanIfTxPduUserTxConfirmationName=CanTp_TxConfirmation, CanIfTxPduUserTxConfirmationUL=CAN_TP, CanIfTxPduId=2, CanIfTxPduRef=UudtIemNPdu2_06f5fefc_Tx
      EcmPropSignalIPdu24_ff7d8ab4_Rx (CanIfRxPduCfg):
        CanIfRxPduCanId = 75
        CanIfRxPduCanIdType = STANDARD_NO_FD_CAN
        CanIfRxPduDlc = 8
        CanIfRxPduUserRxIndicationName = PduR_CanIfRxIndication
        CanIfRxPduUserRxIndicationUL = PDUR
        CanIfRxPduId = 31
        CanIfRxPduReadData = false
        CanIfRxPduReadNotifyStatus = false
        CanIfRxPduDlcCheck = true
        CanIfRxPduHrhIdRef = PropulsionCAN_IEM_751e9595_Rx
        CanIfRxPduRef = EcmPropSignalIPdu24_045785fe_Rx
      IemPropSignalIPdu14_47ea3789_Tx (CanIfTxPduCfg):
        CanIfTxPduCanId = 544
        CanIfTxPduCanIdType = STANDARD_CAN
        CanIfTxPduDlc = 8
        CanIfTxPduUserTxConfirmationName = PduR_CanIfTxConfirmation
        CanIfTxPduUserTxConfirmationUL = PDUR
        CanIfTxPduId = 13
        CanIfTxPduReadNotifyStatus = false
        CanIfTxPduType = STATIC
        CanIfTxPduTruncation = true
        CanIfTxPduBufferRef = PropulsionCAN_c77d42b7
        CanIfTxPduRef = IemPropSignalIPdu14_8139e281_Tx
      UudtIemNPdu1_b38ffc6e_Tx (CanIfTxPduCfg):
        CanIfTxPduCanId = 1776
        CanIfTxPduCanIdType = STANDARD_CAN
        CanIfTxPduDlc = 8
        CanIfTxPduUserTxConfirmationName = CanTp_TxConfirmation
        CanIfTxPduUserTxConfirmationUL = CAN_TP
        CanIfTxPduId = 3
        CanIfTxPduReadNotifyStatus = false
        CanIfTxPduType = STATIC
        CanIfTxPduTruncation = true
        CanIfTxPduBufferRef = PropulsionCAN_c77d42b7
        CanIfTxPduRef = UudtIemNPdu1_4b1dfe9b_Tx
      VDDMPropSignalIPDU16_b505c2af_Rx (CanIfRxPduCfg):
        CanIfRxPduCanId = 597
        CanIfRxPduCanIdType = STANDARD_NO_FD_CAN
        CanIfRxPduDlc = 8
        CanIfRxPduUserRxIndicationName = PduR_CanIfRxIndication
        CanIfRxPduUserRxIndicationUL = PDUR
        CanIfRxPduId = 11
        CanIfRxPduReadData = false
        CanIfRxPduReadNotifyStatus = false
        CanIfRxPduDlcCheck = true
        CanIfRxPduHrhIdRef = PropulsionCAN_IEM_751e9595_Rx
        CanIfRxPduRef = VDDMPropSignalIPDU16_765cb701_Rx
      VddmToAllFuncPropDiagReqNpdu_b900be48_Rx (CanIfRxPduCfg):
        CanIfRxPduCanId = 2047
        CanIfRxPduCanIdType = STANDARD_NO_FD_CAN
        CanIfRxPduDlc = 8
        CanIfRxPduUserRxIndicationName = CanTp_RxIndication
        CanIfRxPduUserRxIndicationType = PDUID_PDUINFOPTR
        CanIfRxPduUserRxIndicationUL = CAN_TP
        CanIfRxPduId = 1
        CanIfRxPduReadData = false
        CanIfRxPduReadNotifyStatus = false
        CanIfRxPduDlcCheck = true
        CanIfRxPduHrhIdRef = PropulsionCAN_IEM_751e9595_Rx
        CanIfRxPduRef = VddmToAllFuncPropDiagReqNpdu_86e6f41a_Rx
      IemEduPropSignalIPdu01_45a04f59_Tx (CanIfTxPduCfg):
        CanIfTxPduCanId = 76
        CanIfTxPduCanIdType = STANDARD_CAN
        CanIfTxPduDlc = 8
        CanIfTxPduUserTxConfirmationName = PduR_CanIfTxConfirmation
        CanIfTxPduUserTxConfirmationUL = PDUR
        CanIfTxPduId = 18
        CanIfTxPduReadNotifyStatus = false
        CanIfTxPduType = STATIC
        CanIfTxPduTruncation = true
        CanIfTxPduBufferRef = PropulsionCAN_c77d42b7
        CanIfTxPduRef = IemEduPropSignalIPdu01_a3cd4ce7_Tx
      IemPropSignalIPdu03_f55121b8_Tx (CanIfTxPduCfg):
        CanIfTxPduCanId = 773
        CanIfTxPduCanIdType = STANDARD_CAN
        CanIfTxPduDlc = 8
        CanIfTxPduUserTxConfirmationName = PduR_CanIfTxConfirmation
        CanIfTxPduUserTxConfirmationUL = PDUR
        CanIfTxPduId = 9
        CanIfTxPduReadNotifyStatus = false
        CanIfTxPduType = STATIC
        CanIfTxPduTruncation = true
        CanIfTxPduBufferRef = PropulsionCAN_c77d42b7
        CanIfTxPduRef = IemPropSignalIPdu03_d9e81404_Tx
      IemPropCanNmNode_9021399f_Rx (CanIfRxPduCfg):
        CanIfRxPduCanIdType = STANDARD_NO_FD_CAN
        CanIfRxPduDlc = 8
        CanIfRxPduUserRxIndicationName = CanNm_RxIndication
        CanIfRxPduUserRxIndicationUL = CAN_NM
        CanIfRxPduId = 0
        CanIfRxPduReadData = false
        CanIfRxPduReadNotifyStatus = false
        CanIfRxPduDlcCheck = true
        CanIfRxPduHrhIdRef = PropulsionCAN_IEM_751e9595_Rx
        CanIfRxPduRef = IemPropCanNmNode_6342b4e7_Rx
        PropulsionCAN_3689664c (CanIfRxPduCanIdRange): CanIfRxPduCanIdRangeLowerCanId=1280, CanIfRxPduCanIdRangeUpperCanId=1343
      IemToVgmJ1979OBDPropCanResNpdu11_d809dece_Tx (CanIfTxPduCfg):
        CanIfTxPduCanId = 2027
        CanIfTxPduCanIdType = STANDARD_CAN
        CanIfTxPduDlc = 8
        CanIfTxPduUserTxConfirmationName = CanTp_TxConfirmation
        CanIfTxPduUserTxConfirmationUL = CAN_TP
        CanIfTxPduId = 0
        CanIfTxPduReadNotifyStatus = false
        CanIfTxPduType = STATIC
        CanIfTxPduTruncation = true
        CanIfTxPduBufferRef = PropulsionCAN_c77d42b7
        CanIfTxPduRef = IemToVgmJ1979OBDPropCanResNpdu11_72c85f7f_Tx
      UudtIemNPdu3_97faad06_Tx (CanIfTxPduCfg):
        CanIfTxPduCanId = 1778
        CanIfTxPduCanIdType = STANDARD_CAN
        CanIfTxPduDlc = 8
        CanIfTxPduUserTxConfirmationName = CanTp_TxConfirmation
        CanIfTxPduUserTxConfirmationUL = CAN_TP
        CanIfTxPduId = 1
        CanIfTxPduReadNotifyStatus = false
        CanIfTxPduType = STATIC
        CanIfTxPduTruncation = true
        CanIfTxPduBufferRef = PropulsionCAN_c77d42b7
        CanIfTxPduRef = UudtIemNPdu3_8b7d031e_Tx
      3 x CanIfRxPduCfg, all with CanIfRxPduCanIdType=STANDARD_NO_FD_CAN, CanIfRxPduDlc=8, CanIfRxPduReadData=false, CanIfRxPduReadNotifyStatus=false, CanIfRxPduUserRxIndicationName=CanTp_RxIndication, CanIfRxPduUserRxIndicationUL=CAN_TP, CanIfRxPduDlcCheck=true, CanIfRxPduUserRxIndicationType=PDUID_PDUINFOPTR, CanIfRxPduHrhIdRef=PropulsionCAN_IEM_751e9595_Rx:
        UudtFcNPdu1: CanIfRxPduId=4, CanIfRxPduCanId=2033, CanIfRxPduRef=UudtFcNPdu1
        UudtFcNPdu2: CanIfRxPduId=3, CanIfRxPduCanId=2034, CanIfRxPduRef=UudtFcNPdu2
        UudtFcNPdu3: CanIfRxPduId=2, CanIfRxPduCanId=2035, CanIfRxPduRef=UudtFcNPdu3
    CanIfPrivateCfg:
      CanIfPrivateSoftwareFilterType = LINEAR
      CanIfPrivateDlcCheck = true
      CanIfSupportTTCAN = false
      CanIfTransceiverMapping = false
      CanIfTransceiverHandling = true
      CanIfSupportExtendedIds = false
      CanIfSupportNmOsek = false
      CanIfTxBufferType = BYTE_QUEUE
      CanIfOptimizeOneController = true
      CanIfWakeupSupport = false
      CanIfStaticFdTxBufferSupport = false
      CanIfRxSearchConsiderMsgType = true
      CanIfMultipleBasicCANTxObjects = false
      CanIfTxBufferFifoSupport = false
      CanIfSetPduReceptionModeSupport = false
      CanIfDataChecksumRxSupport = false
      CanIfDataChecksumTxSupport = false
      CanIfCheckWakeupCanRetType = false
    CanIfPublicCfg:
      CanIfPublicPnSupport = true
      CanIfPublicCancelTransmitSupport = false
      CanIfPublicDevErrorDetect = true
      CanIfPublicHandleTypeEnum = UINT8
      CanIfPublicMultipleDrvSupport = false
      CanIfPublicNumberOfCanHwUnits = 1
      CanIfPublicReadRxPduDataApi = false
      CanIfPublicReadRxPduNotifyStatusApi = false
      CanIfPublicReadTxPduNotifyStatusApi = false
      CanIfPublicSetDynamicTxIdApi = false
      CanIfPublicTxBuffering = true
      CanIfPublicTxConfirmPollingSupport = false
      CanIfPublicVersionInfoApi = false
      CanIfPublicWakeupCheckValidSupport = false
      CanIfPnWakeupTxPduFilterSupport = false
      CanIfPnTrcvHandlingSupport = true
      CanIfJ1939DynAddrSupport = DISABLED
      CanIfSafeBswChecks = false
      CanIfSetBaudrateApi = false
      CanIfBusMirroringSupport = false
      CanIfEnableSecurityEventReporting = false
    CanIfTrcvDrvCfg
      CanIfTrcvCfg_Tja1145 (CanIfTrcvCfg): CanIfTrcvId=0, CanIfTrcvWakeupSupport=false, CanIfTrcvCanTrcvRef=CanTrcvChannel_Tja1145

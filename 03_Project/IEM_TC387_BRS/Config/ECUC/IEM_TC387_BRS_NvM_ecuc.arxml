AUTOSAR XML (schema 00048)
package /ActiveEcuC
  module config NvM: implementation-config-variant=VARIANT-PRE-COMPILE, module-description=NvM_Impl
    NvMConfigBlock (NvMBlockDescriptor):
      NvMBlockCrcType = NVM_CRC16
      NvMBlockManagementType = NVM_BLOCK_REDUNDANT
      NvMInitBlockCallback = NULL_PTR
      NvMResistantToChangedSw = true
      NvMSelectBlockForReadAll = true
      NvMSelectBlockForWriteAll = true
      NvMUseInitCallback = false
      NvMUseJobendCallback = false
      NvMSingleBlockCallback = NULL_PTR
      NvMBswMBlockStatusInformation = false
      NvMBlockUseCrc = true
      NvMBlockUseSyncMechanism = false
      NvMCalcRamBlockCrc = false
      NvMUseServicePorts = false
      NvMNvramBlockIdentifier = 1
      NvMNvBlockNum = 2
      NvMNvBlockLength = 2
      NvMRomBlockDataAddress = NULL_PTR
      NvMBlockPostReadTransformCallback = NULL_PTR
      NvMBlockPreWriteTransformCallback = NULL_PTR
      NvMBlockUseSetRamBlockStatus = true
      NvMBlockJobPriority = 127
      NvMBlockWriteProt = false
      NvMWriteBlockOnce = false
      NvMBlockUseCRCCompMechanism = false
      NvMInvokeCallbacksForReadAll = true
      NvMInvokeCallbacksForWriteAll = true
      NvMRamBlockDataAddress = NvM_ConfigBlock_Ram
      NvMTargetBlockReference
        NvMFeeRef: NvMNameOfFeeBlock=FeeBlock_NvMConfig
    NvMCommon:
      NvMDevErrorDetect = true
      NvMVersionInfoApi = false
      NvMApiConfigClass = NVM_API_CONFIG_CLASS_3
      NvMBswMMultiBlockJobStatusInformation = false
      NvMCompiledConfigId = 1
      NvMCrcNumOfBytes = 64
      NvMDatasetSelectionBits = 1
      NvMDrvModeSwitch = true
      NvMDynamicConfiguration = false
      NvMJobPrioritization = false
      NvMPollingMode = true
      NvMSetRamBlockStatusApi = true
      NvMSizeStandardJobQueue = 8
      NvMMaxNoOfWriteRetries = 1
      NvMMainFunctionPeriod = 0.01
      NvMUseBlockIdCheck = false
      NvMRepairRedundantBlocksApi = false
      NvMSafeBswChecks = false
    NvMCommonVendorParams: NvMCrcIntBuffer=true, NvMKillWriteAllApi=true, NvMCfgCbkIncludeList=Dem_Cbk.h
    12 x NvMBlockDescriptor, all with NvMBlockCrcType=NVM_CRC16, NvMBlockManagementType=NVM_BLOCK_NATIVE, NvMResistantToChangedSw=true, NvMSelectBlockForReadAll=true, NvMSelectBlockForWriteAll=true, NvMBswMBlockStatusInformation=false, NvMBlockUseCrc=false, NvMBlockUseSyncMechanism=false, NvMCalcRamBlockCrc=false, NvMBlockWriteProt=false, NvMNvBlockNum=1, NvMWriteBlockOnce=false, NvMUseServicePorts=false, NvMBlockUseCRCCompMechanism=false, NvMBlockUseSetRamBlockStatus=true, NvMInvokeCallbacksForReadAll=true, NvMInvokeCallbacksForWriteAll=true:
      NvMBlock_ProgRequest: NvMInitBlockCallback=NULL_PTR, NvMUseInitCallback=false, NvMUseJobendCallback=false, NvMSingleBlockCallback=NULL_PTR, NvMBlockJobPriority=1, NvMNvBlockLength=32, NvMNvramBlockIdentifier=2, NvMRamBlockDataAddress=Appl_ProgRequest_NvMRam
        NvMTargetBlockReference
          NvMFeeRef: NvMNameOfFeeBlock=FeeBlock_ProgRequest
      DemAdminDataBlock: NvMInitBlockCallback=Dem_NvM_InitAdminData, NvMUseInitCallback=true, NvMUseJobendCallback=true, NvMSingleBlockCallback=Dem_NvM_JobFinished, NvMBlockJobPriority=127, NvMNvBlockLength=10, NvMNvramBlockIdentifier=3, NvMRamBlockDataAddress=Dem_Cfg_AdminData, NvMRomBlockDataAddress=NULL_PTR
        NvMTargetBlockReference
          NvMFeeRef: NvMNameOfFeeBlock=FeeBlock_DemAdmin
      DemStatusDataBlock: NvMInitBlockCallback=Dem_NvM_InitStatusData, NvMUseInitCallback=true, NvMUseJobendCallback=true, NvMSingleBlockCallback=Dem_NvM_JobFinished, NvMBlockJobPriority=127, NvMNvBlockLength=422, NvMNvramBlockIdentifier=4, NvMRamBlockDataAddress=Dem_Cfg_StatusData, NvMRomBlockDataAddress=NULL_PTR
        NvMTargetBlockReference
          NvMFeeRef: NvMNameOfFeeBlock=FeeBlock_DemStatus
      DemPrimaryDataBlock0: NvMInitBlockCallback=NULL_PTR, NvMUseInitCallback=false, NvMUseJobendCallback=true, NvMSingleBlockCallback=Dem_NvM_JobFinished, NvMBlockJobPriority=127, NvMNvBlockLength=232, NvMNvramBlockIdentifier=5, NvMRamBlockDataAddress=Dem_Cfg_PrimaryEntry_0, NvMRomBlockDataAddress=Dem_Cfg_MemoryEntryInit
        NvMTargetBlockReference
          NvMFeeRef: NvMNameOfFeeBlock=FeeBlock_DemPrimary0
      DemPrimaryDataBlock1: NvMInitBlockCallback=NULL_PTR, NvMUseInitCallback=false, NvMUseJobendCallback=true, NvMSingleBlockCallback=Dem_NvM_JobFinished, NvMBlockJobPriority=127, NvMNvBlockLength=232, NvMNvramBlockIdentifier=6, NvMRamBlockDataAddress=Dem_Cfg_PrimaryEntry_1, NvMRomBlockDataAddress=Dem_Cfg_MemoryEntryInit
        NvMTargetBlockReference
          NvMFeeRef: NvMNameOfFeeBlock=FeeBlock_DemPrimary1
      DemPrimaryDataBlock2: NvMInitBlockCallback=NULL_PTR, NvMUseInitCallback=false, NvMUseJobendCallback=true, NvMSingleBlockCallback=Dem_NvM_JobFinished, NvMBlockJobPriority=127, NvMNvBlockLength=232, NvMNvramBlockIdentifier=7, NvMRamBlockDataAddress=Dem_Cfg_PrimaryEntry_2, NvMRomBlockDataAddress=Dem_Cfg_MemoryEntryInit
        NvMTargetBlockReference
          NvMFeeRef: NvMNameOfFeeBlock=FeeBlock_DemPrimary2
      DemPrimaryDataBlock3: NvMInitBlockCallback=NULL_PTR, NvMUseInitCallback=false, NvMUseJobendCallback=true, NvMSingleBlockCallback=Dem_NvM_JobFinished, NvMBlockJobPriority=127, NvMNvBlockLength=232, NvMNvramBlockIdentifier=8, NvMRamBlockDataAddress=Dem_Cfg_PrimaryEntry_3, NvMRomBlockDataAddress=Dem_Cfg_MemoryEntryInit
        NvMTargetBlockReference
          NvMFeeRef: NvMNameOfFeeBlock=FeeBlock_DemPrimary3
      DemPrimaryDataBlock4: NvMInitBlockCallback=NULL_PTR, NvMUseInitCallback=false, NvMUseJobendCallback=true, NvMSingleBlockCallback=Dem_NvM_JobFinished, NvMBlockJobPriority=127, NvMNvBlockLength=232, NvMNvramBlockIdentifier=9, NvMRamBlockDataAddress=Dem_Cfg_PrimaryEntry_4, NvMRomBlockDataAddress=Dem_Cfg_MemoryEntryInit
        NvMTargetBlockReference
          NvMFeeRef: NvMNameOfFeeBlock=FeeBlock_DemPrimary4
      DemPrimaryDataBlock5: NvMInitBlockCallback=NULL_PTR, NvMUseInitCallback=false, NvMUseJobendCallback=true, NvMSingleBlockCallback=Dem_NvM_JobFinished, NvMBlockJobPriority=127, NvMNvBlockLength=232, NvMNvramBlockIdentifier=10, NvMRamBlockDataAddress=Dem_Cfg_PrimaryEntry_5, NvMRomBlockDataAddress=Dem_Cfg_MemoryEntryInit
        NvMTargetBlockReference
          NvMFeeRef: NvMNameOfFeeBlock=FeeBlock_DemPrimary5
      DemPrimaryDataBlock6: NvMInitBlockCallback=NULL_PTR, NvMUseInitCallback=false, NvMUseJobendCallback=true, NvMSingleBlockCallback=Dem_NvM_JobFinished, NvMBlockJobPriority=127, NvMNvBlockLength=232, NvMNvramBlockIdentifier=11, NvMRamBlockDataAddress=Dem_Cfg_PrimaryEntry_6, NvMRomBlockDataAddress=Dem_Cfg_MemoryEntryInit
        NvMTargetBlockReference
          NvMFeeRef: NvMNameOfFeeBlock=FeeBlock_DemPrimary6
      DemPrimaryDataBlock7: NvMInitBlockCallback=NULL_PTR, NvMUseInitCallback=false, NvMUseJobendCallback=true, NvMSingleBlockCallback=Dem_NvM_JobFinished, NvMBlockJobPriority=127, NvMNvBlockLength=232, NvMNvramBlockIdentifier=12, NvMRamBlockDataAddress=Dem_Cfg_PrimaryEntry_7, NvMRomBlockDataAddress=Dem_Cfg_MemoryEntryInit
        NvMTargetBlockReference
          NvMFeeRef: NvMNameOfFeeBlock=FeeBlock_DemPrimary7
      NvMBlock_CarConfig: NvMInitBlockCallback=NULL_PTR, NvMUseInitCallback=false, NvMUseJobendCallback=false, NvMSingleBlockCallback=NULL_PTR, NvMBlockJobPriority=1, NvMNvBlockLength=16, NvMNvramBlockIdentifier=13, NvMRamBlockDataAddress=Appl_CarConfig_NvMRam
        NvMTargetBlockReference
          NvMFeeRef: NvMNameOfFeeBlock=FeeBlock_CarConfig

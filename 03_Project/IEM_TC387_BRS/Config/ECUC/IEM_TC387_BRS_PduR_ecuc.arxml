AUTOSAR XML (schema 4-2-2)
package /ActiveEcuC
  module config PduR: implementation-config-variant=VARIANT-PRE-COMPILE, module-description=PduR_Impl
    PduRGeneral:
      PduRDevErrorDetect = true
      PduRVersionInfoApi = false
      PduRMetaDataSupport = false
      PduRPduCallback = false
      PduRSwitching = false
      PduRSafeBswChecks = false
      PduREnableDeferredTransmission = false
      PduREnableDeferredReception = false
      PduRSupportMulticore = false
      PduRExtendedErrorChecks = false
      PduRRoutingTypeGateway = false
      PduRSpinlockRetryCounter = 4294967295
      PduRGeneration:
        PduROutOfBoundsWriteProtectionStrategy = NONE
        PduROutOfBoundsWriteSanitizer = false
        PduROutOfBoundsReadSanitizer = false
        PduRNumericalDataTypeMinimizationStrategy = WITH_CAST
        PduRReduceConstantData2Define = false
        PduRBoolDataInArrayOfStructStrategy = BITMASKING
        PduRDeduplicateIndirectedData = true
        PduRDataDeduplicationStrategy = WITH_CAST
        PduRReduceBoolDataByNegationThreshold = 2
        PduRReduceBoolDataByNumericalComparisonThreshold = 2
        PduRReduceBoolDataByNumericalRelationThreshold = 2
        PduRReduceBoolDataByNumericalOperandStrategy = WITH_ANY_VALUE
        PduRReduceNumericalDataByOffsetThreshold = 2
        PduRReduceNumericalDataByArraySubtractionThreshold = 2
        PduRReduceDataByStreaming = false
        PduRShortSymbols = false
        PduRInterfacesForDeactivatedData = false
        PduRReferringKeysInComments = false
    PduRRoutingTables: PduRConfigurationId=0
      PduRRoutingTable
        53 x PduRRoutingPath, all with PduRMulticoreRoutingPath=false, PduRLockRef=PduRLock_PduRExclusiveArea:
          PropulsionCAN_33157db4_Rx_d0a6735a_Rx: PduRRoutingPathCommunicationType=COMMUNICATION_INTERFACE
            PropulsionCAN_33157db4_Rx_d0a6735a_Rx_f30b45d0_Rx (PduRDestPdu):
              PduRDestPduHandleId = 14
              PduRDestPduDirection = RECEIVE
              PduRDestPduRoutingType = API_FORWARDING
              PduRDestPduDataProcessing = IMMEDIATE
              PduRPduLengthHandlingStrategy = IGNORE
              PduRTransmissionConfirmation = false
              PduRDestPduRef = PropulsionCAN_c71a5358_Rx
              PduRDestPduPduRBswModulesRef = Com
            PduRSrcPdu_f30b45d0 (PduRSrcPdu): PduRSourcePduHandleId=14, PduRSrcPduDirection=RECEIVE, PduRSrcPduRef=PropulsionCAN_c71a5358_Rx, PduRSrcPduPduRBswModulesRef=CanNm
          VDDMPropdTCSignalIPdu38_4bda4dd7_Rx: PduRRoutingPathCommunicationType=COMMUNICATION_INTERFACE
            VDDMPropdTCSignalIPdu38_4bda4dd7_Rx_f7a62982_Rx (PduRDestPdu):
              PduRDestPduHandleId = 24
              PduRDestPduDirection = RECEIVE
              PduRDestPduRoutingType = API_FORWARDING
              PduRDestPduDataProcessing = IMMEDIATE
              PduRPduLengthHandlingStrategy = IGNORE
              PduRTransmissionConfirmation = false
              PduRDestPduRef = VDDMPropdTCSignalIPdu38_808bfd3f_Rx
              PduRDestPduPduRBswModulesRef = Com
            PduRSrcPdu_f7a62982 (PduRSrcPdu): PduRSourcePduHandleId=24, PduRSrcPduDirection=RECEIVE, PduRSrcPduRef=VDDMPropdTCSignalIPdu38_4bda4dd7_Rx, PduRSrcPduPduRBswModulesRef=CanIf
          EcmPropSignalIPDU11_86a9e821_Rx: PduRRoutingPathCommunicationType=COMMUNICATION_INTERFACE
            EcmPropSignalIPDU11_86a9e821_Rx_019d6fbe_Rx (PduRDestPdu):
              PduRDestPduHandleId = 10
              PduRDestPduDirection = RECEIVE
              PduRDestPduRoutingType = API_FORWARDING
              PduRDestPduDataProcessing = IMMEDIATE
              PduRPduLengthHandlingStrategy = IGNORE
              PduRTransmissionConfirmation = false
              PduRDestPduRef = EcmPropSignalIPDU11_4ed5e30d_Rx
              PduRDestPduPduRBswModulesRef = Com
            PduRSrcPdu_019d6fbe (PduRSrcPdu): PduRSourcePduHandleId=10, PduRSrcPduDirection=RECEIVE, PduRSrcPduRef=EcmPropSignalIPDU11_86a9e821_Rx, PduRSrcPduPduRBswModulesRef=CanIf
          IemPropSignalIPdu04_516e63ff_Tx: PduRRoutingPathCommunicationType=COMMUNICATION_INTERFACE
            IemPropSignalIPdu04_cfb0e928_Tx (PduRDestPdu):
              PduRDestPduHandleId = 5
              PduRDestPduDirection = TRANSMIT
              PduRDestPduRoutingType = API_FORWARDING
              PduRDestPduDataProcessing = IMMEDIATE
              PduRPduLengthHandlingStrategy = IGNORE
              PduRDestPduDataProvision = PDUR_DIRECT
              PduRTransmissionConfirmation = true
              PduRDestPduRef = IemPropSignalIPdu04_cfb0e928_Tx
              PduRDestPduPduRBswModulesRef = CanIf
            PduRSrcPdu_53beb1f3 (PduRSrcPdu): PduRSourcePduHandleId=5, PduRSrcPduDirection=TRANSMIT, PduRSrcPduRef=IemPropSignalIPdu04_516e63ff_Tx, PduRSrcPduPduRBswModulesRef=Com
          EcmPropSignalIPdu24_045785fe_Rx: PduRRoutingPathCommunicationType=COMMUNICATION_INTERFACE
            PduRSrcPdu_0c4be5f2 (PduRSrcPdu): PduRSourcePduHandleId=12, PduRSrcPduDirection=RECEIVE, PduRSrcPduRef=EcmPropSignalIPdu24_045785fe_Rx, PduRSrcPduPduRBswModulesRef=CanIf
            EcmPropSignalIPdu24_045785fe_Rx_0c4be5f2_Rx (PduRDestPdu):
              PduRDestPduHandleId = 12
              PduRDestPduDirection = RECEIVE
              PduRDestPduRoutingType = API_FORWARDING
              PduRDestPduDataProcessing = IMMEDIATE
              PduRPduLengthHandlingStrategy = IGNORE
              PduRTransmissionConfirmation = false
              PduRDestPduRef = EcmPropSignalIPdu24_8dedad9f_Rx
              PduRDestPduPduRBswModulesRef = Com
          BecmPropSignalIpdu02_a919b6a0_Rx: PduRRoutingPathCommunicationType=COMMUNICATION_INTERFACE
            PduRSrcPdu_03540ad7 (PduRSrcPdu): PduRSourcePduHandleId=1, PduRSrcPduDirection=RECEIVE, PduRSrcPduRef=BecmPropSignalIpdu02_a919b6a0_Rx, PduRSrcPduPduRBswModulesRef=CanIf
            BecmPropSignalIpdu02_a919b6a0_Rx_03540ad7_Rx (PduRDestPdu):
              PduRDestPduHandleId = 1
              PduRDestPduDirection = RECEIVE
              PduRDestPduRoutingType = API_FORWARDING
              PduRDestPduDataProcessing = IMMEDIATE
              PduRPduLengthHandlingStrategy = IGNORE
              PduRTransmissionConfirmation = false
              PduRDestPduRef = BecmPropSignalIpdu02_e391682d_Rx
              PduRDestPduPduRBswModulesRef = Com
          CddObcPropSignalIPdu01_1ee0577a_Rx: PduRRoutingPathCommunicationType=COMMUNICATION_INTERFACE
            PduRSrcPdu_9b6ba7e6 (PduRSrcPdu): PduRSourcePduHandleId=4, PduRSrcPduDirection=RECEIVE, PduRSrcPduRef=CddObcPropSignalIPdu01_1ee0577a_Rx, PduRSrcPduPduRBswModulesRef=CanIf
            CddObcPropSignalIPdu01_1ee0577a_Rx_9b6ba7e6_Rx (PduRDestPdu):
              PduRDestPduHandleId = 4
              PduRDestPduDirection = RECEIVE
              PduRDestPduRoutingType = API_FORWARDING
              PduRDestPduDataProcessing = IMMEDIATE
              PduRPduLengthHandlingStrategy = IGNORE
              PduRTransmissionConfirmation = false
              PduRDestPduRef = CddObcPropSignalIPdu01_003f0830_Rx
              PduRDestPduPduRBswModulesRef = Com
          IemPropSignalIPdu08_58d82fd4_Tx: PduRRoutingPathCommunicationType=COMMUNICATION_INTERFACE
            PduRSrcPdu_145e853b (PduRSrcPdu): PduRSourcePduHandleId=8, PduRSrcPduDirection=TRANSMIT, PduRSrcPduRef=IemPropSignalIPdu08_58d82fd4_Tx, PduRSrcPduPduRBswModulesRef=Com
            IemPropSignalIPdu08_2361eef5_Tx (PduRDestPdu):
              PduRDestPduHandleId = 8
              PduRDestPduDirection = TRANSMIT
              PduRDestPduRoutingType = API_FORWARDING
              PduRDestPduDataProcessing = IMMEDIATE
              PduRPduLengthHandlingStrategy = IGNORE
              PduRDestPduDataProvision = PDUR_DIRECT
              PduRTransmissionConfirmation = true
              PduRDestPduRef = IemPropSignalIPdu08_2361eef5_Tx
              PduRDestPduPduRBswModulesRef = CanIf
          VDDMPropSignalIPDU17_fbd44ae3_Rx: PduRRoutingPathCommunicationType=COMMUNICATION_INTERFACE
            VDDMPropSignalIPDU17_fbd44ae3_Rx_a83bf697_Rx (PduRDestPdu):
              PduRDestPduHandleId = 21
              PduRDestPduDirection = RECEIVE
              PduRDestPduRoutingType = API_FORWARDING
              PduRDestPduDataProcessing = IMMEDIATE
              PduRPduLengthHandlingStrategy = IGNORE
              PduRTransmissionConfirmation = false
              PduRDestPduRef = VDDMPropSignalIPDU17_1ed85da7_Rx
              PduRDestPduPduRBswModulesRef = Com
            PduRSrcPdu_a83bf697 (PduRSrcPdu): PduRSourcePduHandleId=21, PduRSrcPduDirection=RECEIVE, PduRSrcPduRef=VDDMPropSignalIPDU17_fbd44ae3_Rx, PduRSrcPduPduRBswModulesRef=CanIf
          IemPropSignalIPdu01_21049770_Tx: PduRRoutingPathCommunicationType=COMMUNICATION_INTERFACE
            IemPropSignalIPdu01_1988e981_Tx (PduRDestPdu):
              PduRDestPduHandleId = 2
              PduRDestPduDirection = TRANSMIT
              PduRDestPduRoutingType = API_FORWARDING
              PduRDestPduDataProcessing = IMMEDIATE
              PduRPduLengthHandlingStrategy = IGNORE
              PduRDestPduDataProvision = PDUR_DIRECT
              PduRTransmissionConfirmation = true
              PduRDestPduRef = IemPropSignalIPdu01_1988e981_Tx
              PduRDestPduPduRBswModulesRef = CanIf
            PduRSrcPdu_0bf0194b (PduRSrcPdu): PduRSourcePduHandleId=2, PduRSrcPduDirection=TRANSMIT, PduRSrcPduRef=IemPropSignalIPdu01_21049770_Tx, PduRSrcPduPduRBswModulesRef=Com
          IemToEtcUudtDcmIpdu2_39d23cc2_Tx: PduRRoutingPathCommunicationType=TRANSPORT_PROTOCOL
            PduRSrcPdu_1f99744c (PduRSrcPdu): PduRSourcePduHandleId=15, PduRSrcPduDirection=TRANSMIT, PduRSrcPduRef=IemToEtcUudtDcmIpdu2_39d23cc2_Tx, PduRSrcPduPduRBswModulesRef=Dcm
            IemToEtcUudtDcmIpdu2_07005902_Tx (PduRDestPdu):
              PduRDestPduHandleId = 2
              PduRDestPduDirection = TRANSMIT
              PduRDestPduRoutingType = API_FORWARDING
              PduRDestPduDataProcessing = IMMEDIATE
              PduRPduLengthHandlingStrategy = UNUSED
              PduRDestPduRef = IemToEtcUudtDcmIpdu2_07005902_Tx
              PduRDestPduPduRBswModulesRef = CanTp
          VDDMPropSignalIPDU16_765cb701_Rx: PduRRoutingPathCommunicationType=COMMUNICATION_INTERFACE
            PduRSrcPdu_86801b79 (PduRSrcPdu): PduRSourcePduHandleId=20, PduRSrcPduDirection=RECEIVE, PduRSrcPduRef=VDDMPropSignalIPDU16_765cb701_Rx, PduRSrcPduPduRBswModulesRef=CanIf
            VDDMPropSignalIPDU16_765cb701_Rx_86801b79_Rx (PduRDestPdu):
              PduRDestPduHandleId = 20
              PduRDestPduDirection = RECEIVE
              PduRDestPduRoutingType = API_FORWARDING
              PduRDestPduDataProcessing = IMMEDIATE
              PduRPduLengthHandlingStrategy = IGNORE
              PduRTransmissionConfirmation = false
              PduRDestPduRef = VDDMPropSignalIPDU16_69df6d31_Rx
              PduRDestPduPduRBswModulesRef = Com
          IemPropSignalIPdu02_b80dc6ca_Tx: PduRRoutingPathCommunicationType=COMMUNICATION_INTERFACE
            IemPropSignalIPdu02_5460e9e6_Tx (PduRDestPdu):
              PduRDestPduHandleId = 3
              PduRDestPduDirection = TRANSMIT
              PduRDestPduRoutingType = API_FORWARDING
              PduRDestPduDataProcessing = IMMEDIATE
              PduRPduLengthHandlingStrategy = IGNORE
              PduRDestPduDataProvision = PDUR_DIRECT
              PduRTransmissionConfirmation = true
              PduRDestPduRef = IemPropSignalIPdu02_5460e9e6_Tx
              PduRDestPduPduRBswModulesRef = CanIf
            PduRSrcPdu_956c143d (PduRSrcPdu): PduRSourcePduHandleId=3, PduRSrcPduDirection=TRANSMIT, PduRSrcPduRef=IemPropSignalIPdu02_b80dc6ca_Tx, PduRSrcPduPduRBswModulesRef=Com
          IemToVgmDiagDcmIpdu_ce8379a0_Tx: PduRRoutingPathCommunicationType=TRANSPORT_PROTOCOL
            IemToVgmDiagDcmIpdu_411ec11e_Tx (PduRDestPdu):
              PduRDestPduHandleId = 4
              PduRDestPduDirection = TRANSMIT
              PduRDestPduRoutingType = API_FORWARDING
              PduRDestPduDataProcessing = IMMEDIATE
              PduRPduLengthHandlingStrategy = UNUSED
              PduRDestPduRef = IemToVgmDiagDcmIpdu_411ec11e_Tx
              PduRDestPduPduRBswModulesRef = CanTp
            PduRSrcPdu_a6ed57d5 (PduRSrcPdu): PduRSourcePduHandleId=17, PduRSrcPduDirection=TRANSMIT, PduRSrcPduRef=IemToVgmDiagDcmIpdu_ce8379a0_Tx, PduRSrcPduPduRBswModulesRef=Dcm
          VDDMPropSignalIPDU11_60044a2d_Rx: PduRRoutingPathCommunicationType=COMMUNICATION_INTERFACE
            VDDMPropSignalIPDU11_60044a2d_Rx_3ed696a1_Rx (PduRDestPdu):
              PduRDestPduHandleId = 19
              PduRDestPduDirection = RECEIVE
              PduRDestPduRoutingType = API_FORWARDING
              PduRDestPduDataProcessing = IMMEDIATE
              PduRPduLengthHandlingStrategy = IGNORE
              PduRTransmissionConfirmation = false
              PduRDestPduRef = VDDMPropSignalIPDU11_f7bbf892_Rx
              PduRDestPduPduRBswModulesRef = Com
            PduRSrcPdu_3ed696a1 (PduRSrcPdu): PduRSourcePduHandleId=19, PduRSrcPduDirection=RECEIVE, PduRSrcPduRef=VDDMPropSignalIPDU11_60044a2d_Rx, PduRSrcPduPduRBswModulesRef=CanIf
          IemEduPropSignalIPdu01_3346005e_Tx: PduRRoutingPathCommunicationType=COMMUNICATION_INTERFACE
            IemEduPropSignalIPdu01_a3cd4ce7_Tx (PduRDestPdu):
              PduRDestPduHandleId = 0
              PduRDestPduDirection = TRANSMIT
              PduRDestPduRoutingType = API_FORWARDING
              PduRDestPduDataProcessing = IMMEDIATE
              PduRPduLengthHandlingStrategy = IGNORE
              PduRDestPduDataProvision = PDUR_DIRECT
              PduRTransmissionConfirmation = true
              PduRDestPduRef = IemEduPropSignalIPdu01_a3cd4ce7_Tx
              PduRDestPduPduRBswModulesRef = CanIf
            PduRSrcPdu_5ecec422 (PduRSrcPdu): PduRSourcePduHandleId=0, PduRSrcPduDirection=TRANSMIT, PduRSrcPduRef=IemEduPropSignalIPdu01_3346005e_Tx, PduRSrcPduPduRBswModulesRef=Com
          IemPropSignalIPdu12_a116f78b_Tx: PduRRoutingPathCommunicationType=COMMUNICATION_INTERFACE
            IemPropSignalIPdu12_1ae9e24f_Tx (PduRDestPdu):
              PduRDestPduHandleId = 10
              PduRDestPduDirection = TRANSMIT
              PduRDestPduRoutingType = API_FORWARDING
              PduRDestPduDataProcessing = IMMEDIATE
              PduRPduLengthHandlingStrategy = IGNORE
              PduRDestPduDataProvision = PDUR_DIRECT
              PduRTransmissionConfirmation = true
              PduRDestPduRef = IemPropSignalIPdu12_1ae9e24f_Tx
              PduRDestPduPduRBswModulesRef = CanIf
            PduRSrcPdu_a9fef54e (PduRSrcPdu): PduRSourcePduHandleId=10, PduRSrcPduDirection=TRANSMIT, PduRSrcPduRef=IemPropSignalIPdu12_a116f78b_Tx, PduRSrcPduPduRBswModulesRef=Com
          VDDMPropSignalIPDU18_5aed4d59_Rx: PduRRoutingPathCommunicationType=COMMUNICATION_INTERFACE
            VDDMPropSignalIPDU18_5aed4d59_Rx_c01e7a1d_Rx (PduRDestPdu):
              PduRDestPduHandleId = 22
              PduRDestPduDirection = RECEIVE
              PduRDestPduRoutingType = API_FORWARDING
              PduRDestPduDataProcessing = IMMEDIATE
              PduRPduLengthHandlingStrategy = IGNORE
              PduRTransmissionConfirmation = false
              PduRDestPduRef = VDDMPropSignalIPDU18_8e674036_Rx
              PduRDestPduPduRBswModulesRef = Com
            PduRSrcPdu_c01e7a1d (PduRSrcPdu): PduRSourcePduHandleId=22, PduRSrcPduDirection=RECEIVE, PduRSrcPduRef=VDDMPropSignalIPDU18_5aed4d59_Rx, PduRSrcPduPduRBswModulesRef=CanIf
          IemToEtcUudtDcmIpdu3_4ed50c54_Tx: PduRRoutingPathCommunicationType=TRANSPORT_PROTOCOL
            IemToEtcUudtDcmIpdu3_8a88a4e0_Tx (PduRDestPdu):
              PduRDestPduHandleId = 3
              PduRDestPduDirection = TRANSMIT
              PduRDestPduRoutingType = API_FORWARDING
              PduRDestPduDataProcessing = IMMEDIATE
              PduRPduLengthHandlingStrategy = UNUSED
              PduRDestPduRef = IemToEtcUudtDcmIpdu3_8a88a4e0_Tx
              PduRDestPduPduRBswModulesRef = CanTp
            PduRSrcPdu_e109a8bf (PduRSrcPdu): PduRSourcePduHandleId=16, PduRSrcPduDirection=TRANSMIT, PduRSrcPduRef=IemToEtcUudtDcmIpdu3_4ed50c54_Tx, PduRSrcPduPduRBswModulesRef=Dcm
          BecmPropSignalIpdu03_24914b42_Rx: PduRRoutingPathCommunicationType=COMMUNICATION_INTERFACE
            BecmPropSignalIpdu03_24914b42_Rx_2fbd4436_Rx (PduRDestPdu):
              PduRDestPduHandleId = 2
              PduRDestPduDirection = RECEIVE
              PduRDestPduRoutingType = API_FORWARDING
              PduRDestPduDataProcessing = IMMEDIATE
              PduRPduLengthHandlingStrategy = IGNORE
              PduRTransmissionConfirmation = false
              PduRDestPduRef = BecmPropSignalIpdu03_949658bb_Rx
              PduRDestPduPduRBswModulesRef = Com
            PduRSrcPdu_2fbd4436 (PduRSrcPdu): PduRSourcePduHandleId=2, PduRSrcPduDirection=RECEIVE, PduRSrcPduRef=BecmPropSignalIpdu03_24914b42_Rx, PduRSrcPduPduRBswModulesRef=CanIf
          IemPropSignalIPdu14_487552be_Tx: PduRRoutingPathCommunicationType=COMMUNICATION_INTERFACE
            IemPropSignalIPdu14_8139e281_Tx (PduRDestPdu):
              PduRDestPduHandleId = 11
              PduRDestPduDirection = TRANSMIT
              PduRDestPduRoutingType = API_FORWARDING
              PduRDestPduDataProcessing = IMMEDIATE
              PduRPduLengthHandlingStrategy = IGNORE
              PduRDestPduDataProvision = PDUR_DIRECT
              PduRTransmissionConfirmation = true
              PduRDestPduRef = IemPropSignalIPdu14_8139e281_Tx
              PduRDestPduPduRBswModulesRef = CanIf
            PduRSrcPdu_acf6831c (PduRSrcPdu): PduRSourcePduHandleId=11, PduRSrcPduDirection=TRANSMIT, PduRSrcPduRef=IemPropSignalIPdu14_487552be_Tx, PduRSrcPduPduRBswModulesRef=Com
          BecmPropSignalIpdu01_e4f1b6c7_Rx: PduRRoutingPathCommunicationType=COMMUNICATION_INTERFACE
            PduRSrcPdu_d978c2f8 (PduRSrcPdu): PduRSourcePduHandleId=0, PduRSrcPduDirection=RECEIVE, PduRSrcPduRef=BecmPropSignalIpdu01_e4f1b6c7_Rx, PduRSrcPduPduRBswModulesRef=CanIf
            BecmPropSignalIpdu01_e4f1b6c7_Rx_d978c2f8_Rx (PduRDestPdu):
              PduRDestPduHandleId = 0
              PduRDestPduDirection = RECEIVE
              PduRDestPduRoutingType = API_FORWARDING
              PduRDestPduDataProcessing = IMMEDIATE
              PduRPduLengthHandlingStrategy = IGNORE
              PduRTransmissionConfirmation = false
              PduRDestPduRef = BecmPropSignalIpdu01_7a983997_Rx
              PduRDestPduPduRBswModulesRef = Com
          EtcToIemJ1979OBDDiagDcmIpdu11_ac95f359_Rx: PduRRoutingPathCommunicationType=TRANSPORT_PROTOCOL
            PduRSrcPdu_62791526 (PduRSrcPdu): PduRSourcePduHandleId=1, PduRSrcPduDirection=RECEIVE, PduRSrcPduRef=EtcToIemJ1979OBDDiagDcmIpdu11_ac95f359_Rx, PduRSrcPduPduRBswModulesRef=CanTp
            EtcToIemJ1979OBDDiagDcmIpdu11_ac95f359_Rx_62791526_Rx (PduRDestPdu):
              PduRDestPduHandleId = 1
              PduRDestPduDirection = RECEIVE
              PduRDestPduRoutingType = API_FORWARDING
              PduRDestPduDataProcessing = IMMEDIATE
              PduRPduLengthHandlingStrategy = UNUSED
              PduRDestPduRef = EtcToIemJ1979OBDDiagDcmIpdu11_ad182927_Rx
              PduRDestPduPduRBswModulesRef = Dcm
          BecmPropSignalIpdu15_f1c84025_Rx: PduRRoutingPathCommunicationType=COMMUNICATION_INTERFACE
            BecmPropSignalIpdu15_f1c84025_Rx_97fbab59_Rx (PduRDestPdu):
              PduRDestPduHandleId = 3
              PduRDestPduDirection = RECEIVE
              PduRDestPduRoutingType = API_FORWARDING
              PduRDestPduDataProcessing = IMMEDIATE
              PduRPduLengthHandlingStrategy = IGNORE
              PduRTransmissionConfirmation = false
              PduRDestPduRef = BecmPropSignalIpdu15_64eecccf_Rx
              PduRDestPduPduRBswModulesRef = Com
            PduRSrcPdu_97fbab59 (PduRSrcPdu): PduRSourcePduHandleId=3, PduRSrcPduDirection=RECEIVE, PduRSrcPduRef=BecmPropSignalIpdu15_f1c84025_Rx, PduRSrcPduPduRBswModulesRef=CanIf
          IemToEtcUudtDcmIpdu1_a0db6d78_Tx: PduRRoutingPathCommunicationType=TRANSPORT_PROTOCOL
            IemToEtcUudtDcmIpdu1_4ae85965_Tx (PduRDestPdu):
              PduRDestPduHandleId = 1
              PduRDestPduDirection = TRANSMIT
              PduRDestPduRoutingType = API_FORWARDING
              PduRDestPduDataProcessing = IMMEDIATE
              PduRPduLengthHandlingStrategy = UNUSED
              PduRDestPduRef = IemToEtcUudtDcmIpdu1_4ae85965_Tx
              PduRDestPduPduRBswModulesRef = CanTp
            PduRSrcPdu_c6a1321b (PduRSrcPdu): PduRSourcePduHandleId=14, PduRSrcPduDirection=TRANSMIT, PduRSrcPduRef=IemToEtcUudtDcmIpdu1_a0db6d78_Tx, PduRSrcPduPduRBswModulesRef=Dcm
          ECMPropSignalIPDU06_719d5fe2_Rx: PduRRoutingPathCommunicationType=COMMUNICATION_INTERFACE
            PduRSrcPdu_2d833a1c (PduRSrcPdu): PduRSourcePduHandleId=8, PduRSrcPduDirection=RECEIVE, PduRSrcPduRef=ECMPropSignalIPDU06_719d5fe2_Rx, PduRSrcPduPduRBswModulesRef=CanIf
            ECMPropSignalIPDU06_719d5fe2_Rx_2d833a1c_Rx (PduRDestPdu):
              PduRDestPduHandleId = 8
              PduRDestPduDirection = RECEIVE
              PduRDestPduRoutingType = API_FORWARDING
              PduRDestPduDataProcessing = IMMEDIATE
              PduRPduLengthHandlingStrategy = IGNORE
              PduRTransmissionConfirmation = false
              PduRDestPduRef = ECMPropSignalIPDU06_ba4fcd25_Rx
              PduRDestPduPduRBswModulesRef = Com
          VDDMPropSignalIPDU05_753dbccf_Rx: PduRRoutingPathCommunicationType=COMMUNICATION_INTERFACE
            VDDMPropSignalIPDU05_753dbccf_Rx_8adb95b0_Rx (PduRDestPdu):
              PduRDestPduHandleId = 16
              PduRDestPduDirection = RECEIVE
              PduRDestPduRoutingType = API_FORWARDING
              PduRDestPduDataProcessing = IMMEDIATE
              PduRPduLengthHandlingStrategy = IGNORE
              PduRTransmissionConfirmation = false
              PduRDestPduRef = VDDMPropSignalIPDU05_e9cd0dca_Rx
              PduRDestPduPduRBswModulesRef = Com
            PduRSrcPdu_8adb95b0 (PduRSrcPdu): PduRSourcePduHandleId=16, PduRSrcPduDirection=RECEIVE, PduRSrcPduRef=VDDMPropSignalIPDU05_753dbccf_Rx, PduRSrcPduPduRBswModulesRef=CanIf
          IemPropSignalIPdu07_c8673245_Tx: PduRRoutingPathCommunicationType=COMMUNICATION_INTERFACE
            PduRSrcPdu_9766d5ce (PduRSrcPdu): PduRSourcePduHandleId=7, PduRSrcPduDirection=TRANSMIT, PduRSrcPduRef=IemPropSignalIPdu07_c8673245_Tx, PduRSrcPduPduRBswModulesRef=Com
            IemPropSignalIPdu07_8258e94f_Tx (PduRDestPdu):
              PduRDestPduHandleId = 7
              PduRDestPduDirection = TRANSMIT
              PduRDestPduRoutingType = API_FORWARDING
              PduRDestPduDataProcessing = IMMEDIATE
              PduRPduLengthHandlingStrategy = IGNORE
              PduRDestPduDataProvision = PDUR_DIRECT
              PduRTransmissionConfirmation = true
              PduRDestPduRef = IemPropSignalIPdu07_8258e94f_Tx
              PduRDestPduPduRBswModulesRef = CanIf
          VDDMPropSignalIPDU08_146446f0_Rx: PduRRoutingPathCommunicationType=COMMUNICATION_INTERFACE
            PduRSrcPdu_eff178fd (PduRSrcPdu): PduRSourcePduHandleId=18, PduRSrcPduDirection=RECEIVE, PduRSrcPduRef=VDDMPropSignalIPDU08_146446f0_Rx, PduRSrcPduPduRBswModulesRef=CanIf
            VDDMPropSignalIPDU08_146446f0_Rx_eff178fd_Rx (PduRDestPdu):
              PduRDestPduHandleId = 18
              PduRDestPduDirection = RECEIVE
              PduRDestPduRoutingType = API_FORWARDING
              PduRDestPduDataProcessing = IMMEDIATE
              PduRPduLengthHandlingStrategy = IGNORE
              PduRTransmissionConfirmation = false
              PduRDestPduRef = VDDMPropSignalIPDU08_977c7177_Rx
              PduRDestPduPduRBswModulesRef = Com
          VddmPropSignalIPdu26_893fed53_Rx: PduRRoutingPathCommunicationType=COMMUNICATION_INTERFACE
            VddmPropSignalIPdu26_893fed53_Rx_21f2d8e6_Rx (PduRDestPdu):
              PduRDestPduHandleId = 26
              PduRDestPduDirection = RECEIVE
              PduRDestPduRoutingType = API_FORWARDING
              PduRDestPduDataProcessing = IMMEDIATE
              PduRPduLengthHandlingStrategy = IGNORE
              PduRTransmissionConfirmation = false
              PduRDestPduRef = VddmPropSignalIPdu26_8fec2bf2_Rx
              PduRDestPduPduRBswModulesRef = Com
            PduRSrcPdu_21f2d8e6 (PduRSrcPdu): PduRSourcePduHandleId=26, PduRSrcPduDirection=RECEIVE, PduRSrcPduRef=VddmPropSignalIPdu26_893fed53_Rx, PduRSrcPduPduRBswModulesRef=CanIf
          EtcToAllJ1979OBDDiagDcmIpdu11_b7ab7660_Rx: PduRRoutingPathCommunicationType=TRANSPORT_PROTOCOL
            PduRSrcPdu_63335c9b (PduRSrcPdu): PduRSourcePduHandleId=0, PduRSrcPduDirection=RECEIVE, PduRSrcPduRef=EtcToAllJ1979OBDDiagDcmIpdu11_b7ab7660_Rx, PduRSrcPduPduRBswModulesRef=CanTp
            EtcToAllJ1979OBDDiagDcmIpdu11_b7ab7660_Rx_63335c9b_Rx (PduRDestPdu):
              PduRDestPduHandleId = 0
              PduRDestPduDirection = RECEIVE
              PduRDestPduRoutingType = API_FORWARDING
              PduRDestPduDataProcessing = IMMEDIATE
              PduRPduLengthHandlingStrategy = UNUSED
              PduRDestPduRef = EtcToAllJ1979OBDDiagDcmIpdu11_f3f7d8ab_Rx
              PduRDestPduPduRBswModulesRef = Dcm
          VddmBcmPropdTCSignalIPDU01_857b2e99_Rx: PduRRoutingPathCommunicationType=COMMUNICATION_INTERFACE
            VddmBcmPropdTCSignalIPDU01_857b2e99_Rx_f2322b88_Rx (PduRDestPdu):
              PduRDestPduHandleId = 25
              PduRDestPduDirection = RECEIVE
              PduRDestPduRoutingType = API_FORWARDING
              PduRDestPduDataProcessing = IMMEDIATE
              PduRPduLengthHandlingStrategy = IGNORE
              PduRTransmissionConfirmation = false
              PduRDestPduRef = VddmBcmPropdTCSignalIPDU01_886bd56f_Rx
              PduRDestPduPduRBswModulesRef = Com
            PduRSrcPdu_f2322b88 (PduRSrcPdu): PduRSourcePduHandleId=25, PduRSrcPduDirection=RECEIVE, PduRSrcPduRef=VddmBcmPropdTCSignalIPDU01_857b2e99_Rx, PduRSrcPduPduRBswModulesRef=CanIf
          VgmToIemDiagDcmIpdu_81f41e2d_Rx: PduRRoutingPathCommunicationType=TRANSPORT_PROTOCOL
            VgmToIemDiagDcmIpdu_81f41e2d_Rx_f62b73a4_Rx (PduRDestPdu):
              PduRDestPduHandleId = 6
              PduRDestPduDirection = RECEIVE
              PduRDestPduRoutingType = API_FORWARDING
              PduRDestPduDataProcessing = IMMEDIATE
              PduRPduLengthHandlingStrategy = UNUSED
              PduRDestPduRef = VgmToIemDiagDcmIpdu_cbf08236_Rx
              PduRDestPduPduRBswModulesRef = Dcm
            PduRSrcPdu_f62b73a4 (PduRSrcPdu): PduRSourcePduHandleId=6, PduRSrcPduDirection=RECEIVE, PduRSrcPduRef=VgmToIemDiagDcmIpdu_81f41e2d_Rx, PduRSrcPduPduRBswModulesRef=CanTp
          ECMPropSignalIPDU02_2a2da2a9_Rx: PduRRoutingPathCommunicationType=COMMUNICATION_INTERFACE
            PduRSrcPdu_c52842d9 (PduRSrcPdu): PduRSourcePduHandleId=5, PduRSrcPduDirection=RECEIVE, PduRSrcPduRef=ECMPropSignalIPDU02_2a2da2a9_Rx, PduRSrcPduPduRBswModulesRef=CanIf
            ECMPropSignalIPDU02_2a2da2a9_Rx_c52842d9_Rx (PduRDestPdu):
              PduRDestPduHandleId = 5
              PduRDestPduDirection = RECEIVE
              PduRDestPduRoutingType = API_FORWARDING
              PduRDestPduDataProcessing = IMMEDIATE
              PduRPduLengthHandlingStrategy = IGNORE
              PduRTransmissionConfirmation = false
              PduRDestPduRef = ECMPropSignalIPDU02_bd22093c_Rx
              PduRDestPduPduRBswModulesRef = Com
          IemToEtcJ1979OBDDiagDcmIpdu11_da239b2d_Tx: PduRRoutingPathCommunicationType=TRANSPORT_PROTOCOL
            IemToEtcJ1979OBDDiagDcmIpdu11_525ada58_Tx (PduRDestPdu):
              PduRDestPduHandleId = 0
              PduRDestPduDirection = TRANSMIT
              PduRDestPduRoutingType = API_FORWARDING
              PduRDestPduDataProcessing = IMMEDIATE
              PduRPduLengthHandlingStrategy = UNUSED
              PduRDestPduRef = IemToEtcJ1979OBDDiagDcmIpdu11_525ada58_Tx
              PduRDestPduPduRBswModulesRef = CanTp
            PduRSrcPdu_75b2e816 (PduRSrcPdu): PduRSourcePduHandleId=13, PduRSrcPduDirection=TRANSMIT, PduRSrcPduRef=IemToEtcJ1979OBDDiagDcmIpdu11_da239b2d_Tx, PduRSrcPduPduRBswModulesRef=Dcm
          ECMPropSignalIPDU05_3c755f85_Rx: PduRRoutingPathCommunicationType=COMMUNICATION_INTERFACE
            ECMPropSignalIPDU05_3c755f85_Rx_916b682c_Rx (PduRDestPdu):
              PduRDestPduHandleId = 7
              PduRDestPduDirection = RECEIVE
              PduRDestPduRoutingType = API_FORWARDING
              PduRDestPduDataProcessing = IMMEDIATE
              PduRPduLengthHandlingStrategy = IGNORE
              PduRTransmissionConfirmation = false
              PduRDestPduRef = ECMPropSignalIPDU05_23469c9f_Rx
              PduRDestPduPduRBswModulesRef = Com
            PduRSrcPdu_916b682c (PduRSrcPdu): PduRSourcePduHandleId=7, PduRSrcPduDirection=RECEIVE, PduRSrcPduRef=ECMPropSignalIPDU05_3c755f85_Rx, PduRSrcPduPduRBswModulesRef=CanIf
          EcmPropSignalIPdu25_89df781c_Rx: PduRRoutingPathCommunicationType=COMMUNICATION_INTERFACE
            EcmPropSignalIPdu25_89df781c_Rx_87cbdfdf_Rx (PduRDestPdu):
              PduRDestPduHandleId = 13
              PduRDestPduDirection = RECEIVE
              PduRDestPduRoutingType = API_FORWARDING
              PduRDestPduDataProcessing = IMMEDIATE
              PduRPduLengthHandlingStrategy = IGNORE
              PduRTransmissionConfirmation = false
              PduRDestPduRef = EcmPropSignalIPdu25_faea9d09_Rx
              PduRDestPduPduRBswModulesRef = Com
            PduRSrcPdu_87cbdfdf (PduRSrcPdu): PduRSourcePduHandleId=13, PduRSrcPduDirection=RECEIVE, PduRSrcPduRef=EcmPropSignalIPdu25_89df781c_Rx, PduRSrcPduPduRBswModulesRef=CanIf
          VDDMPropSignalIPDU19_d765b0bb_Rx: PduRRoutingPathCommunicationType=COMMUNICATION_INTERFACE
            VDDMPropSignalIPDU19_d765b0bb_Rx_83c4d48c_Rx (PduRDestPdu):
              PduRDestPduHandleId = 23
              PduRDestPduDirection = RECEIVE
              PduRDestPduRoutingType = API_FORWARDING
              PduRDestPduDataProcessing = IMMEDIATE
              PduRPduLengthHandlingStrategy = IGNORE
              PduRTransmissionConfirmation = false
              PduRDestPduRef = VDDMPropSignalIPDU19_f96070a0_Rx
              PduRDestPduPduRBswModulesRef = Com
            PduRSrcPdu_83c4d48c (PduRSrcPdu): PduRSourcePduHandleId=23, PduRSrcPduDirection=RECEIVE, PduRSrcPduRef=VDDMPropSignalIPDU19_d765b0bb_Rx, PduRSrcPduPduRBswModulesRef=CanIf
          IemEduPropSignalIPdu02_aa4f51e4_Tx: PduRRoutingPathCommunicationType=COMMUNICATION_INTERFACE
            PduRSrcPdu_f9d732b4 (PduRSrcPdu): PduRSourcePduHandleId=1, PduRSrcPduDirection=TRANSMIT, PduRSrcPduRef=IemEduPropSignalIPdu02_aa4f51e4_Tx, PduRSrcPduPduRBswModulesRef=Com
            IemEduPropSignalIPdu02_ee254c80_Tx (PduRDestPdu):
              PduRDestPduHandleId = 1
              PduRDestPduDirection = TRANSMIT
              PduRDestPduRoutingType = API_FORWARDING
              PduRDestPduDataProcessing = IMMEDIATE
              PduRPduLengthHandlingStrategy = IGNORE
              PduRDestPduDataProvision = PDUR_DIRECT
              PduRTransmissionConfirmation = true
              PduRDestPduRef = IemEduPropSignalIPdu02_ee254c80_Tx
              PduRDestPduPduRBswModulesRef = CanIf
          SrsPropSignalIPdu02_30ca6a16_Rx: PduRRoutingPathCommunicationType=COMMUNICATION_INTERFACE
            PduRSrcPdu_e6b4c0ad (PduRSrcPdu): PduRSourcePduHandleId=15, PduRSrcPduDirection=RECEIVE, PduRSrcPduRef=SrsPropSignalIPdu02_30ca6a16_Rx, PduRSrcPduPduRBswModulesRef=CanIf
            SrsPropSignalIPdu02_30ca6a16_Rx_e6b4c0ad_Rx (PduRDestPdu):
              PduRDestPduHandleId = 15
              PduRDestPduDirection = RECEIVE
              PduRDestPduRoutingType = API_FORWARDING
              PduRDestPduDataProcessing = IMMEDIATE
              PduRPduLengthHandlingStrategy = IGNORE
              PduRTransmissionConfirmation = false
              PduRDestPduRef = SrsPropSignalIPdu02_4fa2d123_Rx
              PduRDestPduPduRBswModulesRef = Com
          IemPropSignalIPdu06_bf6002d3_Tx: PduRRoutingPathCommunicationType=COMMUNICATION_INTERFACE
            IemPropSignalIPdu06_0fd014ad_Tx (PduRDestPdu):
              PduRDestPduHandleId = 6
              PduRDestPduDirection = TRANSMIT
              PduRDestPduRoutingType = API_FORWARDING
              PduRDestPduDataProcessing = IMMEDIATE
              PduRPduLengthHandlingStrategy = IGNORE
              PduRDestPduDataProvision = PDUR_DIRECT
              PduRTransmissionConfirmation = true
              PduRDestPduRef = IemPropSignalIPdu06_0fd014ad_Tx
              PduRDestPduPduRBswModulesRef = CanIf
            PduRSrcPdu_0af6e6e3 (PduRSrcPdu): PduRSourcePduHandleId=6, PduRSrcPduDirection=TRANSMIT, PduRSrcPduRef=IemPropSignalIPdu06_bf6002d3_Tx, PduRSrcPduPduRBswModulesRef=Com
          ECMPropSignalIPDU04_b1fda267_Rx: PduRRoutingPathCommunicationType=COMMUNICATION_INTERFACE
            PduRSrcPdu_e135b2fa (PduRSrcPdu): PduRSourcePduHandleId=6, PduRSrcPduDirection=RECEIVE, PduRSrcPduRef=ECMPropSignalIPDU04_b1fda267_Rx, PduRSrcPduPduRBswModulesRef=CanIf
            ECMPropSignalIPDU04_b1fda267_Rx_e135b2fa_Rx (PduRDestPdu):
              PduRDestPduHandleId = 6
              PduRDestPduDirection = RECEIVE
              PduRDestPduRoutingType = API_FORWARDING
              PduRDestPduDataProcessing = IMMEDIATE
              PduRPduLengthHandlingStrategy = IGNORE
              PduRTransmissionConfirmation = false
              PduRDestPduRef = ECMPropSignalIPDU04_5441ac09_Rx
              PduRDestPduPduRBswModulesRef = Com
          EcmPropSignalIPDU08_f2c9e4fc_Rx: PduRRoutingPathCommunicationType=COMMUNICATION_INTERFACE
            EcmPropSignalIPDU08_f2c9e4fc_Rx_cd8794a7_Rx (PduRDestPdu):
              PduRDestPduHandleId = 9
              PduRDestPduDirection = RECEIVE
              PduRDestPduRoutingType = API_FORWARDING
              PduRDestPduDataProcessing = IMMEDIATE
              PduRPduLengthHandlingStrategy = IGNORE
              PduRTransmissionConfirmation = false
              PduRDestPduRef = EcmPropSignalIPDU08_2e126ae8_Rx
              PduRDestPduPduRBswModulesRef = Com
            PduRSrcPdu_cd8794a7 (PduRSrcPdu): PduRSourcePduHandleId=9, PduRSrcPduDirection=RECEIVE, PduRSrcPduRef=EcmPropSignalIPDU08_f2c9e4fc_Rx, PduRSrcPduPduRBswModulesRef=CanIf
          VDDMPropSignalIPDU06_38d5bca8_Rx: PduRRoutingPathCommunicationType=COMMUNICATION_INTERFACE
            VDDMPropSignalIPDU06_38d5bca8_Rx_ac9bf55a_Rx (PduRDestPdu):
              PduRDestPduHandleId = 17
              PduRDestPduDirection = RECEIVE
              PduRDestPduRoutingType = API_FORWARDING
              PduRDestPduDataProcessing = IMMEDIATE
              PduRPduLengthHandlingStrategy = IGNORE
              PduRTransmissionConfirmation = false
              PduRDestPduRef = VDDMPropSignalIPDU06_70c45c70_Rx
              PduRDestPduPduRBswModulesRef = Com
            PduRSrcPdu_ac9bf55a (PduRSrcPdu): PduRSourcePduHandleId=17, PduRSrcPduDirection=RECEIVE, PduRSrcPduRef=VDDMPropSignalIPDU06_38d5bca8_Rx, PduRSrcPduPduRBswModulesRef=CanIf
          IemPropSignalIPdu09_2fdf1f42_Tx: PduRRoutingPathCommunicationType=COMMUNICATION_INTERFACE
            PduRSrcPdu_2b1294b8 (PduRSrcPdu): PduRSourcePduHandleId=9, PduRSrcPduDirection=TRANSMIT, PduRSrcPduRef=IemPropSignalIPdu09_2fdf1f42_Tx, PduRSrcPduPduRBswModulesRef=Com
            IemPropSignalIPdu09_aee91317_Tx (PduRDestPdu):
              PduRDestPduHandleId = 9
              PduRDestPduDirection = TRANSMIT
              PduRDestPduRoutingType = API_FORWARDING
              PduRDestPduDataProcessing = IMMEDIATE
              PduRPduLengthHandlingStrategy = IGNORE
              PduRDestPduDataProvision = PDUR_DIRECT
              PduRTransmissionConfirmation = true
              PduRDestPduRef = IemPropSignalIPdu09_aee91317_Tx
              PduRDestPduPduRBswModulesRef = CanIf
          IemPropSignalIPdu16_a67b3392_Tx: PduRRoutingPathCommunicationType=COMMUNICATION_INTERFACE
            IemPropSignalIPdu16_41591f04_Tx (PduRDestPdu):
              PduRDestPduHandleId = 12
              PduRDestPduDirection = TRANSMIT
              PduRDestPduRoutingType = API_FORWARDING
              PduRDestPduDataProcessing = IMMEDIATE
              PduRPduLengthHandlingStrategy = IGNORE
              PduRDestPduDataProvision = PDUR_DIRECT
              PduRTransmissionConfirmation = true
              PduRDestPduRef = IemPropSignalIPdu16_41591f04_Tx
              PduRDestPduPduRBswModulesRef = CanIf
            PduRSrcPdu_35fca203 (PduRSrcPdu): PduRSourcePduHandleId=12, PduRSrcPduDirection=TRANSMIT, PduRSrcPduRef=IemPropSignalIPdu16_a67b3392_Tx, PduRSrcPduPduRBswModulesRef=Com
          IemPropSignalIPdu03_cf0af65c_Tx: PduRRoutingPathCommunicationType=COMMUNICATION_INTERFACE
            PduRSrcPdu_292b77a0 (PduRSrcPdu): PduRSourcePduHandleId=4, PduRSrcPduDirection=TRANSMIT, PduRSrcPduRef=IemPropSignalIPdu03_cf0af65c_Tx, PduRSrcPduPduRBswModulesRef=Com
            IemPropSignalIPdu03_d9e81404_Tx (PduRDestPdu):
              PduRDestPduHandleId = 4
              PduRDestPduDirection = TRANSMIT
              PduRDestPduRoutingType = API_FORWARDING
              PduRDestPduDataProcessing = IMMEDIATE
              PduRPduLengthHandlingStrategy = IGNORE
              PduRDestPduDataProvision = PDUR_DIRECT
              PduRTransmissionConfirmation = true
              PduRDestPduRef = IemPropSignalIPdu03_d9e81404_Tx
              PduRDestPduPduRBswModulesRef = CanIf
          EcmPropSignalIPDU28_6fdbf3ae_Rx: PduRRoutingPathCommunicationType=COMMUNICATION_INTERFACE
            PduRSrcPdu_332380ac (PduRSrcPdu): PduRSourcePduHandleId=11, PduRSrcPduDirection=RECEIVE, PduRSrcPduRef=EcmPropSignalIPDU28_6fdbf3ae_Rx, PduRSrcPduPduRBswModulesRef=CanIf
            EcmPropSignalIPDU28_6fdbf3ae_Rx_332380ac_Rx (PduRDestPdu):
              PduRDestPduHandleId = 11
              PduRDestPduDirection = RECEIVE
              PduRDestPduRoutingType = API_FORWARDING
              PduRDestPduDataProcessing = IMMEDIATE
              PduRPduLengthHandlingStrategy = IGNORE
              PduRTransmissionConfirmation = false
              PduRDestPduRef = EcmPropSignalIPDU28_1c24086a_Rx
              PduRDestPduPduRBswModulesRef = Com
          VgmToAllFuncDiagDcmIpdu_030e2fcd_Rx: PduRRoutingPathCommunicationType=TRANSPORT_PROTOCOL
            PduRSrcPdu_3ccfd7a6 (PduRSrcPdu): PduRSourcePduHandleId=5, PduRSrcPduDirection=RECEIVE, PduRSrcPduRef=VgmToAllFuncDiagDcmIpdu_030e2fcd_Rx, PduRSrcPduPduRBswModulesRef=CanTp
            VgmToAllFuncDiagDcmIpdu_030e2fcd_Rx_3ccfd7a6_Rx (PduRDestPdu):
              PduRDestPduHandleId = 5
              PduRDestPduDirection = RECEIVE
              PduRDestPduRoutingType = API_FORWARDING
              PduRDestPduDataProcessing = IMMEDIATE
              PduRPduLengthHandlingStrategy = UNUSED
              PduRDestPduRef = VgmToAllFuncDiagDcmIpdu_89c72e24_Rx
              PduRDestPduPduRBswModulesRef = Dcm
          PropulsionCAN_EiraUserData: PduRRoutingPathCommunicationType=COMMUNICATION_INTERFACE
            PduRSrcPdu_3 (PduRSrcPdu): PduRSourcePduHandleId=18, PduRSrcPduDirection=TRANSMIT, PduRSrcPduRef=PropulsionCAN_EiraUserData_Tx, PduRSrcPduPduRBswModulesRef=Com
            PropulsionCAN_EiraUserData_Dest (PduRDestPdu):
              PduRDestPduHandleId = 13
              PduRDestPduDirection = TRANSMIT
              PduRDestPduRoutingType = API_FORWARDING
              PduRDestPduDataProcessing = IMMEDIATE
              PduRPduLengthHandlingStrategy = IGNORE
              PduRDestPduDataProvision = PDUR_TRIGGERTRANSMIT
              PduRTransmissionConfirmation = false
              PduRDestPduRef = PropulsionCAN_EiraUserData_Tx
              PduRDestPduPduRBswModulesRef = CanNm
          UudtDcmRx1: PduRRoutingPathCommunicationType=TRANSPORT_PROTOCOL
            PduRSrcPdu: PduRSourcePduHandleId=2, PduRSrcPduDirection=RECEIVE, PduRSrcPduRef=UudtDcmRx1, PduRSrcPduPduRBswModulesRef=CanTp
            UudtDcmRx1_Dest (PduRDestPdu):
              PduRDestPduHandleId = 2
              PduRDestPduDirection = RECEIVE
              PduRDestPduRoutingType = API_FORWARDING
              PduRDestPduDataProcessing = IMMEDIATE
              PduRPduLengthHandlingStrategy = UNUSED
              PduRDestPduRef = UudtDcmRx1
              PduRDestPduPduRBswModulesRef = Dcm
          UudtDcmRx2: PduRRoutingPathCommunicationType=TRANSPORT_PROTOCOL
            PduRSrcPdu_1 (PduRSrcPdu): PduRSourcePduHandleId=3, PduRSrcPduDirection=RECEIVE, PduRSrcPduRef=UudtDcmRx2, PduRSrcPduPduRBswModulesRef=CanTp
            UudtDcmRx2_Dest (PduRDestPdu):
              PduRDestPduHandleId = 3
              PduRDestPduDirection = RECEIVE
              PduRDestPduRoutingType = API_FORWARDING
              PduRDestPduDataProcessing = IMMEDIATE
              PduRPduLengthHandlingStrategy = UNUSED
              PduRDestPduRef = UudtDcmRx2
              PduRDestPduPduRBswModulesRef = Dcm
          UudtDcmRx3: PduRRoutingPathCommunicationType=TRANSPORT_PROTOCOL
            PduRSrcPdu_2 (PduRSrcPdu): PduRSourcePduHandleId=4, PduRSrcPduDirection=RECEIVE, PduRSrcPduRef=UudtDcmRx3, PduRSrcPduPduRBswModulesRef=CanTp
            UudtDcmRx3_Dest (PduRDestPdu):
              PduRDestPduHandleId = 4
              PduRDestPduDirection = RECEIVE
              PduRDestPduRoutingType = API_FORWARDING
              PduRDestPduDataProcessing = IMMEDIATE
              PduRPduLengthHandlingStrategy = UNUSED
              PduRDestPduRef = UudtDcmRx3
              PduRDestPduPduRBswModulesRef = Dcm
      PduRLock_PduRExclusiveArea (PduRLock)
        PduRExclusiveArea: PduRExclusiveAreaId=0
    5 x PduRBswModules, all with PduRCancelReceive=false, PduRCancelTransmit=false, PduRChangeParameterRequestApi=false:
      CanIf: PduRCommunicationInterface=true, PduRLowerModule=true, PduRTransportProtocol=false, PduRTriggertransmit=false, PduRTxConfirmation=true, PduRUpperModule=false, PduRUseTag=false, PduRBswModuleRef=CanIf
      CanTp: PduRCommunicationInterface=false, PduRLowerModule=true, PduRTransportProtocol=true, PduRTriggertransmit=false, PduRTxConfirmation=false, PduRUpperModule=false, PduRUseTag=false, PduRBswModuleRef=CanTp
      Com: PduRCommunicationInterface=true, PduRLowerModule=false, PduRTransportProtocol=false, PduRTriggertransmit=true, PduRTxConfirmation=true, PduRUpperModule=true, PduRUseTag=false, PduRBswModuleRef=Com
      Dcm: PduRCommunicationInterface=false, PduRLowerModule=false, PduRTransportProtocol=true, PduRTriggertransmit=false, PduRTxConfirmation=false, PduRUpperModule=true, PduRUseTag=true, PduRBswModuleRef=Dcm
      CanNm: PduRCommunicationInterface=true, PduRLowerModule=true, PduRTransportProtocol=false, PduRTriggertransmit=true, PduRTxConfirmation=false, PduRUpperModule=false, PduRUseTag=false, PduRBswModuleRef=CanNm

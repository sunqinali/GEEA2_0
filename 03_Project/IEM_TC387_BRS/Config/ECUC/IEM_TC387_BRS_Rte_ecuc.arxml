[part 1 of 5: package /ActiveEcuC]
AUTOSAR XML (schema 4-2-2)
package /ActiveEcuC
  module config Rte: implementation-config-variant=VARIANT-PRE-COMPILE, module-description=Rte_Impl
    RteInitializationBehavior: RteInitializationStrategy=RTE_INITIALIZATION_STRATEGY_AT_DATA_DECLARATION, RteSectionInitializationPolicy=INIT
    RteGeneration:
      RteGenerationMode = COMPATIBILITY_MODE
      RteIocInteractionReturnValue = RTE_IOC
      RteValueRangeCheckEnabled = false
      RteCalibrationSupport = NONE
      RteCodeVendorId = 30
      RteDevErrorDetect = false
      RteDevErrorDetectUninit = false
      RteMeasurementSupport = false
      RteOptimizationMode = MEMORY
      RteVfbTraceEnabled = false
    RteBswGeneral: RteSchMVersionInfoApi=false, RteUseComShadowSignalApi=false
    RteOsInteraction
    16 x RteBswModuleInstance:
      BswM: RteBswImplementationRef=BswM_Impl, RteBswModuleConfigurationRef=BswM
        BSWM_EXCLUSIVE_AREA_0 (RteBswExclusiveAreaImpl): RteExclusiveAreaImplMechanism=ALL_INTERRUPT_BLOCKING, RteBswExclusiveAreaRef=BSWM_EXCLUSIVE_AREA_0
        BswM_MainFunctionTimingEvent0 (RteBswEventToTaskMapping):
          RteBswImmediateRestart = false
          RteBswPositionInTask = 1
          RteCyclicTriggerImplementation = None
          RteBswEventRef = BswM_MainFunctionTimingEvent0
          RteBswMappedToTaskRef = Task_Bsw_10ms
          RteBswUsedOsAlarmRef = Alarm_Bsw_10ms
      Can: RteBswImplementationRef=Can_Impl, RteBswModuleConfigurationRef=Can
        3 x RteBswEventToTaskMapping, all with RteBswImmediateRestart=false, RteCyclicTriggerImplementation=None, RteBswMappedToTaskRef=Task_Bsw_10ms, RteBswUsedOsAlarmRef=Alarm_Bsw_10ms:
          Can_MainFunction_BusOffTimingEvent0: RteBswPositionInTask=2, RteBswEventRef=Can_MainFunction_BusOffTimingEvent0
          Can_MainFunction_WakeupTimingEvent0: RteBswPositionInTask=3, RteBswEventRef=Can_MainFunction_WakeupTimingEvent0
          Can_MainFunction_ModeTimingEvent0: RteBswPositionInTask=4, RteBswEventRef=Can_MainFunction_ModeTimingEvent0
        8 x RteBswExclusiveAreaImpl, all with RteExclusiveAreaImplMechanism=ALL_INTERRUPT_BLOCKING:
          CAN_EXCLUSIVE_AREA_{0..7}: RteBswExclusiveAreaRef=CAN_EXCLUSIVE_AREA_{0..7}
      CanIf: RteBswImplementationRef=CanIf_Impl, RteBswModuleConfigurationRef=CanIf
        8 x RteBswExclusiveAreaImpl, all with RteExclusiveAreaImplMechanism=ALL_INTERRUPT_BLOCKING:
          CANIF_EXCLUSIVE_AREA_{0..7}: RteBswExclusiveAreaRef=CANIF_EXCLUSIVE_AREA_{0..7}
      CanNm: RteBswImplementationRef=CanNm_Impl, RteBswModuleConfigurationRef=CanNm
        CanNm_MainFunctionTimingEvent0 (RteBswEventToTaskMapping):
          RteBswImmediateRestart = false
          RteBswPositionInTask = 1
          RteCyclicTriggerImplementation = None
          RteBswEventRef = CanNm_MainFunctionTimingEvent0
          RteBswMappedToTaskRef = Task_Com_5ms
          RteBswUsedOsAlarmRef = Alarm_Com_5ms
        7 x RteBswExclusiveAreaImpl, all with RteExclusiveAreaImplMechanism=ALL_INTERRUPT_BLOCKING:
          CANNM_EXCLUSIVE_AREA_{0..6}: RteBswExclusiveAreaRef=CANNM_EXCLUSIVE_AREA_{0..6}
      CanSM: RteBswImplementationRef=CanSM_Impl, RteBswModuleConfigurationRef=CanSM
        CanSM_MainFunctionTimingEvent0 (RteBswEventToTaskMapping):
          RteBswImmediateRestart = false
          RteBswPositionInTask = 5
          RteCyclicTriggerImplementation = None
          RteBswEventRef = CanSM_MainFunctionTimingEvent0
          RteBswMappedToTaskRef = Task_Bsw_10ms
          RteBswUsedOsAlarmRef = Alarm_Bsw_10ms
        6 x RteBswExclusiveAreaImpl, all with RteExclusiveAreaImplMechanism=ALL_INTERRUPT_BLOCKING:
          CANSM_EXCLUSIVE_AREA_{1..6}: RteBswExclusiveAreaRef=CANSM_EXCLUSIVE_AREA_{1..6}
      CanTp: RteBswImplementationRef=CanTp_Impl, RteBswModuleConfigurationRef=CanTp
        CanTp_MainFunctionTimingEvent0 (RteBswEventToTaskMapping):
          RteBswImmediateRestart = false
          RteBswPositionInTask = 0
          RteCyclicTriggerImplementation = None
          RteBswEventRef = CanTp_MainFunctionTimingEvent0
          RteBswMappedToTaskRef = Task_Com_5ms
          RteBswUsedOsAlarmRef = Alarm_Com_5ms
        CANTP_EXCLUSIVE_AREA_0 (RteBswExclusiveAreaImpl): RteExclusiveAreaImplMechanism=ALL_INTERRUPT_BLOCKING, RteBswExclusiveAreaRef=CANTP_EXCLUSIVE_AREA_0
      Com: RteBswImplementationRef=Com_Impl, RteBswModuleConfigurationRef=Com
        Com_MainFunctionTxTimingEvent0 (RteBswEventToTaskMapping):
          RteBswImmediateRestart = false
          RteBswPositionInTask = 3
          RteCyclicTriggerImplementation = None
          RteBswEventRef = Com_MainFunctionTxTimingEvent0
          RteBswMappedToTaskRef = Task_Com_5ms
          RteBswUsedOsAlarmRef = Alarm_Com_5ms
        Com_MainFunctionRxTimingEvent0 (RteBswEventToTaskMapping):
          RteBswImmediateRestart = false
          RteBswPositionInTask = 2
          RteCyclicTriggerImplementation = None
          RteBswEventRef = Com_MainFunctionRxTimingEvent0
          RteBswMappedToTaskRef = Task_Com_5ms
          RteBswUsedOsAlarmRef = Alarm_Com_5ms
        3 x RteBswExclusiveAreaImpl, all with RteExclusiveAreaImplMechanism=ALL_INTERRUPT_BLOCKING:
          COM_EXCLUSIVE_AREA_TX: RteBswExclusiveAreaRef=COM_EXCLUSIVE_AREA_TX
          COM_EXCLUSIVE_AREA_RX: RteBswExclusiveAreaRef=COM_EXCLUSIVE_AREA_RX
          COM_EXCLUSIVE_AREA_BOTH: RteBswExclusiveAreaRef=COM_EXCLUSIVE_AREA_BOTH
      ComM: RteBswImplementationRef=ComM_Impl, RteBswModuleConfigurationRef=ComM
        ComM_MainFunction_0TimingEvent0 (RteBswEventToTaskMapping):
          RteBswImmediateRestart = false
          RteBswPositionInTask = 6
          RteCyclicTriggerImplementation = None
          RteBswEventRef = ComM_MainFunction_0TimingEvent0
          RteBswMappedToTaskRef = Task_Bsw_10ms
          RteBswUsedOsAlarmRef = Alarm_Bsw_10ms
        COMM_EXCLUSIVE_AREA_0 (RteBswExclusiveAreaImpl): RteExclusiveAreaImplMechanism=ALL_INTERRUPT_BLOCKING, RteBswExclusiveAreaRef=COMM_EXCLUSIVE_AREA_0
        COMM_EXCLUSIVE_AREA_1 (RteBswExclusiveAreaImpl): RteExclusiveAreaImplMechanism=ALL_INTERRUPT_BLOCKING, RteBswExclusiveAreaRef=COMM_EXCLUSIVE_AREA_1
      Dcm: RteBswImplementationRef=Dcm_Impl, RteBswModuleConfigurationRef=Dcm
        Dcm_MainFunctionTimingEvent0 (RteBswEventToTaskMapping):
          RteBswImmediateRestart = false
          RteBswPositionInTask = 7
          RteCyclicTriggerImplementation = None
          RteBswEventRef = Dcm_MainFunctionTimingEvent0
          RteBswMappedToTaskRef = Task_Bsw_10ms
          RteBswUsedOsAlarmRef = Alarm_Bsw_10ms
        DCM_EXCLUSIVE_AREA_0 (RteBswExclusiveAreaImpl): RteExclusiveAreaImplMechanism=ALL_INTERRUPT_BLOCKING, RteBswExclusiveAreaRef=DCM_EXCLUSIVE_AREA_0
      Dem: RteBswImplementationRef=Dem_Impl, RteBswModuleConfigurationRef=Dem
        Dem_MasterMainFunctionTimingEvent0 (RteBswEventToTaskMapping):
          RteBswImmediateRestart = false
          RteBswPositionInTask = 8
          RteCyclicTriggerImplementation = None
          RteBswEventRef = Dem_MasterMainFunctionTimingEvent0
          RteBswMappedToTaskRef = Task_Bsw_10ms
          RteBswUsedOsAlarmRef = Alarm_Bsw_10ms
        Dem_SatelliteMainFunctionTimingEvent0 (RteBswEventToTaskMapping):
          RteBswImmediateRestart = false
          RteBswPositionInTask = 9
          RteCyclicTriggerImplementation = None
          RteBswEventRef = Dem_SatelliteMainFunctionTimingEvent0
          RteBswMappedToTaskRef = Task_Bsw_10ms
          RteBswUsedOsAlarmRef = Alarm_Bsw_10ms
        5 x RteBswExclusiveAreaImpl, all with RteExclusiveAreaImplMechanism=ALL_INTERRUPT_BLOCKING:
          DEM_EXCLUSIVE_AREA_{0..4}: RteBswExclusiveAreaRef=DEM_EXCLUSIVE_AREA_{0..4}
      Det: RteBswImplementationRef=Det_Impl, RteBswModuleConfigurationRef=Det
        DET_EXCLUSIVE_AREA_0 (RteBswExclusiveAreaImpl): RteExclusiveAreaImplMechanism=ALL_INTERRUPT_BLOCKING, RteBswExclusiveAreaRef=DET_EXCLUSIVE_AREA_0
      EcuM: RteBswImplementationRef=EcuM_Impl, RteBswModuleConfigurationRef=EcuM
        EcuM_MainFunctionTimingEvent0 (RteBswEventToTaskMapping):
          RteBswImmediateRestart = false
          RteBswPositionInTask = 0
          RteCyclicTriggerImplementation = None
          RteBswEventRef = EcuM_MainFunctionTimingEvent0
          RteBswMappedToTaskRef = Task_Bsw_10ms
          RteBswUsedOsAlarmRef = Alarm_Bsw_10ms
        3 x RteBswExclusiveAreaImpl, all with RteExclusiveAreaImplMechanism=ALL_INTERRUPT_BLOCKING:
          ECUM_EXCLUSIVE_AREA_{0..2}: RteBswExclusiveAreaRef=ECUM_EXCLUSIVE_AREA_{0..2}
        3 x RteBswEventToTaskMapping, all with RteBswImmediateRestart=false, RteBswPositionInTask=0, RteCyclicTriggerImplementation=None:
          EcuM_MainFunctionTimingEvent1: RteBswEventRef=EcuM_MainFunctionTimingEvent1, RteBswMappedToTaskRef=Task_EcuM_Core1
          EcuM_MainFunctionTimingEvent2: RteBswEventRef=EcuM_MainFunctionTimingEvent2, RteBswMappedToTaskRef=Task_Appl_10ms, RteBswUsedOsAlarmRef=Alarm_Appl_10ms
          EcuM_MainFunctionTimingEvent3: RteBswEventRef=EcuM_MainFunctionTimingEvent3, RteBswMappedToTaskRef=Task_EcuM_Core3
        ECUM_EXCLUSIVE_AREA_3 (RteBswExclusiveAreaImpl): RteExclusiveAreaImplMechanism=ALL_INTERRUPT_BLOCKING, RteBswExclusiveAreaRef=ECUM_EXCLUSIVE_AREA_3
      Mcu: RteBswImplementationRef=Mcu_Impl, RteBswModuleConfigurationRef=Mcu
        TomTgcReg (RteBswExclusiveAreaImpl): RteExclusiveAreaImplMechanism=ALL_INTERRUPT_BLOCKING, RteBswExclusiveAreaRef=TomTgcReg
        AtomAgcReg (RteBswExclusiveAreaImpl): RteExclusiveAreaImplMechanism=ALL_INTERRUPT_BLOCKING, RteBswExclusiveAreaRef=AtomAgcReg
      Nm: RteBswImplementationRef=Nm_Impl, RteBswModuleConfigurationRef=Nm
        NM_EXCLUSIVE_AREA_0 (RteBswExclusiveAreaImpl): RteExclusiveAreaImplMechanism=ALL_INTERRUPT_BLOCKING, RteBswExclusiveAreaRef=NM_EXCLUSIVE_AREA_0
        NM_EXCLUSIVE_AREA_1 (RteBswExclusiveAreaImpl): RteExclusiveAreaImplMechanism=ALL_INTERRUPT_BLOCKING, RteBswExclusiveAreaRef=NM_EXCLUSIVE_AREA_1
      PduR: RteBswImplementationRef=PduR_Impl, RteBswModuleConfigurationRef=PduR
        PDUR_EXCLUSIVE_AREA_0 (RteBswExclusiveAreaImpl): RteExclusiveAreaImplMechanism=ALL_INTERRUPT_BLOCKING, RteBswExclusiveAreaRef=PDUR_EXCLUSIVE_AREA_0
      Rte: RteBswImplementationRef=Rte_Impl, RteBswModuleConfigurationRef=Rte
        Rte_ComSendSignalProxyPeriodicTimingEvent0 (RteBswEventToTaskMapping):
          RteBswImmediateRestart = false
          RteBswPositionInTask = 4
          RteCyclicTriggerImplementation = None
          RteBswEventRef = Rte_ComSendSignalProxyPeriodicTimingEvent0
          RteBswMappedToTaskRef = Task_Com_5ms
          RteBswUsedOsAlarmRef = Alarm_Com_5ms
    7 x RteSwComponentInstance:
      EcuM_EcuSwComposition: RteSoftwareComponentInstanceRef=EcuM
        12 x RteEventToTaskMapping, all with RteImmediateRestart=false:
          Timer_EcuM_MainFunction: RtePositionInTask=0, RteCyclicTriggerImplementation=None, RteEventRef=Timer_EcuM_MainFunction, RteMappedToTaskRef=Task_Bsw_10ms, RteUsedOsAlarmRef=Alarm_Bsw_10ms
          OpEventSelectShutdownTarget_SelectShutdownTarget_EcuM_ShutdownTarget: RteEventRef=OpEventSelectShutdownTarget_SelectShutdownTarget_EcuM_ShutdownTarget
          OpEventGetShutdownTarget_GetShutdownTarget_EcuM_ShutdownTarget: RteEventRef=OpEventGetShutdownTarget_GetShutdownTarget_EcuM_ShutdownTarget
          OpEventGetLastShutdownTarget_GetLastShutdownTarget_EcuM_ShutdownTarget: RteEventRef=OpEventGetLastShutdownTarget_GetLastShutdownTarget_EcuM_ShutdownTarget
          OpEventSelectShutdownCause_SelectShutdownCause_EcuM_ShutdownTarget: RteEventRef=OpEventSelectShutdownCause_SelectShutdownCause_EcuM_ShutdownTarget
          OpEventGetShutdownCause_GetShutdownCause_EcuM_ShutdownTarget: RteEventRef=OpEventGetShutdownCause_GetShutdownCause_EcuM_ShutdownTarget
          OpEventSelectBootTarget_SelectBootTarget_EcuM_BootTarget: RteEventRef=OpEventSelectBootTarget_SelectBootTarget_EcuM_BootTarget
          OpEventGetBootTarget_GetBootTarget_EcuM_BootTarget: RteEventRef=OpEventGetBootTarget_GetBootTarget_EcuM_BootTarget
          OpEventReleasePOSTRUN_ReleasePOSTRUN_StateRequest_EcuMConf_EcuMFlexUserConfig_EcuMUser_BswM: RteEventRef=OpEventReleasePOSTRUN_ReleasePOSTRUN_StateRequest_EcuMConf_EcuMFlexUserConfig_EcuMUser_BswM
          OpEventRequestRUN_RequestRUN_StateRequest_EcuMConf_EcuMFlexUserConfig_EcuMUser_BswM: RteEventRef=OpEventRequestRUN_RequestRUN_StateRequest_EcuMConf_EcuMFlexUserConfig_EcuMUser_BswM
          OpEventReleaseRUN_ReleaseRUN_StateRequest_EcuMConf_EcuMFlexUserConfig_EcuMUser_BswM: RteEventRef=OpEventReleaseRUN_ReleaseRUN_StateRequest_EcuMConf_EcuMFlexUserConfig_EcuMUser_BswM
          OpEventRequestPOSTRUN_RequestPOSTRUN_StateRequest_EcuMConf_EcuMFlexUserConfig_EcuMUser_BswM: RteEventRef=OpEventRequestPOSTRUN_RequestPOSTRUN_StateRequest_EcuMConf_EcuMFlexUserConfig_EcuMUser_BswM
      DemMaster_0_EcuSwComposition: RteSoftwareComponentInstanceRef=DemMaster_0
        178 x RteEventToTaskMapping, all with RteImmediateRestart=false:
          Timer_Dem_MasterMainFunction: RtePositionInTask=8, RteCyclicTriggerImplementation=None, RteEventRef=Timer_Dem_MasterMainFunction, RteMappedToTaskRef=Task_Bsw_10ms, RteUsedOsAlarmRef=Alarm_Bsw_10ms
          OpEventPostRunRequested_GetPostRunRequested_DemServices: RteEventRef=OpEventPostRunRequested_GetPostRunRequested_DemServices
          OpEventGetDTCStatusAvailabilityMask_GetDTCStatusAvailabilityMask_DemServices: RteEventRef=OpEventGetDTCStatusAvailabilityMask_GetDTCStatusAvailabilityMask_DemServices
          OpEventSetEnableCondition_SetEnableCondition_EnableCond_of: RteEventRef=OpEventSetEnableCondition_SetEnableCondition_EnableCond_of
          OpEventSetEnableCondition_SetEnableCondition_EnableCond_motor: RteEventRef=OpEventSetEnableCondition_SetEnableCondition_EnableCond_motor
          OpEventSetEnableCondition_SetEnableCondition_EnableCond_transition: RteEventRef=OpEventSetEnableCondition_SetEnableCondition_EnableCond_transition
          OpEventSetEnableCondition_SetEnableCondition_EnableCond_No: RteEventRef=OpEventSetEnableCondition_SetEnableCondition_EnableCond_No
          OpEventSetEnableCondition_SetEnableCondition_EnableCond_Nm: RteEventRef=OpEventSetEnableCondition_SetEnableCondition_EnableCond_Nm
          OpEventSetEnableCondition_SetEnableCondition_EnableCond_and_001: RteEventRef=OpEventSetEnableCondition_SetEnableCondition_EnableCond_and_001
          OpEventSetEnableCondition_SetEnableCondition_EnableCond_P5: RteEventRef=OpEventSetEnableCondition_SetEnableCondition_EnableCond_P5
          OpEventSetEnableCondition_SetEnableCondition_EnableCond_resolver: RteEventRef=OpEventSetEnableCondition_SetEnableCondition_EnableCond_resolver
          OpEventSetEnableCondition_SetEnableCondition_EnableCond_or: RteEventRef=OpEventSetEnableCondition_SetEnableCondition_EnableCond_or
          OpEventSetEnableCondition_SetEnableCondition_EnableCond_state: RteEventRef=OpEventSetEnableCondition_SetEnableCondition_EnableCond_state
          OpEventSetEnableCondition_SetEnableCondition_EnableCond_parameter: RteEventRef=OpEventSetEnableCondition_SetEnableCondition_EnableCond_parameter
          OpEventSetEnableCondition_SetEnableCondition_EnableCond_INV_IAC_U_ELEC_LO: RteEventRef=OpEventSetEnableCondition_SetEnableCondition_EnableCond_INV_IAC_U_ELEC_LO
          OpEventSetEnableCondition_SetEnableCondition_EnableCond_seconds: RteEventRef=OpEventSetEnableCondition_SetEnableCondition_EnableCond_seconds
          OpEventSetEnableCondition_SetEnableCondition_EnableCond_LV: RteEventRef=OpEventSetEnableCondition_SetEnableCondition_EnableCond_LV
          OpEventSetEnableCondition_SetEnableCondition_EnableCond_ElPowerLevel: RteEventRef=OpEventSetEnableCondition_SetEnableCondition_EnableCond_ElPowerLevel
          OpEventSetEnableCondition_SetEnableCondition_EnableCond_faults: RteEventRef=OpEventSetEnableCondition_SetEnableCondition_EnableCond_faults
          OpEventSetEnableCondition_SetEnableCondition_EnableCond_NO_002: RteEventRef=OpEventSetEnableCondition_SetEnableCondition_EnableCond_NO_002
          OpEventSetEnableCondition_SetEnableCondition_EnableCond_initliazation: RteEventRef=OpEventSetEnableCondition_SetEnableCondition_EnableCond_initliazation
          OpEventSetEnableCondition_SetEnableCondition_EnableCond_while: RteEventRef=OpEventSetEnableCondition_SetEnableCondition_EnableCond_while
          OpEventSetEnableCondition_SetEnableCondition_EnableCond_start: RteEventRef=OpEventSetEnableCondition_SetEnableCondition_EnableCond_start
          OpEventSetEnableCondition_SetEnableCondition_EnableCond_fault: RteEventRef=OpEventSetEnableCondition_SetEnableCondition_EnableCond_fault
          OpEventSetEnableCondition_SetEnableCondition_EnableCond_faulte: RteEventRef=OpEventSetEnableCondition_SetEnableCondition_EnableCond_faulte
          OpEventSetEnableCondition_SetEnableCondition_EnableCond_a_001: RteEventRef=OpEventSetEnableCondition_SetEnableCondition_EnableCond_a_001
          OpEventSetEnableCondition_SetEnableCondition_EnableCond_consumption: RteEventRef=OpEventSetEnableCondition_SetEnableCondition_EnableCond_consumption
          OpEventSetEnableCondition_SetEnableCondition_EnableCond_BusOff: RteEventRef=OpEventSetEnableCondition_SetEnableCondition_EnableCond_BusOff
          OpEventSetEnableCondition_SetEnableCondition_EnableCond_once: RteEventRef=OpEventSetEnableCondition_SetEnableCondition_EnableCond_once
          OpEventSetEnableCondition_SetEnableCondition_EnableCond_below: RteEventRef=OpEventSetEnableCondition_SetEnableCondition_EnableCond_below
          OpEventSetEnableCondition_SetEnableCondition_EnableCond_system: RteEventRef=OpEventSetEnableCondition_SetEnableCondition_EnableCond_system
          OpEventSetEnableCondition_SetEnableCondition_EnableCond_Voltage9: RteEventRef=OpEventSetEnableCondition_SetEnableCondition_EnableCond_Voltage9
          OpEventSetEnableCondition_SetEnableCondition_EnableCond_for: RteEventRef=OpEventSetEnableCondition_SetEnableCondition_EnableCond_for
          OpEventSetEnableCondition_SetEnableCondition_EnableCond_error: RteEventRef=OpEventSetEnableCondition_SetEnableCondition_EnableCond_error
          OpEventSetEnableCondition_SetEnableCondition_EnableCond_INV_IAC_V_ELEC_HI: RteEventRef=OpEventSetEnableCondition_SetEnableCondition_EnableCond_INV_IAC_V_ELEC_HI
          OpEventSetEnableCondition_SetEnableCondition_EnableCond_passed: RteEventRef=OpEventSetEnableCondition_SetEnableCondition_EnableCond_passed
          OpEventSetEnableCondition_SetEnableCondition_EnableCond_AND: RteEventRef=OpEventSetEnableCondition_SetEnableCondition_EnableCond_AND
          OpEventSetEnableCondition_SetEnableCondition_EnableCond_test: RteEventRef=OpEventSetEnableCondition_SetEnableCondition_EnableCond_test
          OpEventSetEnableCondition_SetEnableCondition_EnableCond_be: RteEventRef=OpEventSetEnableCondition_SetEnableCondition_EnableCond_be
          OpEventSetEnableCondition_SetEnableCondition_EnableCond_CAN: RteEventRef=OpEventSetEnableCondition_SetEnableCondition_EnableCond_CAN
          OpEventSetEnableCondition_SetEnableCondition_EnableCond_power: RteEventRef=OpEventSetEnableCondition_SetEnableCondition_EnableCond_power
          OpEventSetEnableCondition_SetEnableCondition_EnableCond_DTC: RteEventRef=OpEventSetEnableCondition_SetEnableCondition_EnableCond_DTC
          OpEventSetEnableCondition_SetEnableCondition_EnableCond_torque: RteEventRef=OpEventSetEnableCondition_SetEnableCondition_EnableCond_torque
          OpEventSetEnableCondition_SetEnableCondition_EnableCond_no_001: RteEventRef=OpEventSetEnableCondition_SetEnableCondition_EnableCond_no_001
          OpEventSetEnableCondition_SetEnableCondition_EnableCond_by: RteEventRef=OpEventSetEnableCondition_SetEnableCondition_EnableCond_by
          OpEventSetEnableCondition_SetEnableCondition_EnableCond_Factory: RteEventRef=OpEventSetEnableCondition_SetEnableCondition_EnableCond_Factory
          OpEventSetEnableCondition_SetEnableCondition_EnableCond_Crash: RteEventRef=OpEventSetEnableCondition_SetEnableCondition_EnableCond_Crash
          OpEventSetEnableCondition_SetEnableCondition_EnableCond_shall: RteEventRef=OpEventSetEnableCondition_SetEnableCondition_EnableCond_shall
          OpEventSetEnableCondition_SetEnableCondition_EnableCond_vehicle: RteEventRef=OpEventSetEnableCondition_SetEnableCondition_EnableCond_vehicle
          OpEventSetEnableCondition_SetEnableCondition_EnableCond_range: RteEventRef=OpEventSetEnableCondition_SetEnableCondition_EnableCond_range
          OpEventSetEnableCondition_SetEnableCondition_EnableCond_all: RteEventRef=OpEventSetEnableCondition_SetEnableCondition_EnableCond_all
          OpEventSetEnableCondition_SetEnableCondition_EnableCond_Inverter: RteEventRef=OpEventSetEnableCondition_SetEnableCondition_EnableCond_Inverter
          OpEventSetEnableCondition_SetEnableCondition_EnableCond_Car_001: RteEventRef=OpEventSetEnableCondition_SetEnableCondition_EnableCond_Car_001
          OpEventSetEnableCondition_SetEnableCondition_EnableCond_Request: RteEventRef=OpEventSetEnableCondition_SetEnableCondition_EnableCond_Request
          OpEventSetEnableCondition_SetEnableCondition_EnableCond_SPI: RteEventRef=OpEventSetEnableCondition_SetEnableCondition_EnableCond_SPI
          OpEventSetEnableCondition_SetEnableCondition_EnableCond_CU: RteEventRef=OpEventSetEnableCondition_SetEnableCondition_EnableCond_CU
          OpEventSetEnableCondition_SetEnableCondition_EnableCond_change: RteEventRef=OpEventSetEnableCondition_SetEnableCondition_EnableCond_change
          OpEventSetEnableCondition_SetEnableCondition_EnableCond_INV_IAC_W_ELEC_LO: RteEventRef=OpEventSetEnableCondition_SetEnableCondition_EnableCond_INV_IAC_W_ELEC_LO
          OpEventSetEnableCondition_SetEnableCondition_EnableCond_exceptions: RteEventRef=OpEventSetEnableCondition_SetEnableCondition_EnableCond_exceptions
          OpEventSetEnableCondition_SetEnableCondition_EnableCond_to: RteEventRef=OpEventSetEnableCondition_SetEnableCondition_EnableCond_to
          OpEventSetEnableCondition_SetEnableCondition_EnableCond_ECU: RteEventRef=OpEventSetEnableCondition_SetEnableCondition_EnableCond_ECU
          OpEventSetEnableCondition_SetEnableCondition_EnableCond_PS: RteEventRef=OpEventSetEnableCondition_SetEnableCondition_EnableCond_PS
          OpEventSetEnableCondition_SetEnableCondition_EnableCond_off: RteEventRef=OpEventSetEnableCondition_SetEnableCondition_EnableCond_off
          OpEventSetEnableCondition_SetEnableCondition_EnableCond_Bulk: RteEventRef=OpEventSetEnableCondition_SetEnableCondition_EnableCond_Bulk
          OpEventSetEnableCondition_SetEnableCondition_EnableCond_availability: RteEventRef=OpEventSetEnableCondition_SetEnableCondition_EnableCond_availability
          OpEventSetEnableCondition_SetEnableCondition_EnableCond_generic: RteEventRef=OpEventSetEnableCondition_SetEnableCondition_EnableCond_generic
          OpEventSetEnableCondition_SetEnableCondition_EnableCond_with: RteEventRef=OpEventSetEnableCondition_SetEnableCondition_EnableCond_with
          OpEventSetEnableCondition_SetEnableCondition_EnableCond_modes: RteEventRef=OpEventSetEnableCondition_SetEnableCondition_EnableCond_modes
          OpEventSetEnableCondition_SetEnableCondition_EnableCond_Driving: RteEventRef=OpEventSetEnableCondition_SetEnableCondition_EnableCond_Driving
          OpEventSetEnableCondition_SetEnableCondition_EnableCond_notational: RteEventRef=OpEventSetEnableCondition_SetEnableCondition_EnableCond_notational
          OpEventSetEnableCondition_SetEnableCondition_EnableCond_All_001: RteEventRef=OpEventSetEnableCondition_SetEnableCondition_EnableCond_All_001
          OpEventSetEnableCondition_SetEnableCondition_EnableCond_Test_001: RteEventRef=OpEventSetEnableCondition_SetEnableCondition_EnableCond_Test_001
          OpEventSetEnableCondition_SetEnableCondition_EnableCond_signal: RteEventRef=OpEventSetEnableCondition_SetEnableCondition_EnableCond_signal
          OpEventSetEnableCondition_SetEnableCondition_EnableCond_time: RteEventRef=OpEventSetEnableCondition_SetEnableCondition_EnableCond_time
          OpEventSetEnableCondition_SetEnableCondition_EnableCond_operation: RteEventRef=OpEventSetEnableCondition_SetEnableCondition_EnableCond_operation
          OpEventSetEnableCondition_SetEnableCondition_EnableCond_indicated: RteEventRef=OpEventSetEnableCondition_SetEnableCondition_EnableCond_indicated
          OpEventSetEnableCondition_SetEnableCondition_EnableCond_UsageMode: RteEventRef=OpEventSetEnableCondition_SetEnableCondition_EnableCond_UsageMode
          OpEventSetEnableCondition_SetEnableCondition_EnableCond_low: RteEventRef=OpEventSetEnableCondition_SetEnableCondition_EnableCond_low
          OpEventSetEnableCondition_SetEnableCondition_EnableCond_inhibited: RteEventRef=OpEventSetEnableCondition_SetEnableCondition_EnableCond_inhibited
          OpEventSetEnableCondition_SetEnableCondition_EnableCond_as: RteEventRef=OpEventSetEnableCondition_SetEnableCondition_EnableCond_as
          OpEventSetEnableCondition_SetEnableCondition_EnableCond_at: RteEventRef=OpEventSetEnableCondition_SetEnableCondition_EnableCond_at
          OpEventSetEnableCondition_SetEnableCondition_EnableCond_INV_EM_STATOR_TEMP_RNG_LO: RteEventRef=OpEventSetEnableCondition_SetEnableCondition_EnableCond_INV_EM_STATOR_TEMP_RNG_LO
          OpEventSetEnableCondition_SetEnableCondition_EnableCond_init: RteEventRef=OpEventSetEnableCondition_SetEnableCondition_EnableCond_init
          OpEventSetEnableCondition_SetEnableCondition_EnableCond_normallye: RteEventRef=OpEventSetEnableCondition_SetEnableCondition_EnableCond_normallye
          OpEventSetEnableCondition_SetEnableCondition_EnableCond_requested: RteEventRef=OpEventSetEnableCondition_SetEnableCondition_EnableCond_requested
          OpEventSetEnableCondition_SetEnableCondition_EnableCond_current: RteEventRef=OpEventSetEnableCondition_SetEnableCondition_EnableCond_current
          OpEventSetEnableCondition_SetEnableCondition_EnableCond_exit: RteEventRef=OpEventSetEnableCondition_SetEnableCondition_EnableCond_exit
          OpEventSetEnableCondition_SetEnableCondition_EnableCond_toruqe: RteEventRef=OpEventSetEnableCondition_SetEnableCondition_EnableCond_toruqe
          OpEventSetEnableCondition_SetEnableCondition_EnableCond_work: RteEventRef=OpEventSetEnableCondition_SetEnableCondition_EnableCond_work
          OpEventSetEnableCondition_SetEnableCondition_EnableCond_configuration_001: RteEventRef=OpEventSetEnableCondition_SetEnableCondition_EnableCond_configuration_001
          OpEventSetEnableCondition_SetEnableCondition_EnableCond_according: RteEventRef=OpEventSetEnableCondition_SetEnableCondition_EnableCond_according
          OpEventSetEnableCondition_SetEnableCondition_EnableCond_electrical: RteEventRef=OpEventSetEnableCondition_SetEnableCondition_EnableCond_electrical
          OpEventSetEnableCondition_SetEnableCondition_EnableCond_INV_IAC_W_ELEC_HI: RteEventRef=OpEventSetEnableCondition_SetEnableCondition_EnableCond_INV_IAC_W_ELEC_HI
          OpEventSetEnableCondition_SetEnableCondition_EnableCond_KL15: RteEventRef=OpEventSetEnableCondition_SetEnableCondition_EnableCond_KL15
          OpEventSetEnableCondition_SetEnableCondition_EnableCond_Every: RteEventRef=OpEventSetEnableCondition_SetEnableCondition_EnableCond_Every
          OpEventSetEnableCondition_SetEnableCondition_EnableCond_rpm: RteEventRef=OpEventSetEnableCondition_SetEnableCondition_EnableCond_rpm
          OpEventSetEnableCondition_SetEnableCondition_EnableCond_any: RteEventRef=OpEventSetEnableCondition_SetEnableCondition_EnableCond_any
          OpEventSetEnableCondition_SetEnableCondition_EnableCond_runs: RteEventRef=OpEventSetEnableCondition_SetEnableCondition_EnableCond_runs
          OpEventSetEnableCondition_SetEnableCondition_EnableCond_When: RteEventRef=OpEventSetEnableCondition_SetEnableCondition_EnableCond_When
          OpEventSetEnableCondition_SetEnableCondition_EnableCond_car: RteEventRef=OpEventSetEnableCondition_SetEnableCondition_EnableCond_car
          OpEventSetEnableCondition_SetEnableCondition_EnableCond_not_001: RteEventRef=OpEventSetEnableCondition_SetEnableCondition_EnableCond_not_001
          OpEventSetEnableCondition_SetEnableCondition_EnableCond_phase: RteEventRef=OpEventSetEnableCondition_SetEnableCondition_EnableCond_phase
          OpEventSetEnableCondition_SetEnableCondition_EnableCond_active: RteEventRef=OpEventSetEnableCondition_SetEnableCondition_EnableCond_active
          OpEventSetEnableCondition_SetEnableCondition_EnableCond_normally: RteEventRef=OpEventSetEnableCondition_SetEnableCondition_EnableCond_normally
          OpEventSetEnableCondition_SetEnableCondition_EnableCond_enters: RteEventRef=OpEventSetEnableCondition_SetEnableCondition_EnableCond_enters
          OpEventSetEnableCondition_SetEnableCondition_EnableCond_KL30: RteEventRef=OpEventSetEnableCondition_SetEnableCondition_EnableCond_KL30
          OpEventSetEnableCondition_SetEnableCondition_EnableCond_INV_EM_STATOR_TEMP_RNG_HI: RteEventRef=OpEventSetEnableCondition_SetEnableCondition_EnableCond_INV_EM_STATOR_TEMP_RNG_HI
          OpEventSetEnableCondition_SetEnableCondition_EnableCond_Configuration: RteEventRef=OpEventSetEnableCondition_SetEnableCondition_EnableCond_Configuration
          OpEventSetEnableCondition_SetEnableCondition_EnableCond_Prop: RteEventRef=OpEventSetEnableCondition_SetEnableCondition_EnableCond_Prop
          OpEventSetEnableCondition_SetEnableCondition_EnableCond_inhibition: RteEventRef=OpEventSetEnableCondition_SetEnableCondition_EnableCond_inhibition
          OpEventSetEnableCondition_SetEnableCondition_EnableCond_criteria: RteEventRef=OpEventSetEnableCondition_SetEnableCondition_EnableCond_criteria
          OpEventSetEnableCondition_SetEnableCondition_EnableCond_global: RteEventRef=OpEventSetEnableCondition_SetEnableCondition_EnableCond_global
          OpEventSetEnableCondition_SetEnableCondition_EnableCond_CU_temp: RteEventRef=OpEventSetEnableCondition_SetEnableCondition_EnableCond_CU_temp
          OpEventSetEnableCondition_SetEnableCondition_EnableCond_done: RteEventRef=OpEventSetEnableCondition_SetEnableCondition_EnableCond_done
          OpEventSetEnableCondition_SetEnableCondition_EnableCond_Not: RteEventRef=OpEventSetEnableCondition_SetEnableCondition_EnableCond_Not
          OpEventSetEnableCondition_SetEnableCondition_EnableCond_another: RteEventRef=OpEventSetEnableCondition_SetEnableCondition_EnableCond_another
          OpEventSetEnableCondition_SetEnableCondition_EnableCond_Ubat: RteEventRef=OpEventSetEnableCondition_SetEnableCondition_EnableCond_Ubat
          OpEventSetEnableCondition_SetEnableCondition_EnableCond_received: RteEventRef=OpEventSetEnableCondition_SetEnableCondition_EnableCond_received
          OpEventSetEnableCondition_SetEnableCondition_EnableCond_tests: RteEventRef=OpEventSetEnableCondition_SetEnableCondition_EnableCond_tests
          OpEventSetEnableCondition_SetEnableCondition_EnableCond_from: RteEventRef=OpEventSetEnableCondition_SetEnableCondition_EnableCond_from
          OpEventSetEnableCondition_SetEnableCondition_EnableCond_used: RteEventRef=OpEventSetEnableCondition_SetEnableCondition_EnableCond_used
          OpEventSetEnableCondition_SetEnableCondition_EnableCond_HVAC: RteEventRef=OpEventSetEnableCondition_SetEnableCondition_EnableCond_HVAC
          OpEventSetEnableCondition_SetEnableCondition_EnableCond_high: RteEventRef=OpEventSetEnableCondition_SetEnableCondition_EnableCond_high
          OpEventSetEnableCondition_SetEnableCondition_EnableCond_mode: RteEventRef=OpEventSetEnableCondition_SetEnableCondition_EnableCond_mode
          OpEventSetEnableCondition_SetEnableCondition_EnableCond_that: RteEventRef=OpEventSetEnableCondition_SetEnableCondition_EnableCond_that
          OpEventSetEnableCondition_SetEnableCondition_EnableCond_run: RteEventRef=OpEventSetEnableCondition_SetEnableCondition_EnableCond_run
          OpEventSetEnableCondition_SetEnableCondition_EnableCond_discharge: RteEventRef=OpEventSetEnableCondition_SetEnableCondition_EnableCond_discharge
          OpEventSetEnableCondition_SetEnableCondition_EnableCond_until: RteEventRef=OpEventSetEnableCondition_SetEnableCondition_EnableCond_until
          OpEventSetEnableCondition_SetEnableCondition_EnableCond_during: RteEventRef=OpEventSetEnableCondition_SetEnableCondition_EnableCond_during
          OpEventSetEnableCondition_SetEnableCondition_EnableCond_SpdAct: RteEventRef=OpEventSetEnableCondition_SetEnableCondition_EnableCond_SpdAct
          OpEventSetEnableCondition_SetEnableCondition_EnableCond_INV_IAC_U_ELEC_HI: RteEventRef=OpEventSetEnableCondition_SetEnableCondition_EnableCond_INV_IAC_U_ELEC_HI
          OpEventSetEnableCondition_SetEnableCondition_EnableCond_Enabled: RteEventRef=OpEventSetEnableCondition_SetEnableCondition_EnableCond_Enabled
          OpEventSetEnableCondition_SetEnableCondition_EnableCond_bus: RteEventRef=OpEventSetEnableCondition_SetEnableCondition_EnableCond_bus
          OpEventSetEnableCondition_SetEnableCondition_EnableCond_A: RteEventRef=OpEventSetEnableCondition_SetEnableCondition_EnableCond_A
          OpEventSetEnableCondition_SetEnableCondition_EnableCond_temp: RteEventRef=OpEventSetEnableCondition_SetEnableCondition_EnableCond_temp
          OpEventSetEnableCondition_SetEnableCondition_EnableCond_E: RteEventRef=OpEventSetEnableCondition_SetEnableCondition_EnableCond_E
          OpEventSetEnableCondition_SetEnableCondition_EnableCond_abs: RteEventRef=OpEventSetEnableCondition_SetEnableCondition_EnableCond_abs
          OpEventSetEnableCondition_SetEnableCondition_EnableCond_block: RteEventRef=OpEventSetEnableCondition_SetEnableCondition_EnableCond_block
          OpEventSetEnableCondition_SetEnableCondition_EnableCond_The_001: RteEventRef=OpEventSetEnableCondition_SetEnableCondition_EnableCond_The_001
          OpEventSetEnableCondition_SetEnableCondition_EnableCond_P15: RteEventRef=OpEventSetEnableCondition_SetEnableCondition_EnableCond_P15
          OpEventSetEnableCondition_SetEnableCondition_EnableCond_the: RteEventRef=OpEventSetEnableCondition_SetEnableCondition_EnableCond_the
          OpEventSetEnableCondition_SetEnableCondition_EnableCond_limited: RteEventRef=OpEventSetEnableCondition_SetEnableCondition_EnableCond_limited
          OpEventSetEnableCondition_SetEnableCondition_EnableCond_fulfilled: RteEventRef=OpEventSetEnableCondition_SetEnableCondition_EnableCond_fulfilled
          OpEventSetEnableCondition_SetEnableCondition_EnableCond_one: RteEventRef=OpEventSetEnableCondition_SetEnableCondition_EnableCond_one
          OpEventSetEnableCondition_SetEnableCondition_EnableCond_set: RteEventRef=OpEventSetEnableCondition_SetEnableCondition_EnableCond_set
          OpEventSetEnableCondition_SetEnableCondition_EnableCond_control: RteEventRef=OpEventSetEnableCondition_SetEnableCondition_EnableCond_control
          OpEventSetEnableCondition_SetEnableCondition_EnableCond_V: RteEventRef=OpEventSetEnableCondition_SetEnableCondition_EnableCond_V
          OpEventSetEnableCondition_SetEnableCondition_EnableCond_Transport: RteEventRef=OpEventSetEnableCondition_SetEnableCondition_EnableCond_Transport
          OpEventSetEnableCondition_SetEnableCondition_EnableCond_in: RteEventRef=OpEventSetEnableCondition_SetEnableCondition_EnableCond_in
          OpEventSetEnableCondition_SetEnableCondition_EnableCond_when_001: RteEventRef=OpEventSetEnableCondition_SetEnableCondition_EnableCond_when_001
          OpEventSetEnableCondition_SetEnableCondition_EnableCond_ASC: RteEventRef=OpEventSetEnableCondition_SetEnableCondition_EnableCond_ASC
          OpEventSetEnableCondition_SetEnableCondition_EnableCond_offset: RteEventRef=OpEventSetEnableCondition_SetEnableCondition_EnableCond_offset
          OpEventSetEnableCondition_SetEnableCondition_EnableCond_IGBT: RteEventRef=OpEventSetEnableCondition_SetEnableCondition_EnableCond_IGBT
          OpEventSetEnableCondition_SetEnableCondition_EnableCond_is: RteEventRef=OpEventSetEnableCondition_SetEnableCondition_EnableCond_is
          OpEventSetEnableCondition_SetEnableCondition_EnableCond_each: RteEventRef=OpEventSetEnableCondition_SetEnableCondition_EnableCond_each
          OpEventSetEnableCondition_SetEnableCondition_EnableCond_s: RteEventRef=OpEventSetEnableCondition_SetEnableCondition_EnableCond_s
          OpEventSetEnableCondition_SetEnableCondition_EnableCond_sensor: RteEventRef=OpEventSetEnableCondition_SetEnableCondition_EnableCond_sensor
          OpEventSetEnableCondition_SetEnableCondition_EnableCond_INV_IAC_V_ELEC_LO: RteEventRef=OpEventSetEnableCondition_SetEnableCondition_EnableCond_INV_IAC_V_ELEC_LO
          OpEventGetIndicatorStatus_GetIndicatorStatus_IndStatus_WarningIndicator: RteEventRef=OpEventGetIndicatorStatus_GetIndicatorStatus_IndStatus_WarningIndicator
          OpEventGetEventUdsStatus_GetEventUdsStatus_GeneralEvtInfo: RteEventRef=OpEventGetEventUdsStatus_GetEventUdsStatus_GeneralEvtInfo
          OpEventGetEventStatus_GetEventStatus_GeneralEvtInfo: RteEventRef=OpEventGetEventStatus_GetEventStatus_GeneralEvtInfo
          OpEventGetEventFailed_GetEventFailed_GeneralEvtInfo: RteEventRef=OpEventGetEventFailed_GetEventFailed_GeneralEvtInfo
          OpEventGetEventTested_GetEventTested_GeneralEvtInfo: RteEventRef=OpEventGetEventTested_GetEventTested_GeneralEvtInfo
          OpEventGetDTCOfEvent_GetDTCOfEvent_GeneralEvtInfo: RteEventRef=OpEventGetDTCOfEvent_GetDTCOfEvent_GeneralEvtInfo
          OpEventGetFaultDetectionCounter_GetFaultDetectionCounter_GeneralEvtInfo: RteEventRef=OpEventGetFaultDetectionCounter_GetFaultDetectionCounter_GeneralEvtInfo
          OpEventGetEventFreezeFrameDataEx_GetEventFreezeFrameDataEx_GeneralEvtInfo: RteEventRef=OpEventGetEventFreezeFrameDataEx_GetEventFreezeFrameDataEx_GeneralEvtInfo
          OpEventGetEventExtendedDataRecordEx_GetEventExtendedDataRecordEx_GeneralEvtInfo: RteEventRef=OpEventGetEventExtendedDataRecordEx_GetEventExtendedDataRecordEx_GeneralEvtInfo
          OpEventGetEventEnableCondition_GetEventEnableCondition_GeneralEvtInfo: RteEventRef=OpEventGetEventEnableCondition_GetEventEnableCondition_GeneralEvtInfo
          OpEventGetDebouncingOfEvent_GetDebouncingOfEvent_GeneralEvtInfo: RteEventRef=OpEventGetDebouncingOfEvent_GetDebouncingOfEvent_GeneralEvtInfo
          OpEventGetMonitorStatus_GetMonitorStatus_GeneralEvtInfo: RteEventRef=OpEventGetMonitorStatus_GetMonitorStatus_GeneralEvtInfo
          OpEventGetOperationCycleState_GetOperationCycleState_OpCycle_IgnitionCycle: RteEventRef=OpEventGetOperationCycleState_GetOperationCycleState_OpCycle_IgnitionCycle
          OpEventGetOperationCycleState_GetOperationCycleState_OpCycle_PowerCycle: RteEventRef=OpEventGetOperationCycleState_GetOperationCycleState_OpCycle_PowerCycle
          OpEventSetOperationCycleState_SetOperationCycleState_OpCycle_IgnitionCycle: RteEventRef=OpEventSetOperationCycleState_SetOperationCycleState_OpCycle_IgnitionCycle
          OpEventSetOperationCycleState_SetOperationCycleState_OpCycle_PowerCycle: RteEventRef=OpEventSetOperationCycleState_SetOperationCycleState_OpCycle_PowerCycle
          OpEventClearDTC_ClearDTC_ClearDTC_DemClient_Dcm: RteEventRef=OpEventClearDTC_ClearDTC_ClearDTC_DemClient_Dcm
          OpEventSelectDTC_SelectDTC_ClearDTC_DemClient_Dcm: RteEventRef=OpEventSelectDTC_SelectDTC_ClearDTC_DemClient_Dcm
          OpEventGetEventMemoryOverflow_GetEventMemoryOverflow_OverflowIndPrimaryMemory_DemClient_Dcm: RteEventRef=OpEventGetEventMemoryOverflow_GetEventMemoryOverflow_OverflowIndPrimaryMemory_DemClient_Dcm
          OpEventGetNumberOfEventMemoryEntries_GetNumberOfEventMemoryEntries_OverflowIndPrimaryMemory_DemClient_Dcm: RteEventRef=OpEventGetNumberOfEventMemoryEntries_GetNumberOfEventMemoryEntries_OverflowIndPrimaryMemory_DemClient_Dcm
      BswM_EcuSwComposition: RteSoftwareComponentInstanceRef=BswM
        Timer_BswM_MainFunction (RteEventToTaskMapping):
          RteImmediateRestart = false
          RtePositionInTask = 1
          RteCyclicTriggerImplementation = None
          RteEventRef = Timer_BswM_MainFunction
          RteMappedToTaskRef = Task_Bsw_10ms
          RteUsedOsAlarmRef = Alarm_Bsw_10ms
      ComM_EcuSwComposition: RteSoftwareComponentInstanceRef=ComM
        17 x RteEventToTaskMapping, all with RteImmediateRestart=false:
          Timer_ComM_MainFunction_0: RtePositionInTask=6, RteCyclicTriggerImplementation=None, RteEventRef=Timer_ComM_MainFunction_0, RteMappedToTaskRef=Task_Bsw_10ms, RteUsedOsAlarmRef=Alarm_Bsw_10ms
          OpEventGetInhibitionStatus_GetInhibitionStatus_CL_PropulsionCAN_IEM_19020f5a: RteEventRef=OpEventGetInhibitionStatus_GetInhibitionStatus_CL_PropulsionCAN_IEM_19020f5a
          OpEventGetInhibitionStatus_GetInhibitionStatus_CW_PropulsionCAN_IEM_19020f5a: RteEventRef=OpEventGetInhibitionStatus_GetInhibitionStatus_CW_PropulsionCAN_IEM_19020f5a
          OpEventLimitECUToNoComMode_LimitECUToNoComMode_modeLimitation: RteEventRef=OpEventLimitECUToNoComMode_LimitECUToNoComMode_modeLimitation
          OpEventReadInhibitCounter_ReadInhibitCounter_modeLimitation: RteEventRef=OpEventReadInhibitCounter_ReadInhibitCounter_modeLimitation
          OpEventResetInhibitCounter_ResetInhibitCounter_modeLimitation: RteEventRef=OpEventResetInhibitCounter_ResetInhibitCounter_modeLimitation
          OpEventSetECUGroupClassification_SetECUGroupClassification_modeLimitation: RteEventRef=OpEventSetECUGroupClassification_SetECUGroupClassification_modeLimitation
          OpEventLimitChannelToNoComMode_LimitChannelToNoComMode_CL_PropulsionCAN_IEM_19020f5a: RteEventRef=OpEventLimitChannelToNoComMode_LimitChannelToNoComMode_CL_PropulsionCAN_IEM_19020f5a
          OpEventPreventWakeUp_PreventWakeUp_CW_PropulsionCAN_IEM_19020f5a: RteEventRef=OpEventPreventWakeUp_PreventWakeUp_CW_PropulsionCAN_IEM_19020f5a
          OpEventRequestComMode_RequestComMode_UR_PropulsionCAN_IEM_04f8de22: RteEventRef=OpEventRequestComMode_RequestComMode_UR_PropulsionCAN_IEM_04f8de22
          OpEventRequestComMode_RequestComMode_UR_PropulsionCAN_IEM_78c1505e: RteEventRef=OpEventRequestComMode_RequestComMode_UR_PropulsionCAN_IEM_78c1505e
          OpEventGetCurrentComMode_GetCurrentComMode_UR_PropulsionCAN_IEM_04f8de22: RteEventRef=OpEventGetCurrentComMode_GetCurrentComMode_UR_PropulsionCAN_IEM_04f8de22
          OpEventGetCurrentComMode_GetCurrentComMode_UR_PropulsionCAN_IEM_78c1505e: RteEventRef=OpEventGetCurrentComMode_GetCurrentComMode_UR_PropulsionCAN_IEM_78c1505e
          OpEventGetMaxComMode_GetMaxComMode_UR_PropulsionCAN_IEM_04f8de22: RteEventRef=OpEventGetMaxComMode_GetMaxComMode_UR_PropulsionCAN_IEM_04f8de22
          OpEventGetMaxComMode_GetMaxComMode_UR_PropulsionCAN_IEM_78c1505e: RteEventRef=OpEventGetMaxComMode_GetMaxComMode_UR_PropulsionCAN_IEM_78c1505e
          OpEventGetRequestedComMode_GetRequestedComMode_UR_PropulsionCAN_IEM_04f8de22: RteEventRef=OpEventGetRequestedComMode_GetRequestedComMode_UR_PropulsionCAN_IEM_04f8de22
          OpEventGetRequestedComMode_GetRequestedComMode_UR_PropulsionCAN_IEM_78c1505e: RteEventRef=OpEventGetRequestedComMode_GetRequestedComMode_UR_PropulsionCAN_IEM_78c1505e
      DemSatellite_0_EcuSwComposition: RteSoftwareComponentInstanceRef=DemSatellite_0
        4544 x RteEventToTaskMapping, all with RteImmediateRestart=false:
          Timer_Dem_SatelliteMainFunction: RtePositionInTask=9, RteCyclicTriggerImplementation=None, RteEventRef=Timer_Dem_SatelliteMainFunction, RteMappedToTaskRef=Task_Bsw_10ms, RteUsedOsAlarmRef=Alarm_Bsw_10ms
          OpEventGetEventUdsStatus_GetEventUdsStatus_EvtInfo_VCEvBecmPropFr01Tioutd: RteEventRef=OpEventGetEventUdsStatus_GetEventUdsStatus_EvtInfo_VCEvBecmPropFr01Tioutd
          OpEventGetEventUdsStatus_GetEventUdsStatus_Event_VCEvBecmPropFr01Tioutd: RteEventRef=OpEventGetEventUdsStatus_GetEventUdsStatus_Event_VCEvBecmPropFr01Tioutd
          OpEventGetEventUdsStatus_GetEventUdsStatus_EvtInfo_INV_CU_TEMP2_RNG_NOK: RteEventRef=OpEventGetEventUdsStatus_GetEventUdsStatus_EvtInfo_INV_CU_TEMP2_RNG_NOK
          OpEventGetEventUdsStatus_GetEventUdsStatus_Event_INV_CU_TEMP2_RNG_NOK: RteEventRef=OpEventGetEventUdsStatus_GetEventUdsStatus_Event_INV_CU_TEMP2_RNG_NOK
          OpEventGetEventUdsStatus_GetEventUdsStatus_EvtInfo_COM_Busoff: RteEventRef=OpEventGetEventUdsStatus_GetEventUdsStatus_EvtInfo_COM_Busoff
          OpEventGetEventUdsStatus_GetEventUdsStatus_Event_COM_Busoff: RteEventRef=OpEventGetEventUdsStatus_GetEventUdsStatus_Event_COM_Busoff
          OpEventGetEventUdsStatus_GetEventUdsStatus_EvtInfo_INV_IMMO_NOKEY: RteEventRef=OpEventGetEventUdsStatus_GetEventUdsStatus_EvtInfo_INV_IMMO_NOKEY
          OpEventGetEventUdsStatus_GetEventUdsStatus_Event_INV_IMMO_NOKEY: RteEventRef=OpEventGetEventUdsStatus_GetEventUdsStatus_Event_INV_IMMO_NOKEY
          OpEventGetEventUdsStatus_GetEventUdsStatus_EvtInfo_INV_RSLVR_EXCT_OC_HWP: RteEventRef=OpEventGetEventUdsStatus_GetEventUdsStatus_EvtInfo_INV_RSLVR_EXCT_OC_HWP
          OpEventGetEventUdsStatus_GetEventUdsStatus_Event_INV_RSLVR_EXCT_OC_HWP: RteEventRef=OpEventGetEventUdsStatus_GetEventUdsStatus_Event_INV_RSLVR_EXCT_OC_HWP
          OpEventGetEventUdsStatus_GetEventUdsStatus_EvtInfo_PS_P15_W_FLT: RteEventRef=OpEventGetEventUdsStatus_GetEventUdsStatus_EvtInfo_PS_P15_W_FLT
          OpEventGetEventUdsStatus_GetEventUdsStatus_Event_PS_P15_W_FLT: RteEventRef=OpEventGetEventUdsStatus_GetEventUdsStatus_Event_PS_P15_W_FLT
          OpEventGetEventUdsStatus_GetEventUdsStatus_EvtInfo_INV_IAC_PLAUS_SUM: RteEventRef=OpEventGetEventUdsStatus_GetEventUdsStatus_EvtInfo_INV_IAC_PLAUS_SUM
          OpEventGetEventUdsStatus_GetEventUdsStatus_Event_INV_IAC_PLAUS_SUM: RteEventRef=OpEventGetEventUdsStatus_GetEventUdsStatus_Event_INV_IAC_PLAUS_SUM
          OpEventGetEventUdsStatus_GetEventUdsStatus_EvtInfo_PA_ELE_FLT: RteEventRef=OpEventGetEventUdsStatus_GetEventUdsStatus_EvtInfo_PA_ELE_FLT
          OpEventGetEventUdsStatus_GetEventUdsStatus_Event_PA_ELE_FLT: RteEventRef=OpEventGetEventUdsStatus_GetEventUdsStatus_Event_PA_ELE_FLT
          OpEventGetEventUdsStatus_GetEventUdsStatus_EvtInfo_CU_TEMP_GRDT: RteEventRef=OpEventGetEventUdsStatus_GetEventUdsStatus_EvtInfo_CU_TEMP_GRDT
          OpEventGetEventUdsStatus_GetEventUdsStatus_Event_CU_TEMP_GRDT: RteEventRef=OpEventGetEventUdsStatus_GetEventUdsStatus_Event_CU_TEMP_GRDT
          OpEventGetEventUdsStatus_GetEventUdsStatus_EvtInfo_INV_IGBT_TEMP_V_PLAUS: RteEventRef=OpEventGetEventUdsStatus_GetEventUdsStatus_EvtInfo_INV_IGBT_TEMP_V_PLAUS
          OpEventGetEventUdsStatus_GetEventUdsStatus_Event_INV_IGBT_TEMP_V_PLAUS: RteEventRef=OpEventGetEventUdsStatus_GetEventUdsStatus_Event_INV_IGBT_TEMP_V_PLAUS
          OpEventGetEventUdsStatus_GetEventUdsStatus_EvtInfo_Ga_GAEngageFailure: RteEventRef=OpEventGetEventUdsStatus_GetEventUdsStatus_EvtInfo_Ga_GAEngageFailure
          OpEventGetEventUdsStatus_GetEventUdsStatus_Event_Ga_GAEngageFailure: RteEventRef=OpEventGetEventUdsStatus_GetEventUdsStatus_Event_Ga_GAEngageFailure
          OpEventGetEventUdsStatus_GetEventUdsStatus_EvtInfo_INV_IAC_W_RNG_LO: RteEventRef=OpEventGetEventUdsStatus_GetEventUdsStatus_EvtInfo_INV_IAC_W_RNG_LO
          OpEventGetEventUdsStatus_GetEventUdsStatus_Event_INV_IAC_W_RNG_LO: RteEventRef=OpEventGetEventUdsStatus_GetEventUdsStatus_Event_INV_IAC_W_RNG_LO
          OpEventGetEventUdsStatus_GetEventUdsStatus_EvtInfo_PS_WhlSnsr_Vltg_FLT: RteEventRef=OpEventGetEventUdsStatus_GetEventUdsStatus_EvtInfo_PS_WhlSnsr_Vltg_FLT
          OpEventGetEventUdsStatus_GetEventUdsStatus_Event_PS_WhlSnsr_Vltg_FLT: RteEventRef=OpEventGetEventUdsStatus_GetEventUdsStatus_Event_PS_WhlSnsr_Vltg_FLT
          OpEventGetEventUdsStatus_GetEventUdsStatus_EvtInfo_VCEvEcmPropFr02Tioutd: RteEventRef=OpEventGetEventUdsStatus_GetEventUdsStatus_EvtInfo_VCEvEcmPropFr02Tioutd
          OpEventGetEventUdsStatus_GetEventUdsStatus_Event_VCEvEcmPropFr02Tioutd: RteEventRef=OpEventGetEventUdsStatus_GetEventUdsStatus_Event_VCEvEcmPropFr02Tioutd
          OpEventGetEventUdsStatus_GetEventUdsStatus_EvtInfo_Ga_TmSpdSyncFailed: RteEventRef=OpEventGetEventUdsStatus_GetEventUdsStatus_EvtInfo_Ga_TmSpdSyncFailed
          OpEventGetEventUdsStatus_GetEventUdsStatus_Event_Ga_TmSpdSyncFailed: RteEventRef=OpEventGetEventUdsStatus_GetEventUdsStatus_Event_Ga_TmSpdSyncFailed
          OpEventGetEventUdsStatus_GetEventUdsStatus_EvtInfo_INV_RSLVR_EXCT_ELEC_LO: RteEventRef=OpEventGetEventUdsStatus_GetEventUdsStatus_EvtInfo_INV_RSLVR_EXCT_ELEC_LO
          OpEventGetEventUdsStatus_GetEventUdsStatus_Event_INV_RSLVR_EXCT_ELEC_LO: RteEventRef=OpEventGetEventUdsStatus_GetEventUdsStatus_Event_INV_RSLVR_EXCT_ELEC_LO
          OpEventGetEventUdsStatus_GetEventUdsStatus_EvtInfo_VCEvEcmPropXevFr06Tioutd: RteEventRef=OpEventGetEventUdsStatus_GetEventUdsStatus_EvtInfo_VCEvEcmPropXevFr06Tioutd
          OpEventGetEventUdsStatus_GetEventUdsStatus_Event_VCEvEcmPropXevFr06Tioutd: RteEventRef=OpEventGetEventUdsStatus_GetEventUdsStatus_Event_VCEvEcmPropXevFr06Tioutd
          OpEventGetEventUdsStatus_GetEventUdsStatus_EvtInfo_VcEvCntrWhlMotSysTqAllwd: RteEventRef=OpEventGetEventUdsStatus_GetEventUdsStatus_EvtInfo_VcEvCntrWhlMotSysTqAllwd
          OpEventGetEventUdsStatus_GetEventUdsStatus_Event_VcEvCntrWhlMotSysTqAllwd: RteEventRef=OpEventGetEventUdsStatus_GetEventUdsStatus_Event_VcEvCntrWhlMotSysTqAllwd
          OpEventGetEventUdsStatus_GetEventUdsStatus_EvtInfo_INV_UHVDC_1_ELEC_HI: RteEventRef=OpEventGetEventUdsStatus_GetEventUdsStatus_EvtInfo_INV_UHVDC_1_ELEC_HI
          OpEventGetEventUdsStatus_GetEventUdsStatus_Event_INV_UHVDC_1_ELEC_HI: RteEventRef=OpEventGetEventUdsStatus_GetEventUdsStatus_Event_INV_UHVDC_1_ELEC_HI
          OpEventGetEventUdsStatus_GetEventUdsStatus_EvtInfo_INV_EM_STATOR_TEMP2_ELE_FLT: RteEventRef=OpEventGetEventUdsStatus_GetEventUdsStatus_EvtInfo_INV_EM_STATOR_TEMP2_ELE_FLT
          OpEventGetEventUdsStatus_GetEventUdsStatus_Event_INV_EM_STATOR_TEMP2_ELE_FLT: RteEventRef=OpEventGetEventUdsStatus_GetEventUdsStatus_Event_INV_EM_STATOR_TEMP2_ELE_FLT
          OpEventGetEventUdsStatus_GetEventUdsStatus_EvtInfo_AURIX_RST_SNG: RteEventRef=OpEventGetEventUdsStatus_GetEventUdsStatus_EvtInfo_AURIX_RST_SNG
          OpEventGetEventUdsStatus_GetEventUdsStatus_Event_AURIX_RST_SNG: RteEventRef=OpEventGetEventUdsStatus_GetEventUdsStatus_Event_AURIX_RST_SNG
          OpEventGetEventUdsStatus_GetEventUdsStatus_EvtInfo_VCEvEcmPropFr24MgmFr01Tioutd: RteEventRef=OpEventGetEventUdsStatus_GetEventUdsStatus_EvtInfo_VCEvEcmPropFr24MgmFr01Tioutd
          OpEventGetEventUdsStatus_GetEventUdsStatus_Event_VCEvEcmPropFr24MgmFr01Tioutd: RteEventRef=OpEventGetEventUdsStatus_GetEventUdsStatus_Event_VCEvEcmPropFr24MgmFr01Tioutd
          OpEventGetEventUdsStatus_GetEventUdsStatus_EvtInfo_INV_RSLVR_COS_ELEC_OPEN: RteEventRef=OpEventGetEventUdsStatus_GetEventUdsStatus_EvtInfo_INV_RSLVR_COS_ELEC_OPEN
          OpEventGetEventUdsStatus_GetEventUdsStatus_Event_INV_RSLVR_COS_ELEC_OPEN: RteEventRef=OpEventGetEventUdsStatus_GetEventUdsStatus_Event_INV_RSLVR_COS_ELEC_OPEN
          OpEventGetEventUdsStatus_GetEventUdsStatus_EvtInfo_INV_IAC_V_ELEC_LO: RteEventRef=OpEventGetEventUdsStatus_GetEventUdsStatus_EvtInfo_INV_IAC_V_ELEC_LO
          OpEventGetEventUdsStatus_GetEventUdsStatus_Event_INV_IAC_V_ELEC_LO: RteEventRef=OpEventGetEventUdsStatus_GetEventUdsStatus_Event_INV_IAC_V_ELEC_LO
          OpEventGetEventUdsStatus_GetEventUdsStatus_EvtInfo_INV_IAC_W_OFFS: RteEventRef=OpEventGetEventUdsStatus_GetEventUdsStatus_EvtInfo_INV_IAC_W_OFFS
          OpEventGetEventUdsStatus_GetEventUdsStatus_Event_INV_IAC_W_OFFS: RteEventRef=OpEventGetEventUdsStatus_GetEventUdsStatus_Event_INV_IAC_W_OFFS
          OpEventGetEventUdsStatus_GetEventUdsStatus_EvtInfo_INV_EM_STATOR_TEMP2_GRDT: RteEventRef=OpEventGetEventUdsStatus_GetEventUdsStatus_EvtInfo_INV_EM_STATOR_TEMP2_GRDT
          OpEventGetEventUdsStatus_GetEventUdsStatus_Event_INV_EM_STATOR_TEMP2_GRDT: RteEventRef=OpEventGetEventUdsStatus_GetEventUdsStatus_Event_INV_EM_STATOR_TEMP2_GRDT
          OpEventGetEventUdsStatus_GetEventUdsStatus_EvtInfo_INV_EM_OVRSPD_HWP: RteEventRef=OpEventGetEventUdsStatus_GetEventUdsStatus_EvtInfo_INV_EM_OVRSPD_HWP
          OpEventGetEventUdsStatus_GetEventUdsStatus_Event_INV_EM_OVRSPD_HWP: RteEventRef=OpEventGetEventUdsStatus_GetEventUdsStatus_Event_INV_EM_OVRSPD_HWP
          OpEventGetEventUdsStatus_GetEventUdsStatus_EvtInfo_CU_TEMP_HWP: RteEventRef=OpEventGetEventUdsStatus_GetEventUdsStatus_EvtInfo_CU_TEMP_HWP
          OpEventGetEventUdsStatus_GetEventUdsStatus_Event_CU_TEMP_HWP: RteEventRef=OpEventGetEventUdsStatus_GetEventUdsStatus_Event_CU_TEMP_HWP
          OpEventGetEventUdsStatus_GetEventUdsStatus_EvtInfo_INV_UHVDC_1_RNG_HI: RteEventRef=OpEventGetEventUdsStatus_GetEventUdsStatus_EvtInfo_INV_UHVDC_1_RNG_HI
          OpEventGetEventUdsStatus_GetEventUdsStatus_Event_INV_UHVDC_1_RNG_HI: RteEventRef=OpEventGetEventUdsStatus_GetEventUdsStatus_Event_INV_UHVDC_1_RNG_HI
          OpEventGetEventUdsStatus_GetEventUdsStatus_EvtInfo_VcEvEMPerfPlaus: RteEventRef=OpEventGetEventUdsStatus_GetEventUdsStatus_EvtInfo_VcEvEMPerfPlaus
          OpEventGetEventUdsStatus_GetEventUdsStatus_Event_VcEvEMPerfPlaus: RteEventRef=OpEventGetEventUdsStatus_GetEventUdsStatus_Event_VcEvEMPerfPlaus
          OpEventGetEventUdsStatus_GetEventUdsStatus_EvtInfo_VCEvVddmPropFr18Tioutd: RteEventRef=OpEventGetEventUdsStatus_GetEventUdsStatus_EvtInfo_VCEvVddmPropFr18Tioutd
          OpEventGetEventUdsStatus_GetEventUdsStatus_Event_VCEvVddmPropFr18Tioutd: RteEventRef=OpEventGetEventUdsStatus_GetEventUdsStatus_Event_VCEvVddmPropFr18Tioutd
          OpEventGetEventUdsStatus_GetEventUdsStatus_EvtInfo_INV_IAC_U_ELEC_HWP: RteEventRef=OpEventGetEventUdsStatus_GetEventUdsStatus_EvtInfo_INV_IAC_U_ELEC_HWP
          OpEventGetEventUdsStatus_GetEventUdsStatus_Event_INV_IAC_U_ELEC_HWP: RteEventRef=OpEventGetEventUdsStatus_GetEventUdsStatus_Event_INV_IAC_U_ELEC_HWP
          OpEventGetEventUdsStatus_GetEventUdsStatus_EvtInfo_VCEvVddmPropFr15Tioutd: RteEventRef=OpEventGetEventUdsStatus_GetEventUdsStatus_EvtInfo_VCEvVddmPropFr15Tioutd
          OpEventGetEventUdsStatus_GetEventUdsStatus_Event_VCEvVddmPropFr15Tioutd: RteEventRef=OpEventGetEventUdsStatus_GetEventUdsStatus_Event_VCEvVddmPropFr15Tioutd
          OpEventGetEventUdsStatus_GetEventUdsStatus_EvtInfo_Ga_GADisengageFailure: RteEventRef=OpEventGetEventUdsStatus_GetEventUdsStatus_EvtInfo_Ga_GADisengageFailure
          OpEventGetEventUdsStatus_GetEventUdsStatus_Event_Ga_GADisengageFailure: RteEventRef=OpEventGetEventUdsStatus_GetEventUdsStatus_Event_Ga_GADisengageFailure
          OpEventGetEventUdsStatus_GetEventUdsStatus_EvtInfo_CU_TEMP2_RNG_LO: RteEventRef=OpEventGetEventUdsStatus_GetEventUdsStatus_EvtInfo_CU_TEMP2_RNG_LO
          OpEventGetEventUdsStatus_GetEventUdsStatus_Event_CU_TEMP2_RNG_LO: RteEventRef=OpEventGetEventUdsStatus_GetEventUdsStatus_Event_CU_TEMP2_RNG_LO
          OpEventGetEventUdsStatus_GetEventUdsStatus_EvtInfo_INV_RSLVR_SIN_ELEC_OPEN: RteEventRef=OpEventGetEventUdsStatus_GetEventUdsStatus_EvtInfo_INV_RSLVR_SIN_ELEC_OPEN
          OpEventGetEventUdsStatus_GetEventUdsStatus_Event_INV_RSLVR_SIN_ELEC_OPEN: RteEventRef=OpEventGetEventUdsStatus_GetEventUdsStatus_Event_INV_RSLVR_SIN_ELEC_OPEN
          OpEventGetEventUdsStatus_GetEventUdsStatus_EvtInfo_VcEvChkSum: RteEventRef=OpEventGetEventUdsStatus_GetEventUdsStatus_EvtInfo_VcEvChkSum
          OpEventGetEventUdsStatus_GetEventUdsStatus_Event_VcEvChkSum: RteEventRef=OpEventGetEventUdsStatus_GetEventUdsStatus_Event_VcEvChkSum
          OpEventGetEventUdsStatus_GetEventUdsStatus_EvtInfo_PS_P5_UC_FLT: RteEventRef=OpEventGetEventUdsStatus_GetEventUdsStatus_EvtInfo_PS_P5_UC_FLT
          OpEventGetEventUdsStatus_GetEventUdsStatus_Event_PS_P5_UC_FLT: RteEventRef=OpEventGetEventUdsStatus_GetEventUdsStatus_Event_PS_P5_UC_FLT
          OpEventGetEventUdsStatus_GetEventUdsStatus_EvtInfo_INV_RSLVR_COS_ELEC_FLT: RteEventRef=OpEventGetEventUdsStatus_GetEventUdsStatus_EvtInfo_INV_RSLVR_COS_ELEC_FLT
          OpEventGetEventUdsStatus_GetEventUdsStatus_Event_INV_RSLVR_COS_ELEC_FLT: RteEventRef=OpEventGetEventUdsStatus_GetEventUdsStatus_Event_INV_RSLVR_COS_ELEC_FLT
          OpEventGetEventUdsStatus_GetEventUdsStatus_EvtInfo_INV_IAC_W_RNG_HI: RteEventRef=OpEventGetEventUdsStatus_GetEventUdsStatus_EvtInfo_INV_IAC_W_RNG_HI
          OpEventGetEventUdsStatus_GetEventUdsStatus_Event_INV_IAC_W_RNG_HI: RteEventRef=OpEventGetEventUdsStatus_GetEventUdsStatus_Event_INV_IAC_W_RNG_HI
          OpEventGetEventUdsStatus_GetEventUdsStatus_EvtInfo_PS_ECUSUPPLY_HIGH: RteEventRef=OpEventGetEventUdsStatus_GetEventUdsStatus_EvtInfo_PS_ECUSUPPLY_HIGH
          OpEventGetEventUdsStatus_GetEventUdsStatus_Event_PS_ECUSUPPLY_HIGH: RteEventRef=OpEventGetEventUdsStatus_GetEventUdsStatus_Event_PS_ECUSUPPLY_HIGH
          OpEventGetEventUdsStatus_GetEventUdsStatus_EvtInfo_VCEvEcmPropFr05Tioutd: RteEventRef=OpEventGetEventUdsStatus_GetEventUdsStatus_EvtInfo_VCEvEcmPropFr05Tioutd
          OpEventGetEventUdsStatus_GetEventUdsStatus_Event_VCEvEcmPropFr05Tioutd: RteEventRef=OpEventGetEventUdsStatus_GetEventUdsStatus_Event_VCEvEcmPropFr05Tioutd
          OpEventGetEventUdsStatus_GetEventUdsStatus_EvtInfo_PS_ECUSUPPLY_LOW: RteEventRef=OpEventGetEventUdsStatus_GetEventUdsStatus_EvtInfo_PS_ECUSUPPLY_LOW
          OpEventGetEventUdsStatus_GetEventUdsStatus_Event_PS_ECUSUPPLY_LOW: RteEventRef=OpEventGetEventUdsStatus_GetEventUdsStatus_Event_PS_ECUSUPPLY_LOW
          OpEventGetEventUdsStatus_GetEventUdsStatus_EvtInfo_VcEvChkSumHvSysRlySts: RteEventRef=OpEventGetEventUdsStatus_GetEventUdsStatus_EvtInfo_VcEvChkSumHvSysRlySts
          OpEventGetEventUdsStatus_GetEventUdsStatus_Event_VcEvChkSumHvSysRlySts: RteEventRef=OpEventGetEventUdsStatus_GetEventUdsStatus_Event_VcEvChkSumHvSysRlySts
          OpEventGetEventUdsStatus_GetEventUdsStatus_EvtInfo_VcEvMonMode: RteEventRef=OpEventGetEventUdsStatus_GetEventUdsStatus_EvtInfo_VcEvMonMode
          OpEventGetEventUdsStatus_GetEventUdsStatus_Event_VcEvMonMode: RteEventRef=OpEventGetEventUdsStatus_GetEventUdsStatus_Event_VcEvMonMode
          OpEventGetEventUdsStatus_GetEventUdsStatus_EvtInfo_INV_IAC_OC_SWP: RteEventRef=OpEventGetEventUdsStatus_GetEventUdsStatus_EvtInfo_INV_IAC_OC_SWP
          OpEventGetEventUdsStatus_GetEventUdsStatus_Event_INV_IAC_OC_SWP: RteEventRef=OpEventGetEventUdsStatus_GetEventUdsStatus_Event_INV_IAC_OC_SWP
          OpEventGetEventUdsStatus_GetEventUdsStatus_EvtInfo_INV_IMMO_AUTHFAIL: RteEventRef=OpEventGetEventUdsStatus_GetEventUdsStatus_EvtInfo_INV_IMMO_AUTHFAIL
          OpEventGetEventUdsStatus_GetEventUdsStatus_Event_INV_IMMO_AUTHFAIL: RteEventRef=OpEventGetEventUdsStatus_GetEventUdsStatus_Event_INV_IMMO_AUTHFAIL
          OpEventGetEventUdsStatus_GetEventUdsStatus_EvtInfo_PA_OpenCirc_FLT: RteEventRef=OpEventGetEventUdsStatus_GetEventUdsStatus_EvtInfo_PA_OpenCirc_FLT
          OpEventGetEventUdsStatus_GetEventUdsStatus_Event_PA_OpenCirc_FLT: RteEventRef=OpEventGetEventUdsStatus_GetEventUdsStatus_Event_PA_OpenCirc_FLT
          OpEventGetEventUdsStatus_GetEventUdsStatus_EvtInfo_INV_IAC_V_ELEC_HI: RteEventRef=OpEventGetEventUdsStatus_GetEventUdsStatus_EvtInfo_INV_IAC_V_ELEC_HI
          OpEventGetEventUdsStatus_GetEventUdsStatus_Event_INV_IAC_V_ELEC_HI: RteEventRef=OpEventGetEventUdsStatus_GetEventUdsStatus_Event_INV_IAC_V_ELEC_HI
          OpEventGetEventUdsStatus_GetEventUdsStatus_EvtInfo_VCEvEcmPropFr04Tioutd: RteEventRef=OpEventGetEventUdsStatus_GetEventUdsStatus_EvtInfo_VCEvEcmPropFr04Tioutd
          OpEventGetEventUdsStatus_GetEventUdsStatus_Event_VCEvEcmPropFr04Tioutd: RteEventRef=OpEventGetEventUdsStatus_GetEventUdsStatus_Event_VCEvEcmPropFr04Tioutd
          OpEventGetEventUdsStatus_GetEventUdsStatus_EvtInfo_VcEvMonTrqActPlaus: RteEventRef=OpEventGetEventUdsStatus_GetEventUdsStatus_EvtInfo_VcEvMonTrqActPlaus
          OpEventGetEventUdsStatus_GetEventUdsStatus_Event_VcEvMonTrqActPlaus: RteEventRef=OpEventGetEventUdsStatus_GetEventUdsStatus_Event_VcEvMonTrqActPlaus
          OpEventGetEventUdsStatus_GetEventUdsStatus_EvtInfo_VcEvMonTrqAct: RteEventRef=OpEventGetEventUdsStatus_GetEventUdsStatus_EvtInfo_VcEvMonTrqAct
          OpEventGetEventUdsStatus_GetEventUdsStatus_Event_VcEvMonTrqAct: RteEventRef=OpEventGetEventUdsStatus_GetEventUdsStatus_Event_VcEvMonTrqAct
          OpEventGetEventUdsStatus_GetEventUdsStatus_EvtInfo_INV_RSLVR_COS_ELEC_LO: RteEventRef=OpEventGetEventUdsStatus_GetEventUdsStatus_EvtInfo_INV_RSLVR_COS_ELEC_LO
          OpEventGetEventUdsStatus_GetEventUdsStatus_Event_INV_RSLVR_COS_ELEC_LO: RteEventRef=OpEventGetEventUdsStatus_GetEventUdsStatus_Event_INV_RSLVR_COS_ELEC_LO
          OpEventGetEventUdsStatus_GetEventUdsStatus_EvtInfo_INV_COOLT_INLET_TEMP_HWP: RteEventRef=OpEventGetEventUdsStatus_GetEventUdsStatus_EvtInfo_INV_COOLT_INLET_TEMP_HWP
          OpEventGetEventUdsStatus_GetEventUdsStatus_Event_INV_COOLT_INLET_TEMP_HWP: RteEventRef=OpEventGetEventUdsStatus_GetEventUdsStatus_Event_INV_COOLT_INLET_TEMP_HWP
          OpEventGetEventUdsStatus_GetEventUdsStatus_EvtInfo_VCEvEcmPropFr11Tioutd: RteEventRef=OpEventGetEventUdsStatus_GetEventUdsStatus_EvtInfo_VCEvEcmPropFr11Tioutd
          OpEventGetEventUdsStatus_GetEventUdsStatus_Event_VCEvEcmPropFr11Tioutd: RteEventRef=OpEventGetEventUdsStatus_GetEventUdsStatus_Event_VCEvEcmPropFr11Tioutd
          OpEventGetEventUdsStatus_GetEventUdsStatus_EvtInfo_PS_KL30_RNG_HI: RteEventRef=OpEventGetEventUdsStatus_GetEventUdsStatus_EvtInfo_PS_KL30_RNG_HI
          OpEventGetEventUdsStatus_GetEventUdsStatus_Event_PS_KL30_RNG_HI: RteEventRef=OpEventGetEventUdsStatus_GetEventUdsStatus_Event_PS_KL30_RNG_HI
          OpEventGetEventUdsStatus_GetEventUdsStatus_EvtInfo_INV_IAC_OC_HWP: RteEventRef=OpEventGetEventUdsStatus_GetEventUdsStatus_EvtInfo_INV_IAC_OC_HWP
          OpEventGetEventUdsStatus_GetEventUdsStatus_Event_INV_IAC_OC_HWP: RteEventRef=OpEventGetEventUdsStatus_GetEventUdsStatus_Event_INV_IAC_OC_HWP
          OpEventGetEventUdsStatus_GetEventUdsStatus_EvtInfo_INV_RSLVR_COS_RNG_HI: RteEventRef=OpEventGetEventUdsStatus_GetEventUdsStatus_EvtInfo_INV_RSLVR_COS_RNG_HI
          OpEventGetEventUdsStatus_GetEventUdsStatus_Event_INV_RSLVR_COS_RNG_HI: RteEventRef=OpEventGetEventUdsStatus_GetEventUdsStatus_Event_INV_RSLVR_COS_RNG_HI
          OpEventGetEventUdsStatus_GetEventUdsStatus_EvtInfo_INV_IAC_U_ELEC_HI: RteEventRef=OpEventGetEventUdsStatus_GetEventUdsStatus_EvtInfo_INV_IAC_U_ELEC_HI
          OpEventGetEventUdsStatus_GetEventUdsStatus_Event_INV_IAC_U_ELEC_HI: RteEventRef=OpEventGetEventUdsStatus_GetEventUdsStatus_Event_INV_IAC_U_ELEC_HI
          OpEventGetEventUdsStatus_GetEventUdsStatus_EvtInfo_INV_IAC_V_RNG_LO: RteEventRef=OpEventGetEventUdsStatus_GetEventUdsStatus_EvtInfo_INV_IAC_V_RNG_LO
          OpEventGetEventUdsStatus_GetEventUdsStatus_Event_INV_IAC_V_RNG_LO: RteEventRef=OpEventGetEventUdsStatus_GetEventUdsStatus_Event_INV_IAC_V_RNG_LO
          OpEventGetEventUdsStatus_GetEventUdsStatus_EvtInfo_INV_IAC_U_RNG_HI: RteEventRef=OpEventGetEventUdsStatus_GetEventUdsStatus_EvtInfo_INV_IAC_U_RNG_HI
          OpEventGetEventUdsStatus_GetEventUdsStatus_Event_INV_IAC_U_RNG_HI: RteEventRef=OpEventGetEventUdsStatus_GetEventUdsStatus_Event_INV_IAC_U_RNG_HI
          OpEventGetEventUdsStatus_GetEventUdsStatus_EvtInfo_VCEvEcmPropFr25Tioutd: RteEventRef=OpEventGetEventUdsStatus_GetEventUdsStatus_EvtInfo_VCEvEcmPropFr25Tioutd
          OpEventGetEventUdsStatus_GetEventUdsStatus_Event_VCEvEcmPropFr25Tioutd: RteEventRef=OpEventGetEventUdsStatus_GetEventUdsStatus_Event_VCEvEcmPropFr25Tioutd
          OpEventGetEventUdsStatus_GetEventUdsStatus_EvtInfo_INV_IGBT_TEMP_W_RNG_LO: RteEventRef=OpEventGetEventUdsStatus_GetEventUdsStatus_EvtInfo_INV_IGBT_TEMP_W_RNG_LO
          OpEventGetEventUdsStatus_GetEventUdsStatus_Event_INV_IGBT_TEMP_W_RNG_LO: RteEventRef=OpEventGetEventUdsStatus_GetEventUdsStatus_Event_INV_IGBT_TEMP_W_RNG_LO
          OpEventGetEventUdsStatus_GetEventUdsStatus_EvtInfo_PSnsr_RNG_NOK: RteEventRef=OpEventGetEventUdsStatus_GetEventUdsStatus_EvtInfo_PSnsr_RNG_NOK
          OpEventGetEventUdsStatus_GetEventUdsStatus_Event_PSnsr_RNG_NOK: RteEventRef=OpEventGetEventUdsStatus_GetEventUdsStatus_Event_PSnsr_RNG_NOK
          OpEventGetEventUdsStatus_GetEventUdsStatus_EvtInfo_INV_RSLVR_COS_RNG_NOK: RteEventRef=OpEventGetEventUdsStatus_GetEventUdsStatus_EvtInfo_INV_RSLVR_COS_RNG_NOK
          OpEventGetEventUdsStatus_GetEventUdsStatus_Event_INV_RSLVR_COS_RNG_NOK: RteEventRef=OpEventGetEventUdsStatus_GetEventUdsStatus_Event_INV_RSLVR_COS_RNG_NOK
          OpEventGetEventUdsStatus_GetEventUdsStatus_EvtInfo_PS_DRVB_Fault: RteEventRef=OpEventGetEventUdsStatus_GetEventUdsStatus_EvtInfo_PS_DRVB_Fault
          OpEventGetEventUdsStatus_GetEventUdsStatus_Event_PS_DRVB_Fault: RteEventRef=OpEventGetEventUdsStatus_GetEventUdsStatus_Event_PS_DRVB_Fault
          OpEventGetEventUdsStatus_GetEventUdsStatus_EvtInfo_INV_CU_TEMP1_RNG_NOK: RteEventRef=OpEventGetEventUdsStatus_GetEventUdsStatus_EvtInfo_INV_CU_TEMP1_RNG_NOK
          OpEventGetEventUdsStatus_GetEventUdsStatus_Event_INV_CU_TEMP1_RNG_NOK: RteEventRef=OpEventGetEventUdsStatus_GetEventUdsStatus_Event_INV_CU_TEMP1_RNG_NOK
          OpEventGetEventUdsStatus_GetEventUdsStatus_EvtInfo_VcEvCntr: RteEventRef=OpEventGetEventUdsStatus_GetEventUdsStatus_EvtInfo_VcEvCntr
          OpEventGetEventUdsStatus_GetEventUdsStatus_Event_VcEvCntr: RteEventRef=OpEventGetEventUdsStatus_GetEventUdsStatus_Event_VcEvCntr
          OpEventGetEventUdsStatus_GetEventUdsStatus_EvtInfo_INV_RSLVR_SIN_AMP: RteEventRef=OpEventGetEventUdsStatus_GetEventUdsStatus_EvtInfo_INV_RSLVR_SIN_AMP
          OpEventGetEventUdsStatus_GetEventUdsStatus_Event_INV_RSLVR_SIN_AMP: RteEventRef=OpEventGetEventUdsStatus_GetEventUdsStatus_Event_INV_RSLVR_SIN_AMP
          OpEventGetEventUdsStatus_GetEventUdsStatus_EvtInfo_INV_UHVDC_2_RNG_HI: RteEventRef=OpEventGetEventUdsStatus_GetEventUdsStatus_EvtInfo_INV_UHVDC_2_RNG_HI
          OpEventGetEventUdsStatus_GetEventUdsStatus_Event_INV_UHVDC_2_RNG_HI: RteEventRef=OpEventGetEventUdsStatus_GetEventUdsStatus_Event_INV_UHVDC_2_RNG_HI
          OpEventGetEventUdsStatus_GetEventUdsStatus_EvtInfo_INV_IGBT_TEMP_U_GRDT: RteEventRef=OpEventGetEventUdsStatus_GetEventUdsStatus_EvtInfo_INV_IGBT_TEMP_U_GRDT
          OpEventGetEventUdsStatus_GetEventUdsStatus_Event_INV_IGBT_TEMP_U_GRDT: RteEventRef=OpEventGetEventUdsStatus_GetEventUdsStatus_Event_INV_IGBT_TEMP_U_GRDT
          OpEventGetEventUdsStatus_GetEventUdsStatus_EvtInfo_MON_TQ_PLAUS_PWR_MDL: RteEventRef=OpEventGetEventUdsStatus_GetEventUdsStatus_EvtInfo_MON_TQ_PLAUS_PWR_MDL
          OpEventGetEventUdsStatus_GetEventUdsStatus_Event_MON_TQ_PLAUS_PWR_MDL: RteEventRef=OpEventGetEventUdsStatus_GetEventUdsStatus_Event_MON_TQ_PLAUS_PWR_MDL
          OpEventGetEventUdsStatus_GetEventUdsStatus_EvtInfo_INV_IGBT_TEMP_W_PLAUS: RteEventRef=OpEventGetEventUdsStatus_GetEventUdsStatus_EvtInfo_INV_IGBT_TEMP_W_PLAUS
          OpEventGetEventUdsStatus_GetEventUdsStatus_Event_INV_IGBT_TEMP_W_PLAUS: RteEventRef=OpEventGetEventUdsStatus_GetEventUdsStatus_Event_INV_IGBT_TEMP_W_PLAUS
          OpEventGetEventUdsStatus_GetEventUdsStatus_EvtInfo_PS_BLDC_UV_FLT: RteEventRef=OpEventGetEventUdsStatus_GetEventUdsStatus_EvtInfo_PS_BLDC_UV_FLT
          OpEventGetEventUdsStatus_GetEventUdsStatus_Event_PS_BLDC_UV_FLT: RteEventRef=OpEventGetEventUdsStatus_GetEventUdsStatus_Event_PS_BLDC_UV_FLT
          OpEventGetEventUdsStatus_GetEventUdsStatus_EvtInfo_INV_IAC_V_OFFS: RteEventRef=OpEventGetEventUdsStatus_GetEventUdsStatus_EvtInfo_INV_IAC_V_OFFS
          OpEventGetEventUdsStatus_GetEventUdsStatus_Event_INV_IAC_V_OFFS: RteEventRef=OpEventGetEventUdsStatus_GetEventUdsStatus_Event_INV_IAC_V_OFFS
          OpEventGetEventUdsStatus_GetEventUdsStatus_EvtInfo_INV_RSLVR_EXCT_FREQ_RNG_NOK: RteEventRef=OpEventGetEventUdsStatus_GetEventUdsStatus_EvtInfo_INV_RSLVR_EXCT_FREQ_RNG_NOK
          OpEventGetEventUdsStatus_GetEventUdsStatus_Event_INV_RSLVR_EXCT_FREQ_RNG_NOK: RteEventRef=OpEventGetEventUdsStatus_GetEventUdsStatus_Event_INV_RSLVR_EXCT_FREQ_RNG_NOK
          OpEventGetEventUdsStatus_GetEventUdsStatus_EvtInfo_PS_KL30_RNG_LO: RteEventRef=OpEventGetEventUdsStatus_GetEventUdsStatus_EvtInfo_PS_KL30_RNG_LO
          OpEventGetEventUdsStatus_GetEventUdsStatus_Event_PS_KL30_RNG_LO: RteEventRef=OpEventGetEventUdsStatus_GetEventUdsStatus_Event_PS_KL30_RNG_LO
          OpEventGetEventUdsStatus_GetEventUdsStatus_EvtInfo_INV_RSLVR_COS_RNG_LO: RteEventRef=OpEventGetEventUdsStatus_GetEventUdsStatus_EvtInfo_INV_RSLVR_COS_RNG_LO
          OpEventGetEventUdsStatus_GetEventUdsStatus_Event_INV_RSLVR_COS_RNG_LO: RteEventRef=OpEventGetEventUdsStatus_GetEventUdsStatus_Event_INV_RSLVR_COS_RNG_LO
          OpEventGetEventUdsStatus_GetEventUdsStatus_EvtInfo_PSnsr_ELE_FLT: RteEventRef=OpEventGetEventUdsStatus_GetEventUdsStatus_EvtInfo_PSnsr_ELE_FLT
          OpEventGetEventUdsStatus_GetEventUdsStatus_Event_PSnsr_ELE_FLT: RteEventRef=OpEventGetEventUdsStatus_GetEventUdsStatus_Event_PSnsr_ELE_FLT
          OpEventGetEventUdsStatus_GetEventUdsStatus_EvtInfo_INV_RSLVR_SIN_COS_PLAUS_AMP: RteEventRef=OpEventGetEventUdsStatus_GetEventUdsStatus_EvtInfo_INV_RSLVR_SIN_COS_PLAUS_AMP
          OpEventGetEventUdsStatus_GetEventUdsStatus_Event_INV_RSLVR_SIN_COS_PLAUS_AMP: RteEventRef=OpEventGetEventUdsStatus_GetEventUdsStatus_Event_INV_RSLVR_SIN_COS_PLAUS_AMP
          OpEventGetEventUdsStatus_GetEventUdsStatus_EvtInfo_INV_IAC_U_ELEC_LO: RteEventRef=OpEventGetEventUdsStatus_GetEventUdsStatus_EvtInfo_INV_IAC_U_ELEC_LO
          OpEventGetEventUdsStatus_GetEventUdsStatus_Event_INV_IAC_U_ELEC_LO: RteEventRef=OpEventGetEventUdsStatus_GetEventUdsStatus_Event_INV_IAC_U_ELEC_LO
          OpEventGetEventUdsStatus_GetEventUdsStatus_EvtInfo_INV_RSLVR_EXCT_ELEC_HI: RteEventRef=OpEventGetEventUdsStatus_GetEventUdsStatus_EvtInfo_INV_RSLVR_EXCT_ELEC_HI
          OpEventGetEventUdsStatus_GetEventUdsStatus_Event_INV_RSLVR_EXCT_ELEC_HI: RteEventRef=OpEventGetEventUdsStatus_GetEventUdsStatus_Event_INV_RSLVR_EXCT_ELEC_HI
          OpEventGetEventUdsStatus_GetEventUdsStatus_EvtInfo_INV_IAC_U_RNG_LO: RteEventRef=OpEventGetEventUdsStatus_GetEventUdsStatus_EvtInfo_INV_IAC_U_RNG_LO
          OpEventGetEventUdsStatus_GetEventUdsStatus_Event_INV_IAC_U_RNG_LO: RteEventRef=OpEventGetEventUdsStatus_GetEventUdsStatus_Event_INV_IAC_U_RNG_LO
          OpEventGetEventUdsStatus_GetEventUdsStatus_EvtInfo_INV_IAC_V_RNG_HI: RteEventRef=OpEventGetEventUdsStatus_GetEventUdsStatus_EvtInfo_INV_IAC_V_RNG_HI
          OpEventGetEventUdsStatus_GetEventUdsStatus_Event_INV_IAC_V_RNG_HI: RteEventRef=OpEventGetEventUdsStatus_GetEventUdsStatus_Event_INV_IAC_V_RNG_HI
          OpEventGetEventUdsStatus_GetEventUdsStatus_EvtInfo_INV_IGBT_TEMP_U_PLAUS: RteEventRef=OpEventGetEventUdsStatus_GetEventUdsStatus_EvtInfo_INV_IGBT_TEMP_U_PLAUS
          OpEventGetEventUdsStatus_GetEventUdsStatus_Event_INV_IGBT_TEMP_U_PLAUS: RteEventRef=OpEventGetEventUdsStatus_GetEventUdsStatus_Event_INV_IGBT_TEMP_U_PLAUS
          OpEventGetEventUdsStatus_GetEventUdsStatus_EvtInfo_INV_RSLVR_OFFS_DFT: RteEventRef=OpEventGetEventUdsStatus_GetEventUdsStatus_EvtInfo_INV_RSLVR_OFFS_DFT
          OpEventGetEventUdsStatus_GetEventUdsStatus_Event_INV_RSLVR_OFFS_DFT: RteEventRef=OpEventGetEventUdsStatus_GetEventUdsStatus_Event_INV_RSLVR_OFFS_DFT
          OpEventGetEventUdsStatus_GetEventUdsStatus_EvtInfo_Ga_MoveOverThd: RteEventRef=OpEventGetEventUdsStatus_GetEventUdsStatus_EvtInfo_Ga_MoveOverThd
          OpEventGetEventUdsStatus_GetEventUdsStatus_Event_Ga_MoveOverThd: RteEventRef=OpEventGetEventUdsStatus_GetEventUdsStatus_Event_Ga_MoveOverThd
          OpEventGetEventUdsStatus_GetEventUdsStatus_EvtInfo_VcEvMonIPH: RteEventRef=OpEventGetEventUdsStatus_GetEventUdsStatus_EvtInfo_VcEvMonIPH
          OpEventGetEventUdsStatus_GetEventUdsStatus_Event_VcEvMonIPH: RteEventRef=OpEventGetEventUdsStatus_GetEventUdsStatus_Event_VcEvMonIPH
          OpEventGetEventUdsStatus_GetEventUdsStatus_EvtInfo_INV_RSLVR_HW_FLT: RteEventRef=OpEventGetEventUdsStatus_GetEventUdsStatus_EvtInfo_INV_RSLVR_HW_FLT
          OpEventGetEventUdsStatus_GetEventUdsStatus_Event_INV_RSLVR_HW_FLT: RteEventRef=OpEventGetEventUdsStatus_GetEventUdsStatus_Event_INV_RSLVR_HW_FLT
          OpEventGetEventUdsStatus_GetEventUdsStatus_EvtInfo_INV_RSLVR_SIN_ELEC_LO: RteEventRef=OpEventGetEventUdsStatus_GetEventUdsStatus_EvtInfo_INV_RSLVR_SIN_ELEC_LO
          OpEventGetEventUdsStatus_GetEventUdsStatus_Event_INV_RSLVR_SIN_ELEC_LO: RteEventRef=OpEventGetEventUdsStatus_GetEventUdsStatus_Event_INV_RSLVR_SIN_ELEC_LO
          OpEventGetEventUdsStatus_GetEventUdsStatus_EvtInfo_INV_IAC_W_AMP: RteEventRef=OpEventGetEventUdsStatus_GetEventUdsStatus_EvtInfo_INV_IAC_W_AMP
          OpEventGetEventUdsStatus_GetEventUdsStatus_Event_INV_IAC_W_AMP: RteEventRef=OpEventGetEventUdsStatus_GetEventUdsStatus_Event_INV_IAC_W_AMP
          OpEventGetEventUdsStatus_GetEventUdsStatus_EvtInfo_VCC_OverVoltage: RteEventRef=OpEventGetEventUdsStatus_GetEventUdsStatus_EvtInfo_VCC_OverVoltage
          OpEventGetEventUdsStatus_GetEventUdsStatus_Event_VCC_OverVoltage: RteEventRef=OpEventGetEventUdsStatus_GetEventUdsStatus_Event_VCC_OverVoltage
          OpEventGetEventUdsStatus_GetEventUdsStatus_EvtInfo_PS_BLDC_OV_FLT: RteEventRef=OpEventGetEventUdsStatus_GetEventUdsStatus_EvtInfo_PS_BLDC_OV_FLT
          OpEventGetEventUdsStatus_GetEventUdsStatus_Event_PS_BLDC_OV_FLT: RteEventRef=OpEventGetEventUdsStatus_GetEventUdsStatus_Event_PS_BLDC_OV_FLT
          OpEventGetEventUdsStatus_GetEventUdsStatus_EvtInfo_AURIX_EEPROM_FLT: RteEventRef=OpEventGetEventUdsStatus_GetEventUdsStatus_EvtInfo_AURIX_EEPROM_FLT
          OpEventGetEventUdsStatus_GetEventUdsStatus_Event_AURIX_EEPROM_FLT: RteEventRef=OpEventGetEventUdsStatus_GetEventUdsStatus_Event_AURIX_EEPROM_FLT
          OpEventGetEventUdsStatus_GetEventUdsStatus_EvtInfo_FS_MONITIOR_ASC_FW_FLT: RteEventRef=OpEventGetEventUdsStatus_GetEventUdsStatus_EvtInfo_FS_MONITIOR_ASC_FW_FLT
          OpEventGetEventUdsStatus_GetEventUdsStatus_Event_FS_MONITIOR_ASC_FW_FLT: RteEventRef=OpEventGetEventUdsStatus_GetEventUdsStatus_Event_FS_MONITIOR_ASC_FW_FLT
          OpEventGetEventUdsStatus_GetEventUdsStatus_EvtInfo_VCEvSrsPropFr02Tioutd: RteEventRef=OpEventGetEventUdsStatus_GetEventUdsStatus_EvtInfo_VCEvSrsPropFr02Tioutd
          OpEventGetEventUdsStatus_GetEventUdsStatus_Event_VCEvSrsPropFr02Tioutd: RteEventRef=OpEventGetEventUdsStatus_GetEventUdsStatus_Event_VCEvSrsPropFr02Tioutd
          OpEventGetEventUdsStatus_GetEventUdsStatus_EvtInfo_VcEvMonErrMode: RteEventRef=OpEventGetEventUdsStatus_GetEventUdsStatus_EvtInfo_VcEvMonErrMode
          OpEventGetEventUdsStatus_GetEventUdsStatus_Event_VcEvMonErrMode: RteEventRef=OpEventGetEventUdsStatus_GetEventUdsStatus_Event_VcEvMonErrMode
          OpEventGetEventUdsStatus_GetEventUdsStatus_EvtInfo_AURIX_RST_MPL: RteEventRef=OpEventGetEventUdsStatus_GetEventUdsStatus_EvtInfo_AURIX_RST_MPL
          OpEventGetEventUdsStatus_GetEventUdsStatus_Event_AURIX_RST_MPL: RteEventRef=OpEventGetEventUdsStatus_GetEventUdsStatus_Event_AURIX_RST_MPL
          OpEventGetEventUdsStatus_GetEventUdsStatus_EvtInfo_VcEvNodeMisECM: RteEventRef=OpEventGetEventUdsStatus_GetEventUdsStatus_EvtInfo_VcEvNodeMisECM
          OpEventGetEventUdsStatus_GetEventUdsStatus_Event_VcEvNodeMisECM: RteEventRef=OpEventGetEventUdsStatus_GetEventUdsStatus_Event_VcEvNodeMisECM
          OpEventGetEventUdsStatus_GetEventUdsStatus_EvtInfo_PS_KL30_PLAUS: RteEventRef=OpEventGetEventUdsStatus_GetEventUdsStatus_EvtInfo_PS_KL30_PLAUS
          OpEventGetEventUdsStatus_GetEventUdsStatus_Event_PS_KL30_PLAUS: RteEventRef=OpEventGetEventUdsStatus_GetEventUdsStatus_Event_PS_KL30_PLAUS
          OpEventGetEventUdsStatus_GetEventUdsStatus_EvtInfo_INV_IAC_W_ELEC_HI: RteEventRef=OpEventGetEventUdsStatus_GetEventUdsStatus_EvtInfo_INV_IAC_W_ELEC_HI
          OpEventGetEventUdsStatus_GetEventUdsStatus_Event_INV_IAC_W_ELEC_HI: RteEventRef=OpEventGetEventUdsStatus_GetEventUdsStatus_Event_INV_IAC_W_ELEC_HI
          OpEventGetEventUdsStatus_GetEventUdsStatus_EvtInfo_VCEvVddmPropFr19Tioutd: RteEventRef=OpEventGetEventUdsStatus_GetEventUdsStatus_EvtInfo_VCEvVddmPropFr19Tioutd
          OpEventGetEventUdsStatus_GetEventUdsStatus_Event_VCEvVddmPropFr19Tioutd: RteEventRef=OpEventGetEventUdsStatus_GetEventUdsStatus_Event_VCEvVddmPropFr19Tioutd
          OpEventGetEventUdsStatus_GetEventUdsStatus_EvtInfo_INV_TEMP_DCHA_HW: RteEventRef=OpEventGetEventUdsStatus_GetEventUdsStatus_EvtInfo_INV_TEMP_DCHA_HW
          OpEventGetEventUdsStatus_GetEventUdsStatus_Event_INV_TEMP_DCHA_HW: RteEventRef=OpEventGetEventUdsStatus_GetEventUdsStatus_Event_INV_TEMP_DCHA_HW
          OpEventGetEventUdsStatus_GetEventUdsStatus_EvtInfo_VcEvPropCANGlbTiOutd: RteEventRef=OpEventGetEventUdsStatus_GetEventUdsStatus_EvtInfo_VcEvPropCANGlbTiOutd
          OpEventGetEventUdsStatus_GetEventUdsStatus_Event_VcEvPropCANGlbTiOutd: RteEventRef=OpEventGetEventUdsStatus_GetEventUdsStatus_Event_VcEvPropCANGlbTiOutd
          OpEventGetEventUdsStatus_GetEventUdsStatus_EvtInfo_INV_EM_STATOR_TEMP2_RNG_NOK: RteEventRef=OpEventGetEventUdsStatus_GetEventUdsStatus_EvtInfo_INV_EM_STATOR_TEMP2_RNG_NOK
          OpEventGetEventUdsStatus_GetEventUdsStatus_Event_INV_EM_STATOR_TEMP2_RNG_NOK: RteEventRef=OpEventGetEventUdsStatus_GetEventUdsStatus_Event_INV_EM_STATOR_TEMP2_RNG_NOK
          OpEventGetEventUdsStatus_GetEventUdsStatus_EvtInfo_INV_UHVDC_OV_HWP: RteEventRef=OpEventGetEventUdsStatus_GetEventUdsStatus_EvtInfo_INV_UHVDC_OV_HWP
          OpEventGetEventUdsStatus_GetEventUdsStatus_Event_INV_UHVDC_OV_HWP: RteEventRef=OpEventGetEventUdsStatus_GetEventUdsStatus_Event_INV_UHVDC_OV_HWP
          OpEventGetEventUdsStatus_GetEventUdsStatus_EvtInfo_Ga_FindEngleAngleFailed: RteEventRef=OpEventGetEventUdsStatus_GetEventUdsStatus_EvtInfo_Ga_FindEngleAngleFailed
          OpEventGetEventUdsStatus_GetEventUdsStatus_Event_Ga_FindEngleAngleFailed: RteEventRef=OpEventGetEventUdsStatus_GetEventUdsStatus_Event_Ga_FindEngleAngleFailed
          OpEventGetEventUdsStatus_GetEventUdsStatus_EvtInfo_VcEvMonTrqCmp: RteEventRef=OpEventGetEventUdsStatus_GetEventUdsStatus_EvtInfo_VcEvMonTrqCmp
          OpEventGetEventUdsStatus_GetEventUdsStatus_Event_VcEvMonTrqCmp: RteEventRef=OpEventGetEventUdsStatus_GetEventUdsStatus_Event_VcEvMonTrqCmp
          OpEventGetEventUdsStatus_GetEventUdsStatus_EvtInfo_INV_IGBT_TEMP_V_RNG_LO: RteEventRef=OpEventGetEventUdsStatus_GetEventUdsStatus_EvtInfo_INV_IGBT_TEMP_V_RNG_LO
          OpEventGetEventUdsStatus_GetEventUdsStatus_Event_INV_IGBT_TEMP_V_RNG_LO: RteEventRef=OpEventGetEventUdsStatus_GetEventUdsStatus_Event_INV_IGBT_TEMP_V_RNG_LO
          OpEventGetEventUdsStatus_GetEventUdsStatus_EvtInfo_INV_CONTROL_LIMIT: RteEventRef=OpEventGetEventUdsStatus_GetEventUdsStatus_EvtInfo_INV_CONTROL_LIMIT
          OpEventGetEventUdsStatus_GetEventUdsStatus_Event_INV_CONTROL_LIMIT: RteEventRef=OpEventGetEventUdsStatus_GetEventUdsStatus_Event_INV_CONTROL_LIMIT
          OpEventGetEventUdsStatus_GetEventUdsStatus_EvtInfo_COM_CarConfigErr: RteEventRef=OpEventGetEventUdsStatus_GetEventUdsStatus_EvtInfo_COM_CarConfigErr
          OpEventGetEventUdsStatus_GetEventUdsStatus_Event_COM_CarConfigErr: RteEventRef=OpEventGetEventUdsStatus_GetEventUdsStatus_Event_COM_CarConfigErr
          OpEventGetEventUdsStatus_GetEventUdsStatus_EvtInfo_VCEvEcmPropFr08Tioutd: RteEventRef=OpEventGetEventUdsStatus_GetEventUdsStatus_EvtInfo_VCEvEcmPropFr08Tioutd
          OpEventGetEventUdsStatus_GetEventUdsStatus_Event_VCEvEcmPropFr08Tioutd: RteEventRef=OpEventGetEventUdsStatus_GetEventUdsStatus_Event_VCEvEcmPropFr08Tioutd
          OpEventGetEventUdsStatus_GetEventUdsStatus_EvtInfo_CU_TEMP1_RNG_LO: RteEventRef=OpEventGetEventUdsStatus_GetEventUdsStatus_EvtInfo_CU_TEMP1_RNG_LO
          OpEventGetEventUdsStatus_GetEventUdsStatus_Event_CU_TEMP1_RNG_LO: RteEventRef=OpEventGetEventUdsStatus_GetEventUdsStatus_Event_CU_TEMP1_RNG_LO
          OpEventGetEventUdsStatus_GetEventUdsStatus_EvtInfo_INV_EM_STATOR_TEMP2_RNG_SWT: RteEventRef=OpEventGetEventUdsStatus_GetEventUdsStatus_EvtInfo_INV_EM_STATOR_TEMP2_RNG_SWT
          OpEventGetEventUdsStatus_GetEventUdsStatus_Event_INV_EM_STATOR_TEMP2_RNG_SWT: RteEventRef=OpEventGetEventUdsStatus_GetEventUdsStatus_Event_INV_EM_STATOR_TEMP2_RNG_SWT
          OpEventGetEventUdsStatus_GetEventUdsStatus_EvtInfo_GA_BLDC_POS_FLT: RteEventRef=OpEventGetEventUdsStatus_GetEventUdsStatus_EvtInfo_GA_BLDC_POS_FLT
          OpEventGetEventUdsStatus_GetEventUdsStatus_Event_GA_BLDC_POS_FLT: RteEventRef=OpEventGetEventUdsStatus_GetEventUdsStatus_Event_GA_BLDC_POS_FLT
          OpEventGetEventUdsStatus_GetEventUdsStatus_EvtInfo_PS_WhlSnsr_FLT: RteEventRef=OpEventGetEventUdsStatus_GetEventUdsStatus_EvtInfo_PS_WhlSnsr_FLT
          OpEventGetEventUdsStatus_GetEventUdsStatus_Event_PS_WhlSnsr_FLT: RteEventRef=OpEventGetEventUdsStatus_GetEventUdsStatus_Event_PS_WhlSnsr_FLT
          OpEventGetEventUdsStatus_GetEventUdsStatus_EvtInfo_INV_EM_STATOR_TEMP_RNG_LO: RteEventRef=OpEventGetEventUdsStatus_GetEventUdsStatus_EvtInfo_INV_EM_STATOR_TEMP_RNG_LO
          OpEventGetEventUdsStatus_GetEventUdsStatus_Event_INV_EM_STATOR_TEMP_RNG_LO: RteEventRef=OpEventGetEventUdsStatus_GetEventUdsStatus_Event_INV_EM_STATOR_TEMP_RNG_LO
          OpEventGetEventUdsStatus_GetEventUdsStatus_EvtInfo_INV_RSLVR_SIN_ELEC_HI: RteEventRef=OpEventGetEventUdsStatus_GetEventUdsStatus_EvtInfo_INV_RSLVR_SIN_ELEC_HI
          OpEventGetEventUdsStatus_GetEventUdsStatus_Event_INV_RSLVR_SIN_ELEC_HI: RteEventRef=OpEventGetEventUdsStatus_GetEventUdsStatus_Event_INV_RSLVR_SIN_ELEC_HI
          OpEventGetEventUdsStatus_GetEventUdsStatus_EvtInfo_INV_RSLVR_SIN_COS_PLAUS: RteEventRef=OpEventGetEventUdsStatus_GetEventUdsStatus_EvtInfo_INV_RSLVR_SIN_COS_PLAUS
          OpEventGetEventUdsStatus_GetEventUdsStatus_Event_INV_RSLVR_SIN_COS_PLAUS: RteEventRef=OpEventGetEventUdsStatus_GetEventUdsStatus_Event_INV_RSLVR_SIN_COS_PLAUS
          OpEventGetEventUdsStatus_GetEventUdsStatus_EvtInfo_INV_RSLVR_COS_AMP: RteEventRef=OpEventGetEventUdsStatus_GetEventUdsStatus_EvtInfo_INV_RSLVR_COS_AMP
          OpEventGetEventUdsStatus_GetEventUdsStatus_Event_INV_RSLVR_COS_AMP: RteEventRef=OpEventGetEventUdsStatus_GetEventUdsStatus_Event_INV_RSLVR_COS_AMP
          OpEventGetEventUdsStatus_GetEventUdsStatus_EvtInfo_INV_GATE_DRVR_BOT_HWP: RteEventRef=OpEventGetEventUdsStatus_GetEventUdsStatus_EvtInfo_INV_GATE_DRVR_BOT_HWP
          OpEventGetEventUdsStatus_GetEventUdsStatus_Event_INV_GATE_DRVR_BOT_HWP: RteEventRef=OpEventGetEventUdsStatus_GetEventUdsStatus_Event_INV_GATE_DRVR_BOT_HWP
          OpEventGetEventUdsStatus_GetEventUdsStatus_EvtInfo_Eg_HallVolWrong: RteEventRef=OpEventGetEventUdsStatus_GetEventUdsStatus_EvtInfo_Eg_HallVolWrong
          OpEventGetEventUdsStatus_GetEventUdsStatus_Event_Eg_HallVolWrong: RteEventRef=OpEventGetEventUdsStatus_GetEventUdsStatus_Event_Eg_HallVolWrong
          OpEventGetEventUdsStatus_GetEventUdsStatus_EvtInfo_INV_RSLVR_EXCT_RNG_NOK: RteEventRef=OpEventGetEventUdsStatus_GetEventUdsStatus_EvtInfo_INV_RSLVR_EXCT_RNG_NOK
          OpEventGetEventUdsStatus_GetEventUdsStatus_Event_INV_RSLVR_EXCT_RNG_NOK: RteEventRef=OpEventGetEventUdsStatus_GetEventUdsStatus_Event_INV_RSLVR_EXCT_RNG_NOK
          OpEventGetEventUdsStatus_GetEventUdsStatus_EvtInfo_PA_OpenCirc: RteEventRef=OpEventGetEventUdsStatus_GetEventUdsStatus_EvtInfo_PA_OpenCirc
          OpEventGetEventUdsStatus_GetEventUdsStatus_Event_PA_OpenCirc: RteEventRef=OpEventGetEventUdsStatus_GetEventUdsStatus_Event_PA_OpenCirc
          OpEventGetEventUdsStatus_GetEventUdsStatus_EvtInfo_INV_RSLVR_COS_ELEC_HI: RteEventRef=OpEventGetEventUdsStatus_GetEventUdsStatus_EvtInfo_INV_RSLVR_COS_ELEC_HI
          OpEventGetEventUdsStatus_GetEventUdsStatus_Event_INV_RSLVR_COS_ELEC_HI: RteEventRef=OpEventGetEventUdsStatus_GetEventUdsStatus_Event_INV_RSLVR_COS_ELEC_HI
          OpEventGetEventUdsStatus_GetEventUdsStatus_EvtInfo_VcEvCntrHvSysRlySts: RteEventRef=OpEventGetEventUdsStatus_GetEventUdsStatus_EvtInfo_VcEvCntrHvSysRlySts
          OpEventGetEventUdsStatus_GetEventUdsStatus_Event_VcEvCntrHvSysRlySts: RteEventRef=OpEventGetEventUdsStatus_GetEventUdsStatus_Event_VcEvCntrHvSysRlySts
          OpEventGetEventUdsStatus_GetEventUdsStatus_EvtInfo_CRASH_DTC: RteEventRef=OpEventGetEventUdsStatus_GetEventUdsStatus_EvtInfo_CRASH_DTC
          OpEventGetEventUdsStatus_GetEventUdsStatus_Event_CRASH_DTC: RteEventRef=OpEventGetEventUdsStatus_GetEventUdsStatus_Event_CRASH_DTC
          OpEventGetEventUdsStatus_GetEventUdsStatus_EvtInfo_INV_IGBT_TEMP_W_RNG_HI: RteEventRef=OpEventGetEventUdsStatus_GetEventUdsStatus_EvtInfo_INV_IGBT_TEMP_W_RNG_HI
          OpEventGetEventUdsStatus_GetEventUdsStatus_Event_INV_IGBT_TEMP_W_RNG_HI: RteEventRef=OpEventGetEventUdsStatus_GetEventUdsStatus_Event_INV_IGBT_TEMP_W_RNG_HI
          OpEventGetEventUdsStatus_GetEventUdsStatus_EvtInfo_VCEvBecmPropFr02Tioutd: RteEventRef=OpEventGetEventUdsStatus_GetEventUdsStatus_EvtInfo_VCEvBecmPropFr02Tioutd
          OpEventGetEventUdsStatus_GetEventUdsStatus_Event_VCEvBecmPropFr02Tioutd: RteEventRef=OpEventGetEventUdsStatus_GetEventUdsStatus_Event_VCEvBecmPropFr02Tioutd
          OpEventGetEventUdsStatus_GetEventUdsStatus_EvtInfo_INV_IGBT_TEMP_W_GRDT: RteEventRef=OpEventGetEventUdsStatus_GetEventUdsStatus_EvtInfo_INV_IGBT_TEMP_W_GRDT
          OpEventGetEventUdsStatus_GetEventUdsStatus_Event_INV_IGBT_TEMP_W_GRDT: RteEventRef=OpEventGetEventUdsStatus_GetEventUdsStatus_Event_INV_IGBT_TEMP_W_GRDT
          OpEventGetEventUdsStatus_GetEventUdsStatus_EvtInfo_EXT_UC_SPI_FLT: RteEventRef=OpEventGetEventUdsStatus_GetEventUdsStatus_EvtInfo_EXT_UC_SPI_FLT
          OpEventGetEventUdsStatus_GetEventUdsStatus_Event_EXT_UC_SPI_FLT: RteEventRef=OpEventGetEventUdsStatus_GetEventUdsStatus_Event_EXT_UC_SPI_FLT
          OpEventGetEventUdsStatus_GetEventUdsStatus_EvtInfo_INV_IAC_V_ELEC_HWP_001: RteEventRef=OpEventGetEventUdsStatus_GetEventUdsStatus_EvtInfo_INV_IAC_V_ELEC_HWP_001
          OpEventGetEventUdsStatus_GetEventUdsStatus_Event_INV_IAC_V_ELEC_HWP_001: RteEventRef=OpEventGetEventUdsStatus_GetEventUdsStatus_Event_INV_IAC_V_ELEC_HWP_001
          OpEventGetEventUdsStatus_GetEventUdsStatus_EvtInfo_VcEvChkSumWhlMotSysTqAllwd: RteEventRef=OpEventGetEventUdsStatus_GetEventUdsStatus_EvtInfo_VcEvChkSumWhlMotSysTqAllwd
          OpEventGetEventUdsStatus_GetEventUdsStatus_Event_VcEvChkSumWhlMotSysTqAllwd: RteEventRef=OpEventGetEventUdsStatus_GetEventUdsStatus_Event_VcEvChkSumWhlMotSysTqAllwd
          OpEventGetEventUdsStatus_GetEventUdsStatus_EvtInfo_FS_MONITIOR_ASC_FLT: RteEventRef=OpEventGetEventUdsStatus_GetEventUdsStatus_EvtInfo_FS_MONITIOR_ASC_FLT
          OpEventGetEventUdsStatus_GetEventUdsStatus_Event_FS_MONITIOR_ASC_FLT: RteEventRef=OpEventGetEventUdsStatus_GetEventUdsStatus_Event_FS_MONITIOR_ASC_FLT
          OpEventGetEventUdsStatus_GetEventUdsStatus_EvtInfo_INV_IAC_V_AMP: RteEventRef=OpEventGetEventUdsStatus_GetEventUdsStatus_EvtInfo_INV_IAC_V_AMP
          OpEventGetEventUdsStatus_GetEventUdsStatus_Event_INV_IAC_V_AMP: RteEventRef=OpEventGetEventUdsStatus_GetEventUdsStatus_Event_INV_IAC_V_AMP
          OpEventGetEventUdsStatus_GetEventUdsStatus_EvtInfo_INV_IAC_W_ELEC_LO: RteEventRef=OpEventGetEventUdsStatus_GetEventUdsStatus_EvtInfo_INV_IAC_W_ELEC_LO
          OpEventGetEventUdsStatus_GetEventUdsStatus_Event_INV_IAC_W_ELEC_LO: RteEventRef=OpEventGetEventUdsStatus_GetEventUdsStatus_Event_INV_IAC_W_ELEC_LO
          OpEventGetEventUdsStatus_GetEventUdsStatus_EvtInfo_VCEvVddmPropFr08Tioutd_001: RteEventRef=OpEventGetEventUdsStatus_GetEventUdsStatus_EvtInfo_VCEvVddmPropFr08Tioutd_001
          OpEventGetEventUdsStatus_GetEventUdsStatus_Event_VCEvVddmPropFr08Tioutd_001: RteEventRef=OpEventGetEventUdsStatus_GetEventUdsStatus_Event_VCEvVddmPropFr08Tioutd_001
          OpEventGetEventUdsStatus_GetEventUdsStatus_EvtInfo_PS_P12_RES_FLT: RteEventRef=OpEventGetEventUdsStatus_GetEventUdsStatus_EvtInfo_PS_P12_RES_FLT
          OpEventGetEventUdsStatus_GetEventUdsStatus_Event_PS_P12_RES_FLT: RteEventRef=OpEventGetEventUdsStatus_GetEventUdsStatus_Event_PS_P12_RES_FLT
          OpEventGetEventUdsStatus_GetEventUdsStatus_EvtInfo_INV_RSLVR_SIN_RNG_LO: RteEventRef=OpEventGetEventUdsStatus_GetEventUdsStatus_EvtInfo_INV_RSLVR_SIN_RNG_LO
          OpEventGetEventUdsStatus_GetEventUdsStatus_Event_INV_RSLVR_SIN_RNG_LO: RteEventRef=OpEventGetEventUdsStatus_GetEventUdsStatus_Event_INV_RSLVR_SIN_RNG_LO
          OpEventGetEventUdsStatus_GetEventUdsStatus_EvtInfo_CU_TEMP_HW_FLT: RteEventRef=OpEventGetEventUdsStatus_GetEventUdsStatus_EvtInfo_CU_TEMP_HW_FLT
          OpEventGetEventUdsStatus_GetEventUdsStatus_Event_CU_TEMP_HW_FLT: RteEventRef=OpEventGetEventUdsStatus_GetEventUdsStatus_Event_CU_TEMP_HW_FLT
          OpEventGetEventUdsStatus_GetEventUdsStatus_EvtInfo_VCEvEcmPropFr02MgmFr00Tioutd: RteEventRef=OpEventGetEventUdsStatus_GetEventUdsStatus_EvtInfo_VCEvEcmPropFr02MgmFr00Tioutd
          OpEventGetEventUdsStatus_GetEventUdsStatus_Event_VCEvEcmPropFr02MgmFr00Tioutd: RteEventRef=OpEventGetEventUdsStatus_GetEventUdsStatus_Event_VCEvEcmPropFr02MgmFr00Tioutd
          OpEventGetEventUdsStatus_GetEventUdsStatus_EvtInfo_PS_KL15_RNG_HI: RteEventRef=OpEventGetEventUdsStatus_GetEventUdsStatus_EvtInfo_PS_KL15_RNG_HI
          OpEventGetEventUdsStatus_GetEventUdsStatus_Event_PS_KL15_RNG_HI: RteEventRef=OpEventGetEventUdsStatus_GetEventUdsStatus_Event_PS_KL15_RNG_HI
          OpEventGetEventUdsStatus_GetEventUdsStatus_EvtInfo_VCEvVddmPropFr17Tioutd: RteEventRef=OpEventGetEventUdsStatus_GetEventUdsStatus_EvtInfo_VCEvVddmPropFr17Tioutd
          OpEventGetEventUdsStatus_GetEventUdsStatus_Event_VCEvVddmPropFr17Tioutd: RteEventRef=OpEventGetEventUdsStatus_GetEventUdsStatus_Event_VCEvVddmPropFr17Tioutd
          OpEventGetEventUdsStatus_GetEventUdsStatus_EvtInfo_VcEvChkSumCrashStsSafe: RteEventRef=OpEventGetEventUdsStatus_GetEventUdsStatus_EvtInfo_VcEvChkSumCrashStsSafe
          OpEventGetEventUdsStatus_GetEventUdsStatus_Event_VcEvChkSumCrashStsSafe: RteEventRef=OpEventGetEventUdsStatus_GetEventUdsStatus_Event_VcEvChkSumCrashStsSafe
          OpEventGetEventUdsStatus_GetEventUdsStatus_EvtInfo_DiagC_ClutchService: RteEventRef=OpEventGetEventUdsStatus_GetEventUdsStatus_EvtInfo_DiagC_ClutchService
          OpEventGetEventUdsStatus_GetEventUdsStatus_Event_DiagC_ClutchService: RteEventRef=OpEventGetEventUdsStatus_GetEventUdsStatus_Event_DiagC_ClutchService
          OpEventGetEventUdsStatus_GetEventUdsStatus_EvtInfo_INV_EM_STATOR_TEMP_RNG_HI: RteEventRef=OpEventGetEventUdsStatus_GetEventUdsStatus_EvtInfo_INV_EM_STATOR_TEMP_RNG_HI
          OpEventGetEventUdsStatus_GetEventUdsStatus_Event_INV_EM_STATOR_TEMP_RNG_HI: RteEventRef=OpEventGetEventUdsStatus_GetEventUdsStatus_Event_INV_EM_STATOR_TEMP_RNG_HI
          OpEventGetEventUdsStatus_GetEventUdsStatus_EvtInfo_INV_RSLVR_OFFS_OUT_RANG: RteEventRef=OpEventGetEventUdsStatus_GetEventUdsStatus_EvtInfo_INV_RSLVR_OFFS_OUT_RANG
          OpEventGetEventUdsStatus_GetEventUdsStatus_Event_INV_RSLVR_OFFS_OUT_RANG: RteEventRef=OpEventGetEventUdsStatus_GetEventUdsStatus_Event_INV_RSLVR_OFFS_OUT_RANG
          OpEventGetEventUdsStatus_GetEventUdsStatus_EvtInfo_INV_EM_STATOR_TEMP2_RNG_LO: RteEventRef=OpEventGetEventUdsStatus_GetEventUdsStatus_EvtInfo_INV_EM_STATOR_TEMP2_RNG_LO
          OpEventGetEventUdsStatus_GetEventUdsStatus_Event_INV_EM_STATOR_TEMP2_RNG_LO: RteEventRef=OpEventGetEventUdsStatus_GetEventUdsStatus_Event_INV_EM_STATOR_TEMP2_RNG_LO
          OpEventGetEventUdsStatus_GetEventUdsStatus_EvtInfo_VcEvMonISAR: RteEventRef=OpEventGetEventUdsStatus_GetEventUdsStatus_EvtInfo_VcEvMonISAR
          OpEventGetEventUdsStatus_GetEventUdsStatus_Event_VcEvMonISAR: RteEventRef=OpEventGetEventUdsStatus_GetEventUdsStatus_Event_VcEvMonISAR
          OpEventGetEventUdsStatus_GetEventUdsStatus_EvtInfo_GA_BLDC_FLT: RteEventRef=OpEventGetEventUdsStatus_GetEventUdsStatus_EvtInfo_GA_BLDC_FLT
          OpEventGetEventUdsStatus_GetEventUdsStatus_Event_GA_BLDC_FLT: RteEventRef=OpEventGetEventUdsStatus_GetEventUdsStatus_Event_GA_BLDC_FLT
          OpEventGetEventUdsStatus_GetEventUdsStatus_EvtInfo_INV_RSLVR_EXCT_ELEC_OPEN: RteEventRef=OpEventGetEventUdsStatus_GetEventUdsStatus_EvtInfo_INV_RSLVR_EXCT_ELEC_OPEN
          OpEventGetEventUdsStatus_GetEventUdsStatus_Event_INV_RSLVR_EXCT_ELEC_OPEN: RteEventRef=OpEventGetEventUdsStatus_GetEventUdsStatus_Event_INV_RSLVR_EXCT_ELEC_OPEN
          OpEventGetEventUdsStatus_GetEventUdsStatus_EvtInfo_INV_RSLVR_EXCT_PLAUS: RteEventRef=OpEventGetEventUdsStatus_GetEventUdsStatus_EvtInfo_INV_RSLVR_EXCT_PLAUS
          OpEventGetEventUdsStatus_GetEventUdsStatus_Event_INV_RSLVR_EXCT_PLAUS: RteEventRef=OpEventGetEventUdsStatus_GetEventUdsStatus_Event_INV_RSLVR_EXCT_PLAUS
          OpEventGetEventUdsStatus_GetEventUdsStatus_EvtInfo_PS_P15_U_FLT: RteEventRef=OpEventGetEventUdsStatus_GetEventUdsStatus_EvtInfo_PS_P15_U_FLT
          OpEventGetEventUdsStatus_GetEventUdsStatus_Event_PS_P15_U_FLT: RteEventRef=OpEventGetEventUdsStatus_GetEventUdsStatus_Event_PS_P15_U_FLT
          OpEventGetEventUdsStatus_GetEventUdsStatus_EvtInfo_INV_EM_STATOR_TEMP_RNG_SWT: RteEventRef=OpEventGetEventUdsStatus_GetEventUdsStatus_EvtInfo_INV_EM_STATOR_TEMP_RNG_SWT
          OpEventGetEventUdsStatus_GetEventUdsStatus_Event_INV_EM_STATOR_TEMP_RNG_SWT: RteEventRef=OpEventGetEventUdsStatus_GetEventUdsStatus_Event_INV_EM_STATOR_TEMP_RNG_SWT
          OpEventGetEventUdsStatus_GetEventUdsStatus_EvtInfo_INV_UHVDC_OV_SWP: RteEventRef=OpEventGetEventUdsStatus_GetEventUdsStatus_EvtInfo_INV_UHVDC_OV_SWP
          OpEventGetEventUdsStatus_GetEventUdsStatus_Event_INV_UHVDC_OV_SWP: RteEventRef=OpEventGetEventUdsStatus_GetEventUdsStatus_Event_INV_UHVDC_OV_SWP
          OpEventGetEventUdsStatus_GetEventUdsStatus_EvtInfo_AURIX_HW_FLT: RteEventRef=OpEventGetEventUdsStatus_GetEventUdsStatus_EvtInfo_AURIX_HW_FLT
          OpEventGetEventUdsStatus_GetEventUdsStatus_Event_AURIX_HW_FLT: RteEventRef=OpEventGetEventUdsStatus_GetEventUdsStatus_Event_AURIX_HW_FLT
          OpEventGetEventUdsStatus_GetEventUdsStatus_EvtInfo_INV_GATE_DRVR_TOP_HWP: RteEventRef=OpEventGetEventUdsStatus_GetEventUdsStatus_EvtInfo_INV_GATE_DRVR_TOP_HWP
          OpEventGetEventUdsStatus_GetEventUdsStatus_Event_INV_GATE_DRVR_TOP_HWP: RteEventRef=OpEventGetEventUdsStatus_GetEventUdsStatus_Event_INV_GATE_DRVR_TOP_HWP
          OpEventGetEventUdsStatus_GetEventUdsStatus_EvtInfo_INV_ACTV_DCHA_HW: RteEventRef=OpEventGetEventUdsStatus_GetEventUdsStatus_EvtInfo_INV_ACTV_DCHA_HW
          OpEventGetEventUdsStatus_GetEventUdsStatus_Event_INV_ACTV_DCHA_HW: RteEventRef=OpEventGetEventUdsStatus_GetEventUdsStatus_Event_INV_ACTV_DCHA_HW
          OpEventGetEventUdsStatus_GetEventUdsStatus_EvtInfo_INV_IGBT_TEMP_HWP: RteEventRef=OpEventGetEventUdsStatus_GetEventUdsStatus_EvtInfo_INV_IGBT_TEMP_HWP
          OpEventGetEventUdsStatus_GetEventUdsStatus_Event_INV_IGBT_TEMP_HWP: RteEventRef=OpEventGetEventUdsStatus_GetEventUdsStatus_Event_INV_IGBT_TEMP_HWP
          OpEventGetEventUdsStatus_GetEventUdsStatus_EvtInfo_INV_RSLVR_SIN_ELEC_FLT: RteEventRef=OpEventGetEventUdsStatus_GetEventUdsStatus_EvtInfo_INV_RSLVR_SIN_ELEC_FLT
          OpEventGetEventUdsStatus_GetEventUdsStatus_Event_INV_RSLVR_SIN_ELEC_FLT: RteEventRef=OpEventGetEventUdsStatus_GetEventUdsStatus_Event_INV_RSLVR_SIN_ELEC_FLT
          OpEventGetEventUdsStatus_GetEventUdsStatus_EvtInfo_CU_TEMP2_RNG_HI: RteEventRef=OpEventGetEventUdsStatus_GetEventUdsStatus_EvtInfo_CU_TEMP2_RNG_HI
          OpEventGetEventUdsStatus_GetEventUdsStatus_Event_CU_TEMP2_RNG_HI: RteEventRef=OpEventGetEventUdsStatus_GetEventUdsStatus_Event_CU_TEMP2_RNG_HI
          OpEventGetEventUdsStatus_GetEventUdsStatus_EvtInfo_INV_IAC_PHA_LOSS_MPL: RteEventRef=OpEventGetEventUdsStatus_GetEventUdsStatus_EvtInfo_INV_IAC_PHA_LOSS_MPL
          OpEventGetEventUdsStatus_GetEventUdsStatus_Event_INV_IAC_PHA_LOSS_MPL: RteEventRef=OpEventGetEventUdsStatus_GetEventUdsStatus_Event_INV_IAC_PHA_LOSS_MPL
          OpEventGetEventUdsStatus_GetEventUdsStatus_EvtInfo_INV_IAC_U_AMP: RteEventRef=OpEventGetEventUdsStatus_GetEventUdsStatus_EvtInfo_INV_IAC_U_AMP
          OpEventGetEventUdsStatus_GetEventUdsStatus_Event_INV_IAC_U_AMP: RteEventRef=OpEventGetEventUdsStatus_GetEventUdsStatus_Event_INV_IAC_U_AMP
          OpEventGetEventUdsStatus_GetEventUdsStatus_EvtInfo_PSnsr_GRADT_Flt: RteEventRef=OpEventGetEventUdsStatus_GetEventUdsStatus_EvtInfo_PSnsr_GRADT_Flt
          OpEventGetEventUdsStatus_GetEventUdsStatus_Event_PSnsr_GRADT_Flt: RteEventRef=OpEventGetEventUdsStatus_GetEventUdsStatus_Event_PSnsr_GRADT_Flt
          OpEventGetEventUdsStatus_GetEventUdsStatus_EvtInfo_AURIX_WATHDOG_FLT: RteEventRef=OpEventGetEventUdsStatus_GetEventUdsStatus_EvtInfo_AURIX_WATHDOG_FLT
          OpEventGetEventUdsStatus_GetEventUdsStatus_Event_AURIX_WATHDOG_FLT: RteEventRef=OpEventGetEventUdsStatus_GetEventUdsStatus_Event_AURIX_WATHDOG_FLT
          OpEventGetEventUdsStatus_GetEventUdsStatus_EvtInfo_VcEvNodeMisBECM: RteEventRef=OpEventGetEventUdsStatus_GetEventUdsStatus_EvtInfo_VcEvNodeMisBECM
          OpEventGetEventUdsStatus_GetEventUdsStatus_Event_VcEvNodeMisBECM: RteEventRef=OpEventGetEventUdsStatus_GetEventUdsStatus_Event_VcEvNodeMisBECM
          OpEventGetEventUdsStatus_GetEventUdsStatus_EvtInfo_INV_UHVDC_UV_HWP: RteEventRef=OpEventGetEventUdsStatus_GetEventUdsStatus_EvtInfo_INV_UHVDC_UV_HWP
          OpEventGetEventUdsStatus_GetEventUdsStatus_Event_INV_UHVDC_UV_HWP: RteEventRef=OpEventGetEventUdsStatus_GetEventUdsStatus_Event_INV_UHVDC_UV_HWP
          OpEventGetEventUdsStatus_GetEventUdsStatus_EvtInfo_VcEvMonESpd: RteEventRef=OpEventGetEventUdsStatus_GetEventUdsStatus_EvtInfo_VcEvMonESpd
          OpEventGetEventUdsStatus_GetEventUdsStatus_Event_VcEvMonESpd: RteEventRef=OpEventGetEventUdsStatus_GetEventUdsStatus_Event_VcEvMonESpd
          OpEventGetEventUdsStatus_GetEventUdsStatus_EvtInfo_COM_NotConfig: RteEventRef=OpEventGetEventUdsStatus_GetEventUdsStatus_EvtInfo_COM_NotConfig
          OpEventGetEventUdsStatus_GetEventUdsStatus_Event_COM_NotConfig: RteEventRef=OpEventGetEventUdsStatus_GetEventUdsStatus_Event_COM_NotConfig
          OpEventGetEventUdsStatus_GetEventUdsStatus_EvtInfo_INV_RSLVR_SIN_RNG_HI: RteEventRef=OpEventGetEventUdsStatus_GetEventUdsStatus_EvtInfo_INV_RSLVR_SIN_RNG_HI
          OpEventGetEventUdsStatus_GetEventUdsStatus_Event_INV_RSLVR_SIN_RNG_HI: RteEventRef=OpEventGetEventUdsStatus_GetEventUdsStatus_Event_INV_RSLVR_SIN_RNG_HI
          OpEventGetEventUdsStatus_GetEventUdsStatus_EvtInfo_INV_IGBT_TEMP_U_RNG_HI: RteEventRef=OpEventGetEventUdsStatus_GetEventUdsStatus_EvtInfo_INV_IGBT_TEMP_U_RNG_HI
          OpEventGetEventUdsStatus_GetEventUdsStatus_Event_INV_IGBT_TEMP_U_RNG_HI: RteEventRef=OpEventGetEventUdsStatus_GetEventUdsStatus_Event_INV_IGBT_TEMP_U_RNG_HI
          OpEventGetEventUdsStatus_GetEventUdsStatus_EvtInfo_VcEvMonMode_001: RteEventRef=OpEventGetEventUdsStatus_GetEventUdsStatus_EvtInfo_VcEvMonMode_001
          OpEventGetEventUdsStatus_GetEventUdsStatus_Event_VcEvMonMode_001: RteEventRef=OpEventGetEventUdsStatus_GetEventUdsStatus_Event_VcEvMonMode_001
          OpEventGetEventUdsStatus_GetEventUdsStatus_EvtInfo_PA_ACTION_FLT: RteEventRef=OpEventGetEventUdsStatus_GetEventUdsStatus_EvtInfo_PA_ACTION_FLT
          OpEventGetEventUdsStatus_GetEventUdsStatus_Event_PA_ACTION_FLT: RteEventRef=OpEventGetEventUdsStatus_GetEventUdsStatus_Event_PA_ACTION_FLT
          OpEventGetEventUdsStatus_GetEventUdsStatus_EvtInfo_INV_IAC_V_ELEC_HWP: RteEventRef=OpEventGetEventUdsStatus_GetEventUdsStatus_EvtInfo_INV_IAC_V_ELEC_HWP
          OpEventGetEventUdsStatus_GetEventUdsStatus_Event_INV_IAC_V_ELEC_HWP: RteEventRef=OpEventGetEventUdsStatus_GetEventUdsStatus_Event_INV_IAC_V_ELEC_HWP
          OpEventGetEventUdsStatus_GetEventUdsStatus_EvtInfo_CU_TEMP_HW_FLT_001: RteEventRef=OpEventGetEventUdsStatus_GetEventUdsStatus_EvtInfo_CU_TEMP_HW_FLT_001
          OpEventGetEventUdsStatus_GetEventUdsStatus_Event_CU_TEMP_HW_FLT_001: RteEventRef=OpEventGetEventUdsStatus_GetEventUdsStatus_Event_CU_TEMP_HW_FLT_001
          OpEventGetEventUdsStatus_GetEventUdsStatus_EvtInfo_VCC_UnderVoltage: RteEventRef=OpEventGetEventUdsStatus_GetEventUdsStatus_EvtInfo_VCC_UnderVoltage
          OpEventGetEventUdsStatus_GetEventUdsStatus_Event_VCC_UnderVoltage: RteEventRef=OpEventGetEventUdsStatus_GetEventUdsStatus_Event_VCC_UnderVoltage
          OpEventGetEventUdsStatus_GetEventUdsStatus_EvtInfo_VcEvTsttrPlaus: RteEventRef=OpEventGetEventUdsStatus_GetEventUdsStatus_EvtInfo_VcEvTsttrPlaus
          OpEventGetEventUdsStatus_GetEventUdsStatus_Event_VcEvTsttrPlaus: RteEventRef=OpEventGetEventUdsStatus_GetEventUdsStatus_Event_VcEvTsttrPlaus
          OpEventGetEventUdsStatus_GetEventUdsStatus_EvtInfo_INV_RSLVR_EXCT_ELEC_FLT: RteEventRef=OpEventGetEventUdsStatus_GetEventUdsStatus_EvtInfo_INV_RSLVR_EXCT_ELEC_FLT
          OpEventGetEventUdsStatus_GetEventUdsStatus_Event_INV_RSLVR_EXCT_ELEC_FLT: RteEventRef=OpEventGetEventUdsStatus_GetEventUdsStatus_Event_INV_RSLVR_EXCT_ELEC_FLT
          OpEventGetEventUdsStatus_GetEventUdsStatus_EvtInfo_INV_RSLVR_EXCT_RNG_LO: RteEventRef=OpEventGetEventUdsStatus_GetEventUdsStatus_EvtInfo_INV_RSLVR_EXCT_RNG_LO
          OpEventGetEventUdsStatus_GetEventUdsStatus_Event_INV_RSLVR_EXCT_RNG_LO: RteEventRef=OpEventGetEventUdsStatus_GetEventUdsStatus_Event_INV_RSLVR_EXCT_RNG_LO
          OpEventGetEventUdsStatus_GetEventUdsStatus_EvtInfo_INV_EM_STATOR_TEMP2_RNG_HI: RteEventRef=OpEventGetEventUdsStatus_GetEventUdsStatus_EvtInfo_INV_EM_STATOR_TEMP2_RNG_HI
          OpEventGetEventUdsStatus_GetEventUdsStatus_Event_INV_EM_STATOR_TEMP2_RNG_HI: RteEventRef=OpEventGetEventUdsStatus_GetEventUdsStatus_Event_INV_EM_STATOR_TEMP2_RNG_HI
          OpEventGetEventUdsStatus_GetEventUdsStatus_EvtInfo_INV_SHUT_OFF_PAH_START_UP: RteEventRef=OpEventGetEventUdsStatus_GetEventUdsStatus_EvtInfo_INV_SHUT_OFF_PAH_START_UP
          OpEventGetEventUdsStatus_GetEventUdsStatus_Event_INV_SHUT_OFF_PAH_START_UP: RteEventRef=OpEventGetEventUdsStatus_GetEventUdsStatus_Event_INV_SHUT_OFF_PAH_START_UP
          OpEventGetEventUdsStatus_GetEventUdsStatus_EvtInfo_VCEvVddmPropFr08Tioutd: RteEventRef=OpEventGetEventUdsStatus_GetEventUdsStatus_EvtInfo_VCEvVddmPropFr08Tioutd
          OpEventGetEventUdsStatus_GetEventUdsStatus_Event_VCEvVddmPropFr08Tioutd: RteEventRef=OpEventGetEventUdsStatus_GetEventUdsStatus_Event_VCEvVddmPropFr08Tioutd
          OpEventGetEventUdsStatus_GetEventUdsStatus_EvtInfo_INV_RSLVR_EXCT_OC_HWP_001: RteEventRef=OpEventGetEventUdsStatus_GetEventUdsStatus_EvtInfo_INV_RSLVR_EXCT_OC_HWP_001
          OpEventGetEventUdsStatus_GetEventUdsStatus_Event_INV_RSLVR_EXCT_OC_HWP_001: RteEventRef=OpEventGetEventUdsStatus_GetEventUdsStatus_Event_INV_RSLVR_EXCT_OC_HWP_001
          OpEventGetEventUdsStatus_GetEventUdsStatus_EvtInfo_INV_RSLVR_EXCT_OC_HWP_002: RteEventRef=OpEventGetEventUdsStatus_GetEventUdsStatus_EvtInfo_INV_RSLVR_EXCT_OC_HWP_002
          OpEventGetEventUdsStatus_GetEventUdsStatus_Event_INV_RSLVR_EXCT_OC_HWP_002: RteEventRef=OpEventGetEventUdsStatus_GetEventUdsStatus_Event_INV_RSLVR_EXCT_OC_HWP_002
          OpEventGetEventUdsStatus_GetEventUdsStatus_EvtInfo_INV_EM_STATOR_TEMP_ELE_FLT: RteEventRef=OpEventGetEventUdsStatus_GetEventUdsStatus_EvtInfo_INV_EM_STATOR_TEMP_ELE_FLT
          OpEventGetEventUdsStatus_GetEventUdsStatus_Event_INV_EM_STATOR_TEMP_ELE_FLT: RteEventRef=OpEventGetEventUdsStatus_GetEventUdsStatus_Event_INV_EM_STATOR_TEMP_ELE_FLT
          OpEventGetEventUdsStatus_GetEventUdsStatus_EvtInfo_INV_INTERLOCK_FLT: RteEventRef=OpEventGetEventUdsStatus_GetEventUdsStatus_EvtInfo_INV_INTERLOCK_FLT
          OpEventGetEventUdsStatus_GetEventUdsStatus_Event_INV_INTERLOCK_FLT: RteEventRef=OpEventGetEventUdsStatus_GetEventUdsStatus_Event_INV_INTERLOCK_FLT
          OpEventGetEventUdsStatus_GetEventUdsStatus_EvtInfo_Ga_ZeroFindDistanFailure: RteEventRef=OpEventGetEventUdsStatus_GetEventUdsStatus_EvtInfo_Ga_ZeroFindDistanFailure
          OpEventGetEventUdsStatus_GetEventUdsStatus_Event_Ga_ZeroFindDistanFailure: RteEventRef=OpEventGetEventUdsStatus_GetEventUdsStatus_Event_Ga_ZeroFindDistanFailure
          OpEventGetEventUdsStatus_GetEventUdsStatus_EvtInfo_PLOCK_Current_RNG_OUT: RteEventRef=OpEventGetEventUdsStatus_GetEventUdsStatus_EvtInfo_PLOCK_Current_RNG_OUT
          OpEventGetEventUdsStatus_GetEventUdsStatus_Event_PLOCK_Current_RNG_OUT: RteEventRef=OpEventGetEventUdsStatus_GetEventUdsStatus_Event_PLOCK_Current_RNG_OUT
          OpEventGetEventUdsStatus_GetEventUdsStatus_EvtInfo_VCEvVddmPropFr05Tioutd: RteEventRef=OpEventGetEventUdsStatus_GetEventUdsStatus_EvtInfo_VCEvVddmPropFr05Tioutd
          OpEventGetEventUdsStatus_GetEventUdsStatus_Event_VCEvVddmPropFr05Tioutd: RteEventRef=OpEventGetEventUdsStatus_GetEventUdsStatus_Event_VCEvVddmPropFr05Tioutd
          OpEventGetEventUdsStatus_GetEventUdsStatus_EvtInfo_INV_IGBT_TEMP_V_GRDT: RteEventRef=OpEventGetEventUdsStatus_GetEventUdsStatus_EvtInfo_INV_IGBT_TEMP_V_GRDT
          OpEventGetEventUdsStatus_GetEventUdsStatus_Event_INV_IGBT_TEMP_V_GRDT: RteEventRef=OpEventGetEventUdsStatus_GetEventUdsStatus_Event_INV_IGBT_TEMP_V_GRDT
          OpEventGetEventUdsStatus_GetEventUdsStatus_EvtInfo_PS_5V_Fault: RteEventRef=OpEventGetEventUdsStatus_GetEventUdsStatus_EvtInfo_PS_5V_Fault
          OpEventGetEventUdsStatus_GetEventUdsStatus_Event_PS_5V_Fault: RteEventRef=OpEventGetEventUdsStatus_GetEventUdsStatus_Event_PS_5V_Fault
          OpEventGetEventUdsStatus_GetEventUdsStatus_EvtInfo_VcEvCntrCrashStsSafe: RteEventRef=OpEventGetEventUdsStatus_GetEventUdsStatus_EvtInfo_VcEvCntrCrashStsSafe
          OpEventGetEventUdsStatus_GetEventUdsStatus_Event_VcEvCntrCrashStsSafe: RteEventRef=OpEventGetEventUdsStatus_GetEventUdsStatus_Event_VcEvCntrCrashStsSafe
          OpEventGetEventUdsStatus_GetEventUdsStatus_EvtInfo_INV_EM_STATOR_TEMP_GRDT: RteEventRef=OpEventGetEventUdsStatus_GetEventUdsStatus_EvtInfo_INV_EM_STATOR_TEMP_GRDT
          OpEventGetEventUdsStatus_GetEventUdsStatus_Event_INV_EM_STATOR_TEMP_GRDT: RteEventRef=OpEventGetEventUdsStatus_GetEventUdsStatus_Event_INV_EM_STATOR_TEMP_GRDT
          OpEventGetEventUdsStatus_GetEventUdsStatus_EvtInfo_PS_P15_V_FLT: RteEventRef=OpEventGetEventUdsStatus_GetEventUdsStatus_EvtInfo_PS_P15_V_FLT
          OpEventGetEventUdsStatus_GetEventUdsStatus_Event_PS_P15_V_FLT: RteEventRef=OpEventGetEventUdsStatus_GetEventUdsStatus_Event_PS_P15_V_FLT
          OpEventGetEventUdsStatus_GetEventUdsStatus_EvtInfo_INV_EM_STATOR_TEMP_RNG_NOK: RteEventRef=OpEventGetEventUdsStatus_GetEventUdsStatus_EvtInfo_INV_EM_STATOR_TEMP_RNG_NOK
          OpEventGetEventUdsStatus_GetEventUdsStatus_Event_INV_EM_STATOR_TEMP_RNG_NOK: RteEventRef=OpEventGetEventUdsStatus_GetEventUdsStatus_Event_INV_EM_STATOR_TEMP_RNG_NOK
          OpEventGetEventUdsStatus_GetEventUdsStatus_EvtInfo_INV_RSLVR_SIN_RNG_NOK: RteEventRef=OpEventGetEventUdsStatus_GetEventUdsStatus_EvtInfo_INV_RSLVR_SIN_RNG_NOK
          OpEventGetEventUdsStatus_GetEventUdsStatus_Event_INV_RSLVR_SIN_RNG_NOK: RteEventRef=OpEventGetEventUdsStatus_GetEventUdsStatus_Event_INV_RSLVR_SIN_RNG_NOK
          OpEventGetEventUdsStatus_GetEventUdsStatus_EvtInfo_INV_IAC_U_OFFS: RteEventRef=OpEventGetEventUdsStatus_GetEventUdsStatus_EvtInfo_INV_IAC_U_OFFS
          OpEventGetEventUdsStatus_GetEventUdsStatus_Event_INV_IAC_U_OFFS: RteEventRef=OpEventGetEventUdsStatus_GetEventUdsStatus_Event_INV_IAC_U_OFFS
          OpEventGetEventUdsStatus_GetEventUdsStatus_EvtInfo_PS_KL30_BACKUP_FLT: RteEventRef=OpEventGetEventUdsStatus_GetEventUdsStatus_EvtInfo_PS_KL30_BACKUP_FLT
          OpEventGetEventUdsStatus_GetEventUdsStatus_Event_PS_KL30_BACKUP_FLT: RteEventRef=OpEventGetEventUdsStatus_GetEventUdsStatus_Event_PS_KL30_BACKUP_FLT
          OpEventGetEventUdsStatus_GetEventUdsStatus_EvtInfo_INV_IGBT_TEMP_U_RNG_LO: RteEventRef=OpEventGetEventUdsStatus_GetEventUdsStatus_EvtInfo_INV_IGBT_TEMP_U_RNG_LO
          OpEventGetEventUdsStatus_GetEventUdsStatus_Event_INV_IGBT_TEMP_U_RNG_LO: RteEventRef=OpEventGetEventUdsStatus_GetEventUdsStatus_Event_INV_IGBT_TEMP_U_RNG_LO
          OpEventGetEventUdsStatus_GetEventUdsStatus_EvtInfo_INV_EM_STATOR_TEMP_HWP: RteEventRef=OpEventGetEventUdsStatus_GetEventUdsStatus_EvtInfo_INV_EM_STATOR_TEMP_HWP
          OpEventGetEventUdsStatus_GetEventUdsStatus_Event_INV_EM_STATOR_TEMP_HWP: RteEventRef=OpEventGetEventUdsStatus_GetEventUdsStatus_Event_INV_EM_STATOR_TEMP_HWP
          OpEventGetEventUdsStatus_GetEventUdsStatus_EvtInfo_CU_TEMP1_RNG_HI: RteEventRef=OpEventGetEventUdsStatus_GetEventUdsStatus_EvtInfo_CU_TEMP1_RNG_HI
          OpEventGetEventUdsStatus_GetEventUdsStatus_Event_CU_TEMP1_RNG_HI: RteEventRef=OpEventGetEventUdsStatus_GetEventUdsStatus_Event_CU_TEMP1_RNG_HI
          OpEventGetEventUdsStatus_GetEventUdsStatus_EvtInfo_INV_IGBT_TEMP_V_RNG_HI: RteEventRef=OpEventGetEventUdsStatus_GetEventUdsStatus_EvtInfo_INV_IGBT_TEMP_V_RNG_HI
          OpEventGetEventUdsStatus_GetEventUdsStatus_Event_INV_IGBT_TEMP_V_RNG_HI: RteEventRef=OpEventGetEventUdsStatus_GetEventUdsStatus_Event_INV_IGBT_TEMP_V_RNG_HI
          OpEventGetEventUdsStatus_GetEventUdsStatus_EvtInfo_VcEvNodeMisVDDM: RteEventRef=OpEventGetEventUdsStatus_GetEventUdsStatus_EvtInfo_VcEvNodeMisVDDM
          OpEventGetEventUdsStatus_GetEventUdsStatus_Event_VcEvNodeMisVDDM: RteEventRef=OpEventGetEventUdsStatus_GetEventUdsStatus_Event_VcEvNodeMisVDDM
          OpEventGetEventUdsStatus_GetEventUdsStatus_EvtInfo_INV_UHVDC_PLAUS: RteEventRef=OpEventGetEventUdsStatus_GetEventUdsStatus_EvtInfo_INV_UHVDC_PLAUS
          OpEventGetEventUdsStatus_GetEventUdsStatus_Event_INV_UHVDC_PLAUS: RteEventRef=OpEventGetEventUdsStatus_GetEventUdsStatus_Event_INV_UHVDC_PLAUS
          OpEventGetEventUdsStatus_GetEventUdsStatus_EvtInfo_INV_QUIESCENT_FLT: RteEventRef=OpEventGetEventUdsStatus_GetEventUdsStatus_EvtInfo_INV_QUIESCENT_FLT
          OpEventGetEventUdsStatus_GetEventUdsStatus_Event_INV_QUIESCENT_FLT: RteEventRef=OpEventGetEventUdsStatus_GetEventUdsStatus_Event_INV_QUIESCENT_FLT
          OpEventGetEventUdsStatus_GetEventUdsStatus_EvtInfo_INV_RSLVR_EXCT_RNG_HI: RteEventRef=OpEventGetEventUdsStatus_GetEventUdsStatus_EvtInfo_INV_RSLVR_EXCT_RNG_HI
          OpEventGetEventUdsStatus_GetEventUdsStatus_Event_INV_RSLVR_EXCT_RNG_HI: RteEventRef=OpEventGetEventUdsStatus_GetEventUdsStatus_Event_INV_RSLVR_EXCT_RNG_HI
          OpEventGetEventUdsStatus_GetEventUdsStatus_GeneralEvtInfo: RteEventRef=OpEventGetEventUdsStatus_GetEventUdsStatus_GeneralEvtInfo
          OpEventGetEventStatus_GetEventStatus_EvtInfo_VCEvBecmPropFr01Tioutd: RteEventRef=OpEventGetEventStatus_GetEventStatus_EvtInfo_VCEvBecmPropFr01Tioutd
          OpEventGetEventStatus_GetEventStatus_Event_VCEvBecmPropFr01Tioutd: RteEventRef=OpEventGetEventStatus_GetEventStatus_Event_VCEvBecmPropFr01Tioutd
          OpEventGetEventStatus_GetEventStatus_EvtInfo_INV_CU_TEMP2_RNG_NOK: RteEventRef=OpEventGetEventStatus_GetEventStatus_EvtInfo_INV_CU_TEMP2_RNG_NOK
          OpEventGetEventStatus_GetEventStatus_Event_INV_CU_TEMP2_RNG_NOK: RteEventRef=OpEventGetEventStatus_GetEventStatus_Event_INV_CU_TEMP2_RNG_NOK
          OpEventGetEventStatus_GetEventStatus_EvtInfo_COM_Busoff: RteEventRef=OpEventGetEventStatus_GetEventStatus_EvtInfo_COM_Busoff
          OpEventGetEventStatus_GetEventStatus_Event_COM_Busoff: RteEventRef=OpEventGetEventStatus_GetEventStatus_Event_COM_Busoff
          OpEventGetEventStatus_GetEventStatus_EvtInfo_INV_IMMO_NOKEY: RteEventRef=OpEventGetEventStatus_GetEventStatus_EvtInfo_INV_IMMO_NOKEY
          OpEventGetEventStatus_GetEventStatus_Event_INV_IMMO_NOKEY: RteEventRef=OpEventGetEventStatus_GetEventStatus_Event_INV_IMMO_NOKEY
          OpEventGetEventStatus_GetEventStatus_EvtInfo_INV_RSLVR_EXCT_OC_HWP: RteEventRef=OpEventGetEventStatus_GetEventStatus_EvtInfo_INV_RSLVR_EXCT_OC_HWP
          OpEventGetEventStatus_GetEventStatus_Event_INV_RSLVR_EXCT_OC_HWP: RteEventRef=OpEventGetEventStatus_GetEventStatus_Event_INV_RSLVR_EXCT_OC_HWP
          OpEventGetEventStatus_GetEventStatus_EvtInfo_PS_P15_W_FLT: RteEventRef=OpEventGetEventStatus_GetEventStatus_EvtInfo_PS_P15_W_FLT
          OpEventGetEventStatus_GetEventStatus_Event_PS_P15_W_FLT: RteEventRef=OpEventGetEventStatus_GetEventStatus_Event_PS_P15_W_FLT
          OpEventGetEventStatus_GetEventStatus_EvtInfo_INV_IAC_PLAUS_SUM: RteEventRef=OpEventGetEventStatus_GetEventStatus_EvtInfo_INV_IAC_PLAUS_SUM
          OpEventGetEventStatus_GetEventStatus_Event_INV_IAC_PLAUS_SUM: RteEventRef=OpEventGetEventStatus_GetEventStatus_Event_INV_IAC_PLAUS_SUM
          OpEventGetEventStatus_GetEventStatus_EvtInfo_PA_ELE_FLT: RteEventRef=OpEventGetEventStatus_GetEventStatus_EvtInfo_PA_ELE_FLT
          OpEventGetEventStatus_GetEventStatus_Event_PA_ELE_FLT: RteEventRef=OpEventGetEventStatus_GetEventStatus_Event_PA_ELE_FLT
          OpEventGetEventStatus_GetEventStatus_EvtInfo_CU_TEMP_GRDT: RteEventRef=OpEventGetEventStatus_GetEventStatus_EvtInfo_CU_TEMP_GRDT
          OpEventGetEventStatus_GetEventStatus_Event_CU_TEMP_GRDT: RteEventRef=OpEventGetEventStatus_GetEventStatus_Event_CU_TEMP_GRDT
          OpEventGetEventStatus_GetEventStatus_EvtInfo_INV_IGBT_TEMP_V_PLAUS: RteEventRef=OpEventGetEventStatus_GetEventStatus_EvtInfo_INV_IGBT_TEMP_V_PLAUS
          OpEventGetEventStatus_GetEventStatus_Event_INV_IGBT_TEMP_V_PLAUS: RteEventRef=OpEventGetEventStatus_GetEventStatus_Event_INV_IGBT_TEMP_V_PLAUS
          OpEventGetEventStatus_GetEventStatus_EvtInfo_Ga_GAEngageFailure: RteEventRef=OpEventGetEventStatus_GetEventStatus_EvtInfo_Ga_GAEngageFailure
          OpEventGetEventStatus_GetEventStatus_Event_Ga_GAEngageFailure: RteEventRef=OpEventGetEventStatus_GetEventStatus_Event_Ga_GAEngageFailure
          OpEventGetEventStatus_GetEventStatus_EvtInfo_INV_IAC_W_RNG_LO: RteEventRef=OpEventGetEventStatus_GetEventStatus_EvtInfo_INV_IAC_W_RNG_LO
          OpEventGetEventStatus_GetEventStatus_Event_INV_IAC_W_RNG_LO: RteEventRef=OpEventGetEventStatus_GetEventStatus_Event_INV_IAC_W_RNG_LO
          OpEventGetEventStatus_GetEventStatus_EvtInfo_PS_WhlSnsr_Vltg_FLT: RteEventRef=OpEventGetEventStatus_GetEventStatus_EvtInfo_PS_WhlSnsr_Vltg_FLT
          OpEventGetEventStatus_GetEventStatus_Event_PS_WhlSnsr_Vltg_FLT: RteEventRef=OpEventGetEventStatus_GetEventStatus_Event_PS_WhlSnsr_Vltg_FLT
          OpEventGetEventStatus_GetEventStatus_EvtInfo_VCEvEcmPropFr02Tioutd: RteEventRef=OpEventGetEventStatus_GetEventStatus_EvtInfo_VCEvEcmPropFr02Tioutd
          OpEventGetEventStatus_GetEventStatus_Event_VCEvEcmPropFr02Tioutd: RteEventRef=OpEventGetEventStatus_GetEventStatus_Event_VCEvEcmPropFr02Tioutd
          OpEventGetEventStatus_GetEventStatus_EvtInfo_Ga_TmSpdSyncFailed: RteEventRef=OpEventGetEventStatus_GetEventStatus_EvtInfo_Ga_TmSpdSyncFailed
          OpEventGetEventStatus_GetEventStatus_Event_Ga_TmSpdSyncFailed: RteEventRef=OpEventGetEventStatus_GetEventStatus_Event_Ga_TmSpdSyncFailed
          OpEventGetEventStatus_GetEventStatus_EvtInfo_INV_RSLVR_EXCT_ELEC_LO: RteEventRef=OpEventGetEventStatus_GetEventStatus_EvtInfo_INV_RSLVR_EXCT_ELEC_LO
          OpEventGetEventStatus_GetEventStatus_Event_INV_RSLVR_EXCT_ELEC_LO: RteEventRef=OpEventGetEventStatus_GetEventStatus_Event_INV_RSLVR_EXCT_ELEC_LO
          OpEventGetEventStatus_GetEventStatus_EvtInfo_VCEvEcmPropXevFr06Tioutd: RteEventRef=OpEventGetEventStatus_GetEventStatus_EvtInfo_VCEvEcmPropXevFr06Tioutd
          OpEventGetEventStatus_GetEventStatus_Event_VCEvEcmPropXevFr06Tioutd: RteEventRef=OpEventGetEventStatus_GetEventStatus_Event_VCEvEcmPropXevFr06Tioutd
          OpEventGetEventStatus_GetEventStatus_EvtInfo_VcEvCntrWhlMotSysTqAllwd: RteEventRef=OpEventGetEventStatus_GetEventStatus_EvtInfo_VcEvCntrWhlMotSysTqAllwd
          OpEventGetEventStatus_GetEventStatus_Event_VcEvCntrWhlMotSysTqAllwd: RteEventRef=OpEventGetEventStatus_GetEventStatus_Event_VcEvCntrWhlMotSysTqAllwd
          OpEventGetEventStatus_GetEventStatus_EvtInfo_INV_UHVDC_1_ELEC_HI: RteEventRef=OpEventGetEventStatus_GetEventStatus_EvtInfo_INV_UHVDC_1_ELEC_HI
          OpEventGetEventStatus_GetEventStatus_Event_INV_UHVDC_1_ELEC_HI: RteEventRef=OpEventGetEventStatus_GetEventStatus_Event_INV_UHVDC_1_ELEC_HI
          OpEventGetEventStatus_GetEventStatus_EvtInfo_INV_EM_STATOR_TEMP2_ELE_FLT: RteEventRef=OpEventGetEventStatus_GetEventStatus_EvtInfo_INV_EM_STATOR_TEMP2_ELE_FLT
          OpEventGetEventStatus_GetEventStatus_Event_INV_EM_STATOR_TEMP2_ELE_FLT: RteEventRef=OpEventGetEventStatus_GetEventStatus_Event_INV_EM_STATOR_TEMP2_ELE_FLT
          OpEventGetEventStatus_GetEventStatus_EvtInfo_AURIX_RST_SNG: RteEventRef=OpEventGetEventStatus_GetEventStatus_EvtInfo_AURIX_RST_SNG
          OpEventGetEventStatus_GetEventStatus_Event_AURIX_RST_SNG: RteEventRef=OpEventGetEventStatus_GetEventStatus_Event_AURIX_RST_SNG
          OpEventGetEventStatus_GetEventStatus_EvtInfo_VCEvEcmPropFr24MgmFr01Tioutd: RteEventRef=OpEventGetEventStatus_GetEventStatus_EvtInfo_VCEvEcmPropFr24MgmFr01Tioutd
          OpEventGetEventStatus_GetEventStatus_Event_VCEvEcmPropFr24MgmFr01Tioutd: RteEventRef=OpEventGetEventStatus_GetEventStatus_Event_VCEvEcmPropFr24MgmFr01Tioutd
          OpEventGetEventStatus_GetEventStatus_EvtInfo_INV_RSLVR_COS_ELEC_OPEN: RteEventRef=OpEventGetEventStatus_GetEventStatus_EvtInfo_INV_RSLVR_COS_ELEC_OPEN
          OpEventGetEventStatus_GetEventStatus_Event_INV_RSLVR_COS_ELEC_OPEN: RteEventRef=OpEventGetEventStatus_GetEventStatus_Event_INV_RSLVR_COS_ELEC_OPEN
          OpEventGetEventStatus_GetEventStatus_EvtInfo_INV_IAC_V_ELEC_LO: RteEventRef=OpEventGetEventStatus_GetEventStatus_EvtInfo_INV_IAC_V_ELEC_LO
          OpEventGetEventStatus_GetEventStatus_Event_INV_IAC_V_ELEC_LO: RteEventRef=OpEventGetEventStatus_GetEventStatus_Event_INV_IAC_V_ELEC_LO
          OpEventGetEventStatus_GetEventStatus_EvtInfo_INV_IAC_W_OFFS: RteEventRef=OpEventGetEventStatus_GetEventStatus_EvtInfo_INV_IAC_W_OFFS
          OpEventGetEventStatus_GetEventStatus_Event_INV_IAC_W_OFFS: RteEventRef=OpEventGetEventStatus_GetEventStatus_Event_INV_IAC_W_OFFS
          OpEventGetEventStatus_GetEventStatus_EvtInfo_INV_EM_STATOR_TEMP2_GRDT: RteEventRef=OpEventGetEventStatus_GetEventStatus_EvtInfo_INV_EM_STATOR_TEMP2_GRDT
          OpEventGetEventStatus_GetEventStatus_Event_INV_EM_STATOR_TEMP2_GRDT: RteEventRef=OpEventGetEventStatus_GetEventStatus_Event_INV_EM_STATOR_TEMP2_GRDT
          OpEventGetEventStatus_GetEventStatus_EvtInfo_INV_EM_OVRSPD_HWP: RteEventRef=OpEventGetEventStatus_GetEventStatus_EvtInfo_INV_EM_OVRSPD_HWP
          OpEventGetEventStatus_GetEventStatus_Event_INV_EM_OVRSPD_HWP: RteEventRef=OpEventGetEventStatus_GetEventStatus_Event_INV_EM_OVRSPD_HWP
          OpEventGetEventStatus_GetEventStatus_EvtInfo_CU_TEMP_HWP: RteEventRef=OpEventGetEventStatus_GetEventStatus_EvtInfo_CU_TEMP_HWP
          OpEventGetEventStatus_GetEventStatus_Event_CU_TEMP_HWP: RteEventRef=OpEventGetEventStatus_GetEventStatus_Event_CU_TEMP_HWP
          OpEventGetEventStatus_GetEventStatus_EvtInfo_INV_UHVDC_1_RNG_HI: RteEventRef=OpEventGetEventStatus_GetEventStatus_EvtInfo_INV_UHVDC_1_RNG_HI
          OpEventGetEventStatus_GetEventStatus_Event_INV_UHVDC_1_RNG_HI: RteEventRef=OpEventGetEventStatus_GetEventStatus_Event_INV_UHVDC_1_RNG_HI
          OpEventGetEventStatus_GetEventStatus_EvtInfo_VcEvEMPerfPlaus: RteEventRef=OpEventGetEventStatus_GetEventStatus_EvtInfo_VcEvEMPerfPlaus
          OpEventGetEventStatus_GetEventStatus_Event_VcEvEMPerfPlaus: RteEventRef=OpEventGetEventStatus_GetEventStatus_Event_VcEvEMPerfPlaus
          OpEventGetEventStatus_GetEventStatus_EvtInfo_VCEvVddmPropFr18Tioutd: RteEventRef=OpEventGetEventStatus_GetEventStatus_EvtInfo_VCEvVddmPropFr18Tioutd
          OpEventGetEventStatus_GetEventStatus_Event_VCEvVddmPropFr18Tioutd: RteEventRef=OpEventGetEventStatus_GetEventStatus_Event_VCEvVddmPropFr18Tioutd
          OpEventGetEventStatus_GetEventStatus_EvtInfo_INV_IAC_U_ELEC_HWP: RteEventRef=OpEventGetEventStatus_GetEventStatus_EvtInfo_INV_IAC_U_ELEC_HWP
          OpEventGetEventStatus_GetEventStatus_Event_INV_IAC_U_ELEC_HWP: RteEventRef=OpEventGetEventStatus_GetEventStatus_Event_INV_IAC_U_ELEC_HWP
          OpEventGetEventStatus_GetEventStatus_EvtInfo_VCEvVddmPropFr15Tioutd: RteEventRef=OpEventGetEventStatus_GetEventStatus_EvtInfo_VCEvVddmPropFr15Tioutd
          OpEventGetEventStatus_GetEventStatus_Event_VCEvVddmPropFr15Tioutd: RteEventRef=OpEventGetEventStatus_GetEventStatus_Event_VCEvVddmPropFr15Tioutd
          OpEventGetEventStatus_GetEventStatus_EvtInfo_Ga_GADisengageFailure: RteEventRef=OpEventGetEventStatus_GetEventStatus_EvtInfo_Ga_GADisengageFailure
          OpEventGetEventStatus_GetEventStatus_Event_Ga_GADisengageFailure: RteEventRef=OpEventGetEventStatus_GetEventStatus_Event_Ga_GADisengageFailure
          OpEventGetEventStatus_GetEventStatus_EvtInfo_CU_TEMP2_RNG_LO: RteEventRef=OpEventGetEventStatus_GetEventStatus_EvtInfo_CU_TEMP2_RNG_LO
          OpEventGetEventStatus_GetEventStatus_Event_CU_TEMP2_RNG_LO: RteEventRef=OpEventGetEventStatus_GetEventStatus_Event_CU_TEMP2_RNG_LO
          OpEventGetEventStatus_GetEventStatus_EvtInfo_INV_RSLVR_SIN_ELEC_OPEN: RteEventRef=OpEventGetEventStatus_GetEventStatus_EvtInfo_INV_RSLVR_SIN_ELEC_OPEN
          OpEventGetEventStatus_GetEventStatus_Event_INV_RSLVR_SIN_ELEC_OPEN: RteEventRef=OpEventGetEventStatus_GetEventStatus_Event_INV_RSLVR_SIN_ELEC_OPEN
          OpEventGetEventStatus_GetEventStatus_EvtInfo_VcEvChkSum: RteEventRef=OpEventGetEventStatus_GetEventStatus_EvtInfo_VcEvChkSum
          OpEventGetEventStatus_GetEventStatus_Event_VcEvChkSum: RteEventRef=OpEventGetEventStatus_GetEventStatus_Event_VcEvChkSum
          OpEventGetEventStatus_GetEventStatus_EvtInfo_PS_P5_UC_FLT: RteEventRef=OpEventGetEventStatus_GetEventStatus_EvtInfo_PS_P5_UC_FLT
          OpEventGetEventStatus_GetEventStatus_Event_PS_P5_UC_FLT: RteEventRef=OpEventGetEventStatus_GetEventStatus_Event_PS_P5_UC_FLT
          OpEventGetEventStatus_GetEventStatus_EvtInfo_INV_RSLVR_COS_ELEC_FLT: RteEventRef=OpEventGetEventStatus_GetEventStatus_EvtInfo_INV_RSLVR_COS_ELEC_FLT
          OpEventGetEventStatus_GetEventStatus_Event_INV_RSLVR_COS_ELEC_FLT: RteEventRef=OpEventGetEventStatus_GetEventStatus_Event_INV_RSLVR_COS_ELEC_FLT
          OpEventGetEventStatus_GetEventStatus_EvtInfo_INV_IAC_W_RNG_HI: RteEventRef=OpEventGetEventStatus_GetEventStatus_EvtInfo_INV_IAC_W_RNG_HI
          OpEventGetEventStatus_GetEventStatus_Event_INV_IAC_W_RNG_HI: RteEventRef=OpEventGetEventStatus_GetEventStatus_Event_INV_IAC_W_RNG_HI
          OpEventGetEventStatus_GetEventStatus_EvtInfo_PS_ECUSUPPLY_HIGH: RteEventRef=OpEventGetEventStatus_GetEventStatus_EvtInfo_PS_ECUSUPPLY_HIGH
          OpEventGetEventStatus_GetEventStatus_Event_PS_ECUSUPPLY_HIGH: RteEventRef=OpEventGetEventStatus_GetEventStatus_Event_PS_ECUSUPPLY_HIGH
          OpEventGetEventStatus_GetEventStatus_EvtInfo_VCEvEcmPropFr05Tioutd: RteEventRef=OpEventGetEventStatus_GetEventStatus_EvtInfo_VCEvEcmPropFr05Tioutd
          OpEventGetEventStatus_GetEventStatus_Event_VCEvEcmPropFr05Tioutd: RteEventRef=OpEventGetEventStatus_GetEventStatus_Event_VCEvEcmPropFr05Tioutd
          OpEventGetEventStatus_GetEventStatus_EvtInfo_PS_ECUSUPPLY_LOW: RteEventRef=OpEventGetEventStatus_GetEventStatus_EvtInfo_PS_ECUSUPPLY_LOW
          OpEventGetEventStatus_GetEventStatus_Event_PS_ECUSUPPLY_LOW: RteEventRef=OpEventGetEventStatus_GetEventStatus_Event_PS_ECUSUPPLY_LOW
          OpEventGetEventStatus_GetEventStatus_EvtInfo_VcEvChkSumHvSysRlySts: RteEventRef=OpEventGetEventStatus_GetEventStatus_EvtInfo_VcEvChkSumHvSysRlySts
          OpEventGetEventStatus_GetEventStatus_Event_VcEvChkSumHvSysRlySts: RteEventRef=OpEventGetEventStatus_GetEventStatus_Event_VcEvChkSumHvSysRlySts
          OpEventGetEventStatus_GetEventStatus_EvtInfo_VcEvMonMode: RteEventRef=OpEventGetEventStatus_GetEventStatus_EvtInfo_VcEvMonMode
          OpEventGetEventStatus_GetEventStatus_Event_VcEvMonMode: RteEventRef=OpEventGetEventStatus_GetEventStatus_Event_VcEvMonMode
          OpEventGetEventStatus_GetEventStatus_EvtInfo_INV_IAC_OC_SWP: RteEventRef=OpEventGetEventStatus_GetEventStatus_EvtInfo_INV_IAC_OC_SWP
          OpEventGetEventStatus_GetEventStatus_Event_INV_IAC_OC_SWP: RteEventRef=OpEventGetEventStatus_GetEventStatus_Event_INV_IAC_OC_SWP
          OpEventGetEventStatus_GetEventStatus_EvtInfo_INV_IMMO_AUTHFAIL: RteEventRef=OpEventGetEventStatus_GetEventStatus_EvtInfo_INV_IMMO_AUTHFAIL
          OpEventGetEventStatus_GetEventStatus_Event_INV_IMMO_AUTHFAIL: RteEventRef=OpEventGetEventStatus_GetEventStatus_Event_INV_IMMO_AUTHFAIL
          OpEventGetEventStatus_GetEventStatus_EvtInfo_PA_OpenCirc_FLT: RteEventRef=OpEventGetEventStatus_GetEventStatus_EvtInfo_PA_OpenCirc_FLT
          OpEventGetEventStatus_GetEventStatus_Event_PA_OpenCirc_FLT: RteEventRef=OpEventGetEventStatus_GetEventStatus_Event_PA_OpenCirc_FLT
          OpEventGetEventStatus_GetEventStatus_EvtInfo_INV_IAC_V_ELEC_HI: RteEventRef=OpEventGetEventStatus_GetEventStatus_EvtInfo_INV_IAC_V_ELEC_HI
          OpEventGetEventStatus_GetEventStatus_Event_INV_IAC_V_ELEC_HI: RteEventRef=OpEventGetEventStatus_GetEventStatus_Event_INV_IAC_V_ELEC_HI
          OpEventGetEventStatus_GetEventStatus_EvtInfo_VCEvEcmPropFr04Tioutd: RteEventRef=OpEventGetEventStatus_GetEventStatus_EvtInfo_VCEvEcmPropFr04Tioutd
          OpEventGetEventStatus_GetEventStatus_Event_VCEvEcmPropFr04Tioutd: RteEventRef=OpEventGetEventStatus_GetEventStatus_Event_VCEvEcmPropFr04Tioutd
          OpEventGetEventStatus_GetEventStatus_EvtInfo_VcEvMonTrqActPlaus: RteEventRef=OpEventGetEventStatus_GetEventStatus_EvtInfo_VcEvMonTrqActPlaus
          OpEventGetEventStatus_GetEventStatus_Event_VcEvMonTrqActPlaus: RteEventRef=OpEventGetEventStatus_GetEventStatus_Event_VcEvMonTrqActPlaus
          OpEventGetEventStatus_GetEventStatus_EvtInfo_VcEvMonTrqAct: RteEventRef=OpEventGetEventStatus_GetEventStatus_EvtInfo_VcEvMonTrqAct
          OpEventGetEventStatus_GetEventStatus_Event_VcEvMonTrqAct: RteEventRef=OpEventGetEventStatus_GetEventStatus_Event_VcEvMonTrqAct
          OpEventGetEventStatus_GetEventStatus_EvtInfo_INV_RSLVR_COS_ELEC_LO: RteEventRef=OpEventGetEventStatus_GetEventStatus_EvtInfo_INV_RSLVR_COS_ELEC_LO
          OpEventGetEventStatus_GetEventStatus_Event_INV_RSLVR_COS_ELEC_LO: RteEventRef=OpEventGetEventStatus_GetEventStatus_Event_INV_RSLVR_COS_ELEC_LO
          OpEventGetEventStatus_GetEventStatus_EvtInfo_INV_COOLT_INLET_TEMP_HWP: RteEventRef=OpEventGetEventStatus_GetEventStatus_EvtInfo_INV_COOLT_INLET_TEMP_HWP
          OpEventGetEventStatus_GetEventStatus_Event_INV_COOLT_INLET_TEMP_HWP: RteEventRef=OpEventGetEventStatus_GetEventStatus_Event_INV_COOLT_INLET_TEMP_HWP
          OpEventGetEventStatus_GetEventStatus_EvtInfo_VCEvEcmPropFr11Tioutd: RteEventRef=OpEventGetEventStatus_GetEventStatus_EvtInfo_VCEvEcmPropFr11Tioutd
          OpEventGetEventStatus_GetEventStatus_Event_VCEvEcmPropFr11Tioutd: RteEventRef=OpEventGetEventStatus_GetEventStatus_Event_VCEvEcmPropFr11Tioutd
          OpEventGetEventStatus_GetEventStatus_EvtInfo_PS_KL30_RNG_HI: RteEventRef=OpEventGetEventStatus_GetEventStatus_EvtInfo_PS_KL30_RNG_HI
          OpEventGetEventStatus_GetEventStatus_Event_PS_KL30_RNG_HI: RteEventRef=OpEventGetEventStatus_GetEventStatus_Event_PS_KL30_RNG_HI
          OpEventGetEventStatus_GetEventStatus_EvtInfo_INV_IAC_OC_HWP: RteEventRef=OpEventGetEventStatus_GetEventStatus_EvtInfo_INV_IAC_OC_HWP
          OpEventGetEventStatus_GetEventStatus_Event_INV_IAC_OC_HWP: RteEventRef=OpEventGetEventStatus_GetEventStatus_Event_INV_IAC_OC_HWP
          OpEventGetEventStatus_GetEventStatus_EvtInfo_INV_RSLVR_COS_RNG_HI: RteEventRef=OpEventGetEventStatus_GetEventStatus_EvtInfo_INV_RSLVR_COS_RNG_HI
          OpEventGetEventStatus_GetEventStatus_Event_INV_RSLVR_COS_RNG_HI: RteEventRef=OpEventGetEventStatus_GetEventStatus_Event_INV_RSLVR_COS_RNG_HI
          OpEventGetEventStatus_GetEventStatus_EvtInfo_INV_IAC_U_ELEC_HI: RteEventRef=OpEventGetEventStatus_GetEventStatus_EvtInfo_INV_IAC_U_ELEC_HI
          OpEventGetEventStatus_GetEventStatus_Event_INV_IAC_U_ELEC_HI: RteEventRef=OpEventGetEventStatus_GetEventStatus_Event_INV_IAC_U_ELEC_HI
          OpEventGetEventStatus_GetEventStatus_EvtInfo_INV_IAC_V_RNG_LO: RteEventRef=OpEventGetEventStatus_GetEventStatus_EvtInfo_INV_IAC_V_RNG_LO
          OpEventGetEventStatus_GetEventStatus_Event_INV_IAC_V_RNG_LO: RteEventRef=OpEventGetEventStatus_GetEventStatus_Event_INV_IAC_V_RNG_LO
          OpEventGetEventStatus_GetEventStatus_EvtInfo_INV_IAC_U_RNG_HI: RteEventRef=OpEventGetEventStatus_GetEventStatus_EvtInfo_INV_IAC_U_RNG_HI
          OpEventGetEventStatus_GetEventStatus_Event_INV_IAC_U_RNG_HI: RteEventRef=OpEventGetEventStatus_GetEventStatus_Event_INV_IAC_U_RNG_HI
          OpEventGetEventStatus_GetEventStatus_EvtInfo_VCEvEcmPropFr25Tioutd: RteEventRef=OpEventGetEventStatus_GetEventStatus_EvtInfo_VCEvEcmPropFr25Tioutd
          OpEventGetEventStatus_GetEventStatus_Event_VCEvEcmPropFr25Tioutd: RteEventRef=OpEventGetEventStatus_GetEventStatus_Event_VCEvEcmPropFr25Tioutd
          OpEventGetEventStatus_GetEventStatus_EvtInfo_INV_IGBT_TEMP_W_RNG_LO: RteEventRef=OpEventGetEventStatus_GetEventStatus_EvtInfo_INV_IGBT_TEMP_W_RNG_LO
          OpEventGetEventStatus_GetEventStatus_Event_INV_IGBT_TEMP_W_RNG_LO: RteEventRef=OpEventGetEventStatus_GetEventStatus_Event_INV_IGBT_TEMP_W_RNG_LO
          OpEventGetEventStatus_GetEventStatus_EvtInfo_PSnsr_RNG_NOK: RteEventRef=OpEventGetEventStatus_GetEventStatus_EvtInfo_PSnsr_RNG_NOK
          OpEventGetEventStatus_GetEventStatus_Event_PSnsr_RNG_NOK: RteEventRef=OpEventGetEventStatus_GetEventStatus_Event_PSnsr_RNG_NOK
          OpEventGetEventStatus_GetEventStatus_EvtInfo_INV_RSLVR_COS_RNG_NOK: RteEventRef=OpEventGetEventStatus_GetEventStatus_EvtInfo_INV_RSLVR_COS_RNG_NOK
          OpEventGetEventStatus_GetEventStatus_Event_INV_RSLVR_COS_RNG_NOK: RteEventRef=OpEventGetEventStatus_GetEventStatus_Event_INV_RSLVR_COS_RNG_NOK
          OpEventGetEventStatus_GetEventStatus_EvtInfo_PS_DRVB_Fault: RteEventRef=OpEventGetEventStatus_GetEventStatus_EvtInfo_PS_DRVB_Fault
          OpEventGetEventStatus_GetEventStatus_Event_PS_DRVB_Fault: RteEventRef=OpEventGetEventStatus_GetEventStatus_Event_PS_DRVB_Fault
          OpEventGetEventStatus_GetEventStatus_EvtInfo_INV_CU_TEMP1_RNG_NOK: RteEventRef=OpEventGetEventStatus_GetEventStatus_EvtInfo_INV_CU_TEMP1_RNG_NOK
          OpEventGetEventStatus_GetEventStatus_Event_INV_CU_TEMP1_RNG_NOK: RteEventRef=OpEventGetEventStatus_GetEventStatus_Event_INV_CU_TEMP1_RNG_NOK
          OpEventGetEventStatus_GetEventStatus_EvtInfo_VcEvCntr: RteEventRef=OpEventGetEventStatus_GetEventStatus_EvtInfo_VcEvCntr
          OpEventGetEventStatus_GetEventStatus_Event_VcEvCntr: RteEventRef=OpEventGetEventStatus_GetEventStatus_Event_VcEvCntr
          OpEventGetEventStatus_GetEventStatus_EvtInfo_INV_RSLVR_SIN_AMP: RteEventRef=OpEventGetEventStatus_GetEventStatus_EvtInfo_INV_RSLVR_SIN_AMP
          OpEventGetEventStatus_GetEventStatus_Event_INV_RSLVR_SIN_AMP: RteEventRef=OpEventGetEventStatus_GetEventStatus_Event_INV_RSLVR_SIN_AMP
          OpEventGetEventStatus_GetEventStatus_EvtInfo_INV_UHVDC_2_RNG_HI: RteEventRef=OpEventGetEventStatus_GetEventStatus_EvtInfo_INV_UHVDC_2_RNG_HI
          OpEventGetEventStatus_GetEventStatus_Event_INV_UHVDC_2_RNG_HI: RteEventRef=OpEventGetEventStatus_GetEventStatus_Event_INV_UHVDC_2_RNG_HI
          OpEventGetEventStatus_GetEventStatus_EvtInfo_INV_IGBT_TEMP_U_GRDT: RteEventRef=OpEventGetEventStatus_GetEventStatus_EvtInfo_INV_IGBT_TEMP_U_GRDT
          OpEventGetEventStatus_GetEventStatus_Event_INV_IGBT_TEMP_U_GRDT: RteEventRef=OpEventGetEventStatus_GetEventStatus_Event_INV_IGBT_TEMP_U_GRDT
          OpEventGetEventStatus_GetEventStatus_EvtInfo_MON_TQ_PLAUS_PWR_MDL: RteEventRef=OpEventGetEventStatus_GetEventStatus_EvtInfo_MON_TQ_PLAUS_PWR_MDL
          OpEventGetEventStatus_GetEventStatus_Event_MON_TQ_PLAUS_PWR_MDL: RteEventRef=OpEventGetEventStatus_GetEventStatus_Event_MON_TQ_PLAUS_PWR_MDL
          OpEventGetEventStatus_GetEventStatus_EvtInfo_INV_IGBT_TEMP_W_PLAUS: RteEventRef=OpEventGetEventStatus_GetEventStatus_EvtInfo_INV_IGBT_TEMP_W_PLAUS
          OpEventGetEventStatus_GetEventStatus_Event_INV_IGBT_TEMP_W_PLAUS: RteEventRef=OpEventGetEventStatus_GetEventStatus_Event_INV_IGBT_TEMP_W_PLAUS
          OpEventGetEventStatus_GetEventStatus_EvtInfo_PS_BLDC_UV_FLT: RteEventRef=OpEventGetEventStatus_GetEventStatus_EvtInfo_PS_BLDC_UV_FLT
          OpEventGetEventStatus_GetEventStatus_Event_PS_BLDC_UV_FLT: RteEventRef=OpEventGetEventStatus_GetEventStatus_Event_PS_BLDC_UV_FLT
          OpEventGetEventStatus_GetEventStatus_EvtInfo_INV_IAC_V_OFFS: RteEventRef=OpEventGetEventStatus_GetEventStatus_EvtInfo_INV_IAC_V_OFFS
          OpEventGetEventStatus_GetEventStatus_Event_INV_IAC_V_OFFS: RteEventRef=OpEventGetEventStatus_GetEventStatus_Event_INV_IAC_V_OFFS
          OpEventGetEventStatus_GetEventStatus_EvtInfo_INV_RSLVR_EXCT_FREQ_RNG_NOK: RteEventRef=OpEventGetEventStatus_GetEventStatus_EvtInfo_INV_RSLVR_EXCT_FREQ_RNG_NOK
          OpEventGetEventStatus_GetEventStatus_Event_INV_RSLVR_EXCT_FREQ_RNG_NOK: RteEventRef=OpEventGetEventStatus_GetEventStatus_Event_INV_RSLVR_EXCT_FREQ_RNG_NOK
          OpEventGetEventStatus_GetEventStatus_EvtInfo_PS_KL30_RNG_LO: RteEventRef=OpEventGetEventStatus_GetEventStatus_EvtInfo_PS_KL30_RNG_LO
          OpEventGetEventStatus_GetEventStatus_Event_PS_KL30_RNG_LO: RteEventRef=OpEventGetEventStatus_GetEventStatus_Event_PS_KL30_RNG_LO
          OpEventGetEventStatus_GetEventStatus_EvtInfo_INV_RSLVR_COS_RNG_LO: RteEventRef=OpEventGetEventStatus_GetEventStatus_EvtInfo_INV_RSLVR_COS_RNG_LO
          OpEventGetEventStatus_GetEventStatus_Event_INV_RSLVR_COS_RNG_LO: RteEventRef=OpEventGetEventStatus_GetEventStatus_Event_INV_RSLVR_COS_RNG_LO
          OpEventGetEventStatus_GetEventStatus_EvtInfo_PSnsr_ELE_FLT: RteEventRef=OpEventGetEventStatus_GetEventStatus_EvtInfo_PSnsr_ELE_FLT
          OpEventGetEventStatus_GetEventStatus_Event_PSnsr_ELE_FLT: RteEventRef=OpEventGetEventStatus_GetEventStatus_Event_PSnsr_ELE_FLT
          OpEventGetEventStatus_GetEventStatus_EvtInfo_INV_RSLVR_SIN_COS_PLAUS_AMP: RteEventRef=OpEventGetEventStatus_GetEventStatus_EvtInfo_INV_RSLVR_SIN_COS_PLAUS_AMP
          OpEventGetEventStatus_GetEventStatus_Event_INV_RSLVR_SIN_COS_PLAUS_AMP: RteEventRef=OpEventGetEventStatus_GetEventStatus_Event_INV_RSLVR_SIN_COS_PLAUS_AMP
          OpEventGetEventStatus_GetEventStatus_EvtInfo_INV_IAC_U_ELEC_LO: RteEventRef=OpEventGetEventStatus_GetEventStatus_EvtInfo_INV_IAC_U_ELEC_LO
          OpEventGetEventStatus_GetEventStatus_Event_INV_IAC_U_ELEC_LO: RteEventRef=OpEventGetEventStatus_GetEventStatus_Event_INV_IAC_U_ELEC_LO
          OpEventGetEventStatus_GetEventStatus_EvtInfo_INV_RSLVR_EXCT_ELEC_HI: RteEventRef=OpEventGetEventStatus_GetEventStatus_EvtInfo_INV_RSLVR_EXCT_ELEC_HI
          OpEventGetEventStatus_GetEventStatus_Event_INV_RSLVR_EXCT_ELEC_HI: RteEventRef=OpEventGetEventStatus_GetEventStatus_Event_INV_RSLVR_EXCT_ELEC_HI
          OpEventGetEventStatus_GetEventStatus_EvtInfo_INV_IAC_U_RNG_LO: RteEventRef=OpEventGetEventStatus_GetEventStatus_EvtInfo_INV_IAC_U_RNG_LO
          OpEventGetEventStatus_GetEventStatus_Event_INV_IAC_U_RNG_LO: RteEventRef=OpEventGetEventStatus_GetEventStatus_Event_INV_IAC_U_RNG_LO
          OpEventGetEventStatus_GetEventStatus_EvtInfo_INV_IAC_V_RNG_HI: RteEventRef=OpEventGetEventStatus_GetEventStatus_EvtInfo_INV_IAC_V_RNG_HI
          OpEventGetEventStatus_GetEventStatus_Event_INV_IAC_V_RNG_HI: RteEventRef=OpEventGetEventStatus_GetEventStatus_Event_INV_IAC_V_RNG_HI
          OpEventGetEventStatus_GetEventStatus_EvtInfo_INV_IGBT_TEMP_U_PLAUS: RteEventRef=OpEventGetEventStatus_GetEventStatus_EvtInfo_INV_IGBT_TEMP_U_PLAUS
          OpEventGetEventStatus_GetEventStatus_Event_INV_IGBT_TEMP_U_PLAUS: RteEventRef=OpEventGetEventStatus_GetEventStatus_Event_INV_IGBT_TEMP_U_PLAUS
          OpEventGetEventStatus_GetEventStatus_EvtInfo_INV_RSLVR_OFFS_DFT: RteEventRef=OpEventGetEventStatus_GetEventStatus_EvtInfo_INV_RSLVR_OFFS_DFT
          OpEventGetEventStatus_GetEventStatus_Event_INV_RSLVR_OFFS_DFT: RteEventRef=OpEventGetEventStatus_GetEventStatus_Event_INV_RSLVR_OFFS_DFT
          OpEventGetEventStatus_GetEventStatus_EvtInfo_Ga_MoveOverThd: RteEventRef=OpEventGetEventStatus_GetEventStatus_EvtInfo_Ga_MoveOverThd
          OpEventGetEventStatus_GetEventStatus_Event_Ga_MoveOverThd: RteEventRef=OpEventGetEventStatus_GetEventStatus_Event_Ga_MoveOverThd
          OpEventGetEventStatus_GetEventStatus_EvtInfo_VcEvMonIPH: RteEventRef=OpEventGetEventStatus_GetEventStatus_EvtInfo_VcEvMonIPH
          OpEventGetEventStatus_GetEventStatus_Event_VcEvMonIPH: RteEventRef=OpEventGetEventStatus_GetEventStatus_Event_VcEvMonIPH
          OpEventGetEventStatus_GetEventStatus_EvtInfo_INV_RSLVR_HW_FLT: RteEventRef=OpEventGetEventStatus_GetEventStatus_EvtInfo_INV_RSLVR_HW_FLT
          OpEventGetEventStatus_GetEventStatus_Event_INV_RSLVR_HW_FLT: RteEventRef=OpEventGetEventStatus_GetEventStatus_Event_INV_RSLVR_HW_FLT
          OpEventGetEventStatus_GetEventStatus_EvtInfo_INV_RSLVR_SIN_ELEC_LO: RteEventRef=OpEventGetEventStatus_GetEventStatus_EvtInfo_INV_RSLVR_SIN_ELEC_LO
          OpEventGetEventStatus_GetEventStatus_Event_INV_RSLVR_SIN_ELEC_LO: RteEventRef=OpEventGetEventStatus_GetEventStatus_Event_INV_RSLVR_SIN_ELEC_LO
          OpEventGetEventStatus_GetEventStatus_EvtInfo_INV_IAC_W_AMP: RteEventRef=OpEventGetEventStatus_GetEventStatus_EvtInfo_INV_IAC_W_AMP
          OpEventGetEventStatus_GetEventStatus_Event_INV_IAC_W_AMP: RteEventRef=OpEventGetEventStatus_GetEventStatus_Event_INV_IAC_W_AMP
          OpEventGetEventStatus_GetEventStatus_EvtInfo_VCC_OverVoltage: RteEventRef=OpEventGetEventStatus_GetEventStatus_EvtInfo_VCC_OverVoltage
          OpEventGetEventStatus_GetEventStatus_Event_VCC_OverVoltage: RteEventRef=OpEventGetEventStatus_GetEventStatus_Event_VCC_OverVoltage
          OpEventGetEventStatus_GetEventStatus_EvtInfo_PS_BLDC_OV_FLT: RteEventRef=OpEventGetEventStatus_GetEventStatus_EvtInfo_PS_BLDC_OV_FLT
          OpEventGetEventStatus_GetEventStatus_Event_PS_BLDC_OV_FLT: RteEventRef=OpEventGetEventStatus_GetEventStatus_Event_PS_BLDC_OV_FLT
          OpEventGetEventStatus_GetEventStatus_EvtInfo_AURIX_EEPROM_FLT: RteEventRef=OpEventGetEventStatus_GetEventStatus_EvtInfo_AURIX_EEPROM_FLT
          OpEventGetEventStatus_GetEventStatus_Event_AURIX_EEPROM_FLT: RteEventRef=OpEventGetEventStatus_GetEventStatus_Event_AURIX_EEPROM_FLT
          OpEventGetEventStatus_GetEventStatus_EvtInfo_FS_MONITIOR_ASC_FW_FLT: RteEventRef=OpEventGetEventStatus_GetEventStatus_EvtInfo_FS_MONITIOR_ASC_FW_FLT
          OpEventGetEventStatus_GetEventStatus_Event_FS_MONITIOR_ASC_FW_FLT: RteEventRef=OpEventGetEventStatus_GetEventStatus_Event_FS_MONITIOR_ASC_FW_FLT
          OpEventGetEventStatus_GetEventStatus_EvtInfo_VCEvSrsPropFr02Tioutd: RteEventRef=OpEventGetEventStatus_GetEventStatus_EvtInfo_VCEvSrsPropFr02Tioutd
          OpEventGetEventStatus_GetEventStatus_Event_VCEvSrsPropFr02Tioutd: RteEventRef=OpEventGetEventStatus_GetEventStatus_Event_VCEvSrsPropFr02Tioutd
          OpEventGetEventStatus_GetEventStatus_EvtInfo_VcEvMonErrMode: RteEventRef=OpEventGetEventStatus_GetEventStatus_EvtInfo_VcEvMonErrMode
          OpEventGetEventStatus_GetEventStatus_Event_VcEvMonErrMode: RteEventRef=OpEventGetEventStatus_GetEventStatus_Event_VcEvMonErrMode
          OpEventGetEventStatus_GetEventStatus_EvtInfo_AURIX_RST_MPL: RteEventRef=OpEventGetEventStatus_GetEventStatus_EvtInfo_AURIX_RST_MPL
          OpEventGetEventStatus_GetEventStatus_Event_AURIX_RST_MPL: RteEventRef=OpEventGetEventStatus_GetEventStatus_Event_AURIX_RST_MPL
          OpEventGetEventStatus_GetEventStatus_EvtInfo_VcEvNodeMisECM: RteEventRef=OpEventGetEventStatus_GetEventStatus_EvtInfo_VcEvNodeMisECM
          OpEventGetEventStatus_GetEventStatus_Event_VcEvNodeMisECM: RteEventRef=OpEventGetEventStatus_GetEventStatus_Event_VcEvNodeMisECM
          OpEventGetEventStatus_GetEventStatus_EvtInfo_PS_KL30_PLAUS: RteEventRef=OpEventGetEventStatus_GetEventStatus_EvtInfo_PS_KL30_PLAUS
          OpEventGetEventStatus_GetEventStatus_Event_PS_KL30_PLAUS: RteEventRef=OpEventGetEventStatus_GetEventStatus_Event_PS_KL30_PLAUS
          OpEventGetEventStatus_GetEventStatus_EvtInfo_INV_IAC_W_ELEC_HI: RteEventRef=OpEventGetEventStatus_GetEventStatus_EvtInfo_INV_IAC_W_ELEC_HI
          OpEventGetEventStatus_GetEventStatus_Event_INV_IAC_W_ELEC_HI: RteEventRef=OpEventGetEventStatus_GetEventStatus_Event_INV_IAC_W_ELEC_HI
          OpEventGetEventStatus_GetEventStatus_EvtInfo_VCEvVddmPropFr19Tioutd: RteEventRef=OpEventGetEventStatus_GetEventStatus_EvtInfo_VCEvVddmPropFr19Tioutd
          OpEventGetEventStatus_GetEventStatus_Event_VCEvVddmPropFr19Tioutd: RteEventRef=OpEventGetEventStatus_GetEventStatus_Event_VCEvVddmPropFr19Tioutd
          OpEventGetEventStatus_GetEventStatus_EvtInfo_INV_TEMP_DCHA_HW: RteEventRef=OpEventGetEventStatus_GetEventStatus_EvtInfo_INV_TEMP_DCHA_HW
          OpEventGetEventStatus_GetEventStatus_Event_INV_TEMP_DCHA_HW: RteEventRef=OpEventGetEventStatus_GetEventStatus_Event_INV_TEMP_DCHA_HW
          OpEventGetEventStatus_GetEventStatus_EvtInfo_VcEvPropCANGlbTiOutd: RteEventRef=OpEventGetEventStatus_GetEventStatus_EvtInfo_VcEvPropCANGlbTiOutd
          OpEventGetEventStatus_GetEventStatus_Event_VcEvPropCANGlbTiOutd: RteEventRef=OpEventGetEventStatus_GetEventStatus_Event_VcEvPropCANGlbTiOutd
          OpEventGetEventStatus_GetEventStatus_EvtInfo_INV_EM_STATOR_TEMP2_RNG_NOK: RteEventRef=OpEventGetEventStatus_GetEventStatus_EvtInfo_INV_EM_STATOR_TEMP2_RNG_NOK
          OpEventGetEventStatus_GetEventStatus_Event_INV_EM_STATOR_TEMP2_RNG_NOK: RteEventRef=OpEventGetEventStatus_GetEventStatus_Event_INV_EM_STATOR_TEMP2_RNG_NOK
          OpEventGetEventStatus_GetEventStatus_EvtInfo_INV_UHVDC_OV_HWP: RteEventRef=OpEventGetEventStatus_GetEventStatus_EvtInfo_INV_UHVDC_OV_HWP
          OpEventGetEventStatus_GetEventStatus_Event_INV_UHVDC_OV_HWP: RteEventRef=OpEventGetEventStatus_GetEventStatus_Event_INV_UHVDC_OV_HWP
          OpEventGetEventStatus_GetEventStatus_EvtInfo_Ga_FindEngleAngleFailed: RteEventRef=OpEventGetEventStatus_GetEventStatus_EvtInfo_Ga_FindEngleAngleFailed
          OpEventGetEventStatus_GetEventStatus_Event_Ga_FindEngleAngleFailed: RteEventRef=OpEventGetEventStatus_GetEventStatus_Event_Ga_FindEngleAngleFailed
          OpEventGetEventStatus_GetEventStatus_EvtInfo_VcEvMonTrqCmp: RteEventRef=OpEventGetEventStatus_GetEventStatus_EvtInfo_VcEvMonTrqCmp
          OpEventGetEventStatus_GetEventStatus_Event_VcEvMonTrqCmp: RteEventRef=OpEventGetEventStatus_GetEventStatus_Event_VcEvMonTrqCmp
          OpEventGetEventStatus_GetEventStatus_EvtInfo_INV_IGBT_TEMP_V_RNG_LO: RteEventRef=OpEventGetEventStatus_GetEventStatus_EvtInfo_INV_IGBT_TEMP_V_RNG_LO
          OpEventGetEventStatus_GetEventStatus_Event_INV_IGBT_TEMP_V_RNG_LO: RteEventRef=OpEventGetEventStatus_GetEventStatus_Event_INV_IGBT_TEMP_V_RNG_LO
          OpEventGetEventStatus_GetEventStatus_EvtInfo_INV_CONTROL_LIMIT: RteEventRef=OpEventGetEventStatus_GetEventStatus_EvtInfo_INV_CONTROL_LIMIT
          OpEventGetEventStatus_GetEventStatus_Event_INV_CONTROL_LIMIT: RteEventRef=OpEventGetEventStatus_GetEventStatus_Event_INV_CONTROL_LIMIT
          OpEventGetEventStatus_GetEventStatus_EvtInfo_COM_CarConfigErr: RteEventRef=OpEventGetEventStatus_GetEventStatus_EvtInfo_COM_CarConfigErr
          OpEventGetEventStatus_GetEventStatus_Event_COM_CarConfigErr: RteEventRef=OpEventGetEventStatus_GetEventStatus_Event_COM_CarConfigErr
          OpEventGetEventStatus_GetEventStatus_EvtInfo_VCEvEcmPropFr08Tioutd: RteEventRef=OpEventGetEventStatus_GetEventStatus_EvtInfo_VCEvEcmPropFr08Tioutd
          OpEventGetEventStatus_GetEventStatus_Event_VCEvEcmPropFr08Tioutd: RteEventRef=OpEventGetEventStatus_GetEventStatus_Event_VCEvEcmPropFr08Tioutd
          OpEventGetEventStatus_GetEventStatus_EvtInfo_CU_TEMP1_RNG_LO: RteEventRef=OpEventGetEventStatus_GetEventStatus_EvtInfo_CU_TEMP1_RNG_LO
          OpEventGetEventStatus_GetEventStatus_Event_CU_TEMP1_RNG_LO: RteEventRef=OpEventGetEventStatus_GetEventStatus_Event_CU_TEMP1_RNG_LO
          OpEventGetEventStatus_GetEventStatus_EvtInfo_INV_EM_STATOR_TEMP2_RNG_SWT: RteEventRef=OpEventGetEventStatus_GetEventStatus_EvtInfo_INV_EM_STATOR_TEMP2_RNG_SWT
          OpEventGetEventStatus_GetEventStatus_Event_INV_EM_STATOR_TEMP2_RNG_SWT: RteEventRef=OpEventGetEventStatus_GetEventStatus_Event_INV_EM_STATOR_TEMP2_RNG_SWT
          OpEventGetEventStatus_GetEventStatus_EvtInfo_GA_BLDC_POS_FLT: RteEventRef=OpEventGetEventStatus_GetEventStatus_EvtInfo_GA_BLDC_POS_FLT
          OpEventGetEventStatus_GetEventStatus_Event_GA_BLDC_POS_FLT: RteEventRef=OpEventGetEventStatus_GetEventStatus_Event_GA_BLDC_POS_FLT
          OpEventGetEventStatus_GetEventStatus_EvtInfo_PS_WhlSnsr_FLT: RteEventRef=OpEventGetEventStatus_GetEventStatus_EvtInfo_PS_WhlSnsr_FLT
          OpEventGetEventStatus_GetEventStatus_Event_PS_WhlSnsr_FLT: RteEventRef=OpEventGetEventStatus_GetEventStatus_Event_PS_WhlSnsr_FLT
          OpEventGetEventStatus_GetEventStatus_EvtInfo_INV_EM_STATOR_TEMP_RNG_LO: RteEventRef=OpEventGetEventStatus_GetEventStatus_EvtInfo_INV_EM_STATOR_TEMP_RNG_LO
          OpEventGetEventStatus_GetEventStatus_Event_INV_EM_STATOR_TEMP_RNG_LO: RteEventRef=OpEventGetEventStatus_GetEventStatus_Event_INV_EM_STATOR_TEMP_RNG_LO
          OpEventGetEventStatus_GetEventStatus_EvtInfo_INV_RSLVR_SIN_ELEC_HI: RteEventRef=OpEventGetEventStatus_GetEventStatus_EvtInfo_INV_RSLVR_SIN_ELEC_HI
          OpEventGetEventStatus_GetEventStatus_Event_INV_RSLVR_SIN_ELEC_HI: RteEventRef=OpEventGetEventStatus_GetEventStatus_Event_INV_RSLVR_SIN_ELEC_HI
          OpEventGetEventStatus_GetEventStatus_EvtInfo_INV_RSLVR_SIN_COS_PLAUS: RteEventRef=OpEventGetEventStatus_GetEventStatus_EvtInfo_INV_RSLVR_SIN_COS_PLAUS
          OpEventGetEventStatus_GetEventStatus_Event_INV_RSLVR_SIN_COS_PLAUS: RteEventRef=OpEventGetEventStatus_GetEventStatus_Event_INV_RSLVR_SIN_COS_PLAUS
          OpEventGetEventStatus_GetEventStatus_EvtInfo_INV_RSLVR_COS_AMP: RteEventRef=OpEventGetEventStatus_GetEventStatus_EvtInfo_INV_RSLVR_COS_AMP
          OpEventGetEventStatus_GetEventStatus_Event_INV_RSLVR_COS_AMP: RteEventRef=OpEventGetEventStatus_GetEventStatus_Event_INV_RSLVR_COS_AMP
          OpEventGetEventStatus_GetEventStatus_EvtInfo_INV_GATE_DRVR_BOT_HWP: RteEventRef=OpEventGetEventStatus_GetEventStatus_EvtInfo_INV_GATE_DRVR_BOT_HWP
          OpEventGetEventStatus_GetEventStatus_Event_INV_GATE_DRVR_BOT_HWP: RteEventRef=OpEventGetEventStatus_GetEventStatus_Event_INV_GATE_DRVR_BOT_HWP
          OpEventGetEventStatus_GetEventStatus_EvtInfo_Eg_HallVolWrong: RteEventRef=OpEventGetEventStatus_GetEventStatus_EvtInfo_Eg_HallVolWrong
          OpEventGetEventStatus_GetEventStatus_Event_Eg_HallVolWrong: RteEventRef=OpEventGetEventStatus_GetEventStatus_Event_Eg_HallVolWrong
          OpEventGetEventStatus_GetEventStatus_EvtInfo_INV_RSLVR_EXCT_RNG_NOK: RteEventRef=OpEventGetEventStatus_GetEventStatus_EvtInfo_INV_RSLVR_EXCT_RNG_NOK
          OpEventGetEventStatus_GetEventStatus_Event_INV_RSLVR_EXCT_RNG_NOK: RteEventRef=OpEventGetEventStatus_GetEventStatus_Event_INV_RSLVR_EXCT_RNG_NOK
          OpEventGetEventStatus_GetEventStatus_EvtInfo_PA_OpenCirc: RteEventRef=OpEventGetEventStatus_GetEventStatus_EvtInfo_PA_OpenCirc
          OpEventGetEventStatus_GetEventStatus_Event_PA_OpenCirc: RteEventRef=OpEventGetEventStatus_GetEventStatus_Event_PA_OpenCirc
          OpEventGetEventStatus_GetEventStatus_EvtInfo_INV_RSLVR_COS_ELEC_HI: RteEventRef=OpEventGetEventStatus_GetEventStatus_EvtInfo_INV_RSLVR_COS_ELEC_HI
          OpEventGetEventStatus_GetEventStatus_Event_INV_RSLVR_COS_ELEC_HI: RteEventRef=OpEventGetEventStatus_GetEventStatus_Event_INV_RSLVR_COS_ELEC_HI
          OpEventGetEventStatus_GetEventStatus_EvtInfo_VcEvCntrHvSysRlySts: RteEventRef=OpEventGetEventStatus_GetEventStatus_EvtInfo_VcEvCntrHvSysRlySts
          OpEventGetEventStatus_GetEventStatus_Event_VcEvCntrHvSysRlySts: RteEventRef=OpEventGetEventStatus_GetEventStatus_Event_VcEvCntrHvSysRlySts
          OpEventGetEventStatus_GetEventStatus_EvtInfo_CRASH_DTC: RteEventRef=OpEventGetEventStatus_GetEventStatus_EvtInfo_CRASH_DTC
          OpEventGetEventStatus_GetEventStatus_Event_CRASH_DTC: RteEventRef=OpEventGetEventStatus_GetEventStatus_Event_CRASH_DTC
          OpEventGetEventStatus_GetEventStatus_EvtInfo_INV_IGBT_TEMP_W_RNG_HI: RteEventRef=OpEventGetEventStatus_GetEventStatus_EvtInfo_INV_IGBT_TEMP_W_RNG_HI
          OpEventGetEventStatus_GetEventStatus_Event_INV_IGBT_TEMP_W_RNG_HI: RteEventRef=OpEventGetEventStatus_GetEventStatus_Event_INV_IGBT_TEMP_W_RNG_HI
          OpEventGetEventStatus_GetEventStatus_EvtInfo_VCEvBecmPropFr02Tioutd: RteEventRef=OpEventGetEventStatus_GetEventStatus_EvtInfo_VCEvBecmPropFr02Tioutd
          OpEventGetEventStatus_GetEventStatus_Event_VCEvBecmPropFr02Tioutd: RteEventRef=OpEventGetEventStatus_GetEventStatus_Event_VCEvBecmPropFr02Tioutd
          OpEventGetEventStatus_GetEventStatus_EvtInfo_INV_IGBT_TEMP_W_GRDT: RteEventRef=OpEventGetEventStatus_GetEventStatus_EvtInfo_INV_IGBT_TEMP_W_GRDT
          OpEventGetEventStatus_GetEventStatus_Event_INV_IGBT_TEMP_W_GRDT: RteEventRef=OpEventGetEventStatus_GetEventStatus_Event_INV_IGBT_TEMP_W_GRDT
          OpEventGetEventStatus_GetEventStatus_EvtInfo_EXT_UC_SPI_FLT: RteEventRef=OpEventGetEventStatus_GetEventStatus_EvtInfo_EXT_UC_SPI_FLT
          OpEventGetEventStatus_GetEventStatus_Event_EXT_UC_SPI_FLT: RteEventRef=OpEventGetEventStatus_GetEventStatus_Event_EXT_UC_SPI_FLT
          OpEventGetEventStatus_GetEventStatus_EvtInfo_INV_IAC_V_ELEC_HWP_001: RteEventRef=OpEventGetEventStatus_GetEventStatus_EvtInfo_INV_IAC_V_ELEC_HWP_001
          OpEventGetEventStatus_GetEventStatus_Event_INV_IAC_V_ELEC_HWP_001: RteEventRef=OpEventGetEventStatus_GetEventStatus_Event_INV_IAC_V_ELEC_HWP_001
          OpEventGetEventStatus_GetEventStatus_EvtInfo_VcEvChkSumWhlMotSysTqAllwd: RteEventRef=OpEventGetEventStatus_GetEventStatus_EvtInfo_VcEvChkSumWhlMotSysTqAllwd
          OpEventGetEventStatus_GetEventStatus_Event_VcEvChkSumWhlMotSysTqAllwd: RteEventRef=OpEventGetEventStatus_GetEventStatus_Event_VcEvChkSumWhlMotSysTqAllwd
          OpEventGetEventStatus_GetEventStatus_EvtInfo_FS_MONITIOR_ASC_FLT: RteEventRef=OpEventGetEventStatus_GetEventStatus_EvtInfo_FS_MONITIOR_ASC_FLT
          OpEventGetEventStatus_GetEventStatus_Event_FS_MONITIOR_ASC_FLT: RteEventRef=OpEventGetEventStatus_GetEventStatus_Event_FS_MONITIOR_ASC_FLT
          OpEventGetEventStatus_GetEventStatus_EvtInfo_INV_IAC_V_AMP: RteEventRef=OpEventGetEventStatus_GetEventStatus_EvtInfo_INV_IAC_V_AMP
          OpEventGetEventStatus_GetEventStatus_Event_INV_IAC_V_AMP: RteEventRef=OpEventGetEventStatus_GetEventStatus_Event_INV_IAC_V_AMP
          OpEventGetEventStatus_GetEventStatus_EvtInfo_INV_IAC_W_ELEC_LO: RteEventRef=OpEventGetEventStatus_GetEventStatus_EvtInfo_INV_IAC_W_ELEC_LO
          OpEventGetEventStatus_GetEventStatus_Event_INV_IAC_W_ELEC_LO: RteEventRef=OpEventGetEventStatus_GetEventStatus_Event_INV_IAC_W_ELEC_LO
          OpEventGetEventStatus_GetEventStatus_EvtInfo_VCEvVddmPropFr08Tioutd_001: RteEventRef=OpEventGetEventStatus_GetEventStatus_EvtInfo_VCEvVddmPropFr08Tioutd_001
          OpEventGetEventStatus_GetEventStatus_Event_VCEvVddmPropFr08Tioutd_001: RteEventRef=OpEventGetEventStatus_GetEventStatus_Event_VCEvVddmPropFr08Tioutd_001
          OpEventGetEventStatus_GetEventStatus_EvtInfo_PS_P12_RES_FLT: RteEventRef=OpEventGetEventStatus_GetEventStatus_EvtInfo_PS_P12_RES_FLT
          OpEventGetEventStatus_GetEventStatus_Event_PS_P12_RES_FLT: RteEventRef=OpEventGetEventStatus_GetEventStatus_Event_PS_P12_RES_FLT
          OpEventGetEventStatus_GetEventStatus_EvtInfo_INV_RSLVR_SIN_RNG_LO: RteEventRef=OpEventGetEventStatus_GetEventStatus_EvtInfo_INV_RSLVR_SIN_RNG_LO
          OpEventGetEventStatus_GetEventStatus_Event_INV_RSLVR_SIN_RNG_LO: RteEventRef=OpEventGetEventStatus_GetEventStatus_Event_INV_RSLVR_SIN_RNG_LO
          OpEventGetEventStatus_GetEventStatus_EvtInfo_CU_TEMP_HW_FLT: RteEventRef=OpEventGetEventStatus_GetEventStatus_EvtInfo_CU_TEMP_HW_FLT
          OpEventGetEventStatus_GetEventStatus_Event_CU_TEMP_HW_FLT: RteEventRef=OpEventGetEventStatus_GetEventStatus_Event_CU_TEMP_HW_FLT
          OpEventGetEventStatus_GetEventStatus_EvtInfo_VCEvEcmPropFr02MgmFr00Tioutd: RteEventRef=OpEventGetEventStatus_GetEventStatus_EvtInfo_VCEvEcmPropFr02MgmFr00Tioutd
          OpEventGetEventStatus_GetEventStatus_Event_VCEvEcmPropFr02MgmFr00Tioutd: RteEventRef=OpEventGetEventStatus_GetEventStatus_Event_VCEvEcmPropFr02MgmFr00Tioutd
          OpEventGetEventStatus_GetEventStatus_EvtInfo_PS_KL15_RNG_HI: RteEventRef=OpEventGetEventStatus_GetEventStatus_EvtInfo_PS_KL15_RNG_HI
          OpEventGetEventStatus_GetEventStatus_Event_PS_KL15_RNG_HI: RteEventRef=OpEventGetEventStatus_GetEventStatus_Event_PS_KL15_RNG_HI
          OpEventGetEventStatus_GetEventStatus_EvtInfo_VCEvVddmPropFr17Tioutd: RteEventRef=OpEventGetEventStatus_GetEventStatus_EvtInfo_VCEvVddmPropFr17Tioutd
          OpEventGetEventStatus_GetEventStatus_Event_VCEvVddmPropFr17Tioutd: RteEventRef=OpEventGetEventStatus_GetEventStatus_Event_VCEvVddmPropFr17Tioutd
          OpEventGetEventStatus_GetEventStatus_EvtInfo_VcEvChkSumCrashStsSafe: RteEventRef=OpEventGetEventStatus_GetEventStatus_EvtInfo_VcEvChkSumCrashStsSafe
          OpEventGetEventStatus_GetEventStatus_Event_VcEvChkSumCrashStsSafe: RteEventRef=OpEventGetEventStatus_GetEventStatus_Event_VcEvChkSumCrashStsSafe
          OpEventGetEventStatus_GetEventStatus_EvtInfo_DiagC_ClutchService: RteEventRef=OpEventGetEventStatus_GetEventStatus_EvtInfo_DiagC_ClutchService
          OpEventGetEventStatus_GetEventStatus_Event_DiagC_ClutchService: RteEventRef=OpEventGetEventStatus_GetEventStatus_Event_DiagC_ClutchService
          OpEventGetEventStatus_GetEventStatus_EvtInfo_INV_EM_STATOR_TEMP_RNG_HI: RteEventRef=OpEventGetEventStatus_GetEventStatus_EvtInfo_INV_EM_STATOR_TEMP_RNG_HI
          OpEventGetEventStatus_GetEventStatus_Event_INV_EM_STATOR_TEMP_RNG_HI: RteEventRef=OpEventGetEventStatus_GetEventStatus_Event_INV_EM_STATOR_TEMP_RNG_HI
          OpEventGetEventStatus_GetEventStatus_EvtInfo_INV_RSLVR_OFFS_OUT_RANG: RteEventRef=OpEventGetEventStatus_GetEventStatus_EvtInfo_INV_RSLVR_OFFS_OUT_RANG
          OpEventGetEventStatus_GetEventStatus_Event_INV_RSLVR_OFFS_OUT_RANG: RteEventRef=OpEventGetEventStatus_GetEventStatus_Event_INV_RSLVR_OFFS_OUT_RANG
          OpEventGetEventStatus_GetEventStatus_EvtInfo_INV_EM_STATOR_TEMP2_RNG_LO: RteEventRef=OpEventGetEventStatus_GetEventStatus_EvtInfo_INV_EM_STATOR_TEMP2_RNG_LO
          OpEventGetEventStatus_GetEventStatus_Event_INV_EM_STATOR_TEMP2_RNG_LO: RteEventRef=OpEventGetEventStatus_GetEventStatus_Event_INV_EM_STATOR_TEMP2_RNG_LO
          OpEventGetEventStatus_GetEventStatus_EvtInfo_VcEvMonISAR: RteEventRef=OpEventGetEventStatus_GetEventStatus_EvtInfo_VcEvMonISAR
          OpEventGetEventStatus_GetEventStatus_Event_VcEvMonISAR: RteEventRef=OpEventGetEventStatus_GetEventStatus_Event_VcEvMonISAR
          OpEventGetEventStatus_GetEventStatus_EvtInfo_GA_BLDC_FLT: RteEventRef=OpEventGetEventStatus_GetEventStatus_EvtInfo_GA_BLDC_FLT
          OpEventGetEventStatus_GetEventStatus_Event_GA_BLDC_FLT: RteEventRef=OpEventGetEventStatus_GetEventStatus_Event_GA_BLDC_FLT
          OpEventGetEventStatus_GetEventStatus_EvtInfo_INV_RSLVR_EXCT_ELEC_OPEN: RteEventRef=OpEventGetEventStatus_GetEventStatus_EvtInfo_INV_RSLVR_EXCT_ELEC_OPEN
          OpEventGetEventStatus_GetEventStatus_Event_INV_RSLVR_EXCT_ELEC_OPEN: RteEventRef=OpEventGetEventStatus_GetEventStatus_Event_INV_RSLVR_EXCT_ELEC_OPEN
          OpEventGetEventStatus_GetEventStatus_EvtInfo_INV_RSLVR_EXCT_PLAUS: RteEventRef=OpEventGetEventStatus_GetEventStatus_EvtInfo_INV_RSLVR_EXCT_PLAUS
          OpEventGetEventStatus_GetEventStatus_Event_INV_RSLVR_EXCT_PLAUS: RteEventRef=OpEventGetEventStatus_GetEventStatus_Event_INV_RSLVR_EXCT_PLAUS
          OpEventGetEventStatus_GetEventStatus_EvtInfo_PS_P15_U_FLT: RteEventRef=OpEventGetEventStatus_GetEventStatus_EvtInfo_PS_P15_U_FLT
          OpEventGetEventStatus_GetEventStatus_Event_PS_P15_U_FLT: RteEventRef=OpEventGetEventStatus_GetEventStatus_Event_PS_P15_U_FLT
          OpEventGetEventStatus_GetEventStatus_EvtInfo_INV_EM_STATOR_TEMP_RNG_SWT: RteEventRef=OpEventGetEventStatus_GetEventStatus_EvtInfo_INV_EM_STATOR_TEMP_RNG_SWT
          OpEventGetEventStatus_GetEventStatus_Event_INV_EM_STATOR_TEMP_RNG_SWT: RteEventRef=OpEventGetEventStatus_GetEventStatus_Event_INV_EM_STATOR_TEMP_RNG_SWT
          OpEventGetEventStatus_GetEventStatus_EvtInfo_INV_UHVDC_OV_SWP: RteEventRef=OpEventGetEventStatus_GetEventStatus_EvtInfo_INV_UHVDC_OV_SWP
          OpEventGetEventStatus_GetEventStatus_Event_INV_UHVDC_OV_SWP: RteEventRef=OpEventGetEventStatus_GetEventStatus_Event_INV_UHVDC_OV_SWP
          OpEventGetEventStatus_GetEventStatus_EvtInfo_AURIX_HW_FLT: RteEventRef=OpEventGetEventStatus_GetEventStatus_EvtInfo_AURIX_HW_FLT
          OpEventGetEventStatus_GetEventStatus_Event_AURIX_HW_FLT: RteEventRef=OpEventGetEventStatus_GetEventStatus_Event_AURIX_HW_FLT
          OpEventGetEventStatus_GetEventStatus_EvtInfo_INV_GATE_DRVR_TOP_HWP: RteEventRef=OpEventGetEventStatus_GetEventStatus_EvtInfo_INV_GATE_DRVR_TOP_HWP
          OpEventGetEventStatus_GetEventStatus_Event_INV_GATE_DRVR_TOP_HWP: RteEventRef=OpEventGetEventStatus_GetEventStatus_Event_INV_GATE_DRVR_TOP_HWP
          OpEventGetEventStatus_GetEventStatus_EvtInfo_INV_ACTV_DCHA_HW: RteEventRef=OpEventGetEventStatus_GetEventStatus_EvtInfo_INV_ACTV_DCHA_HW
          OpEventGetEventStatus_GetEventStatus_Event_INV_ACTV_DCHA_HW: RteEventRef=OpEventGetEventStatus_GetEventStatus_Event_INV_ACTV_DCHA_HW
          OpEventGetEventStatus_GetEventStatus_EvtInfo_INV_IGBT_TEMP_HWP: RteEventRef=OpEventGetEventStatus_GetEventStatus_EvtInfo_INV_IGBT_TEMP_HWP
          OpEventGetEventStatus_GetEventStatus_Event_INV_IGBT_TEMP_HWP: RteEventRef=OpEventGetEventStatus_GetEventStatus_Event_INV_IGBT_TEMP_HWP
          OpEventGetEventStatus_GetEventStatus_EvtInfo_INV_RSLVR_SIN_ELEC_FLT: RteEventRef=OpEventGetEventStatus_GetEventStatus_EvtInfo_INV_RSLVR_SIN_ELEC_FLT
          OpEventGetEventStatus_GetEventStatus_Event_INV_RSLVR_SIN_ELEC_FLT: RteEventRef=OpEventGetEventStatus_GetEventStatus_Event_INV_RSLVR_SIN_ELEC_FLT
          OpEventGetEventStatus_GetEventStatus_EvtInfo_CU_TEMP2_RNG_HI: RteEventRef=OpEventGetEventStatus_GetEventStatus_EvtInfo_CU_TEMP2_RNG_HI
          OpEventGetEventStatus_GetEventStatus_Event_CU_TEMP2_RNG_HI: RteEventRef=OpEventGetEventStatus_GetEventStatus_Event_CU_TEMP2_RNG_HI
          OpEventGetEventStatus_GetEventStatus_EvtInfo_INV_IAC_PHA_LOSS_MPL: RteEventRef=OpEventGetEventStatus_GetEventStatus_EvtInfo_INV_IAC_PHA_LOSS_MPL
          OpEventGetEventStatus_GetEventStatus_Event_INV_IAC_PHA_LOSS_MPL: RteEventRef=OpEventGetEventStatus_GetEventStatus_Event_INV_IAC_PHA_LOSS_MPL
          OpEventGetEventStatus_GetEventStatus_EvtInfo_INV_IAC_U_AMP: RteEventRef=OpEventGetEventStatus_GetEventStatus_EvtInfo_INV_IAC_U_AMP
          OpEventGetEventStatus_GetEventStatus_Event_INV_IAC_U_AMP: RteEventRef=OpEventGetEventStatus_GetEventStatus_Event_INV_IAC_U_AMP
          OpEventGetEventStatus_GetEventStatus_EvtInfo_PSnsr_GRADT_Flt: RteEventRef=OpEventGetEventStatus_GetEventStatus_EvtInfo_PSnsr_GRADT_Flt
          OpEventGetEventStatus_GetEventStatus_Event_PSnsr_GRADT_Flt: RteEventRef=OpEventGetEventStatus_GetEventStatus_Event_PSnsr_GRADT_Flt
          OpEventGetEventStatus_GetEventStatus_EvtInfo_AURIX_WATHDOG_FLT: RteEventRef=OpEventGetEventStatus_GetEventStatus_EvtInfo_AURIX_WATHDOG_FLT
          OpEventGetEventStatus_GetEventStatus_Event_AURIX_WATHDOG_FLT: RteEventRef=OpEventGetEventStatus_GetEventStatus_Event_AURIX_WATHDOG_FLT
          OpEventGetEventStatus_GetEventStatus_EvtInfo_VcEvNodeMisBECM: RteEventRef=OpEventGetEventStatus_GetEventStatus_EvtInfo_VcEvNodeMisBECM
          OpEventGetEventStatus_GetEventStatus_Event_VcEvNodeMisBECM: RteEventRef=OpEventGetEventStatus_GetEventStatus_Event_VcEvNodeMisBECM
          OpEventGetEventStatus_GetEventStatus_EvtInfo_INV_UHVDC_UV_HWP: RteEventRef=OpEventGetEventStatus_GetEventStatus_EvtInfo_INV_UHVDC_UV_HWP
          OpEventGetEventStatus_GetEventStatus_Event_INV_UHVDC_UV_HWP: RteEventRef=OpEventGetEventStatus_GetEventStatus_Event_INV_UHVDC_UV_HWP
          OpEventGetEventStatus_GetEventStatus_EvtInfo_VcEvMonESpd: RteEventRef=OpEventGetEventStatus_GetEventStatus_EvtInfo_VcEvMonESpd
          OpEventGetEventStatus_GetEventStatus_Event_VcEvMonESpd: RteEventRef=OpEventGetEventStatus_GetEventStatus_Event_VcEvMonESpd
          OpEventGetEventStatus_GetEventStatus_EvtInfo_COM_NotConfig: RteEventRef=OpEventGetEventStatus_GetEventStatus_EvtInfo_COM_NotConfig
          OpEventGetEventStatus_GetEventStatus_Event_COM_NotConfig: RteEventRef=OpEventGetEventStatus_GetEventStatus_Event_COM_NotConfig
          OpEventGetEventStatus_GetEventStatus_EvtInfo_INV_RSLVR_SIN_RNG_HI: RteEventRef=OpEventGetEventStatus_GetEventStatus_EvtInfo_INV_RSLVR_SIN_RNG_HI
          OpEventGetEventStatus_GetEventStatus_Event_INV_RSLVR_SIN_RNG_HI: RteEventRef=OpEventGetEventStatus_GetEventStatus_Event_INV_RSLVR_SIN_RNG_HI
          OpEventGetEventStatus_GetEventStatus_EvtInfo_INV_IGBT_TEMP_U_RNG_HI: RteEventRef=OpEventGetEventStatus_GetEventStatus_EvtInfo_INV_IGBT_TEMP_U_RNG_HI
          OpEventGetEventStatus_GetEventStatus_Event_INV_IGBT_TEMP_U_RNG_HI: RteEventRef=OpEventGetEventStatus_GetEventStatus_Event_INV_IGBT_TEMP_U_RNG_HI
          OpEventGetEventStatus_GetEventStatus_EvtInfo_VcEvMonMode_001: RteEventRef=OpEventGetEventStatus_GetEventStatus_EvtInfo_VcEvMonMode_001
          OpEventGetEventStatus_GetEventStatus_Event_VcEvMonMode_001: RteEventRef=OpEventGetEventStatus_GetEventStatus_Event_VcEvMonMode_001
          OpEventGetEventStatus_GetEventStatus_EvtInfo_PA_ACTION_FLT: RteEventRef=OpEventGetEventStatus_GetEventStatus_EvtInfo_PA_ACTION_FLT
          OpEventGetEventStatus_GetEventStatus_Event_PA_ACTION_FLT: RteEventRef=OpEventGetEventStatus_GetEventStatus_Event_PA_ACTION_FLT
          OpEventGetEventStatus_GetEventStatus_EvtInfo_INV_IAC_V_ELEC_HWP: RteEventRef=OpEventGetEventStatus_GetEventStatus_EvtInfo_INV_IAC_V_ELEC_HWP
          OpEventGetEventStatus_GetEventStatus_Event_INV_IAC_V_ELEC_HWP: RteEventRef=OpEventGetEventStatus_GetEventStatus_Event_INV_IAC_V_ELEC_HWP
          OpEventGetEventStatus_GetEventStatus_EvtInfo_CU_TEMP_HW_FLT_001: RteEventRef=OpEventGetEventStatus_GetEventStatus_EvtInfo_CU_TEMP_HW_FLT_001
          OpEventGetEventStatus_GetEventStatus_Event_CU_TEMP_HW_FLT_001: RteEventRef=OpEventGetEventStatus_GetEventStatus_Event_CU_TEMP_HW_FLT_001
          OpEventGetEventStatus_GetEventStatus_EvtInfo_VCC_UnderVoltage: RteEventRef=OpEventGetEventStatus_GetEventStatus_EvtInfo_VCC_UnderVoltage
          OpEventGetEventStatus_GetEventStatus_Event_VCC_UnderVoltage: RteEventRef=OpEventGetEventStatus_GetEventStatus_Event_VCC_UnderVoltage
          OpEventGetEventStatus_GetEventStatus_EvtInfo_VcEvTsttrPlaus: RteEventRef=OpEventGetEventStatus_GetEventStatus_EvtInfo_VcEvTsttrPlaus
          OpEventGetEventStatus_GetEventStatus_Event_VcEvTsttrPlaus: RteEventRef=OpEventGetEventStatus_GetEventStatus_Event_VcEvTsttrPlaus
          OpEventGetEventStatus_GetEventStatus_EvtInfo_INV_RSLVR_EXCT_ELEC_FLT: RteEventRef=OpEventGetEventStatus_GetEventStatus_EvtInfo_INV_RSLVR_EXCT_ELEC_FLT
          OpEventGetEventStatus_GetEventStatus_Event_INV_RSLVR_EXCT_ELEC_FLT: RteEventRef=OpEventGetEventStatus_GetEventStatus_Event_INV_RSLVR_EXCT_ELEC_FLT
          OpEventGetEventStatus_GetEventStatus_EvtInfo_INV_RSLVR_EXCT_RNG_LO: RteEventRef=OpEventGetEventStatus_GetEventStatus_EvtInfo_INV_RSLVR_EXCT_RNG_LO
          OpEventGetEventStatus_GetEventStatus_Event_INV_RSLVR_EXCT_RNG_LO: RteEventRef=OpEventGetEventStatus_GetEventStatus_Event_INV_RSLVR_EXCT_RNG_LO
          OpEventGetEventStatus_GetEventStatus_EvtInfo_INV_EM_STATOR_TEMP2_RNG_HI: RteEventRef=OpEventGetEventStatus_GetEventStatus_EvtInfo_INV_EM_STATOR_TEMP2_RNG_HI
          OpEventGetEventStatus_GetEventStatus_Event_INV_EM_STATOR_TEMP2_RNG_HI: RteEventRef=OpEventGetEventStatus_GetEventStatus_Event_INV_EM_STATOR_TEMP2_RNG_HI
          OpEventGetEventStatus_GetEventStatus_EvtInfo_INV_SHUT_OFF_PAH_START_UP: RteEventRef=OpEventGetEventStatus_GetEventStatus_EvtInfo_INV_SHUT_OFF_PAH_START_UP
          OpEventGetEventStatus_GetEventStatus_Event_INV_SHUT_OFF_PAH_START_UP: RteEventRef=OpEventGetEventStatus_GetEventStatus_Event_INV_SHUT_OFF_PAH_START_UP
          OpEventGetEventStatus_GetEventStatus_EvtInfo_VCEvVddmPropFr08Tioutd: RteEventRef=OpEventGetEventStatus_GetEventStatus_EvtInfo_VCEvVddmPropFr08Tioutd
          OpEventGetEventStatus_GetEventStatus_Event_VCEvVddmPropFr08Tioutd: RteEventRef=OpEventGetEventStatus_GetEventStatus_Event_VCEvVddmPropFr08Tioutd

[part 5 of 5: package /ActiveEcuC]
AUTOSAR XML (schema 4-2-2)
package /ActiveEcuC  (continued)
  module config Rte: implementation-config-variant=VARIANT-PRE-COMPILE, module-description=Rte_Impl  (continued)
    7 x RteSwComponentInstance:  (continued)
      DemSatellite_0_EcuSwComposition: RteSoftwareComponentInstanceRef=DemSatellite_0  (continued)
        4544 x RteEventToTaskMapping, all with RteImmediateRestart=false:  (continued)
          OpEventGetDebouncingOfEvent_GetDebouncingOfEvent_EvtInfo_COM_CarConfigErr: RteEventRef=OpEventGetDebouncingOfEvent_GetDebouncingOfEvent_EvtInfo_COM_CarConfigErr
          OpEventGetDebouncingOfEvent_GetDebouncingOfEvent_EvtInfo_VCEvEcmPropFr08Tioutd: RteEventRef=OpEventGetDebouncingOfEvent_GetDebouncingOfEvent_EvtInfo_VCEvEcmPropFr08Tioutd
          OpEventGetDebouncingOfEvent_GetDebouncingOfEvent_EvtInfo_CU_TEMP1_RNG_LO: RteEventRef=OpEventGetDebouncingOfEvent_GetDebouncingOfEvent_EvtInfo_CU_TEMP1_RNG_LO
          OpEventGetDebouncingOfEvent_GetDebouncingOfEvent_EvtInfo_INV_EM_STATOR_TEMP2_RNG_SWT: RteEventRef=OpEventGetDebouncingOfEvent_GetDebouncingOfEvent_EvtInfo_INV_EM_STATOR_TEMP2_RNG_SWT
          OpEventGetDebouncingOfEvent_GetDebouncingOfEvent_EvtInfo_GA_BLDC_POS_FLT: RteEventRef=OpEventGetDebouncingOfEvent_GetDebouncingOfEvent_EvtInfo_GA_BLDC_POS_FLT
          OpEventGetDebouncingOfEvent_GetDebouncingOfEvent_EvtInfo_PS_WhlSnsr_FLT: RteEventRef=OpEventGetDebouncingOfEvent_GetDebouncingOfEvent_EvtInfo_PS_WhlSnsr_FLT
          OpEventGetDebouncingOfEvent_GetDebouncingOfEvent_EvtInfo_INV_EM_STATOR_TEMP_RNG_LO: RteEventRef=OpEventGetDebouncingOfEvent_GetDebouncingOfEvent_EvtInfo_INV_EM_STATOR_TEMP_RNG_LO
          OpEventGetDebouncingOfEvent_GetDebouncingOfEvent_EvtInfo_INV_RSLVR_SIN_ELEC_HI: RteEventRef=OpEventGetDebouncingOfEvent_GetDebouncingOfEvent_EvtInfo_INV_RSLVR_SIN_ELEC_HI
          OpEventGetDebouncingOfEvent_GetDebouncingOfEvent_EvtInfo_INV_RSLVR_SIN_COS_PLAUS: RteEventRef=OpEventGetDebouncingOfEvent_GetDebouncingOfEvent_EvtInfo_INV_RSLVR_SIN_COS_PLAUS
          OpEventGetDebouncingOfEvent_GetDebouncingOfEvent_EvtInfo_INV_RSLVR_COS_AMP: RteEventRef=OpEventGetDebouncingOfEvent_GetDebouncingOfEvent_EvtInfo_INV_RSLVR_COS_AMP
          OpEventGetDebouncingOfEvent_GetDebouncingOfEvent_EvtInfo_INV_GATE_DRVR_BOT_HWP: RteEventRef=OpEventGetDebouncingOfEvent_GetDebouncingOfEvent_EvtInfo_INV_GATE_DRVR_BOT_HWP
          OpEventGetDebouncingOfEvent_GetDebouncingOfEvent_EvtInfo_Eg_HallVolWrong: RteEventRef=OpEventGetDebouncingOfEvent_GetDebouncingOfEvent_EvtInfo_Eg_HallVolWrong
          OpEventGetDebouncingOfEvent_GetDebouncingOfEvent_EvtInfo_INV_RSLVR_EXCT_RNG_NOK: RteEventRef=OpEventGetDebouncingOfEvent_GetDebouncingOfEvent_EvtInfo_INV_RSLVR_EXCT_RNG_NOK
          OpEventGetDebouncingOfEvent_GetDebouncingOfEvent_EvtInfo_PA_OpenCirc: RteEventRef=OpEventGetDebouncingOfEvent_GetDebouncingOfEvent_EvtInfo_PA_OpenCirc
          OpEventGetDebouncingOfEvent_GetDebouncingOfEvent_EvtInfo_INV_RSLVR_COS_ELEC_HI: RteEventRef=OpEventGetDebouncingOfEvent_GetDebouncingOfEvent_EvtInfo_INV_RSLVR_COS_ELEC_HI
          OpEventGetDebouncingOfEvent_GetDebouncingOfEvent_EvtInfo_VcEvCntrHvSysRlySts: RteEventRef=OpEventGetDebouncingOfEvent_GetDebouncingOfEvent_EvtInfo_VcEvCntrHvSysRlySts
          OpEventGetDebouncingOfEvent_GetDebouncingOfEvent_EvtInfo_CRASH_DTC: RteEventRef=OpEventGetDebouncingOfEvent_GetDebouncingOfEvent_EvtInfo_CRASH_DTC
          OpEventGetDebouncingOfEvent_GetDebouncingOfEvent_EvtInfo_INV_IGBT_TEMP_W_RNG_HI: RteEventRef=OpEventGetDebouncingOfEvent_GetDebouncingOfEvent_EvtInfo_INV_IGBT_TEMP_W_RNG_HI
          OpEventGetDebouncingOfEvent_GetDebouncingOfEvent_EvtInfo_VCEvBecmPropFr02Tioutd: RteEventRef=OpEventGetDebouncingOfEvent_GetDebouncingOfEvent_EvtInfo_VCEvBecmPropFr02Tioutd
          OpEventGetDebouncingOfEvent_GetDebouncingOfEvent_EvtInfo_INV_IGBT_TEMP_W_GRDT: RteEventRef=OpEventGetDebouncingOfEvent_GetDebouncingOfEvent_EvtInfo_INV_IGBT_TEMP_W_GRDT
          OpEventGetDebouncingOfEvent_GetDebouncingOfEvent_EvtInfo_EXT_UC_SPI_FLT: RteEventRef=OpEventGetDebouncingOfEvent_GetDebouncingOfEvent_EvtInfo_EXT_UC_SPI_FLT
          OpEventGetDebouncingOfEvent_GetDebouncingOfEvent_EvtInfo_INV_IAC_V_ELEC_HWP_001: RteEventRef=OpEventGetDebouncingOfEvent_GetDebouncingOfEvent_EvtInfo_INV_IAC_V_ELEC_HWP_001
          OpEventGetDebouncingOfEvent_GetDebouncingOfEvent_EvtInfo_VcEvChkSumWhlMotSysTqAllwd: RteEventRef=OpEventGetDebouncingOfEvent_GetDebouncingOfEvent_EvtInfo_VcEvChkSumWhlMotSysTqAllwd
          OpEventGetDebouncingOfEvent_GetDebouncingOfEvent_EvtInfo_FS_MONITIOR_ASC_FLT: RteEventRef=OpEventGetDebouncingOfEvent_GetDebouncingOfEvent_EvtInfo_FS_MONITIOR_ASC_FLT
          OpEventGetDebouncingOfEvent_GetDebouncingOfEvent_EvtInfo_INV_IAC_V_AMP: RteEventRef=OpEventGetDebouncingOfEvent_GetDebouncingOfEvent_EvtInfo_INV_IAC_V_AMP
          OpEventGetDebouncingOfEvent_GetDebouncingOfEvent_EvtInfo_INV_IAC_W_ELEC_LO: RteEventRef=OpEventGetDebouncingOfEvent_GetDebouncingOfEvent_EvtInfo_INV_IAC_W_ELEC_LO
          OpEventGetDebouncingOfEvent_GetDebouncingOfEvent_EvtInfo_VCEvVddmPropFr08Tioutd_001: RteEventRef=OpEventGetDebouncingOfEvent_GetDebouncingOfEvent_EvtInfo_VCEvVddmPropFr08Tioutd_001
          OpEventGetDebouncingOfEvent_GetDebouncingOfEvent_EvtInfo_PS_P12_RES_FLT: RteEventRef=OpEventGetDebouncingOfEvent_GetDebouncingOfEvent_EvtInfo_PS_P12_RES_FLT
          OpEventGetDebouncingOfEvent_GetDebouncingOfEvent_EvtInfo_INV_RSLVR_SIN_RNG_LO: RteEventRef=OpEventGetDebouncingOfEvent_GetDebouncingOfEvent_EvtInfo_INV_RSLVR_SIN_RNG_LO
          OpEventGetDebouncingOfEvent_GetDebouncingOfEvent_EvtInfo_CU_TEMP_HW_FLT: RteEventRef=OpEventGetDebouncingOfEvent_GetDebouncingOfEvent_EvtInfo_CU_TEMP_HW_FLT
          OpEventGetDebouncingOfEvent_GetDebouncingOfEvent_EvtInfo_VCEvEcmPropFr02MgmFr00Tioutd: RteEventRef=OpEventGetDebouncingOfEvent_GetDebouncingOfEvent_EvtInfo_VCEvEcmPropFr02MgmFr00Tioutd
          OpEventGetDebouncingOfEvent_GetDebouncingOfEvent_EvtInfo_PS_KL15_RNG_HI: RteEventRef=OpEventGetDebouncingOfEvent_GetDebouncingOfEvent_EvtInfo_PS_KL15_RNG_HI
          OpEventGetDebouncingOfEvent_GetDebouncingOfEvent_EvtInfo_VCEvVddmPropFr17Tioutd: RteEventRef=OpEventGetDebouncingOfEvent_GetDebouncingOfEvent_EvtInfo_VCEvVddmPropFr17Tioutd
          OpEventGetDebouncingOfEvent_GetDebouncingOfEvent_EvtInfo_VcEvChkSumCrashStsSafe: RteEventRef=OpEventGetDebouncingOfEvent_GetDebouncingOfEvent_EvtInfo_VcEvChkSumCrashStsSafe
          OpEventGetDebouncingOfEvent_GetDebouncingOfEvent_EvtInfo_DiagC_ClutchService: RteEventRef=OpEventGetDebouncingOfEvent_GetDebouncingOfEvent_EvtInfo_DiagC_ClutchService
          OpEventGetDebouncingOfEvent_GetDebouncingOfEvent_EvtInfo_INV_EM_STATOR_TEMP_RNG_HI: RteEventRef=OpEventGetDebouncingOfEvent_GetDebouncingOfEvent_EvtInfo_INV_EM_STATOR_TEMP_RNG_HI
          OpEventGetDebouncingOfEvent_GetDebouncingOfEvent_EvtInfo_INV_RSLVR_OFFS_OUT_RANG: RteEventRef=OpEventGetDebouncingOfEvent_GetDebouncingOfEvent_EvtInfo_INV_RSLVR_OFFS_OUT_RANG
          OpEventGetDebouncingOfEvent_GetDebouncingOfEvent_EvtInfo_INV_EM_STATOR_TEMP2_RNG_LO: RteEventRef=OpEventGetDebouncingOfEvent_GetDebouncingOfEvent_EvtInfo_INV_EM_STATOR_TEMP2_RNG_LO
          OpEventGetDebouncingOfEvent_GetDebouncingOfEvent_EvtInfo_VcEvMonISAR: RteEventRef=OpEventGetDebouncingOfEvent_GetDebouncingOfEvent_EvtInfo_VcEvMonISAR
          OpEventGetDebouncingOfEvent_GetDebouncingOfEvent_EvtInfo_GA_BLDC_FLT: RteEventRef=OpEventGetDebouncingOfEvent_GetDebouncingOfEvent_EvtInfo_GA_BLDC_FLT
          OpEventGetDebouncingOfEvent_GetDebouncingOfEvent_EvtInfo_INV_RSLVR_EXCT_ELEC_OPEN: RteEventRef=OpEventGetDebouncingOfEvent_GetDebouncingOfEvent_EvtInfo_INV_RSLVR_EXCT_ELEC_OPEN
          OpEventGetDebouncingOfEvent_GetDebouncingOfEvent_EvtInfo_INV_RSLVR_EXCT_PLAUS: RteEventRef=OpEventGetDebouncingOfEvent_GetDebouncingOfEvent_EvtInfo_INV_RSLVR_EXCT_PLAUS
          OpEventGetDebouncingOfEvent_GetDebouncingOfEvent_EvtInfo_PS_P15_U_FLT: RteEventRef=OpEventGetDebouncingOfEvent_GetDebouncingOfEvent_EvtInfo_PS_P15_U_FLT
          OpEventGetDebouncingOfEvent_GetDebouncingOfEvent_EvtInfo_INV_EM_STATOR_TEMP_RNG_SWT: RteEventRef=OpEventGetDebouncingOfEvent_GetDebouncingOfEvent_EvtInfo_INV_EM_STATOR_TEMP_RNG_SWT
          OpEventGetDebouncingOfEvent_GetDebouncingOfEvent_EvtInfo_INV_UHVDC_OV_SWP: RteEventRef=OpEventGetDebouncingOfEvent_GetDebouncingOfEvent_EvtInfo_INV_UHVDC_OV_SWP
          OpEventGetDebouncingOfEvent_GetDebouncingOfEvent_EvtInfo_AURIX_HW_FLT: RteEventRef=OpEventGetDebouncingOfEvent_GetDebouncingOfEvent_EvtInfo_AURIX_HW_FLT
          OpEventGetDebouncingOfEvent_GetDebouncingOfEvent_EvtInfo_INV_GATE_DRVR_TOP_HWP: RteEventRef=OpEventGetDebouncingOfEvent_GetDebouncingOfEvent_EvtInfo_INV_GATE_DRVR_TOP_HWP
          OpEventGetDebouncingOfEvent_GetDebouncingOfEvent_EvtInfo_INV_ACTV_DCHA_HW: RteEventRef=OpEventGetDebouncingOfEvent_GetDebouncingOfEvent_EvtInfo_INV_ACTV_DCHA_HW
          OpEventGetDebouncingOfEvent_GetDebouncingOfEvent_EvtInfo_INV_IGBT_TEMP_HWP: RteEventRef=OpEventGetDebouncingOfEvent_GetDebouncingOfEvent_EvtInfo_INV_IGBT_TEMP_HWP
          OpEventGetDebouncingOfEvent_GetDebouncingOfEvent_EvtInfo_INV_RSLVR_SIN_ELEC_FLT: RteEventRef=OpEventGetDebouncingOfEvent_GetDebouncingOfEvent_EvtInfo_INV_RSLVR_SIN_ELEC_FLT
          OpEventGetDebouncingOfEvent_GetDebouncingOfEvent_EvtInfo_CU_TEMP2_RNG_HI: RteEventRef=OpEventGetDebouncingOfEvent_GetDebouncingOfEvent_EvtInfo_CU_TEMP2_RNG_HI
          OpEventGetDebouncingOfEvent_GetDebouncingOfEvent_EvtInfo_INV_IAC_PHA_LOSS_MPL: RteEventRef=OpEventGetDebouncingOfEvent_GetDebouncingOfEvent_EvtInfo_INV_IAC_PHA_LOSS_MPL
          OpEventGetDebouncingOfEvent_GetDebouncingOfEvent_EvtInfo_INV_IAC_U_AMP: RteEventRef=OpEventGetDebouncingOfEvent_GetDebouncingOfEvent_EvtInfo_INV_IAC_U_AMP
          OpEventGetDebouncingOfEvent_GetDebouncingOfEvent_EvtInfo_PSnsr_GRADT_Flt: RteEventRef=OpEventGetDebouncingOfEvent_GetDebouncingOfEvent_EvtInfo_PSnsr_GRADT_Flt
          OpEventGetDebouncingOfEvent_GetDebouncingOfEvent_EvtInfo_AURIX_WATHDOG_FLT: RteEventRef=OpEventGetDebouncingOfEvent_GetDebouncingOfEvent_EvtInfo_AURIX_WATHDOG_FLT
          OpEventGetDebouncingOfEvent_GetDebouncingOfEvent_EvtInfo_VcEvNodeMisBECM: RteEventRef=OpEventGetDebouncingOfEvent_GetDebouncingOfEvent_EvtInfo_VcEvNodeMisBECM
          OpEventGetDebouncingOfEvent_GetDebouncingOfEvent_EvtInfo_INV_UHVDC_UV_HWP: RteEventRef=OpEventGetDebouncingOfEvent_GetDebouncingOfEvent_EvtInfo_INV_UHVDC_UV_HWP
          OpEventGetDebouncingOfEvent_GetDebouncingOfEvent_EvtInfo_VcEvMonESpd: RteEventRef=OpEventGetDebouncingOfEvent_GetDebouncingOfEvent_EvtInfo_VcEvMonESpd
          OpEventGetDebouncingOfEvent_GetDebouncingOfEvent_EvtInfo_COM_NotConfig: RteEventRef=OpEventGetDebouncingOfEvent_GetDebouncingOfEvent_EvtInfo_COM_NotConfig
          OpEventGetDebouncingOfEvent_GetDebouncingOfEvent_EvtInfo_INV_RSLVR_SIN_RNG_HI: RteEventRef=OpEventGetDebouncingOfEvent_GetDebouncingOfEvent_EvtInfo_INV_RSLVR_SIN_RNG_HI
          OpEventGetDebouncingOfEvent_GetDebouncingOfEvent_EvtInfo_INV_IGBT_TEMP_U_RNG_HI: RteEventRef=OpEventGetDebouncingOfEvent_GetDebouncingOfEvent_EvtInfo_INV_IGBT_TEMP_U_RNG_HI
          OpEventGetDebouncingOfEvent_GetDebouncingOfEvent_EvtInfo_VcEvMonMode_001: RteEventRef=OpEventGetDebouncingOfEvent_GetDebouncingOfEvent_EvtInfo_VcEvMonMode_001
          OpEventGetDebouncingOfEvent_GetDebouncingOfEvent_EvtInfo_PA_ACTION_FLT: RteEventRef=OpEventGetDebouncingOfEvent_GetDebouncingOfEvent_EvtInfo_PA_ACTION_FLT
          OpEventGetDebouncingOfEvent_GetDebouncingOfEvent_EvtInfo_INV_IAC_V_ELEC_HWP: RteEventRef=OpEventGetDebouncingOfEvent_GetDebouncingOfEvent_EvtInfo_INV_IAC_V_ELEC_HWP
          OpEventGetDebouncingOfEvent_GetDebouncingOfEvent_EvtInfo_CU_TEMP_HW_FLT_001: RteEventRef=OpEventGetDebouncingOfEvent_GetDebouncingOfEvent_EvtInfo_CU_TEMP_HW_FLT_001
          OpEventGetDebouncingOfEvent_GetDebouncingOfEvent_EvtInfo_VCC_UnderVoltage: RteEventRef=OpEventGetDebouncingOfEvent_GetDebouncingOfEvent_EvtInfo_VCC_UnderVoltage
          OpEventGetDebouncingOfEvent_GetDebouncingOfEvent_EvtInfo_VcEvTsttrPlaus: RteEventRef=OpEventGetDebouncingOfEvent_GetDebouncingOfEvent_EvtInfo_VcEvTsttrPlaus
          OpEventGetDebouncingOfEvent_GetDebouncingOfEvent_EvtInfo_INV_RSLVR_EXCT_ELEC_FLT: RteEventRef=OpEventGetDebouncingOfEvent_GetDebouncingOfEvent_EvtInfo_INV_RSLVR_EXCT_ELEC_FLT
          OpEventGetDebouncingOfEvent_GetDebouncingOfEvent_EvtInfo_INV_RSLVR_EXCT_RNG_LO: RteEventRef=OpEventGetDebouncingOfEvent_GetDebouncingOfEvent_EvtInfo_INV_RSLVR_EXCT_RNG_LO
          OpEventGetDebouncingOfEvent_GetDebouncingOfEvent_EvtInfo_INV_EM_STATOR_TEMP2_RNG_HI: RteEventRef=OpEventGetDebouncingOfEvent_GetDebouncingOfEvent_EvtInfo_INV_EM_STATOR_TEMP2_RNG_HI
          OpEventGetDebouncingOfEvent_GetDebouncingOfEvent_EvtInfo_INV_SHUT_OFF_PAH_START_UP: RteEventRef=OpEventGetDebouncingOfEvent_GetDebouncingOfEvent_EvtInfo_INV_SHUT_OFF_PAH_START_UP
          OpEventGetDebouncingOfEvent_GetDebouncingOfEvent_EvtInfo_VCEvVddmPropFr08Tioutd: RteEventRef=OpEventGetDebouncingOfEvent_GetDebouncingOfEvent_EvtInfo_VCEvVddmPropFr08Tioutd
          OpEventGetDebouncingOfEvent_GetDebouncingOfEvent_EvtInfo_INV_RSLVR_EXCT_OC_HWP_001: RteEventRef=OpEventGetDebouncingOfEvent_GetDebouncingOfEvent_EvtInfo_INV_RSLVR_EXCT_OC_HWP_001
          OpEventGetDebouncingOfEvent_GetDebouncingOfEvent_EvtInfo_INV_RSLVR_EXCT_OC_HWP_002: RteEventRef=OpEventGetDebouncingOfEvent_GetDebouncingOfEvent_EvtInfo_INV_RSLVR_EXCT_OC_HWP_002
          OpEventGetDebouncingOfEvent_GetDebouncingOfEvent_EvtInfo_INV_EM_STATOR_TEMP_ELE_FLT: RteEventRef=OpEventGetDebouncingOfEvent_GetDebouncingOfEvent_EvtInfo_INV_EM_STATOR_TEMP_ELE_FLT
          OpEventGetDebouncingOfEvent_GetDebouncingOfEvent_EvtInfo_INV_INTERLOCK_FLT: RteEventRef=OpEventGetDebouncingOfEvent_GetDebouncingOfEvent_EvtInfo_INV_INTERLOCK_FLT
          OpEventGetDebouncingOfEvent_GetDebouncingOfEvent_EvtInfo_Ga_ZeroFindDistanFailure: RteEventRef=OpEventGetDebouncingOfEvent_GetDebouncingOfEvent_EvtInfo_Ga_ZeroFindDistanFailure
          OpEventGetDebouncingOfEvent_GetDebouncingOfEvent_EvtInfo_PLOCK_Current_RNG_OUT: RteEventRef=OpEventGetDebouncingOfEvent_GetDebouncingOfEvent_EvtInfo_PLOCK_Current_RNG_OUT
          OpEventGetDebouncingOfEvent_GetDebouncingOfEvent_EvtInfo_VCEvVddmPropFr05Tioutd: RteEventRef=OpEventGetDebouncingOfEvent_GetDebouncingOfEvent_EvtInfo_VCEvVddmPropFr05Tioutd
          OpEventGetDebouncingOfEvent_GetDebouncingOfEvent_EvtInfo_INV_IGBT_TEMP_V_GRDT: RteEventRef=OpEventGetDebouncingOfEvent_GetDebouncingOfEvent_EvtInfo_INV_IGBT_TEMP_V_GRDT
          OpEventGetDebouncingOfEvent_GetDebouncingOfEvent_EvtInfo_PS_5V_Fault: RteEventRef=OpEventGetDebouncingOfEvent_GetDebouncingOfEvent_EvtInfo_PS_5V_Fault
          OpEventGetDebouncingOfEvent_GetDebouncingOfEvent_EvtInfo_VcEvCntrCrashStsSafe: RteEventRef=OpEventGetDebouncingOfEvent_GetDebouncingOfEvent_EvtInfo_VcEvCntrCrashStsSafe
          OpEventGetDebouncingOfEvent_GetDebouncingOfEvent_EvtInfo_INV_EM_STATOR_TEMP_GRDT: RteEventRef=OpEventGetDebouncingOfEvent_GetDebouncingOfEvent_EvtInfo_INV_EM_STATOR_TEMP_GRDT
          OpEventGetDebouncingOfEvent_GetDebouncingOfEvent_EvtInfo_PS_P15_V_FLT: RteEventRef=OpEventGetDebouncingOfEvent_GetDebouncingOfEvent_EvtInfo_PS_P15_V_FLT
          OpEventGetDebouncingOfEvent_GetDebouncingOfEvent_EvtInfo_INV_EM_STATOR_TEMP_RNG_NOK: RteEventRef=OpEventGetDebouncingOfEvent_GetDebouncingOfEvent_EvtInfo_INV_EM_STATOR_TEMP_RNG_NOK
          OpEventGetDebouncingOfEvent_GetDebouncingOfEvent_EvtInfo_INV_RSLVR_SIN_RNG_NOK: RteEventRef=OpEventGetDebouncingOfEvent_GetDebouncingOfEvent_EvtInfo_INV_RSLVR_SIN_RNG_NOK
          OpEventGetDebouncingOfEvent_GetDebouncingOfEvent_EvtInfo_INV_IAC_U_OFFS: RteEventRef=OpEventGetDebouncingOfEvent_GetDebouncingOfEvent_EvtInfo_INV_IAC_U_OFFS
          OpEventGetDebouncingOfEvent_GetDebouncingOfEvent_EvtInfo_PS_KL30_BACKUP_FLT: RteEventRef=OpEventGetDebouncingOfEvent_GetDebouncingOfEvent_EvtInfo_PS_KL30_BACKUP_FLT
          OpEventGetDebouncingOfEvent_GetDebouncingOfEvent_EvtInfo_INV_IGBT_TEMP_U_RNG_LO: RteEventRef=OpEventGetDebouncingOfEvent_GetDebouncingOfEvent_EvtInfo_INV_IGBT_TEMP_U_RNG_LO
          OpEventGetDebouncingOfEvent_GetDebouncingOfEvent_EvtInfo_INV_EM_STATOR_TEMP_HWP: RteEventRef=OpEventGetDebouncingOfEvent_GetDebouncingOfEvent_EvtInfo_INV_EM_STATOR_TEMP_HWP
          OpEventGetDebouncingOfEvent_GetDebouncingOfEvent_EvtInfo_CU_TEMP1_RNG_HI: RteEventRef=OpEventGetDebouncingOfEvent_GetDebouncingOfEvent_EvtInfo_CU_TEMP1_RNG_HI
          OpEventGetDebouncingOfEvent_GetDebouncingOfEvent_EvtInfo_INV_IGBT_TEMP_V_RNG_HI: RteEventRef=OpEventGetDebouncingOfEvent_GetDebouncingOfEvent_EvtInfo_INV_IGBT_TEMP_V_RNG_HI
          OpEventGetDebouncingOfEvent_GetDebouncingOfEvent_EvtInfo_VcEvNodeMisVDDM: RteEventRef=OpEventGetDebouncingOfEvent_GetDebouncingOfEvent_EvtInfo_VcEvNodeMisVDDM
          OpEventGetDebouncingOfEvent_GetDebouncingOfEvent_EvtInfo_INV_UHVDC_PLAUS: RteEventRef=OpEventGetDebouncingOfEvent_GetDebouncingOfEvent_EvtInfo_INV_UHVDC_PLAUS
          OpEventGetDebouncingOfEvent_GetDebouncingOfEvent_EvtInfo_INV_QUIESCENT_FLT: RteEventRef=OpEventGetDebouncingOfEvent_GetDebouncingOfEvent_EvtInfo_INV_QUIESCENT_FLT
          OpEventGetDebouncingOfEvent_GetDebouncingOfEvent_EvtInfo_INV_RSLVR_EXCT_RNG_HI: RteEventRef=OpEventGetDebouncingOfEvent_GetDebouncingOfEvent_EvtInfo_INV_RSLVR_EXCT_RNG_HI
          OpEventGetDebouncingOfEvent_GetDebouncingOfEvent_GeneralEvtInfo: RteEventRef=OpEventGetDebouncingOfEvent_GetDebouncingOfEvent_GeneralEvtInfo
          OpEventGetMonitorStatus_GetMonitorStatus_EvtInfo_VCEvBecmPropFr01Tioutd: RteEventRef=OpEventGetMonitorStatus_GetMonitorStatus_EvtInfo_VCEvBecmPropFr01Tioutd
          OpEventGetMonitorStatus_GetMonitorStatus_EvtInfo_INV_CU_TEMP2_RNG_NOK: RteEventRef=OpEventGetMonitorStatus_GetMonitorStatus_EvtInfo_INV_CU_TEMP2_RNG_NOK
          OpEventGetMonitorStatus_GetMonitorStatus_EvtInfo_COM_Busoff: RteEventRef=OpEventGetMonitorStatus_GetMonitorStatus_EvtInfo_COM_Busoff
          OpEventGetMonitorStatus_GetMonitorStatus_EvtInfo_INV_IMMO_NOKEY: RteEventRef=OpEventGetMonitorStatus_GetMonitorStatus_EvtInfo_INV_IMMO_NOKEY
          OpEventGetMonitorStatus_GetMonitorStatus_EvtInfo_INV_RSLVR_EXCT_OC_HWP: RteEventRef=OpEventGetMonitorStatus_GetMonitorStatus_EvtInfo_INV_RSLVR_EXCT_OC_HWP
          OpEventGetMonitorStatus_GetMonitorStatus_EvtInfo_PS_P15_W_FLT: RteEventRef=OpEventGetMonitorStatus_GetMonitorStatus_EvtInfo_PS_P15_W_FLT
          OpEventGetMonitorStatus_GetMonitorStatus_EvtInfo_INV_IAC_PLAUS_SUM: RteEventRef=OpEventGetMonitorStatus_GetMonitorStatus_EvtInfo_INV_IAC_PLAUS_SUM
          OpEventGetMonitorStatus_GetMonitorStatus_EvtInfo_PA_ELE_FLT: RteEventRef=OpEventGetMonitorStatus_GetMonitorStatus_EvtInfo_PA_ELE_FLT
          OpEventGetMonitorStatus_GetMonitorStatus_EvtInfo_CU_TEMP_GRDT: RteEventRef=OpEventGetMonitorStatus_GetMonitorStatus_EvtInfo_CU_TEMP_GRDT
          OpEventGetMonitorStatus_GetMonitorStatus_EvtInfo_INV_IGBT_TEMP_V_PLAUS: RteEventRef=OpEventGetMonitorStatus_GetMonitorStatus_EvtInfo_INV_IGBT_TEMP_V_PLAUS
          OpEventGetMonitorStatus_GetMonitorStatus_EvtInfo_Ga_GAEngageFailure: RteEventRef=OpEventGetMonitorStatus_GetMonitorStatus_EvtInfo_Ga_GAEngageFailure
          OpEventGetMonitorStatus_GetMonitorStatus_EvtInfo_INV_IAC_W_RNG_LO: RteEventRef=OpEventGetMonitorStatus_GetMonitorStatus_EvtInfo_INV_IAC_W_RNG_LO
          OpEventGetMonitorStatus_GetMonitorStatus_EvtInfo_PS_WhlSnsr_Vltg_FLT: RteEventRef=OpEventGetMonitorStatus_GetMonitorStatus_EvtInfo_PS_WhlSnsr_Vltg_FLT
          OpEventGetMonitorStatus_GetMonitorStatus_EvtInfo_VCEvEcmPropFr02Tioutd: RteEventRef=OpEventGetMonitorStatus_GetMonitorStatus_EvtInfo_VCEvEcmPropFr02Tioutd
          OpEventGetMonitorStatus_GetMonitorStatus_EvtInfo_Ga_TmSpdSyncFailed: RteEventRef=OpEventGetMonitorStatus_GetMonitorStatus_EvtInfo_Ga_TmSpdSyncFailed
          OpEventGetMonitorStatus_GetMonitorStatus_EvtInfo_INV_RSLVR_EXCT_ELEC_LO: RteEventRef=OpEventGetMonitorStatus_GetMonitorStatus_EvtInfo_INV_RSLVR_EXCT_ELEC_LO
          OpEventGetMonitorStatus_GetMonitorStatus_EvtInfo_VCEvEcmPropXevFr06Tioutd: RteEventRef=OpEventGetMonitorStatus_GetMonitorStatus_EvtInfo_VCEvEcmPropXevFr06Tioutd
          OpEventGetMonitorStatus_GetMonitorStatus_EvtInfo_VcEvCntrWhlMotSysTqAllwd: RteEventRef=OpEventGetMonitorStatus_GetMonitorStatus_EvtInfo_VcEvCntrWhlMotSysTqAllwd
          OpEventGetMonitorStatus_GetMonitorStatus_EvtInfo_INV_UHVDC_1_ELEC_HI: RteEventRef=OpEventGetMonitorStatus_GetMonitorStatus_EvtInfo_INV_UHVDC_1_ELEC_HI
          OpEventGetMonitorStatus_GetMonitorStatus_EvtInfo_INV_EM_STATOR_TEMP2_ELE_FLT: RteEventRef=OpEventGetMonitorStatus_GetMonitorStatus_EvtInfo_INV_EM_STATOR_TEMP2_ELE_FLT
          OpEventGetMonitorStatus_GetMonitorStatus_EvtInfo_AURIX_RST_SNG: RteEventRef=OpEventGetMonitorStatus_GetMonitorStatus_EvtInfo_AURIX_RST_SNG
          OpEventGetMonitorStatus_GetMonitorStatus_EvtInfo_VCEvEcmPropFr24MgmFr01Tioutd: RteEventRef=OpEventGetMonitorStatus_GetMonitorStatus_EvtInfo_VCEvEcmPropFr24MgmFr01Tioutd
          OpEventGetMonitorStatus_GetMonitorStatus_EvtInfo_INV_RSLVR_COS_ELEC_OPEN: RteEventRef=OpEventGetMonitorStatus_GetMonitorStatus_EvtInfo_INV_RSLVR_COS_ELEC_OPEN
          OpEventGetMonitorStatus_GetMonitorStatus_EvtInfo_INV_IAC_V_ELEC_LO: RteEventRef=OpEventGetMonitorStatus_GetMonitorStatus_EvtInfo_INV_IAC_V_ELEC_LO
          OpEventGetMonitorStatus_GetMonitorStatus_EvtInfo_INV_IAC_W_OFFS: RteEventRef=OpEventGetMonitorStatus_GetMonitorStatus_EvtInfo_INV_IAC_W_OFFS
          OpEventGetMonitorStatus_GetMonitorStatus_EvtInfo_INV_EM_STATOR_TEMP2_GRDT: RteEventRef=OpEventGetMonitorStatus_GetMonitorStatus_EvtInfo_INV_EM_STATOR_TEMP2_GRDT
          OpEventGetMonitorStatus_GetMonitorStatus_EvtInfo_INV_EM_OVRSPD_HWP: RteEventRef=OpEventGetMonitorStatus_GetMonitorStatus_EvtInfo_INV_EM_OVRSPD_HWP
          OpEventGetMonitorStatus_GetMonitorStatus_EvtInfo_CU_TEMP_HWP: RteEventRef=OpEventGetMonitorStatus_GetMonitorStatus_EvtInfo_CU_TEMP_HWP
          OpEventGetMonitorStatus_GetMonitorStatus_EvtInfo_INV_UHVDC_1_RNG_HI: RteEventRef=OpEventGetMonitorStatus_GetMonitorStatus_EvtInfo_INV_UHVDC_1_RNG_HI
          OpEventGetMonitorStatus_GetMonitorStatus_EvtInfo_VcEvEMPerfPlaus: RteEventRef=OpEventGetMonitorStatus_GetMonitorStatus_EvtInfo_VcEvEMPerfPlaus
          OpEventGetMonitorStatus_GetMonitorStatus_EvtInfo_VCEvVddmPropFr18Tioutd: RteEventRef=OpEventGetMonitorStatus_GetMonitorStatus_EvtInfo_VCEvVddmPropFr18Tioutd
          OpEventGetMonitorStatus_GetMonitorStatus_EvtInfo_INV_IAC_U_ELEC_HWP: RteEventRef=OpEventGetMonitorStatus_GetMonitorStatus_EvtInfo_INV_IAC_U_ELEC_HWP
          OpEventGetMonitorStatus_GetMonitorStatus_EvtInfo_VCEvVddmPropFr15Tioutd: RteEventRef=OpEventGetMonitorStatus_GetMonitorStatus_EvtInfo_VCEvVddmPropFr15Tioutd
          OpEventGetMonitorStatus_GetMonitorStatus_EvtInfo_Ga_GADisengageFailure: RteEventRef=OpEventGetMonitorStatus_GetMonitorStatus_EvtInfo_Ga_GADisengageFailure
          OpEventGetMonitorStatus_GetMonitorStatus_EvtInfo_CU_TEMP2_RNG_LO: RteEventRef=OpEventGetMonitorStatus_GetMonitorStatus_EvtInfo_CU_TEMP2_RNG_LO
          OpEventGetMonitorStatus_GetMonitorStatus_EvtInfo_INV_RSLVR_SIN_ELEC_OPEN: RteEventRef=OpEventGetMonitorStatus_GetMonitorStatus_EvtInfo_INV_RSLVR_SIN_ELEC_OPEN
          OpEventGetMonitorStatus_GetMonitorStatus_EvtInfo_VcEvChkSum: RteEventRef=OpEventGetMonitorStatus_GetMonitorStatus_EvtInfo_VcEvChkSum
          OpEventGetMonitorStatus_GetMonitorStatus_EvtInfo_PS_P5_UC_FLT: RteEventRef=OpEventGetMonitorStatus_GetMonitorStatus_EvtInfo_PS_P5_UC_FLT
          OpEventGetMonitorStatus_GetMonitorStatus_EvtInfo_INV_RSLVR_COS_ELEC_FLT: RteEventRef=OpEventGetMonitorStatus_GetMonitorStatus_EvtInfo_INV_RSLVR_COS_ELEC_FLT
          OpEventGetMonitorStatus_GetMonitorStatus_EvtInfo_INV_IAC_W_RNG_HI: RteEventRef=OpEventGetMonitorStatus_GetMonitorStatus_EvtInfo_INV_IAC_W_RNG_HI
          OpEventGetMonitorStatus_GetMonitorStatus_EvtInfo_PS_ECUSUPPLY_HIGH: RteEventRef=OpEventGetMonitorStatus_GetMonitorStatus_EvtInfo_PS_ECUSUPPLY_HIGH
          OpEventGetMonitorStatus_GetMonitorStatus_EvtInfo_VCEvEcmPropFr05Tioutd: RteEventRef=OpEventGetMonitorStatus_GetMonitorStatus_EvtInfo_VCEvEcmPropFr05Tioutd
          OpEventGetMonitorStatus_GetMonitorStatus_EvtInfo_PS_ECUSUPPLY_LOW: RteEventRef=OpEventGetMonitorStatus_GetMonitorStatus_EvtInfo_PS_ECUSUPPLY_LOW
          OpEventGetMonitorStatus_GetMonitorStatus_EvtInfo_VcEvChkSumHvSysRlySts: RteEventRef=OpEventGetMonitorStatus_GetMonitorStatus_EvtInfo_VcEvChkSumHvSysRlySts
          OpEventGetMonitorStatus_GetMonitorStatus_EvtInfo_VcEvMonMode: RteEventRef=OpEventGetMonitorStatus_GetMonitorStatus_EvtInfo_VcEvMonMode
          OpEventGetMonitorStatus_GetMonitorStatus_EvtInfo_INV_IAC_OC_SWP: RteEventRef=OpEventGetMonitorStatus_GetMonitorStatus_EvtInfo_INV_IAC_OC_SWP
          OpEventGetMonitorStatus_GetMonitorStatus_EvtInfo_INV_IMMO_AUTHFAIL: RteEventRef=OpEventGetMonitorStatus_GetMonitorStatus_EvtInfo_INV_IMMO_AUTHFAIL
          OpEventGetMonitorStatus_GetMonitorStatus_EvtInfo_PA_OpenCirc_FLT: RteEventRef=OpEventGetMonitorStatus_GetMonitorStatus_EvtInfo_PA_OpenCirc_FLT
          OpEventGetMonitorStatus_GetMonitorStatus_EvtInfo_INV_IAC_V_ELEC_HI: RteEventRef=OpEventGetMonitorStatus_GetMonitorStatus_EvtInfo_INV_IAC_V_ELEC_HI
          OpEventGetMonitorStatus_GetMonitorStatus_EvtInfo_VCEvEcmPropFr04Tioutd: RteEventRef=OpEventGetMonitorStatus_GetMonitorStatus_EvtInfo_VCEvEcmPropFr04Tioutd
          OpEventGetMonitorStatus_GetMonitorStatus_EvtInfo_VcEvMonTrqActPlaus: RteEventRef=OpEventGetMonitorStatus_GetMonitorStatus_EvtInfo_VcEvMonTrqActPlaus
          OpEventGetMonitorStatus_GetMonitorStatus_EvtInfo_VcEvMonTrqAct: RteEventRef=OpEventGetMonitorStatus_GetMonitorStatus_EvtInfo_VcEvMonTrqAct
          OpEventGetMonitorStatus_GetMonitorStatus_EvtInfo_INV_RSLVR_COS_ELEC_LO: RteEventRef=OpEventGetMonitorStatus_GetMonitorStatus_EvtInfo_INV_RSLVR_COS_ELEC_LO
          OpEventGetMonitorStatus_GetMonitorStatus_EvtInfo_INV_COOLT_INLET_TEMP_HWP: RteEventRef=OpEventGetMonitorStatus_GetMonitorStatus_EvtInfo_INV_COOLT_INLET_TEMP_HWP
          OpEventGetMonitorStatus_GetMonitorStatus_EvtInfo_VCEvEcmPropFr11Tioutd: RteEventRef=OpEventGetMonitorStatus_GetMonitorStatus_EvtInfo_VCEvEcmPropFr11Tioutd
          OpEventGetMonitorStatus_GetMonitorStatus_EvtInfo_PS_KL30_RNG_HI: RteEventRef=OpEventGetMonitorStatus_GetMonitorStatus_EvtInfo_PS_KL30_RNG_HI
          OpEventGetMonitorStatus_GetMonitorStatus_EvtInfo_INV_IAC_OC_HWP: RteEventRef=OpEventGetMonitorStatus_GetMonitorStatus_EvtInfo_INV_IAC_OC_HWP
          OpEventGetMonitorStatus_GetMonitorStatus_EvtInfo_INV_RSLVR_COS_RNG_HI: RteEventRef=OpEventGetMonitorStatus_GetMonitorStatus_EvtInfo_INV_RSLVR_COS_RNG_HI
          OpEventGetMonitorStatus_GetMonitorStatus_EvtInfo_INV_IAC_U_ELEC_HI: RteEventRef=OpEventGetMonitorStatus_GetMonitorStatus_EvtInfo_INV_IAC_U_ELEC_HI
          OpEventGetMonitorStatus_GetMonitorStatus_EvtInfo_INV_IAC_V_RNG_LO: RteEventRef=OpEventGetMonitorStatus_GetMonitorStatus_EvtInfo_INV_IAC_V_RNG_LO
          OpEventGetMonitorStatus_GetMonitorStatus_EvtInfo_INV_IAC_U_RNG_HI: RteEventRef=OpEventGetMonitorStatus_GetMonitorStatus_EvtInfo_INV_IAC_U_RNG_HI
          OpEventGetMonitorStatus_GetMonitorStatus_EvtInfo_VCEvEcmPropFr25Tioutd: RteEventRef=OpEventGetMonitorStatus_GetMonitorStatus_EvtInfo_VCEvEcmPropFr25Tioutd
          OpEventGetMonitorStatus_GetMonitorStatus_EvtInfo_INV_IGBT_TEMP_W_RNG_LO: RteEventRef=OpEventGetMonitorStatus_GetMonitorStatus_EvtInfo_INV_IGBT_TEMP_W_RNG_LO
          OpEventGetMonitorStatus_GetMonitorStatus_EvtInfo_PSnsr_RNG_NOK: RteEventRef=OpEventGetMonitorStatus_GetMonitorStatus_EvtInfo_PSnsr_RNG_NOK
          OpEventGetMonitorStatus_GetMonitorStatus_EvtInfo_INV_RSLVR_COS_RNG_NOK: RteEventRef=OpEventGetMonitorStatus_GetMonitorStatus_EvtInfo_INV_RSLVR_COS_RNG_NOK
          OpEventGetMonitorStatus_GetMonitorStatus_EvtInfo_PS_DRVB_Fault: RteEventRef=OpEventGetMonitorStatus_GetMonitorStatus_EvtInfo_PS_DRVB_Fault
          OpEventGetMonitorStatus_GetMonitorStatus_EvtInfo_INV_CU_TEMP1_RNG_NOK: RteEventRef=OpEventGetMonitorStatus_GetMonitorStatus_EvtInfo_INV_CU_TEMP1_RNG_NOK
          OpEventGetMonitorStatus_GetMonitorStatus_EvtInfo_VcEvCntr: RteEventRef=OpEventGetMonitorStatus_GetMonitorStatus_EvtInfo_VcEvCntr
          OpEventGetMonitorStatus_GetMonitorStatus_EvtInfo_INV_RSLVR_SIN_AMP: RteEventRef=OpEventGetMonitorStatus_GetMonitorStatus_EvtInfo_INV_RSLVR_SIN_AMP
          OpEventGetMonitorStatus_GetMonitorStatus_EvtInfo_INV_UHVDC_2_RNG_HI: RteEventRef=OpEventGetMonitorStatus_GetMonitorStatus_EvtInfo_INV_UHVDC_2_RNG_HI
          OpEventGetMonitorStatus_GetMonitorStatus_EvtInfo_INV_IGBT_TEMP_U_GRDT: RteEventRef=OpEventGetMonitorStatus_GetMonitorStatus_EvtInfo_INV_IGBT_TEMP_U_GRDT
          OpEventGetMonitorStatus_GetMonitorStatus_EvtInfo_MON_TQ_PLAUS_PWR_MDL: RteEventRef=OpEventGetMonitorStatus_GetMonitorStatus_EvtInfo_MON_TQ_PLAUS_PWR_MDL
          OpEventGetMonitorStatus_GetMonitorStatus_EvtInfo_INV_IGBT_TEMP_W_PLAUS: RteEventRef=OpEventGetMonitorStatus_GetMonitorStatus_EvtInfo_INV_IGBT_TEMP_W_PLAUS
          OpEventGetMonitorStatus_GetMonitorStatus_EvtInfo_PS_BLDC_UV_FLT: RteEventRef=OpEventGetMonitorStatus_GetMonitorStatus_EvtInfo_PS_BLDC_UV_FLT
          OpEventGetMonitorStatus_GetMonitorStatus_EvtInfo_INV_IAC_V_OFFS: RteEventRef=OpEventGetMonitorStatus_GetMonitorStatus_EvtInfo_INV_IAC_V_OFFS
          OpEventGetMonitorStatus_GetMonitorStatus_EvtInfo_INV_RSLVR_EXCT_FREQ_RNG_NOK: RteEventRef=OpEventGetMonitorStatus_GetMonitorStatus_EvtInfo_INV_RSLVR_EXCT_FREQ_RNG_NOK
          OpEventGetMonitorStatus_GetMonitorStatus_EvtInfo_PS_KL30_RNG_LO: RteEventRef=OpEventGetMonitorStatus_GetMonitorStatus_EvtInfo_PS_KL30_RNG_LO
          OpEventGetMonitorStatus_GetMonitorStatus_EvtInfo_INV_RSLVR_COS_RNG_LO: RteEventRef=OpEventGetMonitorStatus_GetMonitorStatus_EvtInfo_INV_RSLVR_COS_RNG_LO
          OpEventGetMonitorStatus_GetMonitorStatus_EvtInfo_PSnsr_ELE_FLT: RteEventRef=OpEventGetMonitorStatus_GetMonitorStatus_EvtInfo_PSnsr_ELE_FLT
          OpEventGetMonitorStatus_GetMonitorStatus_EvtInfo_INV_RSLVR_SIN_COS_PLAUS_AMP: RteEventRef=OpEventGetMonitorStatus_GetMonitorStatus_EvtInfo_INV_RSLVR_SIN_COS_PLAUS_AMP
          OpEventGetMonitorStatus_GetMonitorStatus_EvtInfo_INV_IAC_U_ELEC_LO: RteEventRef=OpEventGetMonitorStatus_GetMonitorStatus_EvtInfo_INV_IAC_U_ELEC_LO
          OpEventGetMonitorStatus_GetMonitorStatus_EvtInfo_INV_RSLVR_EXCT_ELEC_HI: RteEventRef=OpEventGetMonitorStatus_GetMonitorStatus_EvtInfo_INV_RSLVR_EXCT_ELEC_HI
          OpEventGetMonitorStatus_GetMonitorStatus_EvtInfo_INV_IAC_U_RNG_LO: RteEventRef=OpEventGetMonitorStatus_GetMonitorStatus_EvtInfo_INV_IAC_U_RNG_LO
          OpEventGetMonitorStatus_GetMonitorStatus_EvtInfo_INV_IAC_V_RNG_HI: RteEventRef=OpEventGetMonitorStatus_GetMonitorStatus_EvtInfo_INV_IAC_V_RNG_HI
          OpEventGetMonitorStatus_GetMonitorStatus_EvtInfo_INV_IGBT_TEMP_U_PLAUS: RteEventRef=OpEventGetMonitorStatus_GetMonitorStatus_EvtInfo_INV_IGBT_TEMP_U_PLAUS
          OpEventGetMonitorStatus_GetMonitorStatus_EvtInfo_INV_RSLVR_OFFS_DFT: RteEventRef=OpEventGetMonitorStatus_GetMonitorStatus_EvtInfo_INV_RSLVR_OFFS_DFT
          OpEventGetMonitorStatus_GetMonitorStatus_EvtInfo_Ga_MoveOverThd: RteEventRef=OpEventGetMonitorStatus_GetMonitorStatus_EvtInfo_Ga_MoveOverThd
          OpEventGetMonitorStatus_GetMonitorStatus_EvtInfo_VcEvMonIPH: RteEventRef=OpEventGetMonitorStatus_GetMonitorStatus_EvtInfo_VcEvMonIPH
          OpEventGetMonitorStatus_GetMonitorStatus_EvtInfo_INV_RSLVR_HW_FLT: RteEventRef=OpEventGetMonitorStatus_GetMonitorStatus_EvtInfo_INV_RSLVR_HW_FLT
          OpEventGetMonitorStatus_GetMonitorStatus_EvtInfo_INV_RSLVR_SIN_ELEC_LO: RteEventRef=OpEventGetMonitorStatus_GetMonitorStatus_EvtInfo_INV_RSLVR_SIN_ELEC_LO
          OpEventGetMonitorStatus_GetMonitorStatus_EvtInfo_INV_IAC_W_AMP: RteEventRef=OpEventGetMonitorStatus_GetMonitorStatus_EvtInfo_INV_IAC_W_AMP
          OpEventGetMonitorStatus_GetMonitorStatus_EvtInfo_VCC_OverVoltage: RteEventRef=OpEventGetMonitorStatus_GetMonitorStatus_EvtInfo_VCC_OverVoltage
          OpEventGetMonitorStatus_GetMonitorStatus_EvtInfo_PS_BLDC_OV_FLT: RteEventRef=OpEventGetMonitorStatus_GetMonitorStatus_EvtInfo_PS_BLDC_OV_FLT
          OpEventGetMonitorStatus_GetMonitorStatus_EvtInfo_AURIX_EEPROM_FLT: RteEventRef=OpEventGetMonitorStatus_GetMonitorStatus_EvtInfo_AURIX_EEPROM_FLT
          OpEventGetMonitorStatus_GetMonitorStatus_EvtInfo_FS_MONITIOR_ASC_FW_FLT: RteEventRef=OpEventGetMonitorStatus_GetMonitorStatus_EvtInfo_FS_MONITIOR_ASC_FW_FLT
          OpEventGetMonitorStatus_GetMonitorStatus_EvtInfo_VCEvSrsPropFr02Tioutd: RteEventRef=OpEventGetMonitorStatus_GetMonitorStatus_EvtInfo_VCEvSrsPropFr02Tioutd
          OpEventGetMonitorStatus_GetMonitorStatus_EvtInfo_VcEvMonErrMode: RteEventRef=OpEventGetMonitorStatus_GetMonitorStatus_EvtInfo_VcEvMonErrMode
          OpEventGetMonitorStatus_GetMonitorStatus_EvtInfo_AURIX_RST_MPL: RteEventRef=OpEventGetMonitorStatus_GetMonitorStatus_EvtInfo_AURIX_RST_MPL
          OpEventGetMonitorStatus_GetMonitorStatus_EvtInfo_VcEvNodeMisECM: RteEventRef=OpEventGetMonitorStatus_GetMonitorStatus_EvtInfo_VcEvNodeMisECM
          OpEventGetMonitorStatus_GetMonitorStatus_EvtInfo_PS_KL30_PLAUS: RteEventRef=OpEventGetMonitorStatus_GetMonitorStatus_EvtInfo_PS_KL30_PLAUS
          OpEventGetMonitorStatus_GetMonitorStatus_EvtInfo_INV_IAC_W_ELEC_HI: RteEventRef=OpEventGetMonitorStatus_GetMonitorStatus_EvtInfo_INV_IAC_W_ELEC_HI
          OpEventGetMonitorStatus_GetMonitorStatus_EvtInfo_VCEvVddmPropFr19Tioutd: RteEventRef=OpEventGetMonitorStatus_GetMonitorStatus_EvtInfo_VCEvVddmPropFr19Tioutd
          OpEventGetMonitorStatus_GetMonitorStatus_EvtInfo_INV_TEMP_DCHA_HW: RteEventRef=OpEventGetMonitorStatus_GetMonitorStatus_EvtInfo_INV_TEMP_DCHA_HW
          OpEventGetMonitorStatus_GetMonitorStatus_EvtInfo_VcEvPropCANGlbTiOutd: RteEventRef=OpEventGetMonitorStatus_GetMonitorStatus_EvtInfo_VcEvPropCANGlbTiOutd
          OpEventGetMonitorStatus_GetMonitorStatus_EvtInfo_INV_EM_STATOR_TEMP2_RNG_NOK: RteEventRef=OpEventGetMonitorStatus_GetMonitorStatus_EvtInfo_INV_EM_STATOR_TEMP2_RNG_NOK
          OpEventGetMonitorStatus_GetMonitorStatus_EvtInfo_INV_UHVDC_OV_HWP: RteEventRef=OpEventGetMonitorStatus_GetMonitorStatus_EvtInfo_INV_UHVDC_OV_HWP
          OpEventGetMonitorStatus_GetMonitorStatus_EvtInfo_Ga_FindEngleAngleFailed: RteEventRef=OpEventGetMonitorStatus_GetMonitorStatus_EvtInfo_Ga_FindEngleAngleFailed
          OpEventGetMonitorStatus_GetMonitorStatus_EvtInfo_VcEvMonTrqCmp: RteEventRef=OpEventGetMonitorStatus_GetMonitorStatus_EvtInfo_VcEvMonTrqCmp
          OpEventGetMonitorStatus_GetMonitorStatus_EvtInfo_INV_IGBT_TEMP_V_RNG_LO: RteEventRef=OpEventGetMonitorStatus_GetMonitorStatus_EvtInfo_INV_IGBT_TEMP_V_RNG_LO
          OpEventGetMonitorStatus_GetMonitorStatus_EvtInfo_INV_CONTROL_LIMIT: RteEventRef=OpEventGetMonitorStatus_GetMonitorStatus_EvtInfo_INV_CONTROL_LIMIT
          OpEventGetMonitorStatus_GetMonitorStatus_EvtInfo_COM_CarConfigErr: RteEventRef=OpEventGetMonitorStatus_GetMonitorStatus_EvtInfo_COM_CarConfigErr
          OpEventGetMonitorStatus_GetMonitorStatus_EvtInfo_VCEvEcmPropFr08Tioutd: RteEventRef=OpEventGetMonitorStatus_GetMonitorStatus_EvtInfo_VCEvEcmPropFr08Tioutd
          OpEventGetMonitorStatus_GetMonitorStatus_EvtInfo_CU_TEMP1_RNG_LO: RteEventRef=OpEventGetMonitorStatus_GetMonitorStatus_EvtInfo_CU_TEMP1_RNG_LO
          OpEventGetMonitorStatus_GetMonitorStatus_EvtInfo_INV_EM_STATOR_TEMP2_RNG_SWT: RteEventRef=OpEventGetMonitorStatus_GetMonitorStatus_EvtInfo_INV_EM_STATOR_TEMP2_RNG_SWT
          OpEventGetMonitorStatus_GetMonitorStatus_EvtInfo_GA_BLDC_POS_FLT: RteEventRef=OpEventGetMonitorStatus_GetMonitorStatus_EvtInfo_GA_BLDC_POS_FLT
          OpEventGetMonitorStatus_GetMonitorStatus_EvtInfo_PS_WhlSnsr_FLT: RteEventRef=OpEventGetMonitorStatus_GetMonitorStatus_EvtInfo_PS_WhlSnsr_FLT
          OpEventGetMonitorStatus_GetMonitorStatus_EvtInfo_INV_EM_STATOR_TEMP_RNG_LO: RteEventRef=OpEventGetMonitorStatus_GetMonitorStatus_EvtInfo_INV_EM_STATOR_TEMP_RNG_LO
          OpEventGetMonitorStatus_GetMonitorStatus_EvtInfo_INV_RSLVR_SIN_ELEC_HI: RteEventRef=OpEventGetMonitorStatus_GetMonitorStatus_EvtInfo_INV_RSLVR_SIN_ELEC_HI
          OpEventGetMonitorStatus_GetMonitorStatus_EvtInfo_INV_RSLVR_SIN_COS_PLAUS: RteEventRef=OpEventGetMonitorStatus_GetMonitorStatus_EvtInfo_INV_RSLVR_SIN_COS_PLAUS
          OpEventGetMonitorStatus_GetMonitorStatus_EvtInfo_INV_RSLVR_COS_AMP: RteEventRef=OpEventGetMonitorStatus_GetMonitorStatus_EvtInfo_INV_RSLVR_COS_AMP
          OpEventGetMonitorStatus_GetMonitorStatus_EvtInfo_INV_GATE_DRVR_BOT_HWP: RteEventRef=OpEventGetMonitorStatus_GetMonitorStatus_EvtInfo_INV_GATE_DRVR_BOT_HWP
          OpEventGetMonitorStatus_GetMonitorStatus_EvtInfo_Eg_HallVolWrong: RteEventRef=OpEventGetMonitorStatus_GetMonitorStatus_EvtInfo_Eg_HallVolWrong
          OpEventGetMonitorStatus_GetMonitorStatus_EvtInfo_INV_RSLVR_EXCT_RNG_NOK: RteEventRef=OpEventGetMonitorStatus_GetMonitorStatus_EvtInfo_INV_RSLVR_EXCT_RNG_NOK
          OpEventGetMonitorStatus_GetMonitorStatus_EvtInfo_PA_OpenCirc: RteEventRef=OpEventGetMonitorStatus_GetMonitorStatus_EvtInfo_PA_OpenCirc
          OpEventGetMonitorStatus_GetMonitorStatus_EvtInfo_INV_RSLVR_COS_ELEC_HI: RteEventRef=OpEventGetMonitorStatus_GetMonitorStatus_EvtInfo_INV_RSLVR_COS_ELEC_HI
          OpEventGetMonitorStatus_GetMonitorStatus_EvtInfo_VcEvCntrHvSysRlySts: RteEventRef=OpEventGetMonitorStatus_GetMonitorStatus_EvtInfo_VcEvCntrHvSysRlySts
          OpEventGetMonitorStatus_GetMonitorStatus_EvtInfo_CRASH_DTC: RteEventRef=OpEventGetMonitorStatus_GetMonitorStatus_EvtInfo_CRASH_DTC
          OpEventGetMonitorStatus_GetMonitorStatus_EvtInfo_INV_IGBT_TEMP_W_RNG_HI: RteEventRef=OpEventGetMonitorStatus_GetMonitorStatus_EvtInfo_INV_IGBT_TEMP_W_RNG_HI
          OpEventGetMonitorStatus_GetMonitorStatus_EvtInfo_VCEvBecmPropFr02Tioutd: RteEventRef=OpEventGetMonitorStatus_GetMonitorStatus_EvtInfo_VCEvBecmPropFr02Tioutd
          OpEventGetMonitorStatus_GetMonitorStatus_EvtInfo_INV_IGBT_TEMP_W_GRDT: RteEventRef=OpEventGetMonitorStatus_GetMonitorStatus_EvtInfo_INV_IGBT_TEMP_W_GRDT
          OpEventGetMonitorStatus_GetMonitorStatus_EvtInfo_EXT_UC_SPI_FLT: RteEventRef=OpEventGetMonitorStatus_GetMonitorStatus_EvtInfo_EXT_UC_SPI_FLT
          OpEventGetMonitorStatus_GetMonitorStatus_EvtInfo_INV_IAC_V_ELEC_HWP_001: RteEventRef=OpEventGetMonitorStatus_GetMonitorStatus_EvtInfo_INV_IAC_V_ELEC_HWP_001
          OpEventGetMonitorStatus_GetMonitorStatus_EvtInfo_VcEvChkSumWhlMotSysTqAllwd: RteEventRef=OpEventGetMonitorStatus_GetMonitorStatus_EvtInfo_VcEvChkSumWhlMotSysTqAllwd
          OpEventGetMonitorStatus_GetMonitorStatus_EvtInfo_FS_MONITIOR_ASC_FLT: RteEventRef=OpEventGetMonitorStatus_GetMonitorStatus_EvtInfo_FS_MONITIOR_ASC_FLT
          OpEventGetMonitorStatus_GetMonitorStatus_EvtInfo_INV_IAC_V_AMP: RteEventRef=OpEventGetMonitorStatus_GetMonitorStatus_EvtInfo_INV_IAC_V_AMP
          OpEventGetMonitorStatus_GetMonitorStatus_EvtInfo_INV_IAC_W_ELEC_LO: RteEventRef=OpEventGetMonitorStatus_GetMonitorStatus_EvtInfo_INV_IAC_W_ELEC_LO
          OpEventGetMonitorStatus_GetMonitorStatus_EvtInfo_VCEvVddmPropFr08Tioutd_001: RteEventRef=OpEventGetMonitorStatus_GetMonitorStatus_EvtInfo_VCEvVddmPropFr08Tioutd_001
          OpEventGetMonitorStatus_GetMonitorStatus_EvtInfo_PS_P12_RES_FLT: RteEventRef=OpEventGetMonitorStatus_GetMonitorStatus_EvtInfo_PS_P12_RES_FLT
          OpEventGetMonitorStatus_GetMonitorStatus_EvtInfo_INV_RSLVR_SIN_RNG_LO: RteEventRef=OpEventGetMonitorStatus_GetMonitorStatus_EvtInfo_INV_RSLVR_SIN_RNG_LO
          OpEventGetMonitorStatus_GetMonitorStatus_EvtInfo_CU_TEMP_HW_FLT: RteEventRef=OpEventGetMonitorStatus_GetMonitorStatus_EvtInfo_CU_TEMP_HW_FLT
          OpEventGetMonitorStatus_GetMonitorStatus_EvtInfo_VCEvEcmPropFr02MgmFr00Tioutd: RteEventRef=OpEventGetMonitorStatus_GetMonitorStatus_EvtInfo_VCEvEcmPropFr02MgmFr00Tioutd
          OpEventGetMonitorStatus_GetMonitorStatus_EvtInfo_PS_KL15_RNG_HI: RteEventRef=OpEventGetMonitorStatus_GetMonitorStatus_EvtInfo_PS_KL15_RNG_HI
          OpEventGetMonitorStatus_GetMonitorStatus_EvtInfo_VCEvVddmPropFr17Tioutd: RteEventRef=OpEventGetMonitorStatus_GetMonitorStatus_EvtInfo_VCEvVddmPropFr17Tioutd
          OpEventGetMonitorStatus_GetMonitorStatus_EvtInfo_VcEvChkSumCrashStsSafe: RteEventRef=OpEventGetMonitorStatus_GetMonitorStatus_EvtInfo_VcEvChkSumCrashStsSafe
          OpEventGetMonitorStatus_GetMonitorStatus_EvtInfo_DiagC_ClutchService: RteEventRef=OpEventGetMonitorStatus_GetMonitorStatus_EvtInfo_DiagC_ClutchService
          OpEventGetMonitorStatus_GetMonitorStatus_EvtInfo_INV_EM_STATOR_TEMP_RNG_HI: RteEventRef=OpEventGetMonitorStatus_GetMonitorStatus_EvtInfo_INV_EM_STATOR_TEMP_RNG_HI
          OpEventGetMonitorStatus_GetMonitorStatus_EvtInfo_INV_RSLVR_OFFS_OUT_RANG: RteEventRef=OpEventGetMonitorStatus_GetMonitorStatus_EvtInfo_INV_RSLVR_OFFS_OUT_RANG
          OpEventGetMonitorStatus_GetMonitorStatus_EvtInfo_INV_EM_STATOR_TEMP2_RNG_LO: RteEventRef=OpEventGetMonitorStatus_GetMonitorStatus_EvtInfo_INV_EM_STATOR_TEMP2_RNG_LO
          OpEventGetMonitorStatus_GetMonitorStatus_EvtInfo_VcEvMonISAR: RteEventRef=OpEventGetMonitorStatus_GetMonitorStatus_EvtInfo_VcEvMonISAR
          OpEventGetMonitorStatus_GetMonitorStatus_EvtInfo_GA_BLDC_FLT: RteEventRef=OpEventGetMonitorStatus_GetMonitorStatus_EvtInfo_GA_BLDC_FLT
          OpEventGetMonitorStatus_GetMonitorStatus_EvtInfo_INV_RSLVR_EXCT_ELEC_OPEN: RteEventRef=OpEventGetMonitorStatus_GetMonitorStatus_EvtInfo_INV_RSLVR_EXCT_ELEC_OPEN
          OpEventGetMonitorStatus_GetMonitorStatus_EvtInfo_INV_RSLVR_EXCT_PLAUS: RteEventRef=OpEventGetMonitorStatus_GetMonitorStatus_EvtInfo_INV_RSLVR_EXCT_PLAUS
          OpEventGetMonitorStatus_GetMonitorStatus_EvtInfo_PS_P15_U_FLT: RteEventRef=OpEventGetMonitorStatus_GetMonitorStatus_EvtInfo_PS_P15_U_FLT
          OpEventGetMonitorStatus_GetMonitorStatus_EvtInfo_INV_EM_STATOR_TEMP_RNG_SWT: RteEventRef=OpEventGetMonitorStatus_GetMonitorStatus_EvtInfo_INV_EM_STATOR_TEMP_RNG_SWT
          OpEventGetMonitorStatus_GetMonitorStatus_EvtInfo_INV_UHVDC_OV_SWP: RteEventRef=OpEventGetMonitorStatus_GetMonitorStatus_EvtInfo_INV_UHVDC_OV_SWP
          OpEventGetMonitorStatus_GetMonitorStatus_EvtInfo_AURIX_HW_FLT: RteEventRef=OpEventGetMonitorStatus_GetMonitorStatus_EvtInfo_AURIX_HW_FLT
          OpEventGetMonitorStatus_GetMonitorStatus_EvtInfo_INV_GATE_DRVR_TOP_HWP: RteEventRef=OpEventGetMonitorStatus_GetMonitorStatus_EvtInfo_INV_GATE_DRVR_TOP_HWP
          OpEventGetMonitorStatus_GetMonitorStatus_EvtInfo_INV_ACTV_DCHA_HW: RteEventRef=OpEventGetMonitorStatus_GetMonitorStatus_EvtInfo_INV_ACTV_DCHA_HW
          OpEventGetMonitorStatus_GetMonitorStatus_EvtInfo_INV_IGBT_TEMP_HWP: RteEventRef=OpEventGetMonitorStatus_GetMonitorStatus_EvtInfo_INV_IGBT_TEMP_HWP
          OpEventGetMonitorStatus_GetMonitorStatus_EvtInfo_INV_RSLVR_SIN_ELEC_FLT: RteEventRef=OpEventGetMonitorStatus_GetMonitorStatus_EvtInfo_INV_RSLVR_SIN_ELEC_FLT
          OpEventGetMonitorStatus_GetMonitorStatus_EvtInfo_CU_TEMP2_RNG_HI: RteEventRef=OpEventGetMonitorStatus_GetMonitorStatus_EvtInfo_CU_TEMP2_RNG_HI
          OpEventGetMonitorStatus_GetMonitorStatus_EvtInfo_INV_IAC_PHA_LOSS_MPL: RteEventRef=OpEventGetMonitorStatus_GetMonitorStatus_EvtInfo_INV_IAC_PHA_LOSS_MPL
          OpEventGetMonitorStatus_GetMonitorStatus_EvtInfo_INV_IAC_U_AMP: RteEventRef=OpEventGetMonitorStatus_GetMonitorStatus_EvtInfo_INV_IAC_U_AMP
          OpEventGetMonitorStatus_GetMonitorStatus_EvtInfo_PSnsr_GRADT_Flt: RteEventRef=OpEventGetMonitorStatus_GetMonitorStatus_EvtInfo_PSnsr_GRADT_Flt
          OpEventGetMonitorStatus_GetMonitorStatus_EvtInfo_AURIX_WATHDOG_FLT: RteEventRef=OpEventGetMonitorStatus_GetMonitorStatus_EvtInfo_AURIX_WATHDOG_FLT
          OpEventGetMonitorStatus_GetMonitorStatus_EvtInfo_VcEvNodeMisBECM: RteEventRef=OpEventGetMonitorStatus_GetMonitorStatus_EvtInfo_VcEvNodeMisBECM
          OpEventGetMonitorStatus_GetMonitorStatus_EvtInfo_INV_UHVDC_UV_HWP: RteEventRef=OpEventGetMonitorStatus_GetMonitorStatus_EvtInfo_INV_UHVDC_UV_HWP
          OpEventGetMonitorStatus_GetMonitorStatus_EvtInfo_VcEvMonESpd: RteEventRef=OpEventGetMonitorStatus_GetMonitorStatus_EvtInfo_VcEvMonESpd
          OpEventGetMonitorStatus_GetMonitorStatus_EvtInfo_COM_NotConfig: RteEventRef=OpEventGetMonitorStatus_GetMonitorStatus_EvtInfo_COM_NotConfig
          OpEventGetMonitorStatus_GetMonitorStatus_EvtInfo_INV_RSLVR_SIN_RNG_HI: RteEventRef=OpEventGetMonitorStatus_GetMonitorStatus_EvtInfo_INV_RSLVR_SIN_RNG_HI
          OpEventGetMonitorStatus_GetMonitorStatus_EvtInfo_INV_IGBT_TEMP_U_RNG_HI: RteEventRef=OpEventGetMonitorStatus_GetMonitorStatus_EvtInfo_INV_IGBT_TEMP_U_RNG_HI
          OpEventGetMonitorStatus_GetMonitorStatus_EvtInfo_VcEvMonMode_001: RteEventRef=OpEventGetMonitorStatus_GetMonitorStatus_EvtInfo_VcEvMonMode_001
          OpEventGetMonitorStatus_GetMonitorStatus_EvtInfo_PA_ACTION_FLT: RteEventRef=OpEventGetMonitorStatus_GetMonitorStatus_EvtInfo_PA_ACTION_FLT
          OpEventGetMonitorStatus_GetMonitorStatus_EvtInfo_INV_IAC_V_ELEC_HWP: RteEventRef=OpEventGetMonitorStatus_GetMonitorStatus_EvtInfo_INV_IAC_V_ELEC_HWP
          OpEventGetMonitorStatus_GetMonitorStatus_EvtInfo_CU_TEMP_HW_FLT_001: RteEventRef=OpEventGetMonitorStatus_GetMonitorStatus_EvtInfo_CU_TEMP_HW_FLT_001
          OpEventGetMonitorStatus_GetMonitorStatus_EvtInfo_VCC_UnderVoltage: RteEventRef=OpEventGetMonitorStatus_GetMonitorStatus_EvtInfo_VCC_UnderVoltage
          OpEventGetMonitorStatus_GetMonitorStatus_EvtInfo_VcEvTsttrPlaus: RteEventRef=OpEventGetMonitorStatus_GetMonitorStatus_EvtInfo_VcEvTsttrPlaus
          OpEventGetMonitorStatus_GetMonitorStatus_EvtInfo_INV_RSLVR_EXCT_ELEC_FLT: RteEventRef=OpEventGetMonitorStatus_GetMonitorStatus_EvtInfo_INV_RSLVR_EXCT_ELEC_FLT
          OpEventGetMonitorStatus_GetMonitorStatus_EvtInfo_INV_RSLVR_EXCT_RNG_LO: RteEventRef=OpEventGetMonitorStatus_GetMonitorStatus_EvtInfo_INV_RSLVR_EXCT_RNG_LO
          OpEventGetMonitorStatus_GetMonitorStatus_EvtInfo_INV_EM_STATOR_TEMP2_RNG_HI: RteEventRef=OpEventGetMonitorStatus_GetMonitorStatus_EvtInfo_INV_EM_STATOR_TEMP2_RNG_HI
          OpEventGetMonitorStatus_GetMonitorStatus_EvtInfo_INV_SHUT_OFF_PAH_START_UP: RteEventRef=OpEventGetMonitorStatus_GetMonitorStatus_EvtInfo_INV_SHUT_OFF_PAH_START_UP
          OpEventGetMonitorStatus_GetMonitorStatus_EvtInfo_VCEvVddmPropFr08Tioutd: RteEventRef=OpEventGetMonitorStatus_GetMonitorStatus_EvtInfo_VCEvVddmPropFr08Tioutd
          OpEventGetMonitorStatus_GetMonitorStatus_EvtInfo_INV_RSLVR_EXCT_OC_HWP_001: RteEventRef=OpEventGetMonitorStatus_GetMonitorStatus_EvtInfo_INV_RSLVR_EXCT_OC_HWP_001
          OpEventGetMonitorStatus_GetMonitorStatus_EvtInfo_INV_RSLVR_EXCT_OC_HWP_002: RteEventRef=OpEventGetMonitorStatus_GetMonitorStatus_EvtInfo_INV_RSLVR_EXCT_OC_HWP_002
          OpEventGetMonitorStatus_GetMonitorStatus_EvtInfo_INV_EM_STATOR_TEMP_ELE_FLT: RteEventRef=OpEventGetMonitorStatus_GetMonitorStatus_EvtInfo_INV_EM_STATOR_TEMP_ELE_FLT
          OpEventGetMonitorStatus_GetMonitorStatus_EvtInfo_INV_INTERLOCK_FLT: RteEventRef=OpEventGetMonitorStatus_GetMonitorStatus_EvtInfo_INV_INTERLOCK_FLT
          OpEventGetMonitorStatus_GetMonitorStatus_EvtInfo_Ga_ZeroFindDistanFailure: RteEventRef=OpEventGetMonitorStatus_GetMonitorStatus_EvtInfo_Ga_ZeroFindDistanFailure
          OpEventGetMonitorStatus_GetMonitorStatus_EvtInfo_PLOCK_Current_RNG_OUT: RteEventRef=OpEventGetMonitorStatus_GetMonitorStatus_EvtInfo_PLOCK_Current_RNG_OUT
          OpEventGetMonitorStatus_GetMonitorStatus_EvtInfo_VCEvVddmPropFr05Tioutd: RteEventRef=OpEventGetMonitorStatus_GetMonitorStatus_EvtInfo_VCEvVddmPropFr05Tioutd
          OpEventGetMonitorStatus_GetMonitorStatus_EvtInfo_INV_IGBT_TEMP_V_GRDT: RteEventRef=OpEventGetMonitorStatus_GetMonitorStatus_EvtInfo_INV_IGBT_TEMP_V_GRDT
          OpEventGetMonitorStatus_GetMonitorStatus_EvtInfo_PS_5V_Fault: RteEventRef=OpEventGetMonitorStatus_GetMonitorStatus_EvtInfo_PS_5V_Fault
          OpEventGetMonitorStatus_GetMonitorStatus_EvtInfo_VcEvCntrCrashStsSafe: RteEventRef=OpEventGetMonitorStatus_GetMonitorStatus_EvtInfo_VcEvCntrCrashStsSafe
          OpEventGetMonitorStatus_GetMonitorStatus_EvtInfo_INV_EM_STATOR_TEMP_GRDT: RteEventRef=OpEventGetMonitorStatus_GetMonitorStatus_EvtInfo_INV_EM_STATOR_TEMP_GRDT
          OpEventGetMonitorStatus_GetMonitorStatus_EvtInfo_PS_P15_V_FLT: RteEventRef=OpEventGetMonitorStatus_GetMonitorStatus_EvtInfo_PS_P15_V_FLT
          OpEventGetMonitorStatus_GetMonitorStatus_EvtInfo_INV_EM_STATOR_TEMP_RNG_NOK: RteEventRef=OpEventGetMonitorStatus_GetMonitorStatus_EvtInfo_INV_EM_STATOR_TEMP_RNG_NOK
          OpEventGetMonitorStatus_GetMonitorStatus_EvtInfo_INV_RSLVR_SIN_RNG_NOK: RteEventRef=OpEventGetMonitorStatus_GetMonitorStatus_EvtInfo_INV_RSLVR_SIN_RNG_NOK
          OpEventGetMonitorStatus_GetMonitorStatus_EvtInfo_INV_IAC_U_OFFS: RteEventRef=OpEventGetMonitorStatus_GetMonitorStatus_EvtInfo_INV_IAC_U_OFFS
          OpEventGetMonitorStatus_GetMonitorStatus_EvtInfo_PS_KL30_BACKUP_FLT: RteEventRef=OpEventGetMonitorStatus_GetMonitorStatus_EvtInfo_PS_KL30_BACKUP_FLT
          OpEventGetMonitorStatus_GetMonitorStatus_EvtInfo_INV_IGBT_TEMP_U_RNG_LO: RteEventRef=OpEventGetMonitorStatus_GetMonitorStatus_EvtInfo_INV_IGBT_TEMP_U_RNG_LO
          OpEventGetMonitorStatus_GetMonitorStatus_EvtInfo_INV_EM_STATOR_TEMP_HWP: RteEventRef=OpEventGetMonitorStatus_GetMonitorStatus_EvtInfo_INV_EM_STATOR_TEMP_HWP
          OpEventGetMonitorStatus_GetMonitorStatus_EvtInfo_CU_TEMP1_RNG_HI: RteEventRef=OpEventGetMonitorStatus_GetMonitorStatus_EvtInfo_CU_TEMP1_RNG_HI
          OpEventGetMonitorStatus_GetMonitorStatus_EvtInfo_INV_IGBT_TEMP_V_RNG_HI: RteEventRef=OpEventGetMonitorStatus_GetMonitorStatus_EvtInfo_INV_IGBT_TEMP_V_RNG_HI
          OpEventGetMonitorStatus_GetMonitorStatus_EvtInfo_VcEvNodeMisVDDM: RteEventRef=OpEventGetMonitorStatus_GetMonitorStatus_EvtInfo_VcEvNodeMisVDDM
          OpEventGetMonitorStatus_GetMonitorStatus_EvtInfo_INV_UHVDC_PLAUS: RteEventRef=OpEventGetMonitorStatus_GetMonitorStatus_EvtInfo_INV_UHVDC_PLAUS
          OpEventGetMonitorStatus_GetMonitorStatus_EvtInfo_INV_QUIESCENT_FLT: RteEventRef=OpEventGetMonitorStatus_GetMonitorStatus_EvtInfo_INV_QUIESCENT_FLT
          OpEventGetMonitorStatus_GetMonitorStatus_EvtInfo_INV_RSLVR_EXCT_RNG_HI: RteEventRef=OpEventGetMonitorStatus_GetMonitorStatus_EvtInfo_INV_RSLVR_EXCT_RNG_HI
          OpEventGetMonitorStatus_GetMonitorStatus_GeneralEvtInfo: RteEventRef=OpEventGetMonitorStatus_GetMonitorStatus_GeneralEvtInfo
          OpEventSetEventStatus_SetEventStatus_Event_VCEvBecmPropFr01Tioutd: RteEventRef=OpEventSetEventStatus_SetEventStatus_Event_VCEvBecmPropFr01Tioutd
          OpEventSetEventStatus_SetEventStatus_Event_INV_CU_TEMP2_RNG_NOK: RteEventRef=OpEventSetEventStatus_SetEventStatus_Event_INV_CU_TEMP2_RNG_NOK
          OpEventSetEventStatus_SetEventStatus_Event_COM_Busoff: RteEventRef=OpEventSetEventStatus_SetEventStatus_Event_COM_Busoff
          OpEventSetEventStatus_SetEventStatus_Event_INV_IMMO_NOKEY: RteEventRef=OpEventSetEventStatus_SetEventStatus_Event_INV_IMMO_NOKEY
          OpEventSetEventStatus_SetEventStatus_Event_INV_RSLVR_EXCT_OC_HWP: RteEventRef=OpEventSetEventStatus_SetEventStatus_Event_INV_RSLVR_EXCT_OC_HWP
          OpEventSetEventStatus_SetEventStatus_Event_PS_P15_W_FLT: RteEventRef=OpEventSetEventStatus_SetEventStatus_Event_PS_P15_W_FLT
          OpEventSetEventStatus_SetEventStatus_Event_INV_IAC_PLAUS_SUM: RteEventRef=OpEventSetEventStatus_SetEventStatus_Event_INV_IAC_PLAUS_SUM
          OpEventSetEventStatus_SetEventStatus_Event_PA_ELE_FLT: RteEventRef=OpEventSetEventStatus_SetEventStatus_Event_PA_ELE_FLT
          OpEventSetEventStatus_SetEventStatus_Event_CU_TEMP_GRDT: RteEventRef=OpEventSetEventStatus_SetEventStatus_Event_CU_TEMP_GRDT
          OpEventSetEventStatus_SetEventStatus_Event_INV_IGBT_TEMP_V_PLAUS: RteEventRef=OpEventSetEventStatus_SetEventStatus_Event_INV_IGBT_TEMP_V_PLAUS
          OpEventSetEventStatus_SetEventStatus_Event_Ga_GAEngageFailure: RteEventRef=OpEventSetEventStatus_SetEventStatus_Event_Ga_GAEngageFailure
          OpEventSetEventStatus_SetEventStatus_Event_INV_IAC_W_RNG_LO: RteEventRef=OpEventSetEventStatus_SetEventStatus_Event_INV_IAC_W_RNG_LO
          OpEventSetEventStatus_SetEventStatus_Event_PS_WhlSnsr_Vltg_FLT: RteEventRef=OpEventSetEventStatus_SetEventStatus_Event_PS_WhlSnsr_Vltg_FLT
          OpEventSetEventStatus_SetEventStatus_Event_VCEvEcmPropFr02Tioutd: RteEventRef=OpEventSetEventStatus_SetEventStatus_Event_VCEvEcmPropFr02Tioutd
          OpEventSetEventStatus_SetEventStatus_Event_Ga_TmSpdSyncFailed: RteEventRef=OpEventSetEventStatus_SetEventStatus_Event_Ga_TmSpdSyncFailed
          OpEventSetEventStatus_SetEventStatus_Event_INV_RSLVR_EXCT_ELEC_LO: RteEventRef=OpEventSetEventStatus_SetEventStatus_Event_INV_RSLVR_EXCT_ELEC_LO
          OpEventSetEventStatus_SetEventStatus_Event_VCEvEcmPropXevFr06Tioutd: RteEventRef=OpEventSetEventStatus_SetEventStatus_Event_VCEvEcmPropXevFr06Tioutd
          OpEventSetEventStatus_SetEventStatus_Event_VcEvCntrWhlMotSysTqAllwd: RteEventRef=OpEventSetEventStatus_SetEventStatus_Event_VcEvCntrWhlMotSysTqAllwd
          OpEventSetEventStatus_SetEventStatus_Event_INV_UHVDC_1_ELEC_HI: RteEventRef=OpEventSetEventStatus_SetEventStatus_Event_INV_UHVDC_1_ELEC_HI
          OpEventSetEventStatus_SetEventStatus_Event_INV_EM_STATOR_TEMP2_ELE_FLT: RteEventRef=OpEventSetEventStatus_SetEventStatus_Event_INV_EM_STATOR_TEMP2_ELE_FLT
          OpEventSetEventStatus_SetEventStatus_Event_AURIX_RST_SNG: RteEventRef=OpEventSetEventStatus_SetEventStatus_Event_AURIX_RST_SNG
          OpEventSetEventStatus_SetEventStatus_Event_VCEvEcmPropFr24MgmFr01Tioutd: RteEventRef=OpEventSetEventStatus_SetEventStatus_Event_VCEvEcmPropFr24MgmFr01Tioutd
          OpEventSetEventStatus_SetEventStatus_Event_INV_RSLVR_COS_ELEC_OPEN: RteEventRef=OpEventSetEventStatus_SetEventStatus_Event_INV_RSLVR_COS_ELEC_OPEN
          OpEventSetEventStatus_SetEventStatus_Event_INV_IAC_V_ELEC_LO: RteEventRef=OpEventSetEventStatus_SetEventStatus_Event_INV_IAC_V_ELEC_LO
          OpEventSetEventStatus_SetEventStatus_Event_INV_IAC_W_OFFS: RteEventRef=OpEventSetEventStatus_SetEventStatus_Event_INV_IAC_W_OFFS
          OpEventSetEventStatus_SetEventStatus_Event_INV_EM_STATOR_TEMP2_GRDT: RteEventRef=OpEventSetEventStatus_SetEventStatus_Event_INV_EM_STATOR_TEMP2_GRDT
          OpEventSetEventStatus_SetEventStatus_Event_INV_EM_OVRSPD_HWP: RteEventRef=OpEventSetEventStatus_SetEventStatus_Event_INV_EM_OVRSPD_HWP
          OpEventSetEventStatus_SetEventStatus_Event_CU_TEMP_HWP: RteEventRef=OpEventSetEventStatus_SetEventStatus_Event_CU_TEMP_HWP
          OpEventSetEventStatus_SetEventStatus_Event_INV_UHVDC_1_RNG_HI: RteEventRef=OpEventSetEventStatus_SetEventStatus_Event_INV_UHVDC_1_RNG_HI
          OpEventSetEventStatus_SetEventStatus_Event_VcEvEMPerfPlaus: RteEventRef=OpEventSetEventStatus_SetEventStatus_Event_VcEvEMPerfPlaus
          OpEventSetEventStatus_SetEventStatus_Event_VCEvVddmPropFr18Tioutd: RteEventRef=OpEventSetEventStatus_SetEventStatus_Event_VCEvVddmPropFr18Tioutd
          OpEventSetEventStatus_SetEventStatus_Event_INV_IAC_U_ELEC_HWP: RteEventRef=OpEventSetEventStatus_SetEventStatus_Event_INV_IAC_U_ELEC_HWP
          OpEventSetEventStatus_SetEventStatus_Event_VCEvVddmPropFr15Tioutd: RteEventRef=OpEventSetEventStatus_SetEventStatus_Event_VCEvVddmPropFr15Tioutd
          OpEventSetEventStatus_SetEventStatus_Event_Ga_GADisengageFailure: RteEventRef=OpEventSetEventStatus_SetEventStatus_Event_Ga_GADisengageFailure
          OpEventSetEventStatus_SetEventStatus_Event_CU_TEMP2_RNG_LO: RteEventRef=OpEventSetEventStatus_SetEventStatus_Event_CU_TEMP2_RNG_LO
          OpEventSetEventStatus_SetEventStatus_Event_INV_RSLVR_SIN_ELEC_OPEN: RteEventRef=OpEventSetEventStatus_SetEventStatus_Event_INV_RSLVR_SIN_ELEC_OPEN
          OpEventSetEventStatus_SetEventStatus_Event_VcEvChkSum: RteEventRef=OpEventSetEventStatus_SetEventStatus_Event_VcEvChkSum
          OpEventSetEventStatus_SetEventStatus_Event_PS_P5_UC_FLT: RteEventRef=OpEventSetEventStatus_SetEventStatus_Event_PS_P5_UC_FLT
          OpEventSetEventStatus_SetEventStatus_Event_INV_RSLVR_COS_ELEC_FLT: RteEventRef=OpEventSetEventStatus_SetEventStatus_Event_INV_RSLVR_COS_ELEC_FLT
          OpEventSetEventStatus_SetEventStatus_Event_INV_IAC_W_RNG_HI: RteEventRef=OpEventSetEventStatus_SetEventStatus_Event_INV_IAC_W_RNG_HI
          OpEventSetEventStatus_SetEventStatus_Event_PS_ECUSUPPLY_HIGH: RteEventRef=OpEventSetEventStatus_SetEventStatus_Event_PS_ECUSUPPLY_HIGH
          OpEventSetEventStatus_SetEventStatus_Event_VCEvEcmPropFr05Tioutd: RteEventRef=OpEventSetEventStatus_SetEventStatus_Event_VCEvEcmPropFr05Tioutd
          OpEventSetEventStatus_SetEventStatus_Event_PS_ECUSUPPLY_LOW: RteEventRef=OpEventSetEventStatus_SetEventStatus_Event_PS_ECUSUPPLY_LOW
          OpEventSetEventStatus_SetEventStatus_Event_VcEvChkSumHvSysRlySts: RteEventRef=OpEventSetEventStatus_SetEventStatus_Event_VcEvChkSumHvSysRlySts
          OpEventSetEventStatus_SetEventStatus_Event_VcEvMonMode: RteEventRef=OpEventSetEventStatus_SetEventStatus_Event_VcEvMonMode
          OpEventSetEventStatus_SetEventStatus_Event_INV_IAC_OC_SWP: RteEventRef=OpEventSetEventStatus_SetEventStatus_Event_INV_IAC_OC_SWP
          OpEventSetEventStatus_SetEventStatus_Event_INV_IMMO_AUTHFAIL: RteEventRef=OpEventSetEventStatus_SetEventStatus_Event_INV_IMMO_AUTHFAIL
          OpEventSetEventStatus_SetEventStatus_Event_PA_OpenCirc_FLT: RteEventRef=OpEventSetEventStatus_SetEventStatus_Event_PA_OpenCirc_FLT
          OpEventSetEventStatus_SetEventStatus_Event_INV_IAC_V_ELEC_HI: RteEventRef=OpEventSetEventStatus_SetEventStatus_Event_INV_IAC_V_ELEC_HI
          OpEventSetEventStatus_SetEventStatus_Event_VCEvEcmPropFr04Tioutd: RteEventRef=OpEventSetEventStatus_SetEventStatus_Event_VCEvEcmPropFr04Tioutd
          OpEventSetEventStatus_SetEventStatus_Event_VcEvMonTrqActPlaus: RteEventRef=OpEventSetEventStatus_SetEventStatus_Event_VcEvMonTrqActPlaus
          OpEventSetEventStatus_SetEventStatus_Event_VcEvMonTrqAct: RteEventRef=OpEventSetEventStatus_SetEventStatus_Event_VcEvMonTrqAct
          OpEventSetEventStatus_SetEventStatus_Event_INV_RSLVR_COS_ELEC_LO: RteEventRef=OpEventSetEventStatus_SetEventStatus_Event_INV_RSLVR_COS_ELEC_LO
          OpEventSetEventStatus_SetEventStatus_Event_INV_COOLT_INLET_TEMP_HWP: RteEventRef=OpEventSetEventStatus_SetEventStatus_Event_INV_COOLT_INLET_TEMP_HWP
          OpEventSetEventStatus_SetEventStatus_Event_VCEvEcmPropFr11Tioutd: RteEventRef=OpEventSetEventStatus_SetEventStatus_Event_VCEvEcmPropFr11Tioutd
          OpEventSetEventStatus_SetEventStatus_Event_PS_KL30_RNG_HI: RteEventRef=OpEventSetEventStatus_SetEventStatus_Event_PS_KL30_RNG_HI
          OpEventSetEventStatus_SetEventStatus_Event_INV_IAC_OC_HWP: RteEventRef=OpEventSetEventStatus_SetEventStatus_Event_INV_IAC_OC_HWP
          OpEventSetEventStatus_SetEventStatus_Event_INV_RSLVR_COS_RNG_HI: RteEventRef=OpEventSetEventStatus_SetEventStatus_Event_INV_RSLVR_COS_RNG_HI
          OpEventSetEventStatus_SetEventStatus_Event_INV_IAC_U_ELEC_HI: RteEventRef=OpEventSetEventStatus_SetEventStatus_Event_INV_IAC_U_ELEC_HI
          OpEventSetEventStatus_SetEventStatus_Event_INV_IAC_V_RNG_LO: RteEventRef=OpEventSetEventStatus_SetEventStatus_Event_INV_IAC_V_RNG_LO
          OpEventSetEventStatus_SetEventStatus_Event_INV_IAC_U_RNG_HI: RteEventRef=OpEventSetEventStatus_SetEventStatus_Event_INV_IAC_U_RNG_HI
          OpEventSetEventStatus_SetEventStatus_Event_VCEvEcmPropFr25Tioutd: RteEventRef=OpEventSetEventStatus_SetEventStatus_Event_VCEvEcmPropFr25Tioutd
          OpEventSetEventStatus_SetEventStatus_Event_INV_IGBT_TEMP_W_RNG_LO: RteEventRef=OpEventSetEventStatus_SetEventStatus_Event_INV_IGBT_TEMP_W_RNG_LO
          OpEventSetEventStatus_SetEventStatus_Event_PSnsr_RNG_NOK: RteEventRef=OpEventSetEventStatus_SetEventStatus_Event_PSnsr_RNG_NOK
          OpEventSetEventStatus_SetEventStatus_Event_INV_RSLVR_COS_RNG_NOK: RteEventRef=OpEventSetEventStatus_SetEventStatus_Event_INV_RSLVR_COS_RNG_NOK
          OpEventSetEventStatus_SetEventStatus_Event_PS_DRVB_Fault: RteEventRef=OpEventSetEventStatus_SetEventStatus_Event_PS_DRVB_Fault
          OpEventSetEventStatus_SetEventStatus_Event_INV_CU_TEMP1_RNG_NOK: RteEventRef=OpEventSetEventStatus_SetEventStatus_Event_INV_CU_TEMP1_RNG_NOK
          OpEventSetEventStatus_SetEventStatus_Event_VcEvCntr: RteEventRef=OpEventSetEventStatus_SetEventStatus_Event_VcEvCntr
          OpEventSetEventStatus_SetEventStatus_Event_INV_RSLVR_SIN_AMP: RteEventRef=OpEventSetEventStatus_SetEventStatus_Event_INV_RSLVR_SIN_AMP
          OpEventSetEventStatus_SetEventStatus_Event_INV_UHVDC_2_RNG_HI: RteEventRef=OpEventSetEventStatus_SetEventStatus_Event_INV_UHVDC_2_RNG_HI
          OpEventSetEventStatus_SetEventStatus_Event_INV_IGBT_TEMP_U_GRDT: RteEventRef=OpEventSetEventStatus_SetEventStatus_Event_INV_IGBT_TEMP_U_GRDT
          OpEventSetEventStatus_SetEventStatus_Event_MON_TQ_PLAUS_PWR_MDL: RteEventRef=OpEventSetEventStatus_SetEventStatus_Event_MON_TQ_PLAUS_PWR_MDL
          OpEventSetEventStatus_SetEventStatus_Event_INV_IGBT_TEMP_W_PLAUS: RteEventRef=OpEventSetEventStatus_SetEventStatus_Event_INV_IGBT_TEMP_W_PLAUS
          OpEventSetEventStatus_SetEventStatus_Event_PS_BLDC_UV_FLT: RteEventRef=OpEventSetEventStatus_SetEventStatus_Event_PS_BLDC_UV_FLT
          OpEventSetEventStatus_SetEventStatus_Event_INV_IAC_V_OFFS: RteEventRef=OpEventSetEventStatus_SetEventStatus_Event_INV_IAC_V_OFFS
          OpEventSetEventStatus_SetEventStatus_Event_INV_RSLVR_EXCT_FREQ_RNG_NOK: RteEventRef=OpEventSetEventStatus_SetEventStatus_Event_INV_RSLVR_EXCT_FREQ_RNG_NOK
          OpEventSetEventStatus_SetEventStatus_Event_PS_KL30_RNG_LO: RteEventRef=OpEventSetEventStatus_SetEventStatus_Event_PS_KL30_RNG_LO
          OpEventSetEventStatus_SetEventStatus_Event_INV_RSLVR_COS_RNG_LO: RteEventRef=OpEventSetEventStatus_SetEventStatus_Event_INV_RSLVR_COS_RNG_LO
          OpEventSetEventStatus_SetEventStatus_Event_PSnsr_ELE_FLT: RteEventRef=OpEventSetEventStatus_SetEventStatus_Event_PSnsr_ELE_FLT
          OpEventSetEventStatus_SetEventStatus_Event_INV_RSLVR_SIN_COS_PLAUS_AMP: RteEventRef=OpEventSetEventStatus_SetEventStatus_Event_INV_RSLVR_SIN_COS_PLAUS_AMP
          OpEventSetEventStatus_SetEventStatus_Event_INV_IAC_U_ELEC_LO: RteEventRef=OpEventSetEventStatus_SetEventStatus_Event_INV_IAC_U_ELEC_LO
          OpEventSetEventStatus_SetEventStatus_Event_INV_RSLVR_EXCT_ELEC_HI: RteEventRef=OpEventSetEventStatus_SetEventStatus_Event_INV_RSLVR_EXCT_ELEC_HI
          OpEventSetEventStatus_SetEventStatus_Event_INV_IAC_U_RNG_LO: RteEventRef=OpEventSetEventStatus_SetEventStatus_Event_INV_IAC_U_RNG_LO
          OpEventSetEventStatus_SetEventStatus_Event_INV_IAC_V_RNG_HI: RteEventRef=OpEventSetEventStatus_SetEventStatus_Event_INV_IAC_V_RNG_HI
          OpEventSetEventStatus_SetEventStatus_Event_INV_IGBT_TEMP_U_PLAUS: RteEventRef=OpEventSetEventStatus_SetEventStatus_Event_INV_IGBT_TEMP_U_PLAUS
          OpEventSetEventStatus_SetEventStatus_Event_INV_RSLVR_OFFS_DFT: RteEventRef=OpEventSetEventStatus_SetEventStatus_Event_INV_RSLVR_OFFS_DFT
          OpEventSetEventStatus_SetEventStatus_Event_Ga_MoveOverThd: RteEventRef=OpEventSetEventStatus_SetEventStatus_Event_Ga_MoveOverThd
          OpEventSetEventStatus_SetEventStatus_Event_VcEvMonIPH: RteEventRef=OpEventSetEventStatus_SetEventStatus_Event_VcEvMonIPH
          OpEventSetEventStatus_SetEventStatus_Event_INV_RSLVR_HW_FLT: RteEventRef=OpEventSetEventStatus_SetEventStatus_Event_INV_RSLVR_HW_FLT
          OpEventSetEventStatus_SetEventStatus_Event_INV_RSLVR_SIN_ELEC_LO: RteEventRef=OpEventSetEventStatus_SetEventStatus_Event_INV_RSLVR_SIN_ELEC_LO
          OpEventSetEventStatus_SetEventStatus_Event_INV_IAC_W_AMP: RteEventRef=OpEventSetEventStatus_SetEventStatus_Event_INV_IAC_W_AMP
          OpEventSetEventStatus_SetEventStatus_Event_VCC_OverVoltage: RteEventRef=OpEventSetEventStatus_SetEventStatus_Event_VCC_OverVoltage
          OpEventSetEventStatus_SetEventStatus_Event_PS_BLDC_OV_FLT: RteEventRef=OpEventSetEventStatus_SetEventStatus_Event_PS_BLDC_OV_FLT
          OpEventSetEventStatus_SetEventStatus_Event_AURIX_EEPROM_FLT: RteEventRef=OpEventSetEventStatus_SetEventStatus_Event_AURIX_EEPROM_FLT
          OpEventSetEventStatus_SetEventStatus_Event_FS_MONITIOR_ASC_FW_FLT: RteEventRef=OpEventSetEventStatus_SetEventStatus_Event_FS_MONITIOR_ASC_FW_FLT
          OpEventSetEventStatus_SetEventStatus_Event_VCEvSrsPropFr02Tioutd: RteEventRef=OpEventSetEventStatus_SetEventStatus_Event_VCEvSrsPropFr02Tioutd
          OpEventSetEventStatus_SetEventStatus_Event_VcEvMonErrMode: RteEventRef=OpEventSetEventStatus_SetEventStatus_Event_VcEvMonErrMode
          OpEventSetEventStatus_SetEventStatus_Event_AURIX_RST_MPL: RteEventRef=OpEventSetEventStatus_SetEventStatus_Event_AURIX_RST_MPL
          OpEventSetEventStatus_SetEventStatus_Event_VcEvNodeMisECM: RteEventRef=OpEventSetEventStatus_SetEventStatus_Event_VcEvNodeMisECM
          OpEventSetEventStatus_SetEventStatus_Event_PS_KL30_PLAUS: RteEventRef=OpEventSetEventStatus_SetEventStatus_Event_PS_KL30_PLAUS
          OpEventSetEventStatus_SetEventStatus_Event_INV_IAC_W_ELEC_HI: RteEventRef=OpEventSetEventStatus_SetEventStatus_Event_INV_IAC_W_ELEC_HI
          OpEventSetEventStatus_SetEventStatus_Event_VCEvVddmPropFr19Tioutd: RteEventRef=OpEventSetEventStatus_SetEventStatus_Event_VCEvVddmPropFr19Tioutd
          OpEventSetEventStatus_SetEventStatus_Event_INV_TEMP_DCHA_HW: RteEventRef=OpEventSetEventStatus_SetEventStatus_Event_INV_TEMP_DCHA_HW
          OpEventSetEventStatus_SetEventStatus_Event_VcEvPropCANGlbTiOutd: RteEventRef=OpEventSetEventStatus_SetEventStatus_Event_VcEvPropCANGlbTiOutd
          OpEventSetEventStatus_SetEventStatus_Event_INV_EM_STATOR_TEMP2_RNG_NOK: RteEventRef=OpEventSetEventStatus_SetEventStatus_Event_INV_EM_STATOR_TEMP2_RNG_NOK
          OpEventSetEventStatus_SetEventStatus_Event_INV_UHVDC_OV_HWP: RteEventRef=OpEventSetEventStatus_SetEventStatus_Event_INV_UHVDC_OV_HWP
          OpEventSetEventStatus_SetEventStatus_Event_Ga_FindEngleAngleFailed: RteEventRef=OpEventSetEventStatus_SetEventStatus_Event_Ga_FindEngleAngleFailed
          OpEventSetEventStatus_SetEventStatus_Event_VcEvMonTrqCmp: RteEventRef=OpEventSetEventStatus_SetEventStatus_Event_VcEvMonTrqCmp
          OpEventSetEventStatus_SetEventStatus_Event_INV_IGBT_TEMP_V_RNG_LO: RteEventRef=OpEventSetEventStatus_SetEventStatus_Event_INV_IGBT_TEMP_V_RNG_LO
          OpEventSetEventStatus_SetEventStatus_Event_INV_CONTROL_LIMIT: RteEventRef=OpEventSetEventStatus_SetEventStatus_Event_INV_CONTROL_LIMIT
          OpEventSetEventStatus_SetEventStatus_Event_COM_CarConfigErr: RteEventRef=OpEventSetEventStatus_SetEventStatus_Event_COM_CarConfigErr
          OpEventSetEventStatus_SetEventStatus_Event_VCEvEcmPropFr08Tioutd: RteEventRef=OpEventSetEventStatus_SetEventStatus_Event_VCEvEcmPropFr08Tioutd
          OpEventSetEventStatus_SetEventStatus_Event_CU_TEMP1_RNG_LO: RteEventRef=OpEventSetEventStatus_SetEventStatus_Event_CU_TEMP1_RNG_LO
          OpEventSetEventStatus_SetEventStatus_Event_INV_EM_STATOR_TEMP2_RNG_SWT: RteEventRef=OpEventSetEventStatus_SetEventStatus_Event_INV_EM_STATOR_TEMP2_RNG_SWT
          OpEventSetEventStatus_SetEventStatus_Event_GA_BLDC_POS_FLT: RteEventRef=OpEventSetEventStatus_SetEventStatus_Event_GA_BLDC_POS_FLT
          OpEventSetEventStatus_SetEventStatus_Event_PS_WhlSnsr_FLT: RteEventRef=OpEventSetEventStatus_SetEventStatus_Event_PS_WhlSnsr_FLT
          OpEventSetEventStatus_SetEventStatus_Event_INV_EM_STATOR_TEMP_RNG_LO: RteEventRef=OpEventSetEventStatus_SetEventStatus_Event_INV_EM_STATOR_TEMP_RNG_LO
          OpEventSetEventStatus_SetEventStatus_Event_INV_RSLVR_SIN_ELEC_HI: RteEventRef=OpEventSetEventStatus_SetEventStatus_Event_INV_RSLVR_SIN_ELEC_HI
          OpEventSetEventStatus_SetEventStatus_Event_INV_RSLVR_SIN_COS_PLAUS: RteEventRef=OpEventSetEventStatus_SetEventStatus_Event_INV_RSLVR_SIN_COS_PLAUS
          OpEventSetEventStatus_SetEventStatus_Event_INV_RSLVR_COS_AMP: RteEventRef=OpEventSetEventStatus_SetEventStatus_Event_INV_RSLVR_COS_AMP
          OpEventSetEventStatus_SetEventStatus_Event_INV_GATE_DRVR_BOT_HWP: RteEventRef=OpEventSetEventStatus_SetEventStatus_Event_INV_GATE_DRVR_BOT_HWP
          OpEventSetEventStatus_SetEventStatus_Event_Eg_HallVolWrong: RteEventRef=OpEventSetEventStatus_SetEventStatus_Event_Eg_HallVolWrong
          OpEventSetEventStatus_SetEventStatus_Event_INV_RSLVR_EXCT_RNG_NOK: RteEventRef=OpEventSetEventStatus_SetEventStatus_Event_INV_RSLVR_EXCT_RNG_NOK
          OpEventSetEventStatus_SetEventStatus_Event_PA_OpenCirc: RteEventRef=OpEventSetEventStatus_SetEventStatus_Event_PA_OpenCirc
          OpEventSetEventStatus_SetEventStatus_Event_INV_RSLVR_COS_ELEC_HI: RteEventRef=OpEventSetEventStatus_SetEventStatus_Event_INV_RSLVR_COS_ELEC_HI
          OpEventSetEventStatus_SetEventStatus_Event_VcEvCntrHvSysRlySts: RteEventRef=OpEventSetEventStatus_SetEventStatus_Event_VcEvCntrHvSysRlySts
          OpEventSetEventStatus_SetEventStatus_Event_CRASH_DTC: RteEventRef=OpEventSetEventStatus_SetEventStatus_Event_CRASH_DTC
          OpEventSetEventStatus_SetEventStatus_Event_INV_IGBT_TEMP_W_RNG_HI: RteEventRef=OpEventSetEventStatus_SetEventStatus_Event_INV_IGBT_TEMP_W_RNG_HI
          OpEventSetEventStatus_SetEventStatus_Event_VCEvBecmPropFr02Tioutd: RteEventRef=OpEventSetEventStatus_SetEventStatus_Event_VCEvBecmPropFr02Tioutd
          OpEventSetEventStatus_SetEventStatus_Event_INV_IGBT_TEMP_W_GRDT: RteEventRef=OpEventSetEventStatus_SetEventStatus_Event_INV_IGBT_TEMP_W_GRDT
          OpEventSetEventStatus_SetEventStatus_Event_EXT_UC_SPI_FLT: RteEventRef=OpEventSetEventStatus_SetEventStatus_Event_EXT_UC_SPI_FLT
          OpEventSetEventStatus_SetEventStatus_Event_INV_IAC_V_ELEC_HWP_001: RteEventRef=OpEventSetEventStatus_SetEventStatus_Event_INV_IAC_V_ELEC_HWP_001
          OpEventSetEventStatus_SetEventStatus_Event_VcEvChkSumWhlMotSysTqAllwd: RteEventRef=OpEventSetEventStatus_SetEventStatus_Event_VcEvChkSumWhlMotSysTqAllwd
          OpEventSetEventStatus_SetEventStatus_Event_FS_MONITIOR_ASC_FLT: RteEventRef=OpEventSetEventStatus_SetEventStatus_Event_FS_MONITIOR_ASC_FLT
          OpEventSetEventStatus_SetEventStatus_Event_INV_IAC_V_AMP: RteEventRef=OpEventSetEventStatus_SetEventStatus_Event_INV_IAC_V_AMP
          OpEventSetEventStatus_SetEventStatus_Event_INV_IAC_W_ELEC_LO: RteEventRef=OpEventSetEventStatus_SetEventStatus_Event_INV_IAC_W_ELEC_LO
          OpEventSetEventStatus_SetEventStatus_Event_VCEvVddmPropFr08Tioutd_001: RteEventRef=OpEventSetEventStatus_SetEventStatus_Event_VCEvVddmPropFr08Tioutd_001
          OpEventSetEventStatus_SetEventStatus_Event_PS_P12_RES_FLT: RteEventRef=OpEventSetEventStatus_SetEventStatus_Event_PS_P12_RES_FLT
          OpEventSetEventStatus_SetEventStatus_Event_INV_RSLVR_SIN_RNG_LO: RteEventRef=OpEventSetEventStatus_SetEventStatus_Event_INV_RSLVR_SIN_RNG_LO
          OpEventSetEventStatus_SetEventStatus_Event_CU_TEMP_HW_FLT: RteEventRef=OpEventSetEventStatus_SetEventStatus_Event_CU_TEMP_HW_FLT
          OpEventSetEventStatus_SetEventStatus_Event_VCEvEcmPropFr02MgmFr00Tioutd: RteEventRef=OpEventSetEventStatus_SetEventStatus_Event_VCEvEcmPropFr02MgmFr00Tioutd
          OpEventSetEventStatus_SetEventStatus_Event_PS_KL15_RNG_HI: RteEventRef=OpEventSetEventStatus_SetEventStatus_Event_PS_KL15_RNG_HI
          OpEventSetEventStatus_SetEventStatus_Event_VCEvVddmPropFr17Tioutd: RteEventRef=OpEventSetEventStatus_SetEventStatus_Event_VCEvVddmPropFr17Tioutd
          OpEventSetEventStatus_SetEventStatus_Event_VcEvChkSumCrashStsSafe: RteEventRef=OpEventSetEventStatus_SetEventStatus_Event_VcEvChkSumCrashStsSafe
          OpEventSetEventStatus_SetEventStatus_Event_DiagC_ClutchService: RteEventRef=OpEventSetEventStatus_SetEventStatus_Event_DiagC_ClutchService
          OpEventSetEventStatus_SetEventStatus_Event_INV_EM_STATOR_TEMP_RNG_HI: RteEventRef=OpEventSetEventStatus_SetEventStatus_Event_INV_EM_STATOR_TEMP_RNG_HI
          OpEventSetEventStatus_SetEventStatus_Event_INV_RSLVR_OFFS_OUT_RANG: RteEventRef=OpEventSetEventStatus_SetEventStatus_Event_INV_RSLVR_OFFS_OUT_RANG
          OpEventSetEventStatus_SetEventStatus_Event_INV_EM_STATOR_TEMP2_RNG_LO: RteEventRef=OpEventSetEventStatus_SetEventStatus_Event_INV_EM_STATOR_TEMP2_RNG_LO
          OpEventSetEventStatus_SetEventStatus_Event_VcEvMonISAR: RteEventRef=OpEventSetEventStatus_SetEventStatus_Event_VcEvMonISAR
          OpEventSetEventStatus_SetEventStatus_Event_GA_BLDC_FLT: RteEventRef=OpEventSetEventStatus_SetEventStatus_Event_GA_BLDC_FLT
          OpEventSetEventStatus_SetEventStatus_Event_INV_RSLVR_EXCT_ELEC_OPEN: RteEventRef=OpEventSetEventStatus_SetEventStatus_Event_INV_RSLVR_EXCT_ELEC_OPEN
          OpEventSetEventStatus_SetEventStatus_Event_INV_RSLVR_EXCT_PLAUS: RteEventRef=OpEventSetEventStatus_SetEventStatus_Event_INV_RSLVR_EXCT_PLAUS
          OpEventSetEventStatus_SetEventStatus_Event_PS_P15_U_FLT: RteEventRef=OpEventSetEventStatus_SetEventStatus_Event_PS_P15_U_FLT
          OpEventSetEventStatus_SetEventStatus_Event_INV_EM_STATOR_TEMP_RNG_SWT: RteEventRef=OpEventSetEventStatus_SetEventStatus_Event_INV_EM_STATOR_TEMP_RNG_SWT
          OpEventSetEventStatus_SetEventStatus_Event_INV_UHVDC_OV_SWP: RteEventRef=OpEventSetEventStatus_SetEventStatus_Event_INV_UHVDC_OV_SWP
          OpEventSetEventStatus_SetEventStatus_Event_AURIX_HW_FLT: RteEventRef=OpEventSetEventStatus_SetEventStatus_Event_AURIX_HW_FLT
          OpEventSetEventStatus_SetEventStatus_Event_INV_GATE_DRVR_TOP_HWP: RteEventRef=OpEventSetEventStatus_SetEventStatus_Event_INV_GATE_DRVR_TOP_HWP
          OpEventSetEventStatus_SetEventStatus_Event_INV_ACTV_DCHA_HW: RteEventRef=OpEventSetEventStatus_SetEventStatus_Event_INV_ACTV_DCHA_HW
          OpEventSetEventStatus_SetEventStatus_Event_INV_IGBT_TEMP_HWP: RteEventRef=OpEventSetEventStatus_SetEventStatus_Event_INV_IGBT_TEMP_HWP
          OpEventSetEventStatus_SetEventStatus_Event_INV_RSLVR_SIN_ELEC_FLT: RteEventRef=OpEventSetEventStatus_SetEventStatus_Event_INV_RSLVR_SIN_ELEC_FLT
          OpEventSetEventStatus_SetEventStatus_Event_CU_TEMP2_RNG_HI: RteEventRef=OpEventSetEventStatus_SetEventStatus_Event_CU_TEMP2_RNG_HI
          OpEventSetEventStatus_SetEventStatus_Event_INV_IAC_PHA_LOSS_MPL: RteEventRef=OpEventSetEventStatus_SetEventStatus_Event_INV_IAC_PHA_LOSS_MPL
          OpEventSetEventStatus_SetEventStatus_Event_INV_IAC_U_AMP: RteEventRef=OpEventSetEventStatus_SetEventStatus_Event_INV_IAC_U_AMP
          OpEventSetEventStatus_SetEventStatus_Event_PSnsr_GRADT_Flt: RteEventRef=OpEventSetEventStatus_SetEventStatus_Event_PSnsr_GRADT_Flt
          OpEventSetEventStatus_SetEventStatus_Event_AURIX_WATHDOG_FLT: RteEventRef=OpEventSetEventStatus_SetEventStatus_Event_AURIX_WATHDOG_FLT
          OpEventSetEventStatus_SetEventStatus_Event_VcEvNodeMisBECM: RteEventRef=OpEventSetEventStatus_SetEventStatus_Event_VcEvNodeMisBECM
          OpEventSetEventStatus_SetEventStatus_Event_INV_UHVDC_UV_HWP: RteEventRef=OpEventSetEventStatus_SetEventStatus_Event_INV_UHVDC_UV_HWP
          OpEventSetEventStatus_SetEventStatus_Event_VcEvMonESpd: RteEventRef=OpEventSetEventStatus_SetEventStatus_Event_VcEvMonESpd
          OpEventSetEventStatus_SetEventStatus_Event_COM_NotConfig: RteEventRef=OpEventSetEventStatus_SetEventStatus_Event_COM_NotConfig
          OpEventSetEventStatus_SetEventStatus_Event_INV_RSLVR_SIN_RNG_HI: RteEventRef=OpEventSetEventStatus_SetEventStatus_Event_INV_RSLVR_SIN_RNG_HI
          OpEventSetEventStatus_SetEventStatus_Event_INV_IGBT_TEMP_U_RNG_HI: RteEventRef=OpEventSetEventStatus_SetEventStatus_Event_INV_IGBT_TEMP_U_RNG_HI
          OpEventSetEventStatus_SetEventStatus_Event_VcEvMonMode_001: RteEventRef=OpEventSetEventStatus_SetEventStatus_Event_VcEvMonMode_001
          OpEventSetEventStatus_SetEventStatus_Event_PA_ACTION_FLT: RteEventRef=OpEventSetEventStatus_SetEventStatus_Event_PA_ACTION_FLT
          OpEventSetEventStatus_SetEventStatus_Event_INV_IAC_V_ELEC_HWP: RteEventRef=OpEventSetEventStatus_SetEventStatus_Event_INV_IAC_V_ELEC_HWP
          OpEventSetEventStatus_SetEventStatus_Event_CU_TEMP_HW_FLT_001: RteEventRef=OpEventSetEventStatus_SetEventStatus_Event_CU_TEMP_HW_FLT_001
          OpEventSetEventStatus_SetEventStatus_Event_VCC_UnderVoltage: RteEventRef=OpEventSetEventStatus_SetEventStatus_Event_VCC_UnderVoltage
          OpEventSetEventStatus_SetEventStatus_Event_VcEvTsttrPlaus: RteEventRef=OpEventSetEventStatus_SetEventStatus_Event_VcEvTsttrPlaus
          OpEventSetEventStatus_SetEventStatus_Event_INV_RSLVR_EXCT_ELEC_FLT: RteEventRef=OpEventSetEventStatus_SetEventStatus_Event_INV_RSLVR_EXCT_ELEC_FLT
          OpEventSetEventStatus_SetEventStatus_Event_INV_RSLVR_EXCT_RNG_LO: RteEventRef=OpEventSetEventStatus_SetEventStatus_Event_INV_RSLVR_EXCT_RNG_LO
          OpEventSetEventStatus_SetEventStatus_Event_INV_EM_STATOR_TEMP2_RNG_HI: RteEventRef=OpEventSetEventStatus_SetEventStatus_Event_INV_EM_STATOR_TEMP2_RNG_HI
          OpEventSetEventStatus_SetEventStatus_Event_INV_SHUT_OFF_PAH_START_UP: RteEventRef=OpEventSetEventStatus_SetEventStatus_Event_INV_SHUT_OFF_PAH_START_UP
          OpEventSetEventStatus_SetEventStatus_Event_VCEvVddmPropFr08Tioutd: RteEventRef=OpEventSetEventStatus_SetEventStatus_Event_VCEvVddmPropFr08Tioutd
          OpEventSetEventStatus_SetEventStatus_Event_INV_RSLVR_EXCT_OC_HWP_001: RteEventRef=OpEventSetEventStatus_SetEventStatus_Event_INV_RSLVR_EXCT_OC_HWP_001
          OpEventSetEventStatus_SetEventStatus_Event_INV_RSLVR_EXCT_OC_HWP_002: RteEventRef=OpEventSetEventStatus_SetEventStatus_Event_INV_RSLVR_EXCT_OC_HWP_002
          OpEventSetEventStatus_SetEventStatus_Event_INV_EM_STATOR_TEMP_ELE_FLT: RteEventRef=OpEventSetEventStatus_SetEventStatus_Event_INV_EM_STATOR_TEMP_ELE_FLT
          OpEventSetEventStatus_SetEventStatus_Event_INV_INTERLOCK_FLT: RteEventRef=OpEventSetEventStatus_SetEventStatus_Event_INV_INTERLOCK_FLT
          OpEventSetEventStatus_SetEventStatus_Event_Ga_ZeroFindDistanFailure: RteEventRef=OpEventSetEventStatus_SetEventStatus_Event_Ga_ZeroFindDistanFailure
          OpEventSetEventStatus_SetEventStatus_Event_PLOCK_Current_RNG_OUT: RteEventRef=OpEventSetEventStatus_SetEventStatus_Event_PLOCK_Current_RNG_OUT
          OpEventSetEventStatus_SetEventStatus_Event_VCEvVddmPropFr05Tioutd: RteEventRef=OpEventSetEventStatus_SetEventStatus_Event_VCEvVddmPropFr05Tioutd
          OpEventSetEventStatus_SetEventStatus_Event_INV_IGBT_TEMP_V_GRDT: RteEventRef=OpEventSetEventStatus_SetEventStatus_Event_INV_IGBT_TEMP_V_GRDT
          OpEventSetEventStatus_SetEventStatus_Event_PS_5V_Fault: RteEventRef=OpEventSetEventStatus_SetEventStatus_Event_PS_5V_Fault
          OpEventSetEventStatus_SetEventStatus_Event_VcEvCntrCrashStsSafe: RteEventRef=OpEventSetEventStatus_SetEventStatus_Event_VcEvCntrCrashStsSafe
          OpEventSetEventStatus_SetEventStatus_Event_INV_EM_STATOR_TEMP_GRDT: RteEventRef=OpEventSetEventStatus_SetEventStatus_Event_INV_EM_STATOR_TEMP_GRDT
          OpEventSetEventStatus_SetEventStatus_Event_PS_P15_V_FLT: RteEventRef=OpEventSetEventStatus_SetEventStatus_Event_PS_P15_V_FLT
          OpEventSetEventStatus_SetEventStatus_Event_INV_EM_STATOR_TEMP_RNG_NOK: RteEventRef=OpEventSetEventStatus_SetEventStatus_Event_INV_EM_STATOR_TEMP_RNG_NOK
          OpEventSetEventStatus_SetEventStatus_Event_INV_RSLVR_SIN_RNG_NOK: RteEventRef=OpEventSetEventStatus_SetEventStatus_Event_INV_RSLVR_SIN_RNG_NOK
          OpEventSetEventStatus_SetEventStatus_Event_INV_IAC_U_OFFS: RteEventRef=OpEventSetEventStatus_SetEventStatus_Event_INV_IAC_U_OFFS
          OpEventSetEventStatus_SetEventStatus_Event_PS_KL30_BACKUP_FLT: RteEventRef=OpEventSetEventStatus_SetEventStatus_Event_PS_KL30_BACKUP_FLT
          OpEventSetEventStatus_SetEventStatus_Event_INV_IGBT_TEMP_U_RNG_LO: RteEventRef=OpEventSetEventStatus_SetEventStatus_Event_INV_IGBT_TEMP_U_RNG_LO
          OpEventSetEventStatus_SetEventStatus_Event_INV_EM_STATOR_TEMP_HWP: RteEventRef=OpEventSetEventStatus_SetEventStatus_Event_INV_EM_STATOR_TEMP_HWP
          OpEventSetEventStatus_SetEventStatus_Event_CU_TEMP1_RNG_HI: RteEventRef=OpEventSetEventStatus_SetEventStatus_Event_CU_TEMP1_RNG_HI
          OpEventSetEventStatus_SetEventStatus_Event_INV_IGBT_TEMP_V_RNG_HI: RteEventRef=OpEventSetEventStatus_SetEventStatus_Event_INV_IGBT_TEMP_V_RNG_HI
          OpEventSetEventStatus_SetEventStatus_Event_VcEvNodeMisVDDM: RteEventRef=OpEventSetEventStatus_SetEventStatus_Event_VcEvNodeMisVDDM
          OpEventSetEventStatus_SetEventStatus_Event_INV_UHVDC_PLAUS: RteEventRef=OpEventSetEventStatus_SetEventStatus_Event_INV_UHVDC_PLAUS
          OpEventSetEventStatus_SetEventStatus_Event_INV_QUIESCENT_FLT: RteEventRef=OpEventSetEventStatus_SetEventStatus_Event_INV_QUIESCENT_FLT
          OpEventSetEventStatus_SetEventStatus_Event_INV_RSLVR_EXCT_RNG_HI: RteEventRef=OpEventSetEventStatus_SetEventStatus_Event_INV_RSLVR_EXCT_RNG_HI
          OpEventResetEventStatus_ResetEventStatus_Event_VCEvBecmPropFr01Tioutd: RteEventRef=OpEventResetEventStatus_ResetEventStatus_Event_VCEvBecmPropFr01Tioutd
          OpEventResetEventStatus_ResetEventStatus_Event_INV_CU_TEMP2_RNG_NOK: RteEventRef=OpEventResetEventStatus_ResetEventStatus_Event_INV_CU_TEMP2_RNG_NOK
          OpEventResetEventStatus_ResetEventStatus_Event_COM_Busoff: RteEventRef=OpEventResetEventStatus_ResetEventStatus_Event_COM_Busoff
          OpEventResetEventStatus_ResetEventStatus_Event_INV_IMMO_NOKEY: RteEventRef=OpEventResetEventStatus_ResetEventStatus_Event_INV_IMMO_NOKEY
          OpEventResetEventStatus_ResetEventStatus_Event_INV_RSLVR_EXCT_OC_HWP: RteEventRef=OpEventResetEventStatus_ResetEventStatus_Event_INV_RSLVR_EXCT_OC_HWP
          OpEventResetEventStatus_ResetEventStatus_Event_PS_P15_W_FLT: RteEventRef=OpEventResetEventStatus_ResetEventStatus_Event_PS_P15_W_FLT
          OpEventResetEventStatus_ResetEventStatus_Event_INV_IAC_PLAUS_SUM: RteEventRef=OpEventResetEventStatus_ResetEventStatus_Event_INV_IAC_PLAUS_SUM
          OpEventResetEventStatus_ResetEventStatus_Event_PA_ELE_FLT: RteEventRef=OpEventResetEventStatus_ResetEventStatus_Event_PA_ELE_FLT
          OpEventResetEventStatus_ResetEventStatus_Event_CU_TEMP_GRDT: RteEventRef=OpEventResetEventStatus_ResetEventStatus_Event_CU_TEMP_GRDT
          OpEventResetEventStatus_ResetEventStatus_Event_INV_IGBT_TEMP_V_PLAUS: RteEventRef=OpEventResetEventStatus_ResetEventStatus_Event_INV_IGBT_TEMP_V_PLAUS
          OpEventResetEventStatus_ResetEventStatus_Event_Ga_GAEngageFailure: RteEventRef=OpEventResetEventStatus_ResetEventStatus_Event_Ga_GAEngageFailure
          OpEventResetEventStatus_ResetEventStatus_Event_INV_IAC_W_RNG_LO: RteEventRef=OpEventResetEventStatus_ResetEventStatus_Event_INV_IAC_W_RNG_LO
          OpEventResetEventStatus_ResetEventStatus_Event_PS_WhlSnsr_Vltg_FLT: RteEventRef=OpEventResetEventStatus_ResetEventStatus_Event_PS_WhlSnsr_Vltg_FLT
          OpEventResetEventStatus_ResetEventStatus_Event_VCEvEcmPropFr02Tioutd: RteEventRef=OpEventResetEventStatus_ResetEventStatus_Event_VCEvEcmPropFr02Tioutd
          OpEventResetEventStatus_ResetEventStatus_Event_Ga_TmSpdSyncFailed: RteEventRef=OpEventResetEventStatus_ResetEventStatus_Event_Ga_TmSpdSyncFailed
          OpEventResetEventStatus_ResetEventStatus_Event_INV_RSLVR_EXCT_ELEC_LO: RteEventRef=OpEventResetEventStatus_ResetEventStatus_Event_INV_RSLVR_EXCT_ELEC_LO
          OpEventResetEventStatus_ResetEventStatus_Event_VCEvEcmPropXevFr06Tioutd: RteEventRef=OpEventResetEventStatus_ResetEventStatus_Event_VCEvEcmPropXevFr06Tioutd
          OpEventResetEventStatus_ResetEventStatus_Event_VcEvCntrWhlMotSysTqAllwd: RteEventRef=OpEventResetEventStatus_ResetEventStatus_Event_VcEvCntrWhlMotSysTqAllwd
          OpEventResetEventStatus_ResetEventStatus_Event_INV_UHVDC_1_ELEC_HI: RteEventRef=OpEventResetEventStatus_ResetEventStatus_Event_INV_UHVDC_1_ELEC_HI
          OpEventResetEventStatus_ResetEventStatus_Event_INV_EM_STATOR_TEMP2_ELE_FLT: RteEventRef=OpEventResetEventStatus_ResetEventStatus_Event_INV_EM_STATOR_TEMP2_ELE_FLT
          OpEventResetEventStatus_ResetEventStatus_Event_AURIX_RST_SNG: RteEventRef=OpEventResetEventStatus_ResetEventStatus_Event_AURIX_RST_SNG
          OpEventResetEventStatus_ResetEventStatus_Event_VCEvEcmPropFr24MgmFr01Tioutd: RteEventRef=OpEventResetEventStatus_ResetEventStatus_Event_VCEvEcmPropFr24MgmFr01Tioutd
          OpEventResetEventStatus_ResetEventStatus_Event_INV_RSLVR_COS_ELEC_OPEN: RteEventRef=OpEventResetEventStatus_ResetEventStatus_Event_INV_RSLVR_COS_ELEC_OPEN
          OpEventResetEventStatus_ResetEventStatus_Event_INV_IAC_V_ELEC_LO: RteEventRef=OpEventResetEventStatus_ResetEventStatus_Event_INV_IAC_V_ELEC_LO
          OpEventResetEventStatus_ResetEventStatus_Event_INV_IAC_W_OFFS: RteEventRef=OpEventResetEventStatus_ResetEventStatus_Event_INV_IAC_W_OFFS
          OpEventResetEventStatus_ResetEventStatus_Event_INV_EM_STATOR_TEMP2_GRDT: RteEventRef=OpEventResetEventStatus_ResetEventStatus_Event_INV_EM_STATOR_TEMP2_GRDT
          OpEventResetEventStatus_ResetEventStatus_Event_INV_EM_OVRSPD_HWP: RteEventRef=OpEventResetEventStatus_ResetEventStatus_Event_INV_EM_OVRSPD_HWP
          OpEventResetEventStatus_ResetEventStatus_Event_CU_TEMP_HWP: RteEventRef=OpEventResetEventStatus_ResetEventStatus_Event_CU_TEMP_HWP
          OpEventResetEventStatus_ResetEventStatus_Event_INV_UHVDC_1_RNG_HI: RteEventRef=OpEventResetEventStatus_ResetEventStatus_Event_INV_UHVDC_1_RNG_HI
          OpEventResetEventStatus_ResetEventStatus_Event_VcEvEMPerfPlaus: RteEventRef=OpEventResetEventStatus_ResetEventStatus_Event_VcEvEMPerfPlaus
          OpEventResetEventStatus_ResetEventStatus_Event_VCEvVddmPropFr18Tioutd: RteEventRef=OpEventResetEventStatus_ResetEventStatus_Event_VCEvVddmPropFr18Tioutd
          OpEventResetEventStatus_ResetEventStatus_Event_INV_IAC_U_ELEC_HWP: RteEventRef=OpEventResetEventStatus_ResetEventStatus_Event_INV_IAC_U_ELEC_HWP
          OpEventResetEventStatus_ResetEventStatus_Event_VCEvVddmPropFr15Tioutd: RteEventRef=OpEventResetEventStatus_ResetEventStatus_Event_VCEvVddmPropFr15Tioutd
          OpEventResetEventStatus_ResetEventStatus_Event_Ga_GADisengageFailure: RteEventRef=OpEventResetEventStatus_ResetEventStatus_Event_Ga_GADisengageFailure
          OpEventResetEventStatus_ResetEventStatus_Event_CU_TEMP2_RNG_LO: RteEventRef=OpEventResetEventStatus_ResetEventStatus_Event_CU_TEMP2_RNG_LO
          OpEventResetEventStatus_ResetEventStatus_Event_INV_RSLVR_SIN_ELEC_OPEN: RteEventRef=OpEventResetEventStatus_ResetEventStatus_Event_INV_RSLVR_SIN_ELEC_OPEN
          OpEventResetEventStatus_ResetEventStatus_Event_VcEvChkSum: RteEventRef=OpEventResetEventStatus_ResetEventStatus_Event_VcEvChkSum
          OpEventResetEventStatus_ResetEventStatus_Event_PS_P5_UC_FLT: RteEventRef=OpEventResetEventStatus_ResetEventStatus_Event_PS_P5_UC_FLT
          OpEventResetEventStatus_ResetEventStatus_Event_INV_RSLVR_COS_ELEC_FLT: RteEventRef=OpEventResetEventStatus_ResetEventStatus_Event_INV_RSLVR_COS_ELEC_FLT
          OpEventResetEventStatus_ResetEventStatus_Event_INV_IAC_W_RNG_HI: RteEventRef=OpEventResetEventStatus_ResetEventStatus_Event_INV_IAC_W_RNG_HI
          OpEventResetEventStatus_ResetEventStatus_Event_PS_ECUSUPPLY_HIGH: RteEventRef=OpEventResetEventStatus_ResetEventStatus_Event_PS_ECUSUPPLY_HIGH
          OpEventResetEventStatus_ResetEventStatus_Event_VCEvEcmPropFr05Tioutd: RteEventRef=OpEventResetEventStatus_ResetEventStatus_Event_VCEvEcmPropFr05Tioutd
          OpEventResetEventStatus_ResetEventStatus_Event_PS_ECUSUPPLY_LOW: RteEventRef=OpEventResetEventStatus_ResetEventStatus_Event_PS_ECUSUPPLY_LOW
          OpEventResetEventStatus_ResetEventStatus_Event_VcEvChkSumHvSysRlySts: RteEventRef=OpEventResetEventStatus_ResetEventStatus_Event_VcEvChkSumHvSysRlySts
          OpEventResetEventStatus_ResetEventStatus_Event_VcEvMonMode: RteEventRef=OpEventResetEventStatus_ResetEventStatus_Event_VcEvMonMode
          OpEventResetEventStatus_ResetEventStatus_Event_INV_IAC_OC_SWP: RteEventRef=OpEventResetEventStatus_ResetEventStatus_Event_INV_IAC_OC_SWP
          OpEventResetEventStatus_ResetEventStatus_Event_INV_IMMO_AUTHFAIL: RteEventRef=OpEventResetEventStatus_ResetEventStatus_Event_INV_IMMO_AUTHFAIL
          OpEventResetEventStatus_ResetEventStatus_Event_PA_OpenCirc_FLT: RteEventRef=OpEventResetEventStatus_ResetEventStatus_Event_PA_OpenCirc_FLT
          OpEventResetEventStatus_ResetEventStatus_Event_INV_IAC_V_ELEC_HI: RteEventRef=OpEventResetEventStatus_ResetEventStatus_Event_INV_IAC_V_ELEC_HI
          OpEventResetEventStatus_ResetEventStatus_Event_VCEvEcmPropFr04Tioutd: RteEventRef=OpEventResetEventStatus_ResetEventStatus_Event_VCEvEcmPropFr04Tioutd
          OpEventResetEventStatus_ResetEventStatus_Event_VcEvMonTrqActPlaus: RteEventRef=OpEventResetEventStatus_ResetEventStatus_Event_VcEvMonTrqActPlaus
          OpEventResetEventStatus_ResetEventStatus_Event_VcEvMonTrqAct: RteEventRef=OpEventResetEventStatus_ResetEventStatus_Event_VcEvMonTrqAct
          OpEventResetEventStatus_ResetEventStatus_Event_INV_RSLVR_COS_ELEC_LO: RteEventRef=OpEventResetEventStatus_ResetEventStatus_Event_INV_RSLVR_COS_ELEC_LO
          OpEventResetEventStatus_ResetEventStatus_Event_INV_COOLT_INLET_TEMP_HWP: RteEventRef=OpEventResetEventStatus_ResetEventStatus_Event_INV_COOLT_INLET_TEMP_HWP
          OpEventResetEventStatus_ResetEventStatus_Event_VCEvEcmPropFr11Tioutd: RteEventRef=OpEventResetEventStatus_ResetEventStatus_Event_VCEvEcmPropFr11Tioutd
          OpEventResetEventStatus_ResetEventStatus_Event_PS_KL30_RNG_HI: RteEventRef=OpEventResetEventStatus_ResetEventStatus_Event_PS_KL30_RNG_HI
          OpEventResetEventStatus_ResetEventStatus_Event_INV_IAC_OC_HWP: RteEventRef=OpEventResetEventStatus_ResetEventStatus_Event_INV_IAC_OC_HWP
          OpEventResetEventStatus_ResetEventStatus_Event_INV_RSLVR_COS_RNG_HI: RteEventRef=OpEventResetEventStatus_ResetEventStatus_Event_INV_RSLVR_COS_RNG_HI
          OpEventResetEventStatus_ResetEventStatus_Event_INV_IAC_U_ELEC_HI: RteEventRef=OpEventResetEventStatus_ResetEventStatus_Event_INV_IAC_U_ELEC_HI
          OpEventResetEventStatus_ResetEventStatus_Event_INV_IAC_V_RNG_LO: RteEventRef=OpEventResetEventStatus_ResetEventStatus_Event_INV_IAC_V_RNG_LO
          OpEventResetEventStatus_ResetEventStatus_Event_INV_IAC_U_RNG_HI: RteEventRef=OpEventResetEventStatus_ResetEventStatus_Event_INV_IAC_U_RNG_HI
          OpEventResetEventStatus_ResetEventStatus_Event_VCEvEcmPropFr25Tioutd: RteEventRef=OpEventResetEventStatus_ResetEventStatus_Event_VCEvEcmPropFr25Tioutd
          OpEventResetEventStatus_ResetEventStatus_Event_INV_IGBT_TEMP_W_RNG_LO: RteEventRef=OpEventResetEventStatus_ResetEventStatus_Event_INV_IGBT_TEMP_W_RNG_LO
          OpEventResetEventStatus_ResetEventStatus_Event_PSnsr_RNG_NOK: RteEventRef=OpEventResetEventStatus_ResetEventStatus_Event_PSnsr_RNG_NOK
          OpEventResetEventStatus_ResetEventStatus_Event_INV_RSLVR_COS_RNG_NOK: RteEventRef=OpEventResetEventStatus_ResetEventStatus_Event_INV_RSLVR_COS_RNG_NOK
          OpEventResetEventStatus_ResetEventStatus_Event_PS_DRVB_Fault: RteEventRef=OpEventResetEventStatus_ResetEventStatus_Event_PS_DRVB_Fault
          OpEventResetEventStatus_ResetEventStatus_Event_INV_CU_TEMP1_RNG_NOK: RteEventRef=OpEventResetEventStatus_ResetEventStatus_Event_INV_CU_TEMP1_RNG_NOK
          OpEventResetEventStatus_ResetEventStatus_Event_VcEvCntr: RteEventRef=OpEventResetEventStatus_ResetEventStatus_Event_VcEvCntr
          OpEventResetEventStatus_ResetEventStatus_Event_INV_RSLVR_SIN_AMP: RteEventRef=OpEventResetEventStatus_ResetEventStatus_Event_INV_RSLVR_SIN_AMP
          OpEventResetEventStatus_ResetEventStatus_Event_INV_UHVDC_2_RNG_HI: RteEventRef=OpEventResetEventStatus_ResetEventStatus_Event_INV_UHVDC_2_RNG_HI
          OpEventResetEventStatus_ResetEventStatus_Event_INV_IGBT_TEMP_U_GRDT: RteEventRef=OpEventResetEventStatus_ResetEventStatus_Event_INV_IGBT_TEMP_U_GRDT
          OpEventResetEventStatus_ResetEventStatus_Event_MON_TQ_PLAUS_PWR_MDL: RteEventRef=OpEventResetEventStatus_ResetEventStatus_Event_MON_TQ_PLAUS_PWR_MDL
          OpEventResetEventStatus_ResetEventStatus_Event_INV_IGBT_TEMP_W_PLAUS: RteEventRef=OpEventResetEventStatus_ResetEventStatus_Event_INV_IGBT_TEMP_W_PLAUS
          OpEventResetEventStatus_ResetEventStatus_Event_PS_BLDC_UV_FLT: RteEventRef=OpEventResetEventStatus_ResetEventStatus_Event_PS_BLDC_UV_FLT
          OpEventResetEventStatus_ResetEventStatus_Event_INV_IAC_V_OFFS: RteEventRef=OpEventResetEventStatus_ResetEventStatus_Event_INV_IAC_V_OFFS
          OpEventResetEventStatus_ResetEventStatus_Event_INV_RSLVR_EXCT_FREQ_RNG_NOK: RteEventRef=OpEventResetEventStatus_ResetEventStatus_Event_INV_RSLVR_EXCT_FREQ_RNG_NOK
          OpEventResetEventStatus_ResetEventStatus_Event_PS_KL30_RNG_LO: RteEventRef=OpEventResetEventStatus_ResetEventStatus_Event_PS_KL30_RNG_LO
          OpEventResetEventStatus_ResetEventStatus_Event_INV_RSLVR_COS_RNG_LO: RteEventRef=OpEventResetEventStatus_ResetEventStatus_Event_INV_RSLVR_COS_RNG_LO
          OpEventResetEventStatus_ResetEventStatus_Event_PSnsr_ELE_FLT: RteEventRef=OpEventResetEventStatus_ResetEventStatus_Event_PSnsr_ELE_FLT
          OpEventResetEventStatus_ResetEventStatus_Event_INV_RSLVR_SIN_COS_PLAUS_AMP: RteEventRef=OpEventResetEventStatus_ResetEventStatus_Event_INV_RSLVR_SIN_COS_PLAUS_AMP
          OpEventResetEventStatus_ResetEventStatus_Event_INV_IAC_U_ELEC_LO: RteEventRef=OpEventResetEventStatus_ResetEventStatus_Event_INV_IAC_U_ELEC_LO
          OpEventResetEventStatus_ResetEventStatus_Event_INV_RSLVR_EXCT_ELEC_HI: RteEventRef=OpEventResetEventStatus_ResetEventStatus_Event_INV_RSLVR_EXCT_ELEC_HI
          OpEventResetEventStatus_ResetEventStatus_Event_INV_IAC_U_RNG_LO: RteEventRef=OpEventResetEventStatus_ResetEventStatus_Event_INV_IAC_U_RNG_LO
          OpEventResetEventStatus_ResetEventStatus_Event_INV_IAC_V_RNG_HI: RteEventRef=OpEventResetEventStatus_ResetEventStatus_Event_INV_IAC_V_RNG_HI
          OpEventResetEventStatus_ResetEventStatus_Event_INV_IGBT_TEMP_U_PLAUS: RteEventRef=OpEventResetEventStatus_ResetEventStatus_Event_INV_IGBT_TEMP_U_PLAUS
          OpEventResetEventStatus_ResetEventStatus_Event_INV_RSLVR_OFFS_DFT: RteEventRef=OpEventResetEventStatus_ResetEventStatus_Event_INV_RSLVR_OFFS_DFT
          OpEventResetEventStatus_ResetEventStatus_Event_Ga_MoveOverThd: RteEventRef=OpEventResetEventStatus_ResetEventStatus_Event_Ga_MoveOverThd
          OpEventResetEventStatus_ResetEventStatus_Event_VcEvMonIPH: RteEventRef=OpEventResetEventStatus_ResetEventStatus_Event_VcEvMonIPH
          OpEventResetEventStatus_ResetEventStatus_Event_INV_RSLVR_HW_FLT: RteEventRef=OpEventResetEventStatus_ResetEventStatus_Event_INV_RSLVR_HW_FLT
          OpEventResetEventStatus_ResetEventStatus_Event_INV_RSLVR_SIN_ELEC_LO: RteEventRef=OpEventResetEventStatus_ResetEventStatus_Event_INV_RSLVR_SIN_ELEC_LO
          OpEventResetEventStatus_ResetEventStatus_Event_INV_IAC_W_AMP: RteEventRef=OpEventResetEventStatus_ResetEventStatus_Event_INV_IAC_W_AMP
          OpEventResetEventStatus_ResetEventStatus_Event_VCC_OverVoltage: RteEventRef=OpEventResetEventStatus_ResetEventStatus_Event_VCC_OverVoltage
          OpEventResetEventStatus_ResetEventStatus_Event_PS_BLDC_OV_FLT: RteEventRef=OpEventResetEventStatus_ResetEventStatus_Event_PS_BLDC_OV_FLT
          OpEventResetEventStatus_ResetEventStatus_Event_AURIX_EEPROM_FLT: RteEventRef=OpEventResetEventStatus_ResetEventStatus_Event_AURIX_EEPROM_FLT
          OpEventResetEventStatus_ResetEventStatus_Event_FS_MONITIOR_ASC_FW_FLT: RteEventRef=OpEventResetEventStatus_ResetEventStatus_Event_FS_MONITIOR_ASC_FW_FLT
          OpEventResetEventStatus_ResetEventStatus_Event_VCEvSrsPropFr02Tioutd: RteEventRef=OpEventResetEventStatus_ResetEventStatus_Event_VCEvSrsPropFr02Tioutd
          OpEventResetEventStatus_ResetEventStatus_Event_VcEvMonErrMode: RteEventRef=OpEventResetEventStatus_ResetEventStatus_Event_VcEvMonErrMode
          OpEventResetEventStatus_ResetEventStatus_Event_AURIX_RST_MPL: RteEventRef=OpEventResetEventStatus_ResetEventStatus_Event_AURIX_RST_MPL
          OpEventResetEventStatus_ResetEventStatus_Event_VcEvNodeMisECM: RteEventRef=OpEventResetEventStatus_ResetEventStatus_Event_VcEvNodeMisECM
          OpEventResetEventStatus_ResetEventStatus_Event_PS_KL30_PLAUS: RteEventRef=OpEventResetEventStatus_ResetEventStatus_Event_PS_KL30_PLAUS
          OpEventResetEventStatus_ResetEventStatus_Event_INV_IAC_W_ELEC_HI: RteEventRef=OpEventResetEventStatus_ResetEventStatus_Event_INV_IAC_W_ELEC_HI
          OpEventResetEventStatus_ResetEventStatus_Event_VCEvVddmPropFr19Tioutd: RteEventRef=OpEventResetEventStatus_ResetEventStatus_Event_VCEvVddmPropFr19Tioutd
          OpEventResetEventStatus_ResetEventStatus_Event_INV_TEMP_DCHA_HW: RteEventRef=OpEventResetEventStatus_ResetEventStatus_Event_INV_TEMP_DCHA_HW
          OpEventResetEventStatus_ResetEventStatus_Event_VcEvPropCANGlbTiOutd: RteEventRef=OpEventResetEventStatus_ResetEventStatus_Event_VcEvPropCANGlbTiOutd
          OpEventResetEventStatus_ResetEventStatus_Event_INV_EM_STATOR_TEMP2_RNG_NOK: RteEventRef=OpEventResetEventStatus_ResetEventStatus_Event_INV_EM_STATOR_TEMP2_RNG_NOK
          OpEventResetEventStatus_ResetEventStatus_Event_INV_UHVDC_OV_HWP: RteEventRef=OpEventResetEventStatus_ResetEventStatus_Event_INV_UHVDC_OV_HWP
          OpEventResetEventStatus_ResetEventStatus_Event_Ga_FindEngleAngleFailed: RteEventRef=OpEventResetEventStatus_ResetEventStatus_Event_Ga_FindEngleAngleFailed
          OpEventResetEventStatus_ResetEventStatus_Event_VcEvMonTrqCmp: RteEventRef=OpEventResetEventStatus_ResetEventStatus_Event_VcEvMonTrqCmp
          OpEventResetEventStatus_ResetEventStatus_Event_INV_IGBT_TEMP_V_RNG_LO: RteEventRef=OpEventResetEventStatus_ResetEventStatus_Event_INV_IGBT_TEMP_V_RNG_LO
          OpEventResetEventStatus_ResetEventStatus_Event_INV_CONTROL_LIMIT: RteEventRef=OpEventResetEventStatus_ResetEventStatus_Event_INV_CONTROL_LIMIT
          OpEventResetEventStatus_ResetEventStatus_Event_COM_CarConfigErr: RteEventRef=OpEventResetEventStatus_ResetEventStatus_Event_COM_CarConfigErr
          OpEventResetEventStatus_ResetEventStatus_Event_VCEvEcmPropFr08Tioutd: RteEventRef=OpEventResetEventStatus_ResetEventStatus_Event_VCEvEcmPropFr08Tioutd
          OpEventResetEventStatus_ResetEventStatus_Event_CU_TEMP1_RNG_LO: RteEventRef=OpEventResetEventStatus_ResetEventStatus_Event_CU_TEMP1_RNG_LO
          OpEventResetEventStatus_ResetEventStatus_Event_INV_EM_STATOR_TEMP2_RNG_SWT: RteEventRef=OpEventResetEventStatus_ResetEventStatus_Event_INV_EM_STATOR_TEMP2_RNG_SWT
          OpEventResetEventStatus_ResetEventStatus_Event_GA_BLDC_POS_FLT: RteEventRef=OpEventResetEventStatus_ResetEventStatus_Event_GA_BLDC_POS_FLT
          OpEventResetEventStatus_ResetEventStatus_Event_PS_WhlSnsr_FLT: RteEventRef=OpEventResetEventStatus_ResetEventStatus_Event_PS_WhlSnsr_FLT
          OpEventResetEventStatus_ResetEventStatus_Event_INV_EM_STATOR_TEMP_RNG_LO: RteEventRef=OpEventResetEventStatus_ResetEventStatus_Event_INV_EM_STATOR_TEMP_RNG_LO
          OpEventResetEventStatus_ResetEventStatus_Event_INV_RSLVR_SIN_ELEC_HI: RteEventRef=OpEventResetEventStatus_ResetEventStatus_Event_INV_RSLVR_SIN_ELEC_HI
          OpEventResetEventStatus_ResetEventStatus_Event_INV_RSLVR_SIN_COS_PLAUS: RteEventRef=OpEventResetEventStatus_ResetEventStatus_Event_INV_RSLVR_SIN_COS_PLAUS
          OpEventResetEventStatus_ResetEventStatus_Event_INV_RSLVR_COS_AMP: RteEventRef=OpEventResetEventStatus_ResetEventStatus_Event_INV_RSLVR_COS_AMP
          OpEventResetEventStatus_ResetEventStatus_Event_INV_GATE_DRVR_BOT_HWP: RteEventRef=OpEventResetEventStatus_ResetEventStatus_Event_INV_GATE_DRVR_BOT_HWP
          OpEventResetEventStatus_ResetEventStatus_Event_Eg_HallVolWrong: RteEventRef=OpEventResetEventStatus_ResetEventStatus_Event_Eg_HallVolWrong
          OpEventResetEventStatus_ResetEventStatus_Event_INV_RSLVR_EXCT_RNG_NOK: RteEventRef=OpEventResetEventStatus_ResetEventStatus_Event_INV_RSLVR_EXCT_RNG_NOK
          OpEventResetEventStatus_ResetEventStatus_Event_PA_OpenCirc: RteEventRef=OpEventResetEventStatus_ResetEventStatus_Event_PA_OpenCirc
          OpEventResetEventStatus_ResetEventStatus_Event_INV_RSLVR_COS_ELEC_HI: RteEventRef=OpEventResetEventStatus_ResetEventStatus_Event_INV_RSLVR_COS_ELEC_HI
          OpEventResetEventStatus_ResetEventStatus_Event_VcEvCntrHvSysRlySts: RteEventRef=OpEventResetEventStatus_ResetEventStatus_Event_VcEvCntrHvSysRlySts
          OpEventResetEventStatus_ResetEventStatus_Event_CRASH_DTC: RteEventRef=OpEventResetEventStatus_ResetEventStatus_Event_CRASH_DTC
          OpEventResetEventStatus_ResetEventStatus_Event_INV_IGBT_TEMP_W_RNG_HI: RteEventRef=OpEventResetEventStatus_ResetEventStatus_Event_INV_IGBT_TEMP_W_RNG_HI
          OpEventResetEventStatus_ResetEventStatus_Event_VCEvBecmPropFr02Tioutd: RteEventRef=OpEventResetEventStatus_ResetEventStatus_Event_VCEvBecmPropFr02Tioutd
          OpEventResetEventStatus_ResetEventStatus_Event_INV_IGBT_TEMP_W_GRDT: RteEventRef=OpEventResetEventStatus_ResetEventStatus_Event_INV_IGBT_TEMP_W_GRDT
          OpEventResetEventStatus_ResetEventStatus_Event_EXT_UC_SPI_FLT: RteEventRef=OpEventResetEventStatus_ResetEventStatus_Event_EXT_UC_SPI_FLT
          OpEventResetEventStatus_ResetEventStatus_Event_INV_IAC_V_ELEC_HWP_001: RteEventRef=OpEventResetEventStatus_ResetEventStatus_Event_INV_IAC_V_ELEC_HWP_001
          OpEventResetEventStatus_ResetEventStatus_Event_VcEvChkSumWhlMotSysTqAllwd: RteEventRef=OpEventResetEventStatus_ResetEventStatus_Event_VcEvChkSumWhlMotSysTqAllwd
          OpEventResetEventStatus_ResetEventStatus_Event_FS_MONITIOR_ASC_FLT: RteEventRef=OpEventResetEventStatus_ResetEventStatus_Event_FS_MONITIOR_ASC_FLT
          OpEventResetEventStatus_ResetEventStatus_Event_INV_IAC_V_AMP: RteEventRef=OpEventResetEventStatus_ResetEventStatus_Event_INV_IAC_V_AMP
          OpEventResetEventStatus_ResetEventStatus_Event_INV_IAC_W_ELEC_LO: RteEventRef=OpEventResetEventStatus_ResetEventStatus_Event_INV_IAC_W_ELEC_LO
          OpEventResetEventStatus_ResetEventStatus_Event_VCEvVddmPropFr08Tioutd_001: RteEventRef=OpEventResetEventStatus_ResetEventStatus_Event_VCEvVddmPropFr08Tioutd_001
          OpEventResetEventStatus_ResetEventStatus_Event_PS_P12_RES_FLT: RteEventRef=OpEventResetEventStatus_ResetEventStatus_Event_PS_P12_RES_FLT
          OpEventResetEventStatus_ResetEventStatus_Event_INV_RSLVR_SIN_RNG_LO: RteEventRef=OpEventResetEventStatus_ResetEventStatus_Event_INV_RSLVR_SIN_RNG_LO
          OpEventResetEventStatus_ResetEventStatus_Event_CU_TEMP_HW_FLT: RteEventRef=OpEventResetEventStatus_ResetEventStatus_Event_CU_TEMP_HW_FLT
          OpEventResetEventStatus_ResetEventStatus_Event_VCEvEcmPropFr02MgmFr00Tioutd: RteEventRef=OpEventResetEventStatus_ResetEventStatus_Event_VCEvEcmPropFr02MgmFr00Tioutd
          OpEventResetEventStatus_ResetEventStatus_Event_PS_KL15_RNG_HI: RteEventRef=OpEventResetEventStatus_ResetEventStatus_Event_PS_KL15_RNG_HI
          OpEventResetEventStatus_ResetEventStatus_Event_VCEvVddmPropFr17Tioutd: RteEventRef=OpEventResetEventStatus_ResetEventStatus_Event_VCEvVddmPropFr17Tioutd
          OpEventResetEventStatus_ResetEventStatus_Event_VcEvChkSumCrashStsSafe: RteEventRef=OpEventResetEventStatus_ResetEventStatus_Event_VcEvChkSumCrashStsSafe
          OpEventResetEventStatus_ResetEventStatus_Event_DiagC_ClutchService: RteEventRef=OpEventResetEventStatus_ResetEventStatus_Event_DiagC_ClutchService
          OpEventResetEventStatus_ResetEventStatus_Event_INV_EM_STATOR_TEMP_RNG_HI: RteEventRef=OpEventResetEventStatus_ResetEventStatus_Event_INV_EM_STATOR_TEMP_RNG_HI
          OpEventResetEventStatus_ResetEventStatus_Event_INV_RSLVR_OFFS_OUT_RANG: RteEventRef=OpEventResetEventStatus_ResetEventStatus_Event_INV_RSLVR_OFFS_OUT_RANG
          OpEventResetEventStatus_ResetEventStatus_Event_INV_EM_STATOR_TEMP2_RNG_LO: RteEventRef=OpEventResetEventStatus_ResetEventStatus_Event_INV_EM_STATOR_TEMP2_RNG_LO
          OpEventResetEventStatus_ResetEventStatus_Event_VcEvMonISAR: RteEventRef=OpEventResetEventStatus_ResetEventStatus_Event_VcEvMonISAR
          OpEventResetEventStatus_ResetEventStatus_Event_GA_BLDC_FLT: RteEventRef=OpEventResetEventStatus_ResetEventStatus_Event_GA_BLDC_FLT
          OpEventResetEventStatus_ResetEventStatus_Event_INV_RSLVR_EXCT_ELEC_OPEN: RteEventRef=OpEventResetEventStatus_ResetEventStatus_Event_INV_RSLVR_EXCT_ELEC_OPEN
          OpEventResetEventStatus_ResetEventStatus_Event_INV_RSLVR_EXCT_PLAUS: RteEventRef=OpEventResetEventStatus_ResetEventStatus_Event_INV_RSLVR_EXCT_PLAUS
          OpEventResetEventStatus_ResetEventStatus_Event_PS_P15_U_FLT: RteEventRef=OpEventResetEventStatus_ResetEventStatus_Event_PS_P15_U_FLT
          OpEventResetEventStatus_ResetEventStatus_Event_INV_EM_STATOR_TEMP_RNG_SWT: RteEventRef=OpEventResetEventStatus_ResetEventStatus_Event_INV_EM_STATOR_TEMP_RNG_SWT
          OpEventResetEventStatus_ResetEventStatus_Event_INV_UHVDC_OV_SWP: RteEventRef=OpEventResetEventStatus_ResetEventStatus_Event_INV_UHVDC_OV_SWP
          OpEventResetEventStatus_ResetEventStatus_Event_AURIX_HW_FLT: RteEventRef=OpEventResetEventStatus_ResetEventStatus_Event_AURIX_HW_FLT
          OpEventResetEventStatus_ResetEventStatus_Event_INV_GATE_DRVR_TOP_HWP: RteEventRef=OpEventResetEventStatus_ResetEventStatus_Event_INV_GATE_DRVR_TOP_HWP
          OpEventResetEventStatus_ResetEventStatus_Event_INV_ACTV_DCHA_HW: RteEventRef=OpEventResetEventStatus_ResetEventStatus_Event_INV_ACTV_DCHA_HW
          OpEventResetEventStatus_ResetEventStatus_Event_INV_IGBT_TEMP_HWP: RteEventRef=OpEventResetEventStatus_ResetEventStatus_Event_INV_IGBT_TEMP_HWP
          OpEventResetEventStatus_ResetEventStatus_Event_INV_RSLVR_SIN_ELEC_FLT: RteEventRef=OpEventResetEventStatus_ResetEventStatus_Event_INV_RSLVR_SIN_ELEC_FLT
          OpEventResetEventStatus_ResetEventStatus_Event_CU_TEMP2_RNG_HI: RteEventRef=OpEventResetEventStatus_ResetEventStatus_Event_CU_TEMP2_RNG_HI
          OpEventResetEventStatus_ResetEventStatus_Event_INV_IAC_PHA_LOSS_MPL: RteEventRef=OpEventResetEventStatus_ResetEventStatus_Event_INV_IAC_PHA_LOSS_MPL
          OpEventResetEventStatus_ResetEventStatus_Event_INV_IAC_U_AMP: RteEventRef=OpEventResetEventStatus_ResetEventStatus_Event_INV_IAC_U_AMP
          OpEventResetEventStatus_ResetEventStatus_Event_PSnsr_GRADT_Flt: RteEventRef=OpEventResetEventStatus_ResetEventStatus_Event_PSnsr_GRADT_Flt
          OpEventResetEventStatus_ResetEventStatus_Event_AURIX_WATHDOG_FLT: RteEventRef=OpEventResetEventStatus_ResetEventStatus_Event_AURIX_WATHDOG_FLT
          OpEventResetEventStatus_ResetEventStatus_Event_VcEvNodeMisBECM: RteEventRef=OpEventResetEventStatus_ResetEventStatus_Event_VcEvNodeMisBECM
          OpEventResetEventStatus_ResetEventStatus_Event_INV_UHVDC_UV_HWP: RteEventRef=OpEventResetEventStatus_ResetEventStatus_Event_INV_UHVDC_UV_HWP
          OpEventResetEventStatus_ResetEventStatus_Event_VcEvMonESpd: RteEventRef=OpEventResetEventStatus_ResetEventStatus_Event_VcEvMonESpd
          OpEventResetEventStatus_ResetEventStatus_Event_COM_NotConfig: RteEventRef=OpEventResetEventStatus_ResetEventStatus_Event_COM_NotConfig
          OpEventResetEventStatus_ResetEventStatus_Event_INV_RSLVR_SIN_RNG_HI: RteEventRef=OpEventResetEventStatus_ResetEventStatus_Event_INV_RSLVR_SIN_RNG_HI
          OpEventResetEventStatus_ResetEventStatus_Event_INV_IGBT_TEMP_U_RNG_HI: RteEventRef=OpEventResetEventStatus_ResetEventStatus_Event_INV_IGBT_TEMP_U_RNG_HI
          OpEventResetEventStatus_ResetEventStatus_Event_VcEvMonMode_001: RteEventRef=OpEventResetEventStatus_ResetEventStatus_Event_VcEvMonMode_001
          OpEventResetEventStatus_ResetEventStatus_Event_PA_ACTION_FLT: RteEventRef=OpEventResetEventStatus_ResetEventStatus_Event_PA_ACTION_FLT
          OpEventResetEventStatus_ResetEventStatus_Event_INV_IAC_V_ELEC_HWP: RteEventRef=OpEventResetEventStatus_ResetEventStatus_Event_INV_IAC_V_ELEC_HWP
          OpEventResetEventStatus_ResetEventStatus_Event_CU_TEMP_HW_FLT_001: RteEventRef=OpEventResetEventStatus_ResetEventStatus_Event_CU_TEMP_HW_FLT_001
          OpEventResetEventStatus_ResetEventStatus_Event_VCC_UnderVoltage: RteEventRef=OpEventResetEventStatus_ResetEventStatus_Event_VCC_UnderVoltage
          OpEventResetEventStatus_ResetEventStatus_Event_VcEvTsttrPlaus: RteEventRef=OpEventResetEventStatus_ResetEventStatus_Event_VcEvTsttrPlaus
          OpEventResetEventStatus_ResetEventStatus_Event_INV_RSLVR_EXCT_ELEC_FLT: RteEventRef=OpEventResetEventStatus_ResetEventStatus_Event_INV_RSLVR_EXCT_ELEC_FLT
          OpEventResetEventStatus_ResetEventStatus_Event_INV_RSLVR_EXCT_RNG_LO: RteEventRef=OpEventResetEventStatus_ResetEventStatus_Event_INV_RSLVR_EXCT_RNG_LO
          OpEventResetEventStatus_ResetEventStatus_Event_INV_EM_STATOR_TEMP2_RNG_HI: RteEventRef=OpEventResetEventStatus_ResetEventStatus_Event_INV_EM_STATOR_TEMP2_RNG_HI
          OpEventResetEventStatus_ResetEventStatus_Event_INV_SHUT_OFF_PAH_START_UP: RteEventRef=OpEventResetEventStatus_ResetEventStatus_Event_INV_SHUT_OFF_PAH_START_UP
          OpEventResetEventStatus_ResetEventStatus_Event_VCEvVddmPropFr08Tioutd: RteEventRef=OpEventResetEventStatus_ResetEventStatus_Event_VCEvVddmPropFr08Tioutd
          OpEventResetEventStatus_ResetEventStatus_Event_INV_RSLVR_EXCT_OC_HWP_001: RteEventRef=OpEventResetEventStatus_ResetEventStatus_Event_INV_RSLVR_EXCT_OC_HWP_001
          OpEventResetEventStatus_ResetEventStatus_Event_INV_RSLVR_EXCT_OC_HWP_002: RteEventRef=OpEventResetEventStatus_ResetEventStatus_Event_INV_RSLVR_EXCT_OC_HWP_002
          OpEventResetEventStatus_ResetEventStatus_Event_INV_EM_STATOR_TEMP_ELE_FLT: RteEventRef=OpEventResetEventStatus_ResetEventStatus_Event_INV_EM_STATOR_TEMP_ELE_FLT
          OpEventResetEventStatus_ResetEventStatus_Event_INV_INTERLOCK_FLT: RteEventRef=OpEventResetEventStatus_ResetEventStatus_Event_INV_INTERLOCK_FLT
          OpEventResetEventStatus_ResetEventStatus_Event_Ga_ZeroFindDistanFailure: RteEventRef=OpEventResetEventStatus_ResetEventStatus_Event_Ga_ZeroFindDistanFailure
          OpEventResetEventStatus_ResetEventStatus_Event_PLOCK_Current_RNG_OUT: RteEventRef=OpEventResetEventStatus_ResetEventStatus_Event_PLOCK_Current_RNG_OUT
          OpEventResetEventStatus_ResetEventStatus_Event_VCEvVddmPropFr05Tioutd: RteEventRef=OpEventResetEventStatus_ResetEventStatus_Event_VCEvVddmPropFr05Tioutd
          OpEventResetEventStatus_ResetEventStatus_Event_INV_IGBT_TEMP_V_GRDT: RteEventRef=OpEventResetEventStatus_ResetEventStatus_Event_INV_IGBT_TEMP_V_GRDT
          OpEventResetEventStatus_ResetEventStatus_Event_PS_5V_Fault: RteEventRef=OpEventResetEventStatus_ResetEventStatus_Event_PS_5V_Fault
          OpEventResetEventStatus_ResetEventStatus_Event_VcEvCntrCrashStsSafe: RteEventRef=OpEventResetEventStatus_ResetEventStatus_Event_VcEvCntrCrashStsSafe
          OpEventResetEventStatus_ResetEventStatus_Event_INV_EM_STATOR_TEMP_GRDT: RteEventRef=OpEventResetEventStatus_ResetEventStatus_Event_INV_EM_STATOR_TEMP_GRDT
          OpEventResetEventStatus_ResetEventStatus_Event_PS_P15_V_FLT: RteEventRef=OpEventResetEventStatus_ResetEventStatus_Event_PS_P15_V_FLT
          OpEventResetEventStatus_ResetEventStatus_Event_INV_EM_STATOR_TEMP_RNG_NOK: RteEventRef=OpEventResetEventStatus_ResetEventStatus_Event_INV_EM_STATOR_TEMP_RNG_NOK
          OpEventResetEventStatus_ResetEventStatus_Event_INV_RSLVR_SIN_RNG_NOK: RteEventRef=OpEventResetEventStatus_ResetEventStatus_Event_INV_RSLVR_SIN_RNG_NOK
          OpEventResetEventStatus_ResetEventStatus_Event_INV_IAC_U_OFFS: RteEventRef=OpEventResetEventStatus_ResetEventStatus_Event_INV_IAC_U_OFFS
          OpEventResetEventStatus_ResetEventStatus_Event_PS_KL30_BACKUP_FLT: RteEventRef=OpEventResetEventStatus_ResetEventStatus_Event_PS_KL30_BACKUP_FLT
          OpEventResetEventStatus_ResetEventStatus_Event_INV_IGBT_TEMP_U_RNG_LO: RteEventRef=OpEventResetEventStatus_ResetEventStatus_Event_INV_IGBT_TEMP_U_RNG_LO
          OpEventResetEventStatus_ResetEventStatus_Event_INV_EM_STATOR_TEMP_HWP: RteEventRef=OpEventResetEventStatus_ResetEventStatus_Event_INV_EM_STATOR_TEMP_HWP
          OpEventResetEventStatus_ResetEventStatus_Event_CU_TEMP1_RNG_HI: RteEventRef=OpEventResetEventStatus_ResetEventStatus_Event_CU_TEMP1_RNG_HI
          OpEventResetEventStatus_ResetEventStatus_Event_INV_IGBT_TEMP_V_RNG_HI: RteEventRef=OpEventResetEventStatus_ResetEventStatus_Event_INV_IGBT_TEMP_V_RNG_HI
          OpEventResetEventStatus_ResetEventStatus_Event_VcEvNodeMisVDDM: RteEventRef=OpEventResetEventStatus_ResetEventStatus_Event_VcEvNodeMisVDDM
          OpEventResetEventStatus_ResetEventStatus_Event_INV_UHVDC_PLAUS: RteEventRef=OpEventResetEventStatus_ResetEventStatus_Event_INV_UHVDC_PLAUS
          OpEventResetEventStatus_ResetEventStatus_Event_INV_QUIESCENT_FLT: RteEventRef=OpEventResetEventStatus_ResetEventStatus_Event_INV_QUIESCENT_FLT
          OpEventResetEventStatus_ResetEventStatus_Event_INV_RSLVR_EXCT_RNG_HI: RteEventRef=OpEventResetEventStatus_ResetEventStatus_Event_INV_RSLVR_EXCT_RNG_HI
          OpEventResetEventDebounceStatus_ResetEventDebounceStatus_Event_VCEvBecmPropFr01Tioutd: RteEventRef=OpEventResetEventDebounceStatus_ResetEventDebounceStatus_Event_VCEvBecmPropFr01Tioutd
          OpEventResetEventDebounceStatus_ResetEventDebounceStatus_Event_INV_CU_TEMP2_RNG_NOK: RteEventRef=OpEventResetEventDebounceStatus_ResetEventDebounceStatus_Event_INV_CU_TEMP2_RNG_NOK
          OpEventResetEventDebounceStatus_ResetEventDebounceStatus_Event_COM_Busoff: RteEventRef=OpEventResetEventDebounceStatus_ResetEventDebounceStatus_Event_COM_Busoff
          OpEventResetEventDebounceStatus_ResetEventDebounceStatus_Event_INV_IMMO_NOKEY: RteEventRef=OpEventResetEventDebounceStatus_ResetEventDebounceStatus_Event_INV_IMMO_NOKEY
          OpEventResetEventDebounceStatus_ResetEventDebounceStatus_Event_INV_RSLVR_EXCT_OC_HWP: RteEventRef=OpEventResetEventDebounceStatus_ResetEventDebounceStatus_Event_INV_RSLVR_EXCT_OC_HWP
          OpEventResetEventDebounceStatus_ResetEventDebounceStatus_Event_PS_P15_W_FLT: RteEventRef=OpEventResetEventDebounceStatus_ResetEventDebounceStatus_Event_PS_P15_W_FLT
          OpEventResetEventDebounceStatus_ResetEventDebounceStatus_Event_INV_IAC_PLAUS_SUM: RteEventRef=OpEventResetEventDebounceStatus_ResetEventDebounceStatus_Event_INV_IAC_PLAUS_SUM
          OpEventResetEventDebounceStatus_ResetEventDebounceStatus_Event_PA_ELE_FLT: RteEventRef=OpEventResetEventDebounceStatus_ResetEventDebounceStatus_Event_PA_ELE_FLT
          OpEventResetEventDebounceStatus_ResetEventDebounceStatus_Event_CU_TEMP_GRDT: RteEventRef=OpEventResetEventDebounceStatus_ResetEventDebounceStatus_Event_CU_TEMP_GRDT
          OpEventResetEventDebounceStatus_ResetEventDebounceStatus_Event_INV_IGBT_TEMP_V_PLAUS: RteEventRef=OpEventResetEventDebounceStatus_ResetEventDebounceStatus_Event_INV_IGBT_TEMP_V_PLAUS
          OpEventResetEventDebounceStatus_ResetEventDebounceStatus_Event_Ga_GAEngageFailure: RteEventRef=OpEventResetEventDebounceStatus_ResetEventDebounceStatus_Event_Ga_GAEngageFailure
          OpEventResetEventDebounceStatus_ResetEventDebounceStatus_Event_INV_IAC_W_RNG_LO: RteEventRef=OpEventResetEventDebounceStatus_ResetEventDebounceStatus_Event_INV_IAC_W_RNG_LO
          OpEventResetEventDebounceStatus_ResetEventDebounceStatus_Event_PS_WhlSnsr_Vltg_FLT: RteEventRef=OpEventResetEventDebounceStatus_ResetEventDebounceStatus_Event_PS_WhlSnsr_Vltg_FLT
          OpEventResetEventDebounceStatus_ResetEventDebounceStatus_Event_VCEvEcmPropFr02Tioutd: RteEventRef=OpEventResetEventDebounceStatus_ResetEventDebounceStatus_Event_VCEvEcmPropFr02Tioutd
          OpEventResetEventDebounceStatus_ResetEventDebounceStatus_Event_Ga_TmSpdSyncFailed: RteEventRef=OpEventResetEventDebounceStatus_ResetEventDebounceStatus_Event_Ga_TmSpdSyncFailed
          OpEventResetEventDebounceStatus_ResetEventDebounceStatus_Event_INV_RSLVR_EXCT_ELEC_LO: RteEventRef=OpEventResetEventDebounceStatus_ResetEventDebounceStatus_Event_INV_RSLVR_EXCT_ELEC_LO
          OpEventResetEventDebounceStatus_ResetEventDebounceStatus_Event_VCEvEcmPropXevFr06Tioutd: RteEventRef=OpEventResetEventDebounceStatus_ResetEventDebounceStatus_Event_VCEvEcmPropXevFr06Tioutd
          OpEventResetEventDebounceStatus_ResetEventDebounceStatus_Event_VcEvCntrWhlMotSysTqAllwd: RteEventRef=OpEventResetEventDebounceStatus_ResetEventDebounceStatus_Event_VcEvCntrWhlMotSysTqAllwd
          OpEventResetEventDebounceStatus_ResetEventDebounceStatus_Event_INV_UHVDC_1_ELEC_HI: RteEventRef=OpEventResetEventDebounceStatus_ResetEventDebounceStatus_Event_INV_UHVDC_1_ELEC_HI
          OpEventResetEventDebounceStatus_ResetEventDebounceStatus_Event_INV_EM_STATOR_TEMP2_ELE_FLT: RteEventRef=OpEventResetEventDebounceStatus_ResetEventDebounceStatus_Event_INV_EM_STATOR_TEMP2_ELE_FLT
          OpEventResetEventDebounceStatus_ResetEventDebounceStatus_Event_AURIX_RST_SNG: RteEventRef=OpEventResetEventDebounceStatus_ResetEventDebounceStatus_Event_AURIX_RST_SNG
          OpEventResetEventDebounceStatus_ResetEventDebounceStatus_Event_VCEvEcmPropFr24MgmFr01Tioutd: RteEventRef=OpEventResetEventDebounceStatus_ResetEventDebounceStatus_Event_VCEvEcmPropFr24MgmFr01Tioutd
          OpEventResetEventDebounceStatus_ResetEventDebounceStatus_Event_INV_RSLVR_COS_ELEC_OPEN: RteEventRef=OpEventResetEventDebounceStatus_ResetEventDebounceStatus_Event_INV_RSLVR_COS_ELEC_OPEN
          OpEventResetEventDebounceStatus_ResetEventDebounceStatus_Event_INV_IAC_V_ELEC_LO: RteEventRef=OpEventResetEventDebounceStatus_ResetEventDebounceStatus_Event_INV_IAC_V_ELEC_LO
          OpEventResetEventDebounceStatus_ResetEventDebounceStatus_Event_INV_IAC_W_OFFS: RteEventRef=OpEventResetEventDebounceStatus_ResetEventDebounceStatus_Event_INV_IAC_W_OFFS
          OpEventResetEventDebounceStatus_ResetEventDebounceStatus_Event_INV_EM_STATOR_TEMP2_GRDT: RteEventRef=OpEventResetEventDebounceStatus_ResetEventDebounceStatus_Event_INV_EM_STATOR_TEMP2_GRDT
          OpEventResetEventDebounceStatus_ResetEventDebounceStatus_Event_INV_EM_OVRSPD_HWP: RteEventRef=OpEventResetEventDebounceStatus_ResetEventDebounceStatus_Event_INV_EM_OVRSPD_HWP
          OpEventResetEventDebounceStatus_ResetEventDebounceStatus_Event_CU_TEMP_HWP: RteEventRef=OpEventResetEventDebounceStatus_ResetEventDebounceStatus_Event_CU_TEMP_HWP
          OpEventResetEventDebounceStatus_ResetEventDebounceStatus_Event_INV_UHVDC_1_RNG_HI: RteEventRef=OpEventResetEventDebounceStatus_ResetEventDebounceStatus_Event_INV_UHVDC_1_RNG_HI
          OpEventResetEventDebounceStatus_ResetEventDebounceStatus_Event_VcEvEMPerfPlaus: RteEventRef=OpEventResetEventDebounceStatus_ResetEventDebounceStatus_Event_VcEvEMPerfPlaus
          OpEventResetEventDebounceStatus_ResetEventDebounceStatus_Event_VCEvVddmPropFr18Tioutd: RteEventRef=OpEventResetEventDebounceStatus_ResetEventDebounceStatus_Event_VCEvVddmPropFr18Tioutd
          OpEventResetEventDebounceStatus_ResetEventDebounceStatus_Event_INV_IAC_U_ELEC_HWP: RteEventRef=OpEventResetEventDebounceStatus_ResetEventDebounceStatus_Event_INV_IAC_U_ELEC_HWP
          OpEventResetEventDebounceStatus_ResetEventDebounceStatus_Event_VCEvVddmPropFr15Tioutd: RteEventRef=OpEventResetEventDebounceStatus_ResetEventDebounceStatus_Event_VCEvVddmPropFr15Tioutd
          OpEventResetEventDebounceStatus_ResetEventDebounceStatus_Event_Ga_GADisengageFailure: RteEventRef=OpEventResetEventDebounceStatus_ResetEventDebounceStatus_Event_Ga_GADisengageFailure
          OpEventResetEventDebounceStatus_ResetEventDebounceStatus_Event_CU_TEMP2_RNG_LO: RteEventRef=OpEventResetEventDebounceStatus_ResetEventDebounceStatus_Event_CU_TEMP2_RNG_LO
          OpEventResetEventDebounceStatus_ResetEventDebounceStatus_Event_INV_RSLVR_SIN_ELEC_OPEN: RteEventRef=OpEventResetEventDebounceStatus_ResetEventDebounceStatus_Event_INV_RSLVR_SIN_ELEC_OPEN
          OpEventResetEventDebounceStatus_ResetEventDebounceStatus_Event_VcEvChkSum: RteEventRef=OpEventResetEventDebounceStatus_ResetEventDebounceStatus_Event_VcEvChkSum
          OpEventResetEventDebounceStatus_ResetEventDebounceStatus_Event_PS_P5_UC_FLT: RteEventRef=OpEventResetEventDebounceStatus_ResetEventDebounceStatus_Event_PS_P5_UC_FLT
          OpEventResetEventDebounceStatus_ResetEventDebounceStatus_Event_INV_RSLVR_COS_ELEC_FLT: RteEventRef=OpEventResetEventDebounceStatus_ResetEventDebounceStatus_Event_INV_RSLVR_COS_ELEC_FLT
          OpEventResetEventDebounceStatus_ResetEventDebounceStatus_Event_INV_IAC_W_RNG_HI: RteEventRef=OpEventResetEventDebounceStatus_ResetEventDebounceStatus_Event_INV_IAC_W_RNG_HI
          OpEventResetEventDebounceStatus_ResetEventDebounceStatus_Event_PS_ECUSUPPLY_HIGH: RteEventRef=OpEventResetEventDebounceStatus_ResetEventDebounceStatus_Event_PS_ECUSUPPLY_HIGH
          OpEventResetEventDebounceStatus_ResetEventDebounceStatus_Event_VCEvEcmPropFr05Tioutd: RteEventRef=OpEventResetEventDebounceStatus_ResetEventDebounceStatus_Event_VCEvEcmPropFr05Tioutd
          OpEventResetEventDebounceStatus_ResetEventDebounceStatus_Event_PS_ECUSUPPLY_LOW: RteEventRef=OpEventResetEventDebounceStatus_ResetEventDebounceStatus_Event_PS_ECUSUPPLY_LOW
          OpEventResetEventDebounceStatus_ResetEventDebounceStatus_Event_VcEvChkSumHvSysRlySts: RteEventRef=OpEventResetEventDebounceStatus_ResetEventDebounceStatus_Event_VcEvChkSumHvSysRlySts
          OpEventResetEventDebounceStatus_ResetEventDebounceStatus_Event_VcEvMonMode: RteEventRef=OpEventResetEventDebounceStatus_ResetEventDebounceStatus_Event_VcEvMonMode
          OpEventResetEventDebounceStatus_ResetEventDebounceStatus_Event_INV_IAC_OC_SWP: RteEventRef=OpEventResetEventDebounceStatus_ResetEventDebounceStatus_Event_INV_IAC_OC_SWP
          OpEventResetEventDebounceStatus_ResetEventDebounceStatus_Event_INV_IMMO_AUTHFAIL: RteEventRef=OpEventResetEventDebounceStatus_ResetEventDebounceStatus_Event_INV_IMMO_AUTHFAIL
          OpEventResetEventDebounceStatus_ResetEventDebounceStatus_Event_PA_OpenCirc_FLT: RteEventRef=OpEventResetEventDebounceStatus_ResetEventDebounceStatus_Event_PA_OpenCirc_FLT
          OpEventResetEventDebounceStatus_ResetEventDebounceStatus_Event_INV_IAC_V_ELEC_HI: RteEventRef=OpEventResetEventDebounceStatus_ResetEventDebounceStatus_Event_INV_IAC_V_ELEC_HI
          OpEventResetEventDebounceStatus_ResetEventDebounceStatus_Event_VCEvEcmPropFr04Tioutd: RteEventRef=OpEventResetEventDebounceStatus_ResetEventDebounceStatus_Event_VCEvEcmPropFr04Tioutd
          OpEventResetEventDebounceStatus_ResetEventDebounceStatus_Event_VcEvMonTrqActPlaus: RteEventRef=OpEventResetEventDebounceStatus_ResetEventDebounceStatus_Event_VcEvMonTrqActPlaus
          OpEventResetEventDebounceStatus_ResetEventDebounceStatus_Event_VcEvMonTrqAct: RteEventRef=OpEventResetEventDebounceStatus_ResetEventDebounceStatus_Event_VcEvMonTrqAct
          OpEventResetEventDebounceStatus_ResetEventDebounceStatus_Event_INV_RSLVR_COS_ELEC_LO: RteEventRef=OpEventResetEventDebounceStatus_ResetEventDebounceStatus_Event_INV_RSLVR_COS_ELEC_LO
          OpEventResetEventDebounceStatus_ResetEventDebounceStatus_Event_INV_COOLT_INLET_TEMP_HWP: RteEventRef=OpEventResetEventDebounceStatus_ResetEventDebounceStatus_Event_INV_COOLT_INLET_TEMP_HWP
          OpEventResetEventDebounceStatus_ResetEventDebounceStatus_Event_VCEvEcmPropFr11Tioutd: RteEventRef=OpEventResetEventDebounceStatus_ResetEventDebounceStatus_Event_VCEvEcmPropFr11Tioutd
          OpEventResetEventDebounceStatus_ResetEventDebounceStatus_Event_PS_KL30_RNG_HI: RteEventRef=OpEventResetEventDebounceStatus_ResetEventDebounceStatus_Event_PS_KL30_RNG_HI
          OpEventResetEventDebounceStatus_ResetEventDebounceStatus_Event_INV_IAC_OC_HWP: RteEventRef=OpEventResetEventDebounceStatus_ResetEventDebounceStatus_Event_INV_IAC_OC_HWP
          OpEventResetEventDebounceStatus_ResetEventDebounceStatus_Event_INV_RSLVR_COS_RNG_HI: RteEventRef=OpEventResetEventDebounceStatus_ResetEventDebounceStatus_Event_INV_RSLVR_COS_RNG_HI
          OpEventResetEventDebounceStatus_ResetEventDebounceStatus_Event_INV_IAC_U_ELEC_HI: RteEventRef=OpEventResetEventDebounceStatus_ResetEventDebounceStatus_Event_INV_IAC_U_ELEC_HI
          OpEventResetEventDebounceStatus_ResetEventDebounceStatus_Event_INV_IAC_V_RNG_LO: RteEventRef=OpEventResetEventDebounceStatus_ResetEventDebounceStatus_Event_INV_IAC_V_RNG_LO
          OpEventResetEventDebounceStatus_ResetEventDebounceStatus_Event_INV_IAC_U_RNG_HI: RteEventRef=OpEventResetEventDebounceStatus_ResetEventDebounceStatus_Event_INV_IAC_U_RNG_HI
          OpEventResetEventDebounceStatus_ResetEventDebounceStatus_Event_VCEvEcmPropFr25Tioutd: RteEventRef=OpEventResetEventDebounceStatus_ResetEventDebounceStatus_Event_VCEvEcmPropFr25Tioutd
          OpEventResetEventDebounceStatus_ResetEventDebounceStatus_Event_INV_IGBT_TEMP_W_RNG_LO: RteEventRef=OpEventResetEventDebounceStatus_ResetEventDebounceStatus_Event_INV_IGBT_TEMP_W_RNG_LO
          OpEventResetEventDebounceStatus_ResetEventDebounceStatus_Event_PSnsr_RNG_NOK: RteEventRef=OpEventResetEventDebounceStatus_ResetEventDebounceStatus_Event_PSnsr_RNG_NOK
          OpEventResetEventDebounceStatus_ResetEventDebounceStatus_Event_INV_RSLVR_COS_RNG_NOK: RteEventRef=OpEventResetEventDebounceStatus_ResetEventDebounceStatus_Event_INV_RSLVR_COS_RNG_NOK
          OpEventResetEventDebounceStatus_ResetEventDebounceStatus_Event_PS_DRVB_Fault: RteEventRef=OpEventResetEventDebounceStatus_ResetEventDebounceStatus_Event_PS_DRVB_Fault
          OpEventResetEventDebounceStatus_ResetEventDebounceStatus_Event_INV_CU_TEMP1_RNG_NOK: RteEventRef=OpEventResetEventDebounceStatus_ResetEventDebounceStatus_Event_INV_CU_TEMP1_RNG_NOK
          OpEventResetEventDebounceStatus_ResetEventDebounceStatus_Event_VcEvCntr: RteEventRef=OpEventResetEventDebounceStatus_ResetEventDebounceStatus_Event_VcEvCntr
          OpEventResetEventDebounceStatus_ResetEventDebounceStatus_Event_INV_RSLVR_SIN_AMP: RteEventRef=OpEventResetEventDebounceStatus_ResetEventDebounceStatus_Event_INV_RSLVR_SIN_AMP
          OpEventResetEventDebounceStatus_ResetEventDebounceStatus_Event_INV_UHVDC_2_RNG_HI: RteEventRef=OpEventResetEventDebounceStatus_ResetEventDebounceStatus_Event_INV_UHVDC_2_RNG_HI
          OpEventResetEventDebounceStatus_ResetEventDebounceStatus_Event_INV_IGBT_TEMP_U_GRDT: RteEventRef=OpEventResetEventDebounceStatus_ResetEventDebounceStatus_Event_INV_IGBT_TEMP_U_GRDT
          OpEventResetEventDebounceStatus_ResetEventDebounceStatus_Event_MON_TQ_PLAUS_PWR_MDL: RteEventRef=OpEventResetEventDebounceStatus_ResetEventDebounceStatus_Event_MON_TQ_PLAUS_PWR_MDL
          OpEventResetEventDebounceStatus_ResetEventDebounceStatus_Event_INV_IGBT_TEMP_W_PLAUS: RteEventRef=OpEventResetEventDebounceStatus_ResetEventDebounceStatus_Event_INV_IGBT_TEMP_W_PLAUS
          OpEventResetEventDebounceStatus_ResetEventDebounceStatus_Event_PS_BLDC_UV_FLT: RteEventRef=OpEventResetEventDebounceStatus_ResetEventDebounceStatus_Event_PS_BLDC_UV_FLT
          OpEventResetEventDebounceStatus_ResetEventDebounceStatus_Event_INV_IAC_V_OFFS: RteEventRef=OpEventResetEventDebounceStatus_ResetEventDebounceStatus_Event_INV_IAC_V_OFFS
          OpEventResetEventDebounceStatus_ResetEventDebounceStatus_Event_INV_RSLVR_EXCT_FREQ_RNG_NOK: RteEventRef=OpEventResetEventDebounceStatus_ResetEventDebounceStatus_Event_INV_RSLVR_EXCT_FREQ_RNG_NOK
          OpEventResetEventDebounceStatus_ResetEventDebounceStatus_Event_PS_KL30_RNG_LO: RteEventRef=OpEventResetEventDebounceStatus_ResetEventDebounceStatus_Event_PS_KL30_RNG_LO
          OpEventResetEventDebounceStatus_ResetEventDebounceStatus_Event_INV_RSLVR_COS_RNG_LO: RteEventRef=OpEventResetEventDebounceStatus_ResetEventDebounceStatus_Event_INV_RSLVR_COS_RNG_LO
          OpEventResetEventDebounceStatus_ResetEventDebounceStatus_Event_PSnsr_ELE_FLT: RteEventRef=OpEventResetEventDebounceStatus_ResetEventDebounceStatus_Event_PSnsr_ELE_FLT
          OpEventResetEventDebounceStatus_ResetEventDebounceStatus_Event_INV_RSLVR_SIN_COS_PLAUS_AMP: RteEventRef=OpEventResetEventDebounceStatus_ResetEventDebounceStatus_Event_INV_RSLVR_SIN_COS_PLAUS_AMP
          OpEventResetEventDebounceStatus_ResetEventDebounceStatus_Event_INV_IAC_U_ELEC_LO: RteEventRef=OpEventResetEventDebounceStatus_ResetEventDebounceStatus_Event_INV_IAC_U_ELEC_LO
          OpEventResetEventDebounceStatus_ResetEventDebounceStatus_Event_INV_RSLVR_EXCT_ELEC_HI: RteEventRef=OpEventResetEventDebounceStatus_ResetEventDebounceStatus_Event_INV_RSLVR_EXCT_ELEC_HI
          OpEventResetEventDebounceStatus_ResetEventDebounceStatus_Event_INV_IAC_U_RNG_LO: RteEventRef=OpEventResetEventDebounceStatus_ResetEventDebounceStatus_Event_INV_IAC_U_RNG_LO
          OpEventResetEventDebounceStatus_ResetEventDebounceStatus_Event_INV_IAC_V_RNG_HI: RteEventRef=OpEventResetEventDebounceStatus_ResetEventDebounceStatus_Event_INV_IAC_V_RNG_HI
          OpEventResetEventDebounceStatus_ResetEventDebounceStatus_Event_INV_IGBT_TEMP_U_PLAUS: RteEventRef=OpEventResetEventDebounceStatus_ResetEventDebounceStatus_Event_INV_IGBT_TEMP_U_PLAUS
          OpEventResetEventDebounceStatus_ResetEventDebounceStatus_Event_INV_RSLVR_OFFS_DFT: RteEventRef=OpEventResetEventDebounceStatus_ResetEventDebounceStatus_Event_INV_RSLVR_OFFS_DFT
          OpEventResetEventDebounceStatus_ResetEventDebounceStatus_Event_Ga_MoveOverThd: RteEventRef=OpEventResetEventDebounceStatus_ResetEventDebounceStatus_Event_Ga_MoveOverThd
          OpEventResetEventDebounceStatus_ResetEventDebounceStatus_Event_VcEvMonIPH: RteEventRef=OpEventResetEventDebounceStatus_ResetEventDebounceStatus_Event_VcEvMonIPH
          OpEventResetEventDebounceStatus_ResetEventDebounceStatus_Event_INV_RSLVR_HW_FLT: RteEventRef=OpEventResetEventDebounceStatus_ResetEventDebounceStatus_Event_INV_RSLVR_HW_FLT
          OpEventResetEventDebounceStatus_ResetEventDebounceStatus_Event_INV_RSLVR_SIN_ELEC_LO: RteEventRef=OpEventResetEventDebounceStatus_ResetEventDebounceStatus_Event_INV_RSLVR_SIN_ELEC_LO
          OpEventResetEventDebounceStatus_ResetEventDebounceStatus_Event_INV_IAC_W_AMP: RteEventRef=OpEventResetEventDebounceStatus_ResetEventDebounceStatus_Event_INV_IAC_W_AMP
          OpEventResetEventDebounceStatus_ResetEventDebounceStatus_Event_VCC_OverVoltage: RteEventRef=OpEventResetEventDebounceStatus_ResetEventDebounceStatus_Event_VCC_OverVoltage
          OpEventResetEventDebounceStatus_ResetEventDebounceStatus_Event_PS_BLDC_OV_FLT: RteEventRef=OpEventResetEventDebounceStatus_ResetEventDebounceStatus_Event_PS_BLDC_OV_FLT
          OpEventResetEventDebounceStatus_ResetEventDebounceStatus_Event_AURIX_EEPROM_FLT: RteEventRef=OpEventResetEventDebounceStatus_ResetEventDebounceStatus_Event_AURIX_EEPROM_FLT
          OpEventResetEventDebounceStatus_ResetEventDebounceStatus_Event_FS_MONITIOR_ASC_FW_FLT: RteEventRef=OpEventResetEventDebounceStatus_ResetEventDebounceStatus_Event_FS_MONITIOR_ASC_FW_FLT
          OpEventResetEventDebounceStatus_ResetEventDebounceStatus_Event_VCEvSrsPropFr02Tioutd: RteEventRef=OpEventResetEventDebounceStatus_ResetEventDebounceStatus_Event_VCEvSrsPropFr02Tioutd
          OpEventResetEventDebounceStatus_ResetEventDebounceStatus_Event_VcEvMonErrMode: RteEventRef=OpEventResetEventDebounceStatus_ResetEventDebounceStatus_Event_VcEvMonErrMode
          OpEventResetEventDebounceStatus_ResetEventDebounceStatus_Event_AURIX_RST_MPL: RteEventRef=OpEventResetEventDebounceStatus_ResetEventDebounceStatus_Event_AURIX_RST_MPL
          OpEventResetEventDebounceStatus_ResetEventDebounceStatus_Event_VcEvNodeMisECM: RteEventRef=OpEventResetEventDebounceStatus_ResetEventDebounceStatus_Event_VcEvNodeMisECM
          OpEventResetEventDebounceStatus_ResetEventDebounceStatus_Event_PS_KL30_PLAUS: RteEventRef=OpEventResetEventDebounceStatus_ResetEventDebounceStatus_Event_PS_KL30_PLAUS
          OpEventResetEventDebounceStatus_ResetEventDebounceStatus_Event_INV_IAC_W_ELEC_HI: RteEventRef=OpEventResetEventDebounceStatus_ResetEventDebounceStatus_Event_INV_IAC_W_ELEC_HI
          OpEventResetEventDebounceStatus_ResetEventDebounceStatus_Event_VCEvVddmPropFr19Tioutd: RteEventRef=OpEventResetEventDebounceStatus_ResetEventDebounceStatus_Event_VCEvVddmPropFr19Tioutd
          OpEventResetEventDebounceStatus_ResetEventDebounceStatus_Event_INV_TEMP_DCHA_HW: RteEventRef=OpEventResetEventDebounceStatus_ResetEventDebounceStatus_Event_INV_TEMP_DCHA_HW
          OpEventResetEventDebounceStatus_ResetEventDebounceStatus_Event_VcEvPropCANGlbTiOutd: RteEventRef=OpEventResetEventDebounceStatus_ResetEventDebounceStatus_Event_VcEvPropCANGlbTiOutd
          OpEventResetEventDebounceStatus_ResetEventDebounceStatus_Event_INV_EM_STATOR_TEMP2_RNG_NOK: RteEventRef=OpEventResetEventDebounceStatus_ResetEventDebounceStatus_Event_INV_EM_STATOR_TEMP2_RNG_NOK
          OpEventResetEventDebounceStatus_ResetEventDebounceStatus_Event_INV_UHVDC_OV_HWP: RteEventRef=OpEventResetEventDebounceStatus_ResetEventDebounceStatus_Event_INV_UHVDC_OV_HWP
          OpEventResetEventDebounceStatus_ResetEventDebounceStatus_Event_Ga_FindEngleAngleFailed: RteEventRef=OpEventResetEventDebounceStatus_ResetEventDebounceStatus_Event_Ga_FindEngleAngleFailed
          OpEventResetEventDebounceStatus_ResetEventDebounceStatus_Event_VcEvMonTrqCmp: RteEventRef=OpEventResetEventDebounceStatus_ResetEventDebounceStatus_Event_VcEvMonTrqCmp
          OpEventResetEventDebounceStatus_ResetEventDebounceStatus_Event_INV_IGBT_TEMP_V_RNG_LO: RteEventRef=OpEventResetEventDebounceStatus_ResetEventDebounceStatus_Event_INV_IGBT_TEMP_V_RNG_LO
          OpEventResetEventDebounceStatus_ResetEventDebounceStatus_Event_INV_CONTROL_LIMIT: RteEventRef=OpEventResetEventDebounceStatus_ResetEventDebounceStatus_Event_INV_CONTROL_LIMIT
          OpEventResetEventDebounceStatus_ResetEventDebounceStatus_Event_COM_CarConfigErr: RteEventRef=OpEventResetEventDebounceStatus_ResetEventDebounceStatus_Event_COM_CarConfigErr
          OpEventResetEventDebounceStatus_ResetEventDebounceStatus_Event_VCEvEcmPropFr08Tioutd: RteEventRef=OpEventResetEventDebounceStatus_ResetEventDebounceStatus_Event_VCEvEcmPropFr08Tioutd
          OpEventResetEventDebounceStatus_ResetEventDebounceStatus_Event_CU_TEMP1_RNG_LO: RteEventRef=OpEventResetEventDebounceStatus_ResetEventDebounceStatus_Event_CU_TEMP1_RNG_LO
          OpEventResetEventDebounceStatus_ResetEventDebounceStatus_Event_INV_EM_STATOR_TEMP2_RNG_SWT: RteEventRef=OpEventResetEventDebounceStatus_ResetEventDebounceStatus_Event_INV_EM_STATOR_TEMP2_RNG_SWT
          OpEventResetEventDebounceStatus_ResetEventDebounceStatus_Event_GA_BLDC_POS_FLT: RteEventRef=OpEventResetEventDebounceStatus_ResetEventDebounceStatus_Event_GA_BLDC_POS_FLT
          OpEventResetEventDebounceStatus_ResetEventDebounceStatus_Event_PS_WhlSnsr_FLT: RteEventRef=OpEventResetEventDebounceStatus_ResetEventDebounceStatus_Event_PS_WhlSnsr_FLT
          OpEventResetEventDebounceStatus_ResetEventDebounceStatus_Event_INV_EM_STATOR_TEMP_RNG_LO: RteEventRef=OpEventResetEventDebounceStatus_ResetEventDebounceStatus_Event_INV_EM_STATOR_TEMP_RNG_LO
          OpEventResetEventDebounceStatus_ResetEventDebounceStatus_Event_INV_RSLVR_SIN_ELEC_HI: RteEventRef=OpEventResetEventDebounceStatus_ResetEventDebounceStatus_Event_INV_RSLVR_SIN_ELEC_HI
          OpEventResetEventDebounceStatus_ResetEventDebounceStatus_Event_INV_RSLVR_SIN_COS_PLAUS: RteEventRef=OpEventResetEventDebounceStatus_ResetEventDebounceStatus_Event_INV_RSLVR_SIN_COS_PLAUS
          OpEventResetEventDebounceStatus_ResetEventDebounceStatus_Event_INV_RSLVR_COS_AMP: RteEventRef=OpEventResetEventDebounceStatus_ResetEventDebounceStatus_Event_INV_RSLVR_COS_AMP
          OpEventResetEventDebounceStatus_ResetEventDebounceStatus_Event_INV_GATE_DRVR_BOT_HWP: RteEventRef=OpEventResetEventDebounceStatus_ResetEventDebounceStatus_Event_INV_GATE_DRVR_BOT_HWP
          OpEventResetEventDebounceStatus_ResetEventDebounceStatus_Event_Eg_HallVolWrong: RteEventRef=OpEventResetEventDebounceStatus_ResetEventDebounceStatus_Event_Eg_HallVolWrong
          OpEventResetEventDebounceStatus_ResetEventDebounceStatus_Event_INV_RSLVR_EXCT_RNG_NOK: RteEventRef=OpEventResetEventDebounceStatus_ResetEventDebounceStatus_Event_INV_RSLVR_EXCT_RNG_NOK
          OpEventResetEventDebounceStatus_ResetEventDebounceStatus_Event_PA_OpenCirc: RteEventRef=OpEventResetEventDebounceStatus_ResetEventDebounceStatus_Event_PA_OpenCirc
          OpEventResetEventDebounceStatus_ResetEventDebounceStatus_Event_INV_RSLVR_COS_ELEC_HI: RteEventRef=OpEventResetEventDebounceStatus_ResetEventDebounceStatus_Event_INV_RSLVR_COS_ELEC_HI
          OpEventResetEventDebounceStatus_ResetEventDebounceStatus_Event_VcEvCntrHvSysRlySts: RteEventRef=OpEventResetEventDebounceStatus_ResetEventDebounceStatus_Event_VcEvCntrHvSysRlySts
          OpEventResetEventDebounceStatus_ResetEventDebounceStatus_Event_CRASH_DTC: RteEventRef=OpEventResetEventDebounceStatus_ResetEventDebounceStatus_Event_CRASH_DTC
          OpEventResetEventDebounceStatus_ResetEventDebounceStatus_Event_INV_IGBT_TEMP_W_RNG_HI: RteEventRef=OpEventResetEventDebounceStatus_ResetEventDebounceStatus_Event_INV_IGBT_TEMP_W_RNG_HI
          OpEventResetEventDebounceStatus_ResetEventDebounceStatus_Event_VCEvBecmPropFr02Tioutd: RteEventRef=OpEventResetEventDebounceStatus_ResetEventDebounceStatus_Event_VCEvBecmPropFr02Tioutd
          OpEventResetEventDebounceStatus_ResetEventDebounceStatus_Event_INV_IGBT_TEMP_W_GRDT: RteEventRef=OpEventResetEventDebounceStatus_ResetEventDebounceStatus_Event_INV_IGBT_TEMP_W_GRDT
          OpEventResetEventDebounceStatus_ResetEventDebounceStatus_Event_EXT_UC_SPI_FLT: RteEventRef=OpEventResetEventDebounceStatus_ResetEventDebounceStatus_Event_EXT_UC_SPI_FLT
          OpEventResetEventDebounceStatus_ResetEventDebounceStatus_Event_INV_IAC_V_ELEC_HWP_001: RteEventRef=OpEventResetEventDebounceStatus_ResetEventDebounceStatus_Event_INV_IAC_V_ELEC_HWP_001
          OpEventResetEventDebounceStatus_ResetEventDebounceStatus_Event_VcEvChkSumWhlMotSysTqAllwd: RteEventRef=OpEventResetEventDebounceStatus_ResetEventDebounceStatus_Event_VcEvChkSumWhlMotSysTqAllwd
          OpEventResetEventDebounceStatus_ResetEventDebounceStatus_Event_FS_MONITIOR_ASC_FLT: RteEventRef=OpEventResetEventDebounceStatus_ResetEventDebounceStatus_Event_FS_MONITIOR_ASC_FLT
          OpEventResetEventDebounceStatus_ResetEventDebounceStatus_Event_INV_IAC_V_AMP: RteEventRef=OpEventResetEventDebounceStatus_ResetEventDebounceStatus_Event_INV_IAC_V_AMP
          OpEventResetEventDebounceStatus_ResetEventDebounceStatus_Event_INV_IAC_W_ELEC_LO: RteEventRef=OpEventResetEventDebounceStatus_ResetEventDebounceStatus_Event_INV_IAC_W_ELEC_LO
          OpEventResetEventDebounceStatus_ResetEventDebounceStatus_Event_VCEvVddmPropFr08Tioutd_001: RteEventRef=OpEventResetEventDebounceStatus_ResetEventDebounceStatus_Event_VCEvVddmPropFr08Tioutd_001
          OpEventResetEventDebounceStatus_ResetEventDebounceStatus_Event_PS_P12_RES_FLT: RteEventRef=OpEventResetEventDebounceStatus_ResetEventDebounceStatus_Event_PS_P12_RES_FLT
          OpEventResetEventDebounceStatus_ResetEventDebounceStatus_Event_INV_RSLVR_SIN_RNG_LO: RteEventRef=OpEventResetEventDebounceStatus_ResetEventDebounceStatus_Event_INV_RSLVR_SIN_RNG_LO
          OpEventResetEventDebounceStatus_ResetEventDebounceStatus_Event_CU_TEMP_HW_FLT: RteEventRef=OpEventResetEventDebounceStatus_ResetEventDebounceStatus_Event_CU_TEMP_HW_FLT
          OpEventResetEventDebounceStatus_ResetEventDebounceStatus_Event_VCEvEcmPropFr02MgmFr00Tioutd: RteEventRef=OpEventResetEventDebounceStatus_ResetEventDebounceStatus_Event_VCEvEcmPropFr02MgmFr00Tioutd
          OpEventResetEventDebounceStatus_ResetEventDebounceStatus_Event_PS_KL15_RNG_HI: RteEventRef=OpEventResetEventDebounceStatus_ResetEventDebounceStatus_Event_PS_KL15_RNG_HI
          OpEventResetEventDebounceStatus_ResetEventDebounceStatus_Event_VCEvVddmPropFr17Tioutd: RteEventRef=OpEventResetEventDebounceStatus_ResetEventDebounceStatus_Event_VCEvVddmPropFr17Tioutd
          OpEventResetEventDebounceStatus_ResetEventDebounceStatus_Event_VcEvChkSumCrashStsSafe: RteEventRef=OpEventResetEventDebounceStatus_ResetEventDebounceStatus_Event_VcEvChkSumCrashStsSafe
          OpEventResetEventDebounceStatus_ResetEventDebounceStatus_Event_DiagC_ClutchService: RteEventRef=OpEventResetEventDebounceStatus_ResetEventDebounceStatus_Event_DiagC_ClutchService
          OpEventResetEventDebounceStatus_ResetEventDebounceStatus_Event_INV_EM_STATOR_TEMP_RNG_HI: RteEventRef=OpEventResetEventDebounceStatus_ResetEventDebounceStatus_Event_INV_EM_STATOR_TEMP_RNG_HI
          OpEventResetEventDebounceStatus_ResetEventDebounceStatus_Event_INV_RSLVR_OFFS_OUT_RANG: RteEventRef=OpEventResetEventDebounceStatus_ResetEventDebounceStatus_Event_INV_RSLVR_OFFS_OUT_RANG
          OpEventResetEventDebounceStatus_ResetEventDebounceStatus_Event_INV_EM_STATOR_TEMP2_RNG_LO: RteEventRef=OpEventResetEventDebounceStatus_ResetEventDebounceStatus_Event_INV_EM_STATOR_TEMP2_RNG_LO
          OpEventResetEventDebounceStatus_ResetEventDebounceStatus_Event_VcEvMonISAR: RteEventRef=OpEventResetEventDebounceStatus_ResetEventDebounceStatus_Event_VcEvMonISAR
          OpEventResetEventDebounceStatus_ResetEventDebounceStatus_Event_GA_BLDC_FLT: RteEventRef=OpEventResetEventDebounceStatus_ResetEventDebounceStatus_Event_GA_BLDC_FLT
          OpEventResetEventDebounceStatus_ResetEventDebounceStatus_Event_INV_RSLVR_EXCT_ELEC_OPEN: RteEventRef=OpEventResetEventDebounceStatus_ResetEventDebounceStatus_Event_INV_RSLVR_EXCT_ELEC_OPEN
          OpEventResetEventDebounceStatus_ResetEventDebounceStatus_Event_INV_RSLVR_EXCT_PLAUS: RteEventRef=OpEventResetEventDebounceStatus_ResetEventDebounceStatus_Event_INV_RSLVR_EXCT_PLAUS
          OpEventResetEventDebounceStatus_ResetEventDebounceStatus_Event_PS_P15_U_FLT: RteEventRef=OpEventResetEventDebounceStatus_ResetEventDebounceStatus_Event_PS_P15_U_FLT
          OpEventResetEventDebounceStatus_ResetEventDebounceStatus_Event_INV_EM_STATOR_TEMP_RNG_SWT: RteEventRef=OpEventResetEventDebounceStatus_ResetEventDebounceStatus_Event_INV_EM_STATOR_TEMP_RNG_SWT
          OpEventResetEventDebounceStatus_ResetEventDebounceStatus_Event_INV_UHVDC_OV_SWP: RteEventRef=OpEventResetEventDebounceStatus_ResetEventDebounceStatus_Event_INV_UHVDC_OV_SWP
          OpEventResetEventDebounceStatus_ResetEventDebounceStatus_Event_AURIX_HW_FLT: RteEventRef=OpEventResetEventDebounceStatus_ResetEventDebounceStatus_Event_AURIX_HW_FLT
          OpEventResetEventDebounceStatus_ResetEventDebounceStatus_Event_INV_GATE_DRVR_TOP_HWP: RteEventRef=OpEventResetEventDebounceStatus_ResetEventDebounceStatus_Event_INV_GATE_DRVR_TOP_HWP
          OpEventResetEventDebounceStatus_ResetEventDebounceStatus_Event_INV_ACTV_DCHA_HW: RteEventRef=OpEventResetEventDebounceStatus_ResetEventDebounceStatus_Event_INV_ACTV_DCHA_HW
          OpEventResetEventDebounceStatus_ResetEventDebounceStatus_Event_INV_IGBT_TEMP_HWP: RteEventRef=OpEventResetEventDebounceStatus_ResetEventDebounceStatus_Event_INV_IGBT_TEMP_HWP
          OpEventResetEventDebounceStatus_ResetEventDebounceStatus_Event_INV_RSLVR_SIN_ELEC_FLT: RteEventRef=OpEventResetEventDebounceStatus_ResetEventDebounceStatus_Event_INV_RSLVR_SIN_ELEC_FLT
          OpEventResetEventDebounceStatus_ResetEventDebounceStatus_Event_CU_TEMP2_RNG_HI: RteEventRef=OpEventResetEventDebounceStatus_ResetEventDebounceStatus_Event_CU_TEMP2_RNG_HI
          OpEventResetEventDebounceStatus_ResetEventDebounceStatus_Event_INV_IAC_PHA_LOSS_MPL: RteEventRef=OpEventResetEventDebounceStatus_ResetEventDebounceStatus_Event_INV_IAC_PHA_LOSS_MPL
          OpEventResetEventDebounceStatus_ResetEventDebounceStatus_Event_INV_IAC_U_AMP: RteEventRef=OpEventResetEventDebounceStatus_ResetEventDebounceStatus_Event_INV_IAC_U_AMP
          OpEventResetEventDebounceStatus_ResetEventDebounceStatus_Event_PSnsr_GRADT_Flt: RteEventRef=OpEventResetEventDebounceStatus_ResetEventDebounceStatus_Event_PSnsr_GRADT_Flt
          OpEventResetEventDebounceStatus_ResetEventDebounceStatus_Event_AURIX_WATHDOG_FLT: RteEventRef=OpEventResetEventDebounceStatus_ResetEventDebounceStatus_Event_AURIX_WATHDOG_FLT
          OpEventResetEventDebounceStatus_ResetEventDebounceStatus_Event_VcEvNodeMisBECM: RteEventRef=OpEventResetEventDebounceStatus_ResetEventDebounceStatus_Event_VcEvNodeMisBECM
          OpEventResetEventDebounceStatus_ResetEventDebounceStatus_Event_INV_UHVDC_UV_HWP: RteEventRef=OpEventResetEventDebounceStatus_ResetEventDebounceStatus_Event_INV_UHVDC_UV_HWP
          OpEventResetEventDebounceStatus_ResetEventDebounceStatus_Event_VcEvMonESpd: RteEventRef=OpEventResetEventDebounceStatus_ResetEventDebounceStatus_Event_VcEvMonESpd
          OpEventResetEventDebounceStatus_ResetEventDebounceStatus_Event_COM_NotConfig: RteEventRef=OpEventResetEventDebounceStatus_ResetEventDebounceStatus_Event_COM_NotConfig
          OpEventResetEventDebounceStatus_ResetEventDebounceStatus_Event_INV_RSLVR_SIN_RNG_HI: RteEventRef=OpEventResetEventDebounceStatus_ResetEventDebounceStatus_Event_INV_RSLVR_SIN_RNG_HI
          OpEventResetEventDebounceStatus_ResetEventDebounceStatus_Event_INV_IGBT_TEMP_U_RNG_HI: RteEventRef=OpEventResetEventDebounceStatus_ResetEventDebounceStatus_Event_INV_IGBT_TEMP_U_RNG_HI
          OpEventResetEventDebounceStatus_ResetEventDebounceStatus_Event_VcEvMonMode_001: RteEventRef=OpEventResetEventDebounceStatus_ResetEventDebounceStatus_Event_VcEvMonMode_001
          OpEventResetEventDebounceStatus_ResetEventDebounceStatus_Event_PA_ACTION_FLT: RteEventRef=OpEventResetEventDebounceStatus_ResetEventDebounceStatus_Event_PA_ACTION_FLT
          OpEventResetEventDebounceStatus_ResetEventDebounceStatus_Event_INV_IAC_V_ELEC_HWP: RteEventRef=OpEventResetEventDebounceStatus_ResetEventDebounceStatus_Event_INV_IAC_V_ELEC_HWP
          OpEventResetEventDebounceStatus_ResetEventDebounceStatus_Event_CU_TEMP_HW_FLT_001: RteEventRef=OpEventResetEventDebounceStatus_ResetEventDebounceStatus_Event_CU_TEMP_HW_FLT_001
          OpEventResetEventDebounceStatus_ResetEventDebounceStatus_Event_VCC_UnderVoltage: RteEventRef=OpEventResetEventDebounceStatus_ResetEventDebounceStatus_Event_VCC_UnderVoltage
          OpEventResetEventDebounceStatus_ResetEventDebounceStatus_Event_VcEvTsttrPlaus: RteEventRef=OpEventResetEventDebounceStatus_ResetEventDebounceStatus_Event_VcEvTsttrPlaus
          OpEventResetEventDebounceStatus_ResetEventDebounceStatus_Event_INV_RSLVR_EXCT_ELEC_FLT: RteEventRef=OpEventResetEventDebounceStatus_ResetEventDebounceStatus_Event_INV_RSLVR_EXCT_ELEC_FLT
          OpEventResetEventDebounceStatus_ResetEventDebounceStatus_Event_INV_RSLVR_EXCT_RNG_LO: RteEventRef=OpEventResetEventDebounceStatus_ResetEventDebounceStatus_Event_INV_RSLVR_EXCT_RNG_LO
          OpEventResetEventDebounceStatus_ResetEventDebounceStatus_Event_INV_EM_STATOR_TEMP2_RNG_HI: RteEventRef=OpEventResetEventDebounceStatus_ResetEventDebounceStatus_Event_INV_EM_STATOR_TEMP2_RNG_HI
          OpEventResetEventDebounceStatus_ResetEventDebounceStatus_Event_INV_SHUT_OFF_PAH_START_UP: RteEventRef=OpEventResetEventDebounceStatus_ResetEventDebounceStatus_Event_INV_SHUT_OFF_PAH_START_UP
          OpEventResetEventDebounceStatus_ResetEventDebounceStatus_Event_VCEvVddmPropFr08Tioutd: RteEventRef=OpEventResetEventDebounceStatus_ResetEventDebounceStatus_Event_VCEvVddmPropFr08Tioutd
          OpEventResetEventDebounceStatus_ResetEventDebounceStatus_Event_INV_RSLVR_EXCT_OC_HWP_001: RteEventRef=OpEventResetEventDebounceStatus_ResetEventDebounceStatus_Event_INV_RSLVR_EXCT_OC_HWP_001
          OpEventResetEventDebounceStatus_ResetEventDebounceStatus_Event_INV_RSLVR_EXCT_OC_HWP_002: RteEventRef=OpEventResetEventDebounceStatus_ResetEventDebounceStatus_Event_INV_RSLVR_EXCT_OC_HWP_002
          OpEventResetEventDebounceStatus_ResetEventDebounceStatus_Event_INV_EM_STATOR_TEMP_ELE_FLT: RteEventRef=OpEventResetEventDebounceStatus_ResetEventDebounceStatus_Event_INV_EM_STATOR_TEMP_ELE_FLT
          OpEventResetEventDebounceStatus_ResetEventDebounceStatus_Event_INV_INTERLOCK_FLT: RteEventRef=OpEventResetEventDebounceStatus_ResetEventDebounceStatus_Event_INV_INTERLOCK_FLT
          OpEventResetEventDebounceStatus_ResetEventDebounceStatus_Event_Ga_ZeroFindDistanFailure: RteEventRef=OpEventResetEventDebounceStatus_ResetEventDebounceStatus_Event_Ga_ZeroFindDistanFailure
          OpEventResetEventDebounceStatus_ResetEventDebounceStatus_Event_PLOCK_Current_RNG_OUT: RteEventRef=OpEventResetEventDebounceStatus_ResetEventDebounceStatus_Event_PLOCK_Current_RNG_OUT
          OpEventResetEventDebounceStatus_ResetEventDebounceStatus_Event_VCEvVddmPropFr05Tioutd: RteEventRef=OpEventResetEventDebounceStatus_ResetEventDebounceStatus_Event_VCEvVddmPropFr05Tioutd
          OpEventResetEventDebounceStatus_ResetEventDebounceStatus_Event_INV_IGBT_TEMP_V_GRDT: RteEventRef=OpEventResetEventDebounceStatus_ResetEventDebounceStatus_Event_INV_IGBT_TEMP_V_GRDT
          OpEventResetEventDebounceStatus_ResetEventDebounceStatus_Event_PS_5V_Fault: RteEventRef=OpEventResetEventDebounceStatus_ResetEventDebounceStatus_Event_PS_5V_Fault
          OpEventResetEventDebounceStatus_ResetEventDebounceStatus_Event_VcEvCntrCrashStsSafe: RteEventRef=OpEventResetEventDebounceStatus_ResetEventDebounceStatus_Event_VcEvCntrCrashStsSafe
          OpEventResetEventDebounceStatus_ResetEventDebounceStatus_Event_INV_EM_STATOR_TEMP_GRDT: RteEventRef=OpEventResetEventDebounceStatus_ResetEventDebounceStatus_Event_INV_EM_STATOR_TEMP_GRDT
          OpEventResetEventDebounceStatus_ResetEventDebounceStatus_Event_PS_P15_V_FLT: RteEventRef=OpEventResetEventDebounceStatus_ResetEventDebounceStatus_Event_PS_P15_V_FLT
          OpEventResetEventDebounceStatus_ResetEventDebounceStatus_Event_INV_EM_STATOR_TEMP_RNG_NOK: RteEventRef=OpEventResetEventDebounceStatus_ResetEventDebounceStatus_Event_INV_EM_STATOR_TEMP_RNG_NOK
          OpEventResetEventDebounceStatus_ResetEventDebounceStatus_Event_INV_RSLVR_SIN_RNG_NOK: RteEventRef=OpEventResetEventDebounceStatus_ResetEventDebounceStatus_Event_INV_RSLVR_SIN_RNG_NOK
          OpEventResetEventDebounceStatus_ResetEventDebounceStatus_Event_INV_IAC_U_OFFS: RteEventRef=OpEventResetEventDebounceStatus_ResetEventDebounceStatus_Event_INV_IAC_U_OFFS
          OpEventResetEventDebounceStatus_ResetEventDebounceStatus_Event_PS_KL30_BACKUP_FLT: RteEventRef=OpEventResetEventDebounceStatus_ResetEventDebounceStatus_Event_PS_KL30_BACKUP_FLT
          OpEventResetEventDebounceStatus_ResetEventDebounceStatus_Event_INV_IGBT_TEMP_U_RNG_LO: RteEventRef=OpEventResetEventDebounceStatus_ResetEventDebounceStatus_Event_INV_IGBT_TEMP_U_RNG_LO
          OpEventResetEventDebounceStatus_ResetEventDebounceStatus_Event_INV_EM_STATOR_TEMP_HWP: RteEventRef=OpEventResetEventDebounceStatus_ResetEventDebounceStatus_Event_INV_EM_STATOR_TEMP_HWP
          OpEventResetEventDebounceStatus_ResetEventDebounceStatus_Event_CU_TEMP1_RNG_HI: RteEventRef=OpEventResetEventDebounceStatus_ResetEventDebounceStatus_Event_CU_TEMP1_RNG_HI
          OpEventResetEventDebounceStatus_ResetEventDebounceStatus_Event_INV_IGBT_TEMP_V_RNG_HI: RteEventRef=OpEventResetEventDebounceStatus_ResetEventDebounceStatus_Event_INV_IGBT_TEMP_V_RNG_HI
          OpEventResetEventDebounceStatus_ResetEventDebounceStatus_Event_VcEvNodeMisVDDM: RteEventRef=OpEventResetEventDebounceStatus_ResetEventDebounceStatus_Event_VcEvNodeMisVDDM
          OpEventResetEventDebounceStatus_ResetEventDebounceStatus_Event_INV_UHVDC_PLAUS: RteEventRef=OpEventResetEventDebounceStatus_ResetEventDebounceStatus_Event_INV_UHVDC_PLAUS
          OpEventResetEventDebounceStatus_ResetEventDebounceStatus_Event_INV_QUIESCENT_FLT: RteEventRef=OpEventResetEventDebounceStatus_ResetEventDebounceStatus_Event_INV_QUIESCENT_FLT
          OpEventResetEventDebounceStatus_ResetEventDebounceStatus_Event_INV_RSLVR_EXCT_RNG_HI: RteEventRef=OpEventResetEventDebounceStatus_ResetEventDebounceStatus_Event_INV_RSLVR_EXCT_RNG_HI
      Det_EcuSwComposition: RteSoftwareComponentInstanceRef=Det
      Dcm_EcuSwComposition: RteSoftwareComponentInstanceRef=Dcm
        7 x RteEventToTaskMapping, all with RteImmediateRestart=false:
          Timer_Dcm_MainFunction: RtePositionInTask=7, RteCyclicTriggerImplementation=None, RteEventRef=Timer_Dcm_MainFunction, RteMappedToTaskRef=Task_Bsw_10ms, RteUsedOsAlarmRef=Alarm_Bsw_10ms
          OpEventGetSecurityLevel_GetSecurityLevel_DCMServices: RteEventRef=OpEventGetSecurityLevel_GetSecurityLevel_DCMServices
          OpEventGetActiveProtocol_GetActiveProtocol_DCMServices: RteEventRef=OpEventGetActiveProtocol_GetActiveProtocol_DCMServices
          OpEventGetRequestKind_GetRequestKind_DCMServices: RteEventRef=OpEventGetRequestKind_GetRequestKind_DCMServices
          OpEventGetSesCtrlType_GetSesCtrlType_DCMServices: RteEventRef=OpEventGetSesCtrlType_GetSesCtrlType_DCMServices
          OpEventResetToDefaultSession_ResetToDefaultSession_DCMServices: RteEventRef=OpEventResetToDefaultSession_ResetToDefaultSession_DCMServices
          OpEventSetActiveDiagnostic_SetActiveDiagnostic_DCMServices: RteEventRef=OpEventSetActiveDiagnostic_SetActiveDiagnostic_DCMServices
    3 x RteBswModuleInstance:
      McalLib: RteBswImplementationRef=McalLib_Impl, RteBswModuleConfigurationRef=McalLib
        4 x RteBswExclusiveAreaImpl, all with RteExclusiveAreaImplMechanism=ALL_INTERRUPT_BLOCKING:
          PeripheralEndInit: RteBswExclusiveAreaRef=PeripheralEndInit
          SafetyEndInit: RteBswExclusiveAreaRef=SafetyEndInit
          CpuEndInit: RteBswExclusiveAreaRef=CpuEndInit
          StmTimerResolution: RteBswExclusiveAreaRef=StmTimerResolution
      Port: RteBswImplementationRef=Port_Impl, RteBswModuleConfigurationRef=Port
      Spi: RteBswImplementationRef=Spi_Impl, RteBswModuleConfigurationRef=Spi
        11 x RteBswExclusiveAreaImpl, all with RteExclusiveAreaImplMechanism=ALL_INTERRUPT_BLOCKING:
          Buffer_Update: RteBswExclusiveAreaRef=Buffer_Update
          SyncLock: RteBswExclusiveAreaRef=SyncLock
          ChannelLock: RteBswExclusiveAreaRef=ChannelLock
          Cancel_Seq: RteBswExclusiveAreaRef=Cancel_Seq
          Queue_Update_QSPI{0..5}: RteBswExclusiveAreaRef=Queue_Update_QSPI{0..5}
          Queue_Update: RteBswExclusiveAreaRef=Queue_Update
        Spi_MainFunction_HandlingTimingEvent0 (RteBswEventToTaskMapping):
          RteBswImmediateRestart = false
          RteBswPositionInTask = 10
          RteCyclicTriggerImplementation = None
          RteBswEventRef = Spi_MainFunction_HandlingTimingEvent0
          RteBswMappedToTaskRef = Task_Bsw_10ms
          RteBswUsedOsAlarmRef = Alarm_Bsw_10ms
    Os_OsCore0_swc_EcuSwComposition (RteSwComponentInstance): RteSoftwareComponentInstanceRef=Os_OsCore0_swc
      OpEventGetElapsedValue_GetElapsedValue_OsService_SystemTimer (RteEventToTaskMapping): RteImmediateRestart=false, RteEventRef=OpEventGetElapsedValue_GetElapsedValue_OsService_SystemTimer
      OpEventGetCounterValue_GetCounterValue_OsService_SystemTimer (RteEventToTaskMapping): RteImmediateRestart=false, RteEventRef=OpEventGetCounterValue_GetCounterValue_OsService_SystemTimer
    Os_OsCore2_swc_EcuSwComposition (RteSwComponentInstance): RteSoftwareComponentInstanceRef=Os_OsCore2_swc
      OpEventGetCounterValue_GetCounterValue_OsService_SystemTimer_Core2 (RteEventToTaskMapping): RteImmediateRestart=false, RteEventRef=OpEventGetCounterValue_GetCounterValue_OsService_SystemTimer_Core2
      OpEventGetElapsedValue_GetElapsedValue_OsService_SystemTimer_Core2 (RteEventToTaskMapping): RteImmediateRestart=false, RteEventRef=OpEventGetElapsedValue_GetElapsedValue_OsService_SystemTimer_Core2
    3 x RteBswModuleInstance:
      CanTrcv: RteBswImplementationRef=CanTrcv_Impl, RteBswModuleConfigurationRef=CanTrcv
        CanTrcv_30_Tja1145_MainFunctionTimingEvent0 (RteBswEventToTaskMapping):
          RteBswImmediateRestart = false
          RteBswPositionInTask = 5
          RteCyclicTriggerImplementation = None
          RteBswEventRef = CanTrcv_30_Tja1145_MainFunctionTimingEvent0
          RteBswMappedToTaskRef = Task_Com_5ms
          RteBswUsedOsAlarmRef = Alarm_Com_5ms
        CANTRCV_30_TJA1145_EXCLUSIVE_AREA_0 (RteBswExclusiveAreaImpl): RteExclusiveAreaImplMechanism=ALL_INTERRUPT_BLOCKING, RteBswExclusiveAreaRef=CANTRCV_30_TJA1145_EXCLUSIVE_AREA_0
      Fee: RteBswImplementationRef=Fee_Impl, RteBswModuleConfigurationRef=Fee
        Fee_MainFunctionTimingEvent0 (RteBswEventToTaskMapping):
          RteBswImmediateRestart = false
          RteBswPositionInTask = 20
          RteCyclicTriggerImplementation = None
          RteBswEventRef = Fee_MainFunctionTimingEvent0
          RteBswMappedToTaskRef = Task_Bsw_10ms
          RteBswUsedOsAlarmRef = Alarm_Bsw_10ms
      Fls: RteBswImplementationRef=Fls_Impl, RteBswModuleConfigurationRef=Fls
        6 x RteBswExclusiveAreaImpl, all with RteExclusiveAreaImplMechanism=ALL_INTERRUPT_BLOCKING:
          Init: RteBswExclusiveAreaRef=Init
          Erase: RteBswExclusiveAreaRef=Erase
          Write: RteBswExclusiveAreaRef=Write
          Main: RteBswExclusiveAreaRef=Main
          ResumeErase: RteBswExclusiveAreaRef=ResumeErase
          UserContentCount: RteBswExclusiveAreaRef=UserContentCount
        Fls_17_Dmu_MainFunctionTimingEvent0 (RteBswEventToTaskMapping):
          RteBswImmediateRestart = false
          RteBswPositionInTask = 19
          RteCyclicTriggerImplementation = None
          RteBswEventRef = Fls_17_Dmu_MainFunctionTimingEvent0
          RteBswMappedToTaskRef = Task_Com_5ms
          RteBswUsedOsAlarmRef = Alarm_Com_5ms
    NvM_EcuSwComposition (RteSwComponentInstance): RteSoftwareComponentInstanceRef=NvM
      Timer_NvM_MainFunction (RteEventToTaskMapping):
        RteImmediateRestart = false
        RtePositionInTask = 21
        RteCyclicTriggerImplementation = None
        RteEventRef = Timer_NvM_MainFunction
        RteMappedToTaskRef = Task_Bsw_10ms
        RteUsedOsAlarmRef = Alarm_Bsw_10ms
    NvM (RteBswModuleInstance): RteBswImplementationRef=NvM_Impl, RteBswModuleConfigurationRef=NvM
      NVM_EXCLUSIVE_AREA_0 (RteBswExclusiveAreaImpl): RteExclusiveAreaImplMechanism=ALL_INTERRUPT_BLOCKING, RteBswExclusiveAreaRef=NVM_EXCLUSIVE_AREA_0
      NvM_MainFunctionTimingEvent0 (RteBswEventToTaskMapping):
        RteBswImmediateRestart = false
        RteBswPositionInTask = 21
        RteCyclicTriggerImplementation = None
        RteBswEventRef = NvM_MainFunctionTimingEvent0
        RteBswMappedToTaskRef = Task_Bsw_10ms
        RteBswUsedOsAlarmRef = Alarm_Bsw_10ms

AUTOSAR XML (schema 4-2-2)
package /ActiveEcuC
  module config Port: implementation-config-variant=VARIANT-POST-BUILD-LOADABLE, module-description=Port_Impl
    PortConfigSet
      17 x PortContainer:
        Port_0: PortNumber=0, PortNumberOfPortPins=13
          13 x PortPin, all with PortPinDirection=PORT_PIN_IN, PortPinDirectionChangeable=false, PortPinInitialMode=GPIO, PortPinLevelValue=PORT_PIN_LEVEL_LOW, PortPinModeChangeable=false, PortPinInputPullResistor=PORT_PIN_IN_PULL_UP, PortPinOutputPadDriveStrength=PORT_PIN_DEFAULT_DRIVER, PortPinOutputPinDriveMode=PORT_PIN_OUT_PUSHPULL, PortPinInputPadLevel=PORT_INPUT_LEVEL_CMOS_AUTOMOTIVE, PortPinEnableAnalogInputOnly=PORT_PIN_ANALOG_INPUT_DISABLE, PortPinEmergencyStop=false, PortPinControllerSelect=DISABLE, PortPinMode=PORT_PIN_MODE_ALL:
            P0_{0..12}: PortPinId={0..12}, PortPinSymbolicName=P0_{0..12}
        Port_1: PortNumber=1, PortNumberOfPortPins=5
          5 x PortPin, all with PortPinDirection=PORT_PIN_IN, PortPinDirectionChangeable=false, PortPinInitialMode=GPIO, PortPinLevelValue=PORT_PIN_LEVEL_LOW, PortPinModeChangeable=false, PortPinInputPullResistor=PORT_PIN_IN_PULL_UP, PortPinOutputPadDriveStrength=PORT_PIN_DEFAULT_DRIVER, PortPinOutputPinDriveMode=PORT_PIN_OUT_PUSHPULL, PortPinInputPadLevel=PORT_INPUT_LEVEL_CMOS_AUTOMOTIVE, PortPinEnableAnalogInputOnly=PORT_PIN_ANALOG_INPUT_DISABLE, PortPinEmergencyStop=false, PortPinControllerSelect=DISABLE, PortPinMode=PORT_PIN_MODE_ALL:
            P1_3: PortPinId=19, PortPinSymbolicName=P1_3
            P1_4: PortPinId=20, PortPinSymbolicName=P1_4
            P1_5: PortPinId=21, PortPinSymbolicName=P1_5
            P1_6: PortPinId=22, PortPinSymbolicName=P1_6
            P1_7: PortPinId=23, PortPinSymbolicName=P1_7
        Port_2: PortNumber=2, PortNumberOfPortPins=12
          12 x PortPin, all with PortPinDirection=PORT_PIN_IN, PortPinDirectionChangeable=false, PortPinInitialMode=GPIO, PortPinLevelValue=PORT_PIN_LEVEL_LOW, PortPinModeChangeable=false, PortPinInputPullResistor=PORT_PIN_IN_PULL_UP, PortPinOutputPadDriveStrength=PORT_PIN_DEFAULT_DRIVER, PortPinOutputPinDriveMode=PORT_PIN_OUT_PUSHPULL, PortPinInputPadLevel=PORT_INPUT_LEVEL_CMOS_AUTOMOTIVE, PortPinEnableAnalogInputOnly=PORT_PIN_ANALOG_INPUT_DISABLE, PortPinEmergencyStop=false, PortPinControllerSelect=DISABLE, PortPinMode=PORT_PIN_MODE_ALL:
            P2_0: PortPinId=32, PortPinSymbolicName=P2_0
            P2_1: PortPinId=33, PortPinSymbolicName=P2_1
            P2_2: PortPinId=34, PortPinSymbolicName=P2_2
            P2_3: PortPinId=35, PortPinSymbolicName=P2_3
            P2_4: PortPinId=36, PortPinSymbolicName=P2_4
            P2_5: PortPinId=37, PortPinSymbolicName=P2_5
            P2_6: PortPinId=38, PortPinSymbolicName=P2_6
            P2_7: PortPinId=39, PortPinSymbolicName=P2_7
            P2_8: PortPinId=40, PortPinSymbolicName=P2_8
            P2_9: PortPinId=41, PortPinSymbolicName=P2_9
            P2_10: PortPinId=42, PortPinSymbolicName=P2_10
            P2_11: PortPinId=43, PortPinSymbolicName=P2_11
        Port_10: PortNumber=10, PortNumberOfPortPins=9
          9 x PortPin, all with PortPinDirectionChangeable=false, PortPinModeChangeable=false, PortPinOutputPadDriveStrength=PORT_PIN_DEFAULT_DRIVER, PortPinOutputPinDriveMode=PORT_PIN_OUT_PUSHPULL, PortPinInputPadLevel=PORT_INPUT_LEVEL_CMOS_AUTOMOTIVE, PortPinEnableAnalogInputOnly=PORT_PIN_ANALOG_INPUT_DISABLE, PortPinEmergencyStop=false, PortPinControllerSelect=DISABLE, PortPinMode=PORT_PIN_MODE_ALL:
            P10_0: PortPinId=160, PortPinSymbolicName=P10_0, PortPinDirection=PORT_PIN_IN, PortPinInitialMode=GPIO, PortPinLevelValue=PORT_PIN_LEVEL_LOW, PortPinInputPullResistor=PORT_PIN_IN_PULL_UP
            P10_1: PortPinId=161, PortPinSymbolicName=P10_1, PortPinDirection=PORT_PIN_IN, PortPinInitialMode=GPIO, PortPinLevelValue=PORT_PIN_LEVEL_LOW, PortPinInputPullResistor=PORT_PIN_IN_PULL_UP
            P10_2: PortPinId=162, PortPinSymbolicName=P10_2, PortPinDirection=PORT_PIN_IN, PortPinInitialMode=GPIO, PortPinLevelValue=PORT_PIN_LEVEL_LOW, PortPinInputPullResistor=PORT_PIN_IN_PULL_UP
            P10_3: PortPinId=163, PortPinSymbolicName=P10_3, PortPinDirection=PORT_PIN_IN, PortPinInitialMode=GPIO, PortPinLevelValue=PORT_PIN_LEVEL_LOW, PortPinInputPullResistor=PORT_PIN_IN_PULL_UP
            P10_4: PortPinId=164, PortPinSymbolicName=P10_4, PortPinDirection=PORT_PIN_IN, PortPinInitialMode=GPIO, PortPinLevelValue=PORT_PIN_LEVEL_LOW, PortPinInputPullResistor=PORT_PIN_IN_PULL_UP
            P10_5: PortPinId=165, PortPinSymbolicName=P10_5, PortPinDirection=PORT_PIN_OUT, PortPinInitialMode=ALT3, PortPinLevelValue=PORT_PIN_LEVEL_HIGH, PortPinInputPullResistor=PORT_PIN_IN_NO_PULL
            P10_6: PortPinId=166, PortPinSymbolicName=P10_6, PortPinDirection=PORT_PIN_OUT, PortPinInitialMode=ALT3, PortPinLevelValue=PORT_PIN_LEVEL_LOW, PortPinInputPullResistor=PORT_PIN_IN_NO_PULL
            P10_7: PortPinId=167, PortPinSymbolicName=P10_7, PortPinDirection=PORT_PIN_IN, PortPinInitialMode=GPIO, PortPinLevelValue=PORT_PIN_LEVEL_LOW, PortPinInputPullResistor=PORT_PIN_IN_PULL_UP
            P10_8: PortPinId=168, PortPinSymbolicName=P10_8, PortPinDirection=PORT_PIN_OUT, PortPinInitialMode=ALT3, PortPinLevelValue=PORT_PIN_LEVEL_LOW, PortPinInputPullResistor=PORT_PIN_IN_NO_PULL
        Port_11: PortNumber=11, PortNumberOfPortPins=16
          16 x PortPin, all with PortPinDirectionChangeable=false, PortPinModeChangeable=false, PortPinOutputPadDriveStrength=PORT_PIN_DEFAULT_DRIVER, PortPinOutputPinDriveMode=PORT_PIN_OUT_PUSHPULL, PortPinInputPadLevel=PORT_INPUT_LEVEL_CMOS_AUTOMOTIVE, PortPinEnableAnalogInputOnly=PORT_PIN_ANALOG_INPUT_DISABLE, PortPinEmergencyStop=false, PortPinControllerSelect=DISABLE, PortPinMode=PORT_PIN_MODE_ALL:
            P11_0: PortPinId=176, PortPinSymbolicName=P11_0, PortPinDirection=PORT_PIN_OUT, PortPinInitialMode=ALT5, PortPinLevelValue=PORT_PIN_LEVEL_HIGH, PortPinInputPullResistor=PORT_PIN_IN_NO_PULL
            P11_1: PortPinId=177, PortPinSymbolicName=P11_1, PortPinDirection=PORT_PIN_IN, PortPinInitialMode=GPIO, PortPinLevelValue=PORT_PIN_LEVEL_LOW, PortPinInputPullResistor=PORT_PIN_IN_PULL_UP
            P11_2: PortPinId=178, PortPinSymbolicName=P11_2, PortPinDirection=PORT_PIN_IN, PortPinInitialMode=GPIO, PortPinLevelValue=PORT_PIN_LEVEL_LOW, PortPinInputPullResistor=PORT_PIN_IN_PULL_UP
            P11_3: PortPinId=179, PortPinSymbolicName=P11_3, PortPinDirection=PORT_PIN_IN, PortPinInitialMode=GPIO, PortPinLevelValue=PORT_PIN_LEVEL_LOW, PortPinInputPullResistor=PORT_PIN_IN_PULL_UP
            P11_4: PortPinId=180, PortPinSymbolicName=P11_4, PortPinDirection=PORT_PIN_IN, PortPinInitialMode=GPIO, PortPinLevelValue=PORT_PIN_LEVEL_LOW, PortPinInputPullResistor=PORT_PIN_IN_PULL_UP
            P11_5: PortPinId=181, PortPinSymbolicName=P11_5, PortPinDirection=PORT_PIN_IN, PortPinInitialMode=GPIO, PortPinLevelValue=PORT_PIN_LEVEL_LOW, PortPinInputPullResistor=PORT_PIN_IN_PULL_UP
            P11_6: PortPinId=182, PortPinSymbolicName=P11_6, PortPinDirection=PORT_PIN_IN, PortPinInitialMode=GPIO, PortPinLevelValue=PORT_PIN_LEVEL_LOW, PortPinInputPullResistor=PORT_PIN_IN_PULL_UP
            P11_7: PortPinId=183, PortPinSymbolicName=P11_7, PortPinDirection=PORT_PIN_IN, PortPinInitialMode=GPIO, PortPinLevelValue=PORT_PIN_LEVEL_LOW, PortPinInputPullResistor=PORT_PIN_IN_PULL_UP
            P11_8: PortPinId=184, PortPinSymbolicName=P11_8, PortPinDirection=PORT_PIN_IN, PortPinInitialMode=GPIO, PortPinLevelValue=PORT_PIN_LEVEL_LOW, PortPinInputPullResistor=PORT_PIN_IN_PULL_UP
            P11_9: PortPinId=185, PortPinSymbolicName=P11_9, PortPinDirection=PORT_PIN_IN, PortPinInitialMode=GPIO, PortPinLevelValue=PORT_PIN_LEVEL_LOW, PortPinInputPullResistor=PORT_PIN_IN_PULL_UP
            P11_10: PortPinId=186, PortPinSymbolicName=P11_10, PortPinDirection=PORT_PIN_IN, PortPinInitialMode=GPIO, PortPinLevelValue=PORT_PIN_LEVEL_LOW, PortPinInputPullResistor=PORT_PIN_IN_PULL_UP
            P11_11: PortPinId=187, PortPinSymbolicName=P11_11, PortPinDirection=PORT_PIN_IN, PortPinInitialMode=GPIO, PortPinLevelValue=PORT_PIN_LEVEL_LOW, PortPinInputPullResistor=PORT_PIN_IN_PULL_UP
            P11_12: PortPinId=188, PortPinSymbolicName=P11_12, PortPinDirection=PORT_PIN_IN, PortPinInitialMode=GPIO, PortPinLevelValue=PORT_PIN_LEVEL_LOW, PortPinInputPullResistor=PORT_PIN_IN_PULL_UP
            P11_13: PortPinId=189, PortPinSymbolicName=P11_13, PortPinDirection=PORT_PIN_IN, PortPinInitialMode=GPIO, PortPinLevelValue=PORT_PIN_LEVEL_LOW, PortPinInputPullResistor=PORT_PIN_IN_PULL_UP
            P11_14: PortPinId=190, PortPinSymbolicName=P11_14, PortPinDirection=PORT_PIN_IN, PortPinInitialMode=GPIO, PortPinLevelValue=PORT_PIN_LEVEL_LOW, PortPinInputPullResistor=PORT_PIN_IN_PULL_UP
            P11_15: PortPinId=191, PortPinSymbolicName=P11_15, PortPinDirection=PORT_PIN_IN, PortPinInitialMode=GPIO, PortPinLevelValue=PORT_PIN_LEVEL_LOW, PortPinInputPullResistor=PORT_PIN_IN_PULL_UP
        Port_12: PortNumber=12, PortNumberOfPortPins=2
          P12_0 (PortPin):
            PortPinId = 192
            PortPinSymbolicName = P12_0
            PortPinDirection = PORT_PIN_IN
            PortPinDirectionChangeable = false
            PortPinInitialMode = GPIO
            PortPinLevelValue = PORT_PIN_LEVEL_LOW
            PortPinModeChangeable = false
            PortPinInputPullResistor = PORT_PIN_IN_PULL_UP
            PortPinOutputPadDriveStrength = PORT_PIN_DEFAULT_DRIVER
            PortPinOutputPinDriveMode = PORT_PIN_OUT_PUSHPULL
            PortPinInputPadLevel = PORT_INPUT_LEVEL_CMOS_AUTOMOTIVE
            PortPinEnableAnalogInputOnly = PORT_PIN_ANALOG_INPUT_DISABLE
            PortPinEmergencyStop = false
            PortPinControllerSelect = DISABLE
            PortPinMode = PORT_PIN_MODE_ALL
          P12_1 (PortPin):
            PortPinId = 193
            PortPinSymbolicName = P12_1
            PortPinDirection = PORT_PIN_IN
            PortPinDirectionChangeable = false
            PortPinInitialMode = GPIO
            PortPinLevelValue = PORT_PIN_LEVEL_LOW
            PortPinModeChangeable = false
            PortPinInputPullResistor = PORT_PIN_IN_PULL_UP
            PortPinOutputPadDriveStrength = PORT_PIN_DEFAULT_DRIVER
            PortPinOutputPinDriveMode = PORT_PIN_OUT_PUSHPULL
            PortPinInputPadLevel = PORT_INPUT_LEVEL_CMOS_AUTOMOTIVE
            PortPinEnableAnalogInputOnly = PORT_PIN_ANALOG_INPUT_DISABLE
            PortPinEmergencyStop = false
            PortPinControllerSelect = DISABLE
            PortPinMode = PORT_PIN_MODE_ALL
        Port_13: PortNumber=13, PortNumberOfPortPins=4
          4 x PortPin, all with PortPinDirection=PORT_PIN_IN, PortPinDirectionChangeable=false, PortPinInitialMode=GPIO, PortPinLevelValue=PORT_PIN_LEVEL_LOW, PortPinModeChangeable=false, PortPinInputPullResistor=PORT_PIN_IN_PULL_UP, PortPinOutputPadDriveStrength=PORT_PIN_DEFAULT_DRIVER, PortPinOutputPinDriveMode=PORT_PIN_OUT_PUSHPULL, PortPinInputPadLevel=PORT_INPUT_LEVEL_CMOS_AUTOMOTIVE, PortPinEnableAnalogInputOnly=PORT_PIN_ANALOG_INPUT_DISABLE, PortPinEmergencyStop=false, PortPinControllerSelect=DISABLE, PortPinMode=PORT_PIN_MODE_ALL:
            P13_0: PortPinId=208, PortPinSymbolicName=P13_0
            P13_1: PortPinId=209, PortPinSymbolicName=P13_1
            P13_2: PortPinId=210, PortPinSymbolicName=P13_2
            P13_3: PortPinId=211, PortPinSymbolicName=P13_3
          PortLVDS_0 (PortLVDS):
            PortLVDSPinPair = Pin_0_Pin_1
            PortLVDSRxEnController = PORT_CONTROLLED
            PortLVDSRxPathEnable = false
            PortLVDSRxTerminationMode = INTERNAL_TERMINATION
            PortLVDSMode = LVDSH
            PortLVDSPadSupply = V3_3
            PortLVDSTxEnController = PORT_CONTROLLED
            PortLVDSTxPathEnable = false
            PortLVDSTxPowerDownPullDown = DISABLE
          PortLVDS_1 (PortLVDS):
            PortLVDSPinPair = Pin_2_Pin_3
            PortLVDSRxEnController = PORT_CONTROLLED
            PortLVDSRxPathEnable = false
            PortLVDSRxTerminationMode = INTERNAL_TERMINATION
            PortLVDSMode = LVDSH
            PortLVDSPadSupply = V3_3
            PortLVDSTxEnController = PORT_CONTROLLED
            PortLVDSTxPathEnable = false
            PortLVDSTxPowerDownPullDown = DISABLE
        Port_14: PortNumber=14, PortNumberOfPortPins=11
          11 x PortPin, all with PortPinDirection=PORT_PIN_IN, PortPinDirectionChangeable=false, PortPinInitialMode=GPIO, PortPinLevelValue=PORT_PIN_LEVEL_LOW, PortPinModeChangeable=false, PortPinOutputPadDriveStrength=PORT_PIN_DEFAULT_DRIVER, PortPinOutputPinDriveMode=PORT_PIN_OUT_PUSHPULL, PortPinInputPadLevel=PORT_INPUT_LEVEL_CMOS_AUTOMOTIVE, PortPinEnableAnalogInputOnly=PORT_PIN_ANALOG_INPUT_DISABLE, PortPinEmergencyStop=false, PortPinControllerSelect=DISABLE, PortPinMode=PORT_PIN_MODE_ALL:
            P14_0: PortPinId=224, PortPinSymbolicName=P14_0, PortPinInputPullResistor=PORT_PIN_IN_PULL_UP
            P14_1: PortPinId=225, PortPinSymbolicName=P14_1, PortPinInputPullResistor=PORT_PIN_IN_PULL_UP
            P14_2: PortPinId=226, PortPinSymbolicName=P14_2, PortPinInputPullResistor=PORT_PIN_IN_PULL_DOWN
            P14_3: PortPinId=227, PortPinSymbolicName=P14_3, PortPinInputPullResistor=PORT_PIN_IN_PULL_UP
            P14_4: PortPinId=228, PortPinSymbolicName=P14_4, PortPinInputPullResistor=PORT_PIN_IN_PULL_UP
            P14_5: PortPinId=229, PortPinSymbolicName=P14_5, PortPinInputPullResistor=PORT_PIN_IN_PULL_UP
            P14_6: PortPinId=230, PortPinSymbolicName=P14_6, PortPinInputPullResistor=PORT_PIN_IN_PULL_UP
            P14_7: PortPinId=231, PortPinSymbolicName=P14_7, PortPinInputPullResistor=PORT_PIN_IN_PULL_UP
            P14_8: PortPinId=232, PortPinSymbolicName=P14_8, PortPinInputPullResistor=PORT_PIN_IN_PULL_UP
            P14_9: PortPinId=233, PortPinSymbolicName=P14_9, PortPinInputPullResistor=PORT_PIN_IN_PULL_UP
            P14_10: PortPinId=234, PortPinSymbolicName=P14_10, PortPinInputPullResistor=PORT_PIN_IN_PULL_UP
          PortLVDS_0 (PortLVDS):
            PortLVDSPinPair = Pin_9_Pin_10
            PortLVDSRxEnController = PORT_CONTROLLED
            PortLVDSRxPathEnable = false
            PortLVDSRxTerminationMode = INTERNAL_TERMINATION
            PortLVDSMode = LVDSH
            PortLVDSPadSupply = V3_3
            PortLVDSTxEnController = PORT_CONTROLLED
            PortLVDSTxPathEnable = false
            PortLVDSTxPowerDownPullDown = DISABLE
        Port_15: PortNumber=15, PortNumberOfPortPins=9
          9 x PortPin, all with PortPinDirection=PORT_PIN_IN, PortPinDirectionChangeable=false, PortPinInitialMode=GPIO, PortPinLevelValue=PORT_PIN_LEVEL_LOW, PortPinModeChangeable=false, PortPinInputPullResistor=PORT_PIN_IN_PULL_UP, PortPinOutputPadDriveStrength=PORT_PIN_DEFAULT_DRIVER, PortPinOutputPinDriveMode=PORT_PIN_OUT_PUSHPULL, PortPinInputPadLevel=PORT_INPUT_LEVEL_CMOS_AUTOMOTIVE, PortPinEnableAnalogInputOnly=PORT_PIN_ANALOG_INPUT_DISABLE, PortPinEmergencyStop=false, PortPinControllerSelect=DISABLE, PortPinMode=PORT_PIN_MODE_ALL:
            P15_0: PortPinId=240, PortPinSymbolicName=P15_0
            P15_1: PortPinId=241, PortPinSymbolicName=P15_1
            P15_2: PortPinId=242, PortPinSymbolicName=P15_2
            P15_3: PortPinId=243, PortPinSymbolicName=P15_3
            P15_4: PortPinId=244, PortPinSymbolicName=P15_4
            P15_5: PortPinId=245, PortPinSymbolicName=P15_5
            P15_6: PortPinId=246, PortPinSymbolicName=P15_6
            P15_7: PortPinId=247, PortPinSymbolicName=P15_7
            P15_8: PortPinId=248, PortPinSymbolicName=P15_8
        Port_20: PortNumber=20, PortNumberOfPortPins=13
          13 x PortPin, all with PortPinDirection=PORT_PIN_IN, PortPinDirectionChangeable=false, PortPinInitialMode=GPIO, PortPinLevelValue=PORT_PIN_LEVEL_LOW, PortPinModeChangeable=false, PortPinInputPullResistor=PORT_PIN_IN_PULL_UP, PortPinOutputPadDriveStrength=PORT_PIN_DEFAULT_DRIVER, PortPinOutputPinDriveMode=PORT_PIN_OUT_PUSHPULL, PortPinInputPadLevel=PORT_INPUT_LEVEL_CMOS_AUTOMOTIVE, PortPinEnableAnalogInputOnly=PORT_PIN_ANALOG_INPUT_DISABLE, PortPinEmergencyStop=false, PortPinControllerSelect=DISABLE, PortPinMode=PORT_PIN_MODE_ALL:
            P20_0: PortPinId=320, PortPinSymbolicName=P20_0
            P20_1: PortPinId=321, PortPinSymbolicName=P20_1
            P20_2: PortPinId=322, PortPinSymbolicName=P20_2
            P20_3: PortPinId=323, PortPinSymbolicName=P20_3
            P20_6: PortPinId=326, PortPinSymbolicName=P20_6
            P20_7: PortPinId=327, PortPinSymbolicName=P20_7
            P20_8: PortPinId=328, PortPinSymbolicName=P20_8
            P20_9: PortPinId=329, PortPinSymbolicName=P20_9
            P20_10: PortPinId=330, PortPinSymbolicName=P20_10
            P20_11: PortPinId=331, PortPinSymbolicName=P20_11
            P20_12: PortPinId=332, PortPinSymbolicName=P20_12
            P20_13: PortPinId=333, PortPinSymbolicName=P20_13
            P20_14: PortPinId=334, PortPinSymbolicName=P20_14
        Port_21: PortNumber=21, PortNumberOfPortPins=8
          8 x PortPin, all with PortPinDirection=PORT_PIN_IN, PortPinDirectionChangeable=false, PortPinInitialMode=GPIO, PortPinLevelValue=PORT_PIN_LEVEL_LOW, PortPinModeChangeable=false, PortPinInputPullResistor=PORT_PIN_IN_PULL_UP, PortPinOutputPadDriveStrength=PORT_PIN_DEFAULT_DRIVER, PortPinOutputPinDriveMode=PORT_PIN_OUT_PUSHPULL, PortPinInputPadLevel=PORT_INPUT_LEVEL_CMOS_AUTOMOTIVE, PortPinEnableAnalogInputOnly=PORT_PIN_ANALOG_INPUT_DISABLE, PortPinEmergencyStop=false, PortPinControllerSelect=DISABLE, PortPinMode=PORT_PIN_MODE_ALL:
            P21_0: PortPinId=336, PortPinSymbolicName=P21_0
            P21_1: PortPinId=337, PortPinSymbolicName=P21_1
            P21_2: PortPinId=338, PortPinSymbolicName=P21_2
            P21_3: PortPinId=339, PortPinSymbolicName=P21_3
            P21_4: PortPinId=340, PortPinSymbolicName=P21_4
            P21_5: PortPinId=341, PortPinSymbolicName=P21_5
            P21_6: PortPinId=342, PortPinSymbolicName=P21_6
            P21_7: PortPinId=343, PortPinSymbolicName=P21_7
          3 x PortLVDS, all with PortLVDSRxEnController=PORT_CONTROLLED, PortLVDSRxPathEnable=false, PortLVDSRxTerminationMode=INTERNAL_TERMINATION, PortLVDSMode=LVDSH, PortLVDSPadSupply=V3_3, PortLVDSTxEnController=PORT_CONTROLLED, PortLVDSTxPathEnable=false, PortLVDSTxPowerDownPullDown=DISABLE:
            PortLVDS_0: PortLVDSPinPair=Pin_0_Pin_1
            PortLVDS_1: PortLVDSPinPair=Pin_2_Pin_3
            PortLVDS_2: PortLVDSPinPair=Pin_4_Pin_5
        Port_22: PortNumber=22, PortNumberOfPortPins=12
          12 x PortPin, all with PortPinDirectionChangeable=false, PortPinModeChangeable=false, PortPinOutputPadDriveStrength=PORT_PIN_DEFAULT_DRIVER, PortPinOutputPinDriveMode=PORT_PIN_OUT_PUSHPULL, PortPinInputPadLevel=PORT_INPUT_LEVEL_CMOS_AUTOMOTIVE, PortPinEnableAnalogInputOnly=PORT_PIN_ANALOG_INPUT_DISABLE, PortPinEmergencyStop=false, PortPinControllerSelect=DISABLE, PortPinMode=PORT_PIN_MODE_ALL:
            P22_0: PortPinId=352, PortPinSymbolicName=P22_0, PortPinDirection=PORT_PIN_OUT, PortPinInitialMode=ALT3, PortPinLevelValue=PORT_PIN_LEVEL_LOW, PortPinInputPullResistor=PORT_PIN_IN_NO_PULL
            P22_1: PortPinId=353, PortPinSymbolicName=P22_1, PortPinDirection=PORT_PIN_IN, PortPinInitialMode=GPIO, PortPinLevelValue=PORT_PIN_LEVEL_LOW, PortPinInputPullResistor=PORT_PIN_IN_PULL_UP
            P22_2: PortPinId=354, PortPinSymbolicName=P22_2, PortPinDirection=PORT_PIN_OUT, PortPinInitialMode=ALT3, PortPinLevelValue=PORT_PIN_LEVEL_HIGH, PortPinInputPullResistor=PORT_PIN_IN_NO_PULL
            P22_3: PortPinId=355, PortPinSymbolicName=P22_3, PortPinDirection=PORT_PIN_OUT, PortPinInitialMode=ALT3, PortPinLevelValue=PORT_PIN_LEVEL_LOW, PortPinInputPullResistor=PORT_PIN_IN_NO_PULL
            P22_4: PortPinId=356, PortPinSymbolicName=P22_4, PortPinDirection=PORT_PIN_OUT, PortPinInitialMode=GPIO, PortPinLevelValue=PORT_PIN_LEVEL_LOW, PortPinInputPullResistor=PORT_PIN_IN_NO_PULL
            P22_5: PortPinId=357, PortPinSymbolicName=P22_5, PortPinDirection=PORT_PIN_IN, PortPinInitialMode=GPIO, PortPinLevelValue=PORT_PIN_LEVEL_LOW, PortPinInputPullResistor=PORT_PIN_IN_PULL_UP
            P22_6: PortPinId=358, PortPinSymbolicName=P22_6, PortPinDirection=PORT_PIN_IN, PortPinInitialMode=GPIO, PortPinLevelValue=PORT_PIN_LEVEL_LOW, PortPinInputPullResistor=PORT_PIN_IN_PULL_UP
            P22_7: PortPinId=359, PortPinSymbolicName=P22_7, PortPinDirection=PORT_PIN_IN, PortPinInitialMode=GPIO, PortPinLevelValue=PORT_PIN_LEVEL_LOW, PortPinInputPullResistor=PORT_PIN_IN_PULL_UP
            P22_8: PortPinId=360, PortPinSymbolicName=P22_8, PortPinDirection=PORT_PIN_IN, PortPinInitialMode=GPIO, PortPinLevelValue=PORT_PIN_LEVEL_LOW, PortPinInputPullResistor=PORT_PIN_IN_PULL_UP
            P22_9: PortPinId=361, PortPinSymbolicName=P22_9, PortPinDirection=PORT_PIN_IN, PortPinInitialMode=GPIO, PortPinLevelValue=PORT_PIN_LEVEL_LOW, PortPinInputPullResistor=PORT_PIN_IN_PULL_UP
            P22_10: PortPinId=362, PortPinSymbolicName=P22_10, PortPinDirection=PORT_PIN_IN, PortPinInitialMode=GPIO, PortPinLevelValue=PORT_PIN_LEVEL_LOW, PortPinInputPullResistor=PORT_PIN_IN_PULL_UP
            P22_11: PortPinId=363, PortPinSymbolicName=P22_11, PortPinDirection=PORT_PIN_OUT, PortPinInitialMode=GPIO, PortPinLevelValue=PORT_PIN_LEVEL_HIGH, PortPinInputPullResistor=PORT_PIN_IN_NO_PULL
          PortLVDS_0 (PortLVDS):
            PortLVDSPinPair = Pin_0_Pin_1
            PortLVDSRxEnController = PORT_CONTROLLED
            PortLVDSRxPathEnable = false
            PortLVDSRxTerminationMode = INTERNAL_TERMINATION
            PortLVDSMode = LVDSH
            PortLVDSPadSupply = V3_3
            PortLVDSTxEnController = PORT_CONTROLLED
            PortLVDSTxPathEnable = false
            PortLVDSTxPowerDownPullDown = DISABLE
          PortLVDS_1 (PortLVDS):
            PortLVDSPinPair = Pin_2_Pin_3
            PortLVDSRxEnController = PORT_CONTROLLED
            PortLVDSRxPathEnable = false
            PortLVDSRxTerminationMode = INTERNAL_TERMINATION
            PortLVDSMode = LVDSH
            PortLVDSPadSupply = V3_3
            PortLVDSTxEnController = PORT_CONTROLLED
            PortLVDSTxPathEnable = false
            PortLVDSTxPowerDownPullDown = DISABLE
        Port_23: PortNumber=23, PortNumberOfPortPins=8
          8 x PortPin, all with PortPinDirection=PORT_PIN_IN, PortPinDirectionChangeable=false, PortPinInitialMode=GPIO, PortPinLevelValue=PORT_PIN_LEVEL_LOW, PortPinModeChangeable=false, PortPinInputPullResistor=PORT_PIN_IN_PULL_UP, PortPinOutputPadDriveStrength=PORT_PIN_DEFAULT_DRIVER, PortPinOutputPinDriveMode=PORT_PIN_OUT_PUSHPULL, PortPinInputPadLevel=PORT_INPUT_LEVEL_CMOS_AUTOMOTIVE, PortPinEnableAnalogInputOnly=PORT_PIN_ANALOG_INPUT_DISABLE, PortPinEmergencyStop=false, PortPinControllerSelect=DISABLE, PortPinMode=PORT_PIN_MODE_ALL:
            P23_0: PortPinId=368, PortPinSymbolicName=P23_0
            P23_1: PortPinId=369, PortPinSymbolicName=P23_1
            P23_2: PortPinId=370, PortPinSymbolicName=P23_2
            P23_3: PortPinId=371, PortPinSymbolicName=P23_3
            P23_4: PortPinId=372, PortPinSymbolicName=P23_4
            P23_5: PortPinId=373, PortPinSymbolicName=P23_5
            P23_6: PortPinId=374, PortPinSymbolicName=P23_6
            P23_7: PortPinId=375, PortPinSymbolicName=P23_7
        Port_32: PortNumber=32, PortNumberOfPortPins=8
          8 x PortPin, all with PortPinDirectionChangeable=false, PortPinInitialMode=GPIO, PortPinModeChangeable=false, PortPinOutputPadDriveStrength=PORT_PIN_DEFAULT_DRIVER, PortPinOutputPinDriveMode=PORT_PIN_OUT_PUSHPULL, PortPinInputPadLevel=PORT_INPUT_LEVEL_CMOS_AUTOMOTIVE, PortPinEnableAnalogInputOnly=PORT_PIN_ANALOG_INPUT_DISABLE, PortPinEmergencyStop=false, PortPinControllerSelect=DISABLE, PortPinMode=PORT_PIN_MODE_ALL:
            P32_0: PortPinId=512, PortPinSymbolicName=P32_0, PortPinDirection=PORT_PIN_IN, PortPinLevelValue=PORT_PIN_LEVEL_LOW, PortPinInputPullResistor=PORT_PIN_IN_PULL_UP
            P32_1: PortPinId=513, PortPinSymbolicName=P32_1, PortPinDirection=PORT_PIN_IN, PortPinLevelValue=PORT_PIN_LEVEL_LOW, PortPinInputPullResistor=PORT_PIN_IN_PULL_UP
            P32_2: PortPinId=514, PortPinSymbolicName=P32_2, PortPinDirection=PORT_PIN_IN, PortPinLevelValue=PORT_PIN_LEVEL_LOW, PortPinInputPullResistor=PORT_PIN_IN_PULL_UP
            P32_3: PortPinId=515, PortPinSymbolicName=P32_3, PortPinDirection=PORT_PIN_IN, PortPinLevelValue=PORT_PIN_LEVEL_LOW, PortPinInputPullResistor=PORT_PIN_IN_PULL_UP
            P32_4: PortPinId=516, PortPinSymbolicName=P32_4, PortPinDirection=PORT_PIN_OUT, PortPinLevelValue=PORT_PIN_LEVEL_HIGH, PortPinInputPullResistor=PORT_PIN_IN_PULL_UP
            P32_5: PortPinId=517, PortPinSymbolicName=P32_5, PortPinDirection=PORT_PIN_OUT, PortPinLevelValue=PORT_PIN_LEVEL_HIGH, PortPinInputPullResistor=PORT_PIN_IN_NO_PULL
            P32_6: PortPinId=518, PortPinSymbolicName=P32_6, PortPinDirection=PORT_PIN_IN, PortPinLevelValue=PORT_PIN_LEVEL_LOW, PortPinInputPullResistor=PORT_PIN_IN_PULL_UP
            P32_7: PortPinId=519, PortPinSymbolicName=P32_7, PortPinDirection=PORT_PIN_IN, PortPinLevelValue=PORT_PIN_LEVEL_LOW, PortPinInputPullResistor=PORT_PIN_IN_PULL_UP
        Port_33: PortNumber=33, PortNumberOfPortPins=16
          16 x PortPin, all with PortPinDirection=PORT_PIN_IN, PortPinDirectionChangeable=false, PortPinInitialMode=GPIO, PortPinLevelValue=PORT_PIN_LEVEL_LOW, PortPinModeChangeable=false, PortPinInputPullResistor=PORT_PIN_IN_PULL_UP, PortPinOutputPadDriveStrength=PORT_PIN_DEFAULT_DRIVER, PortPinOutputPinDriveMode=PORT_PIN_OUT_PUSHPULL, PortPinInputPadLevel=PORT_INPUT_LEVEL_CMOS_AUTOMOTIVE, PortPinEnableAnalogInputOnly=PORT_PIN_ANALOG_INPUT_DISABLE, PortPinEmergencyStop=false, PortPinControllerSelect=DISABLE, PortPinMode=PORT_PIN_MODE_ALL:
            P33_0: PortPinId=528, PortPinSymbolicName=P33_0
            P33_1: PortPinId=529, PortPinSymbolicName=P33_1
            P33_2: PortPinId=530, PortPinSymbolicName=P33_2
            P33_3: PortPinId=531, PortPinSymbolicName=P33_3
            P33_4: PortPinId=532, PortPinSymbolicName=P33_4
            P33_5: PortPinId=533, PortPinSymbolicName=P33_5
            P33_6: PortPinId=534, PortPinSymbolicName=P33_6
            P33_7: PortPinId=535, PortPinSymbolicName=P33_7
            P33_8: PortPinId=536, PortPinSymbolicName=P33_8
            P33_9: PortPinId=537, PortPinSymbolicName=P33_9
            P33_10: PortPinId=538, PortPinSymbolicName=P33_10
            P33_11: PortPinId=539, PortPinSymbolicName=P33_11
            P33_12: PortPinId=540, PortPinSymbolicName=P33_12
            P33_13: PortPinId=541, PortPinSymbolicName=P33_13
            P33_14: PortPinId=542, PortPinSymbolicName=P33_14
            P33_15: PortPinId=543, PortPinSymbolicName=P33_15
        Port_34: PortNumber=34, PortNumberOfPortPins=5
          5 x PortPin, all with PortPinDirection=PORT_PIN_IN, PortPinDirectionChangeable=false, PortPinInitialMode=GPIO, PortPinLevelValue=PORT_PIN_LEVEL_LOW, PortPinModeChangeable=false, PortPinInputPullResistor=PORT_PIN_IN_PULL_UP, PortPinOutputPadDriveStrength=PORT_PIN_DEFAULT_DRIVER, PortPinOutputPinDriveMode=PORT_PIN_OUT_PUSHPULL, PortPinInputPadLevel=PORT_INPUT_LEVEL_CMOS_AUTOMOTIVE, PortPinEnableAnalogInputOnly=PORT_PIN_ANALOG_INPUT_DISABLE, PortPinEmergencyStop=false, PortPinControllerSelect=DISABLE, PortPinMode=PORT_PIN_MODE_ALL:
            P34_1: PortPinId=545, PortPinSymbolicName=P34_1
            P34_2: PortPinId=546, PortPinSymbolicName=P34_2
            P34_3: PortPinId=547, PortPinSymbolicName=P34_3
            P34_4: PortPinId=548, PortPinSymbolicName=P34_4
            P34_5: PortPinId=549, PortPinSymbolicName=P34_5
        Port_40: PortNumber=40, PortNumberOfPortPins=15
          15 x PortPin, all with PortPinDirection=PORT_PIN_IN, PortPinDirectionChangeable=false, PortPinInitialMode=GPIO, PortPinLevelValue=PORT_PIN_LEVEL_LOW, PortPinModeChangeable=false, PortPinInputPullResistor=PORT_PIN_IN_PULL_UP, PortPinOutputPadDriveStrength=PORT_PIN_DEFAULT_DRIVER, PortPinOutputPinDriveMode=PORT_PIN_OUT_PUSHPULL, PortPinInputPadLevel=PORT_INPUT_LEVEL_CMOS_AUTOMOTIVE, PortPinEnableAnalogInputOnly=PORT_PIN_ANALOG_INPUT_DISABLE, PortPinEmergencyStop=false, PortPinControllerSelect=DISABLE, PortPinMode=PORT_PIN_MODE_ALL:
            P40_0: PortPinId=640, PortPinSymbolicName=P40_0
            P40_1: PortPinId=641, PortPinSymbolicName=P40_1
            P40_2: PortPinId=642, PortPinSymbolicName=P40_2
            P40_3: PortPinId=643, PortPinSymbolicName=P40_3
            P40_4: PortPinId=644, PortPinSymbolicName=P40_4
            P40_5: PortPinId=645, PortPinSymbolicName=P40_5
            P40_6: PortPinId=646, PortPinSymbolicName=P40_6
            P40_7: PortPinId=647, PortPinSymbolicName=P40_7
            P40_8: PortPinId=648, PortPinSymbolicName=P40_8
            P40_9: PortPinId=649, PortPinSymbolicName=P40_9
            P40_10: PortPinId=650, PortPinSymbolicName=P40_10
            P40_11: PortPinId=651, PortPinSymbolicName=P40_11
            P40_12: PortPinId=652, PortPinSymbolicName=P40_12
            P40_13: PortPinId=653, PortPinSymbolicName=P40_13
            P40_14: PortPinId=654, PortPinSymbolicName=P40_14
    PortGeneral:
      PortDevErrorDetect = false
      PortSetPinDirectionApi = false
      PortSetPinModeApi = false
      PortVersionInfoApi = false
      PortInitApiMode = PORT_MCAL_SUPERVISOR
      PortSafetyEnable = true
      PortInitCheckApi = false
    CommonPublishedInformation:
      ArMajorVersion = 4
      ArMinorVersion = 2
      ArPatchVersion = 2
      SwMajorVersion = 20
      SwMinorVersion = 0
      SwPatchVersion = 1
      ModuleId = 124
      VendorId = 17
      Release = _TRICORE_TC377

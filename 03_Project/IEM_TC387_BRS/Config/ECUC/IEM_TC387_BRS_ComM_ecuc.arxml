AUTOSAR XML (schema 4-2-2)
package /ActiveEcuC
  module config ComM: implementation-config-variant=VARIANT-PRE-COMPILE, module-description=ComM_Impl
    ComMGeneral:
      ComMPncGatewayEnabled = false
      ComMPncIdCounting = COMM_PNC_ID_COUNT_FROM_NM_MESSAGE
      ComMPncSupport = true
      ComMDevErrorDetect = true
      ComMEcuGroupClassification = 3
      ComMModeLimitationEnabled = false
      ComMSynchronousWakeUp = true
      ComMTMinFullComModeDuration = 5
      ComMVersionInfoApi = false
      ComMWakeupInhibitionEnabled = false
      ComMSafeBswChecks = false
      ComMGeneration: ComMOutOfBoundsWriteSanitizer=false, ComMOutOfBoundsReadSanitizer=false
    ComMConfigSet: ComMPncEnabled=true
      3 x ComMPnc, all with ComMChannelPerPnc=PropulsionCAN_IEM_19020f5a, ComMUserPerPnc=PropulsionCAN_IEM_78c1505e:
        System_MAPPING_6666c73f: ComMPncId=29
          PropulsionCAN_db9c2837_Rx_c1d6a06c (ComMPncComSignal):
            ComMPncComSignalDirection = RX
            ComMPncComSignalKind = EIRA
            ComMPncComSignalChannelRef = PropulsionCAN_IEM_19020f5a
            ComMPncComSignalRef = PropulsionCAN_db9c2837_Rx
          PropulsionCAN_Eira_Tx (ComMPncComSignal):
            ComMPncComSignalDirection = TX
            ComMPncComSignalKind = EIRA
            ComMPncComSignalRef = PropulsionCAN_EiraSignal_Tx
            ComMPncComSignalChannelRef = PropulsionCAN_IEM_19020f5a
        System_MAPPING_06a14eda: ComMPncId=30
          PropulsionCAN_db9c2837_Rx_c1d6a06c (ComMPncComSignal):
            ComMPncComSignalDirection = RX
            ComMPncComSignalKind = EIRA
            ComMPncComSignalChannelRef = PropulsionCAN_IEM_19020f5a
            ComMPncComSignalRef = PropulsionCAN_db9c2837_Rx
          PropulsionCAN_Eira_Tx (ComMPncComSignal):
            ComMPncComSignalDirection = TX
            ComMPncComSignalKind = EIRA
            ComMPncComSignalRef = PropulsionCAN_EiraSignal_Tx
            ComMPncComSignalChannelRef = PropulsionCAN_IEM_19020f5a
        System_MAPPING_f6d9daae: ComMPncId=26
          PropulsionCAN_db9c2837_Rx_c1d6a06c (ComMPncComSignal):
            ComMPncComSignalDirection = RX
            ComMPncComSignalKind = EIRA
            ComMPncComSignalChannelRef = PropulsionCAN_IEM_19020f5a
            ComMPncComSignalRef = PropulsionCAN_db9c2837_Rx
          PropulsionCAN_Eira_Tx (ComMPncComSignal):
            ComMPncComSignalDirection = TX
            ComMPncComSignalKind = EIRA
            ComMPncComSignalRef = PropulsionCAN_EiraSignal_Tx
            ComMPncComSignalChannelRef = PropulsionCAN_IEM_19020f5a
      PropulsionCAN_IEM_78c1505e (ComMUser): ComMUserIdentifier=1, ComMUserModeNotification=false
      5 x ComMPnc, all with ComMChannelPerPnc=PropulsionCAN_IEM_19020f5a, ComMUserPerPnc=PropulsionCAN_IEM_78c1505e:
        System_MAPPING_6fd08b14: ComMPncId=25
          PropulsionCAN_db9c2837_Rx_c1d6a06c (ComMPncComSignal):
            ComMPncComSignalDirection = RX
            ComMPncComSignalKind = EIRA
            ComMPncComSignalChannelRef = PropulsionCAN_IEM_19020f5a
            ComMPncComSignalRef = PropulsionCAN_db9c2837_Rx
          PropulsionCAN_Eira_Tx (ComMPncComSignal):
            ComMPncComSignalDirection = TX
            ComMPncComSignalKind = EIRA
            ComMPncComSignalRef = PropulsionCAN_EiraSignal_Tx
            ComMPncComSignalChannelRef = PropulsionCAN_IEM_19020f5a
        System_MAPPING_7f7df67e: ComMPncId=39
          PropulsionCAN_db9c2837_Rx_c1d6a06c (ComMPncComSignal):
            ComMPncComSignalDirection = RX
            ComMPncComSignalKind = EIRA
            ComMPncComSignalChannelRef = PropulsionCAN_IEM_19020f5a
            ComMPncComSignalRef = PropulsionCAN_db9c2837_Rx
          PropulsionCAN_Eira_Tx (ComMPncComSignal):
            ComMPncComSignalDirection = TX
            ComMPncComSignalKind = EIRA
            ComMPncComSignalRef = PropulsionCAN_EiraSignal_Tx
            ComMPncComSignalChannelRef = PropulsionCAN_IEM_19020f5a
        System_MAPPING_ddf4896d: ComMPncId=16
          PropulsionCAN_db9c2837_Rx_c1d6a06c (ComMPncComSignal):
            ComMPncComSignalDirection = RX
            ComMPncComSignalKind = EIRA
            ComMPncComSignalChannelRef = PropulsionCAN_IEM_19020f5a
            ComMPncComSignalRef = PropulsionCAN_db9c2837_Rx
          PropulsionCAN_Eira_Tx (ComMPncComSignal):
            ComMPncComSignalDirection = TX
            ComMPncComSignalKind = EIRA
            ComMPncComSignalRef = PropulsionCAN_EiraSignal_Tx
            ComMPncComSignalChannelRef = PropulsionCAN_IEM_19020f5a
        System_MAPPING_18d7bb82: ComMPncId=24
          PropulsionCAN_db9c2837_Rx_c1d6a06c (ComMPncComSignal):
            ComMPncComSignalDirection = RX
            ComMPncComSignalKind = EIRA
            ComMPncComSignalChannelRef = PropulsionCAN_IEM_19020f5a
            ComMPncComSignalRef = PropulsionCAN_db9c2837_Rx
          PropulsionCAN_Eira_Tx (ComMPncComSignal):
            ComMPncComSignalDirection = TX
            ComMPncComSignalKind = EIRA
            ComMPncComSignalRef = PropulsionCAN_EiraSignal_Tx
            ComMPncComSignalChannelRef = PropulsionCAN_IEM_19020f5a
        System_MAPPING_9fa81f60: ComMPncId=33
          PropulsionCAN_db9c2837_Rx_c1d6a06c (ComMPncComSignal):
            ComMPncComSignalDirection = RX
            ComMPncComSignalKind = EIRA
            ComMPncComSignalChannelRef = PropulsionCAN_IEM_19020f5a
            ComMPncComSignalRef = PropulsionCAN_db9c2837_Rx
          PropulsionCAN_Eira_Tx (ComMPncComSignal):
            ComMPncComSignalDirection = TX
            ComMPncComSignalKind = EIRA
            ComMPncComSignalRef = PropulsionCAN_EiraSignal_Tx
            ComMPncComSignalChannelRef = PropulsionCAN_IEM_19020f5a
      PropulsionCAN_IEM_04f8de22 (ComMUser): ComMUserIdentifier=0, ComMUserModeNotification=false
      PropulsionCAN_IEM_19020f5a (ComMChannel):
        ComMBusType = COMM_BUS_TYPE_CAN
        ComMChannelId = 0
        ComMPncGatewayType = COMM_GATEWAY_TYPE_NONE
        ComMFullCommRequestNotificationEnabled = false
        ComMMainFunctionPeriod = 0.02
        ComMNoCom = false
        ComMNoWakeup = false
        ComMNetworkManagement: ComMNmVariant=FULL, ComMPncNmRequest=false
        PropulsionCAN_IEM_1d9bb637 (ComMUserPerChannel): ComMUserChannel=PropulsionCAN_IEM_04f8de22
        PropulsionCAN_IEM_ee33faf5 (ComMUserPerChannel): ComMUserChannel=PropulsionCAN_IEM_78c1505e
      System_MAPPING_76cbba55 (ComMPnc): ComMPncId=35, ComMChannelPerPnc=PropulsionCAN_IEM_19020f5a, ComMUserPerPnc=PropulsionCAN_IEM_78c1505e
        PropulsionCAN_db9c2837_Rx_c1d6a06c (ComMPncComSignal):
          ComMPncComSignalDirection = RX
          ComMPncComSignalKind = EIRA
          ComMPncComSignalChannelRef = PropulsionCAN_IEM_19020f5a
          ComMPncComSignalRef = PropulsionCAN_db9c2837_Rx
        PropulsionCAN_Eira_Tx (ComMPncComSignal):
          ComMPncComSignalDirection = TX
          ComMPncComSignalKind = EIRA
          ComMPncComSignalRef = PropulsionCAN_EiraSignal_Tx
          ComMPncComSignalChannelRef = PropulsionCAN_IEM_19020f5a
      System_MAPPING_81deea38 (ComMPnc): ComMPncId=27, ComMChannelPerPnc=PropulsionCAN_IEM_19020f5a, ComMUserPerPnc=PropulsionCAN_IEM_78c1505e
        PropulsionCAN_db9c2837_Rx_c1d6a06c (ComMPncComSignal):
          ComMPncComSignalDirection = RX
          ComMPncComSignalKind = EIRA
          ComMPncComSignalChannelRef = PropulsionCAN_IEM_19020f5a
          ComMPncComSignalRef = PropulsionCAN_db9c2837_Rx
        PropulsionCAN_Eira_Tx (ComMPncComSignal):
          ComMPncComSignalDirection = TX
          ComMPncComSignalKind = EIRA
          ComMPncComSignalRef = PropulsionCAN_EiraSignal_Tx
          ComMPncComSignalChannelRef = PropulsionCAN_IEM_19020f5a

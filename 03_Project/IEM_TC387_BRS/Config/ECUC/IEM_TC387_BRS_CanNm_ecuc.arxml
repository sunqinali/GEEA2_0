AUTOSAR XML (schema 4-2-2)
package /ActiveEcuC
  module config CanNm: implementation-config-variant=VARIANT-PRE-COMPILE, module-description=CanNm_Impl
    CanNmGlobalConfig:
      CanNmBusLoadReductionEnabled = false
      CanNmBusSynchronizationEnabled = false
      CanNmComControlEnabled = false
      CanNmImmediateRestartEnabled = false
      CanNmNodeDetectionEnabled = true
      CanNmPduRxIndicationEnabled = true
      CanNmPnEiraCalcEnabled = true
      CanNmRemoteSleepIndEnabled = false
      CanNmRepeatMsgIndEnabled = false
      CanNmStateChangeIndEnabled = false
      CanNmUserDataEnabled = true
      CanNmComUserDataSupport = true
      CanNmCoordinatorSyncSupport = false
      CanNmDevErrorDetect = true
      CanNmImmediateTxconfEnabled = false
      CanNmMainFunctionPeriod = 0.01
      CanNmPassiveModeEnabled = false
      CanNmVersionInfoApi = false
      CanNmDisableTxErrReport = false
      CanNmApiOptimization = false
      CanNmCanIfRangeConfigDLCCheck = true
      CanNmRuntimeMeasurementSupport = false
      CanNmSafeBswChecks = false
      CanNmPnResetTime = 2
      CanNmPnEiraRxNSduRef = PropulsionCAN_c71a5358_Rx
      CanNmPnInfo: CanNmPnInfoLength=6, CanNmPnInfoOffset=2
        6 x CanNmPnFilterMaskByte:
          CanNmPnFilterMaskByte_2: CanNmPnFilterMaskByteIndex=2, CanNmPnFilterMaskByteValue=138
          CanNmPnFilterMaskByte_{3..5}: CanNmPnFilterMaskByteIndex={3..5}, CanNmPnFilterMaskByteValue=0
          CanNmPnFilterMaskByte_0: CanNmPnFilterMaskByteIndex=0, CanNmPnFilterMaskByteValue=1
          CanNmPnFilterMaskByte_1: CanNmPnFilterMaskByteIndex=1, CanNmPnFilterMaskByteValue=111
      PropulsionCanNmCluster_99dff440 (CanNmChannelConfig):
        CanNmBusLoadReductionActive = false
        CanNmCarWakeUpRxEnabled = false
        CanNmImmediateNmCycleTime = 0.02
        CanNmImmediateNmTransmissions = 20
        CanNmMsgCycleOffset = 0.1
        CanNmMsgCycleTime = 1
        CanNmMsgReducedTime = 0.5
        CanNmMsgTimeoutTime = 0.5
        CanNmNodeId = 28
        CanNmPduCbvPosition = CANNM_PDU_BYTE_1
        CanNmPduNidPosition = CANNM_PDU_BYTE_0
        CanNmPnEnabled = true
        CanNmPnEraCalcEnabled = false
        CanNmRemoteSleepIndTime = 0
        CanNmRepeatMessageTime = 1
        CanNmTimeoutTime = 3
        CanNmUserDataLength = 6
        CanNmWaitBusSleepTime = 4
        CanNmActiveWakeupBitEnabled = false
        CanNmNodeIdEnabled = true
        CanNmNodeDetectionEnabled = true
        CanNmRepeatMsgIndEnabled = false
        CanNmImmediateRestartEnabled = false
        CanNmComControlEnabled = false
        CanNmCriBitAlwaysEnabled = false
        CanNmComMNetworkHandleRef = PropulsionCAN_IEM_19020f5a
        IemPropNmPdu1_277f9a9b_Tx (CanNmTxPdu): CanNmTxConfirmationPduId=0, CanNmTxPduRef=IemPropNmPdu1_277f9a9b_Tx
        PropulsionCanNmCluster_99dff440_Rx (CanNmRxPdu): CanNmRxPduId=0, CanNmRxPduRef=IemPropCanNmNode_6342b4e7_Rx
        CanNmUserDataTxPdu: CanNmTxUserDataPduId=0, CanNmTxUserDataPduRef=PropulsionCAN_EiraUserData_Tx
      CanNmGeneration: CanNmOutOfBoundsWriteSanitizer=false, CanNmOutOfBoundsReadSanitizer=false, CanNmInterfacesForDeactivatedData=false

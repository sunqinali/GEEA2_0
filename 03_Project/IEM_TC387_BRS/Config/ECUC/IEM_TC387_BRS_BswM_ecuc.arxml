AUTOSAR XML (schema 4-2-2)
package /ActiveEcuC
  module config BswM: implementation-config-variant=VARIANT-PRE-COMPILE, module-description=BswM_Impl
    BswMGeneral:
      BswMCanSMEnabled = true
      BswMComMEnabled = true
      BswMDcmEnabled = true
      BswMDevErrorDetect = true
      BswMEcuMEnabled = true
      BswMEthIfEnabled = false
      BswMEthSMEnabled = false
      BswMFrSMEnabled = false
      BswMGenericRequestEnabled = false
      BswMJ1939DcmEnabled = false
      BswMJ1939NmEnabled = false
      BswMLinSMEnabled = false
      BswMLinTPEnabled = false
      BswMNmEnabled = false
      BswMNvMEnabled = true
      BswMPduREnabled = false
      BswMRuleControlEnabled = false
      BswMSdEnabled = false
      BswMVersionInfoApi = false
      BswMWdgMEnabled = false
      BswMModeCheck = true
      BswMActionListQueueSearchAlgorithm = LINEAR_SEARCH
      BswMMainFunctionPeriod = 0.01
      BswMSafeBswChecks = false
      BswMCommonData
      BswMGeneration:
        BswMOutOfBoundsWriteSanitizer = false
        BswMOutOfBoundsReadSanitizer = false
        BswMReduceConstantData2Define = true
        BswMReduceDataByStreaming = false
        BswMBoolDataInArrayOfStructStrategy = BITMASKING
        BswMInterfacesForDeactivatedData = false
    BswMConfig: BswMPartitionRef=EcucPartition_Core0
      BswMArbitration
        MRP_EcuMIndication (BswMModeRequestPort): BswMArbitrateOnInit=false, BswMRequestProcessing=BSWM_DEFERRED
          BswMModeRequestSource
            BswMEcuMIndication
          BswMModeInitValue
            BswMBswModeInitValue: BswMBswModeInitValueMode=ECUM_STATE_OFF
        MRP_DcmApplicationUpdated (BswMModeRequestPort): BswMArbitrateOnInit=false, BswMRequestProcessing=BSWM_FORCED_IMMEDIATE
          BswMModeRequestSource
            BswMDcmApplicationUpdatedIndication
          BswMModeInitValue
            BswMBswModeInitValue: BswMBswModeInitValueMode=FALSE
        COND_EcuM_RUN (BswMModeCondition): BswMConditionType=BSWM_EQUALS, BswMConditionMode=MRP_EcuMIndication
          BswMConditionValue
            BswMBswMode: BswMBswRequestedMode=ECUM_STATE_RUN
        COND_DcmApplicationUpdated (BswMModeCondition): BswMConditionType=BSWM_EQUALS, BswMConditionMode=MRP_DcmApplicationUpdated
          BswMConditionValue
            BswMBswMode: BswMBswRequestedMode=TRUE
        EXP_EcuM_RUN (BswMLogicalExpression): BswMArgumentRef=COND_EcuM_RUN
        EXP_DcmApplicationUpdated (BswMLogicalExpression): BswMArgumentRef=COND_DcmApplicationUpdated
        RULE_EnterRun (BswMRule): BswMNestedExecutionOnly=false, BswMRuleId=0, BswMRuleInitState=BSWM_FALSE, BswMRuleExpressionRef=EXP_EcuM_RUN, BswMRuleTrueActionList=AL_EnterRun
        RULE_ProgReset (BswMRule):
          BswMNestedExecutionOnly = false
          BswMRuleId = 1
          BswMRuleInitState = BSWM_FALSE
          BswMRuleExpressionRef = EXP_DcmApplicationUpdated
          BswMRuleTrueActionList = AL_ProgReset
        MRP_ComM_PropulsionCAN (BswMModeRequestPort): BswMArbitrateOnInit=true, BswMRequestProcessing=BSWM_IMMEDIATE
          BswMModeRequestSource
            BswMComMIndication: BswMComMChannelRef=PropulsionCAN_IEM_19020f5a
          BswMModeInitValue
            BswMBswModeInitValue: BswMBswModeInitValueMode=COMM_NO_COMMUNICATION
        MRP_CanSM_PropulsionCAN (BswMModeRequestPort): BswMArbitrateOnInit=true, BswMRequestProcessing=BSWM_DEFERRED
          BswMModeRequestSource
            BswMCanSMIndication: BswMCanSMChannelRef=PropulsionCAN_IEM_19020f5a
          BswMModeInitValue
            BswMBswModeInitValue: BswMBswModeInitValueMode=CANSM_BSWM_NO_COMMUNICATION
        COND_ComM_FULL (BswMModeCondition): BswMConditionType=BSWM_EQUALS, BswMConditionMode=MRP_ComM_PropulsionCAN
          BswMConditionValue
            BswMBswMode: BswMBswRequestedMode=COMM_FULL_COMMUNICATION
        EXP_ComM_FULL (BswMLogicalExpression): BswMArgumentRef=COND_ComM_FULL
        RULE_ComM_Full (BswMRule):
          BswMNestedExecutionOnly = false
          BswMRuleId = 2
          BswMRuleInitState = BSWM_FALSE
          BswMRuleExpressionRef = EXP_ComM_FULL
          BswMRuleTrueActionList = AL_ComMFullEntered
      BswMModeControl
        5 x BswMAction:
          ACT_ComMAllow
            BswMAvailableActions
              BswMComMAllowCom: BswMComAllowed=true, BswMComMAllowChannelRef=PropulsionCAN_IEM_19020f5a
          ACT_ComMFull
            BswMAvailableActions
              BswMComMModeSwitch: BswMComMRequestedMode=BSWM_FULL_COM, BswMComMUserRef=PropulsionCAN_IEM_04f8de22
          ACT_ProgRequest
            BswMAvailableActions
              BswMUserCallout: BswMUserCalloutFunction=Appl_BswM_ProgRequest(), BswMCreateCallout=false
          ACT_SelectReset
            BswMAvailableActions
              BswMEcuMSelectShutdownTarget: BswMEcuMShutdownTarget=RESET, BswMEcuMResetModeRef=ECUM_RESET_MCU
          ACT_GoDown
            BswMAvailableActions
              BswMEcuMGoDown: BswMEcuMUserIdRef=EcuMUser_BswM
        AL_EnterRun (BswMActionList): BswMActionListExecution=BSWM_TRIGGER
          4 x BswMActionListItem, all with BswMAbortOnFail=false:
            ACT_ComMAllow: BswMActionListItemIndex=0, BswMActionListItemRef=BswMModeControl/ACT_ComMAllow
            ACT_ComMFull: BswMActionListItemIndex=1, BswMActionListItemRef=BswMModeControl/ACT_ComMFull
            ACT_ComIpduStart: BswMActionListItemIndex=2, BswMActionListItemRef=BswMModeControl/ACT_ComIpduStart
            ACT_ComDmEnable: BswMActionListItemIndex=3, BswMActionListItemRef=BswMModeControl/ACT_ComDmEnable
        AL_ProgReset (BswMActionList): BswMActionListExecution=BSWM_TRIGGER
          4 x BswMActionListItem, all with BswMAbortOnFail=false:
            ACT_ProgRequest: BswMActionListItemIndex=1, BswMActionListItemRef=BswMModeControl/ACT_ProgRequest
            ACT_SelectReset: BswMActionListItemIndex=2, BswMActionListItemRef=BswMModeControl/ACT_SelectReset
            ACT_GoDown: BswMActionListItemIndex=3, BswMActionListItemRef=BswMModeControl/ACT_GoDown
            ACT_ComIpduStop: BswMActionListItemIndex=0, BswMActionListItemRef=BswMModeControl/ACT_ComIpduStop
        3 x BswMAction:
          ACT_ComIpduStart
            BswMAvailableActions
              BswMPduGroupSwitch:
                BswMPduGroupSwitchReinit = true
                BswMEnabledPduGroupRef = RxMPG_PropulsionCAN_aad5aa75
                BswMEnabledPduGroupRef = RxSPG_PropulsionCAN_fca0cb9e
                BswMEnabledPduGroupRef = TxMPG_PropulsionCAN_3709a166
                BswMEnabledPduGroupRef = TxSPG_PropulsionCAN_617cc08d
          ACT_ComDmEnable
            BswMAvailableActions
              BswMDeadlineMonitoringControl: BswMEnabledDMPduGroupRef=RxMPG_PropulsionCAN_aad5aa75, BswMEnabledDMPduGroupRef=RxSPG_PropulsionCAN_fca0cb9e
          ACT_DcmComMResync
            BswMAvailableActions
              BswMUserCallout: BswMUserCalloutFunction=Appl_BswM_OnComMFull, BswMCreateCallout=false
        AL_ComMFullEntered (BswMActionList): BswMActionListExecution=BSWM_TRIGGER
          ACT_DcmComMResync (BswMActionListItem): BswMAbortOnFail=false, BswMActionListItemIndex=0, BswMActionListItemRef=BswMModeControl/ACT_DcmComMResync
        ACT_ComIpduStop (BswMAction)
          BswMAvailableActions
            BswMPduGroupSwitch:
              BswMPduGroupSwitchReinit = false
              BswMDisabledPduGroupRef = RxMPG_PropulsionCAN_aad5aa75
              BswMDisabledPduGroupRef = RxSPG_PropulsionCAN_fca0cb9e
              BswMDisabledPduGroupRef = TxMPG_PropulsionCAN_3709a166
              BswMDisabledPduGroupRef = TxSPG_PropulsionCAN_617cc08d

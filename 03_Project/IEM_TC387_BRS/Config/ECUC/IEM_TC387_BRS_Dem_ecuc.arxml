[part 3 of 3: package /ActiveEcuC]
AUTOSAR XML (schema 4-2-2)
package /ActiveEcuC  (continued)
  module config Dem: implementation-config-variant=VARIANT-PRE-COMPILE, module-description=Dem_Impl  (continued)
    DemConfigSet  (continued)
      PSnsr_GRADT_Flt (DemEventParameter):
        DemEventKind = DEM_EVENT_KIND_SWC
        DemMaxNumberFreezeFrameRecords = 2
        DemEventTimeSeries = DEM_TIMESERIES_SNAPSHOT_NONE
        DemEventAvailable = true
        DemEventId = 161
        DemEventAvailableInVariant = true
        DemEventLatchTestFailed = false
        DemEventCreateInfoPort = true
        DemDTCClassRef = DTCClass_PSnsr_GRADT_Flt
        DemExtendedDataClassRef = ExtendedDataClass_5ecd55b9
        DemFreezeFrameClassRef = FreezeFrameClass_c3111450
        DemEventClass:
          DemAgingAllowed = true
          DemAgingCycleCounterThreshold = 40
          DemEventDestination = DEM_DTC_ORIGIN_PRIMARY_MEMORY
          DemEventPriority = 1
          DemEventFailureCycleCounterThreshold = 0
          DemConsiderPtoStatus = false
          DemFFPrestorageSupported = false
          DemAgingCycleRef = PowerCycle
          DemOperationCycleRef = PowerCycle
          DemDebounceAlgorithmClass
            DemDebounceCounterBased:
              DemDebounceCounterDecrementStepSize = 128
              DemDebounceCounterIncrementStepSize = 127
              DemDebounceCounterJumpDown = true
              DemDebounceCounterJumpUp = true
              DemDebounceBehavior = DEM_DEBOUNCE_FREEZE
              DemDebounceCounterFailedThreshold = 127
              DemDebounceCounterJumpDownValue = 0
              DemDebounceCounterJumpUpValue = 0
              DemDebounceCounterPassedThreshold = -128
              DemDebounceCounterStorage = false
              DemDebounceContinuous = false
      AURIX_WATHDOG_FLT (DemEventParameter):
        DemEventKind = DEM_EVENT_KIND_SWC
        DemMaxNumberFreezeFrameRecords = 2
        DemEventTimeSeries = DEM_TIMESERIES_SNAPSHOT_NONE
        DemEventAvailable = true
        DemEventId = 5
        DemEventAvailableInVariant = true
        DemEventLatchTestFailed = false
        DemEventCreateInfoPort = true
        DemDTCClassRef = DTCClass_AURIX_WATHDOG_FLT
        DemExtendedDataClassRef = ExtendedDataClass_5ecd55b9
        DemFreezeFrameClassRef = FreezeFrameClass_c3111450
        DemEventClass:
          DemAgingAllowed = true
          DemAgingCycleCounterThreshold = 40
          DemEventDestination = DEM_DTC_ORIGIN_PRIMARY_MEMORY
          DemEventPriority = 1
          DemEventFailureCycleCounterThreshold = 0
          DemConsiderPtoStatus = false
          DemFFPrestorageSupported = false
          DemAgingCycleRef = PowerCycle
          DemOperationCycleRef = PowerCycle
          DemDebounceAlgorithmClass
            DemDebounceCounterBased:
              DemDebounceCounterDecrementStepSize = 128
              DemDebounceCounterIncrementStepSize = 127
              DemDebounceCounterJumpDown = true
              DemDebounceCounterJumpUp = true
              DemDebounceBehavior = DEM_DEBOUNCE_FREEZE
              DemDebounceCounterFailedThreshold = 127
              DemDebounceCounterJumpDownValue = 0
              DemDebounceCounterJumpUpValue = 0
              DemDebounceCounterPassedThreshold = -128
              DemDebounceCounterStorage = false
              DemDebounceContinuous = false
          IndicatorAttribute_WarningIndicator (DemIndicatorAttribute):
            DemIndicatorFailureCycleSource = DEM_FAILURE_CYCLE_EVENT
            DemIndicatorBehaviour = DEM_INDICATOR_CONTINUOUS
            DemIndicatorHealingCycleCounterThreshold = 3
            DemIndicatorHealingCycleRef = PowerCycle
            DemIndicatorRef = WarningIndicator
      DTCClass_INV_UHVDC_PLAUS (DemDTCClass): DemDTCSeverity=DEM_DTC_SEV_IMMEDIATELY, DemUdsDTC=1053794, DemImmediateNvStorage=false
      DTCClass_INV_IAC_OC_HWP (DemDTCClass): DemDTCSeverity=DEM_DTC_SEV_IMMEDIATELY, DemUdsDTC=1052953, DemImmediateNvStorage=false
      VcEvNodeMisBECM (DemEventParameter):
        DemEventKind = DEM_EVENT_KIND_SWC
        DemMaxNumberFreezeFrameRecords = 2
        DemEventTimeSeries = DEM_TIMESERIES_SNAPSHOT_NONE
        DemEventAvailable = true
        DemEventId = 202
        DemEventAvailableInVariant = true
        DemEventLatchTestFailed = false
        DemEventCreateInfoPort = true
        DemDTCClassRef = DTCClass_VcEvNodeMisBECM
        DemExtendedDataClassRef = ExtendedDataClass_5ecd55b9
        DemFreezeFrameClassRef = FreezeFrameClass_c3111450
        DemEventClass:
          DemAgingAllowed = true
          DemAgingCycleCounterThreshold = 40
          DemEventDestination = DEM_DTC_ORIGIN_PRIMARY_MEMORY
          DemEventPriority = 1
          DemEventFailureCycleCounterThreshold = 0
          DemConsiderPtoStatus = false
          DemFFPrestorageSupported = false
          DemAgingCycleRef = PowerCycle
          DemEnableConditionGroupRef = EnableConditionGroup_6f8868bd
          DemOperationCycleRef = PowerCycle
          DemDebounceAlgorithmClass
            DemDebounceCounterBased:
              DemDebounceCounterDecrementStepSize = 128
              DemDebounceCounterIncrementStepSize = 127
              DemDebounceCounterJumpDown = true
              DemDebounceCounterJumpUp = true
              DemDebounceBehavior = DEM_DEBOUNCE_FREEZE
              DemDebounceCounterFailedThreshold = 127
              DemDebounceCounterJumpDownValue = 0
              DemDebounceCounterJumpUpValue = 0
              DemDebounceCounterPassedThreshold = -128
              DemDebounceCounterStorage = false
              DemDebounceContinuous = false
          IndicatorAttribute_WarningIndicator (DemIndicatorAttribute):
            DemIndicatorFailureCycleSource = DEM_FAILURE_CYCLE_EVENT
            DemIndicatorBehaviour = DEM_INDICATOR_CONTINUOUS
            DemIndicatorHealingCycleCounterThreshold = 3
            DemIndicatorHealingCycleRef = PowerCycle
            DemIndicatorRef = WarningIndicator
      3 x DemDTCClass, all with DemDTCSeverity=DEM_DTC_SEV_IMMEDIATELY, DemImmediateNvStorage=false:
        DTCClass_INV_IAC_V_ELEC_HWP_001: DemUdsDTC=781569
        DTCClass_Ga_MoveOverThd: DemUdsDTC=528532
        DTCClass_VcEvNodeMisBECM: DemUdsDTC=12652800
      INV_UHVDC_UV_HWP (DemEventParameter):
        DemEventKind = DEM_EVENT_KIND_SWC
        DemMaxNumberFreezeFrameRecords = 2
        DemEventTimeSeries = DEM_TIMESERIES_SNAPSHOT_NONE
        DemEventAvailable = true
        DemEventId = 135
        DemEventAvailableInVariant = true
        DemEventLatchTestFailed = false
        DemEventCreateInfoPort = true
        DemDTCClassRef = DTCClass_INV_UHVDC_UV_HWP
        DemExtendedDataClassRef = ExtendedDataClass_5ecd55b9
        DemFreezeFrameClassRef = FreezeFrameClass_c3111450
        DemEventClass:
          DemAgingAllowed = true
          DemAgingCycleCounterThreshold = 40
          DemEventDestination = DEM_DTC_ORIGIN_PRIMARY_MEMORY
          DemEventPriority = 1
          DemEventFailureCycleCounterThreshold = 0
          DemConsiderPtoStatus = false
          DemFFPrestorageSupported = false
          DemAgingCycleRef = PowerCycle
          DemOperationCycleRef = PowerCycle
          DemDebounceAlgorithmClass
            DemDebounceCounterBased:
              DemDebounceCounterDecrementStepSize = 128
              DemDebounceCounterIncrementStepSize = 127
              DemDebounceCounterJumpDown = true
              DemDebounceCounterJumpUp = true
              DemDebounceBehavior = DEM_DEBOUNCE_FREEZE
              DemDebounceCounterFailedThreshold = 127
              DemDebounceCounterJumpDownValue = 0
              DemDebounceCounterJumpUpValue = 0
              DemDebounceCounterPassedThreshold = -128
              DemDebounceCounterStorage = false
              DemDebounceContinuous = false
          IndicatorAttribute_WarningIndicator (DemIndicatorAttribute):
            DemIndicatorFailureCycleSource = DEM_FAILURE_CYCLE_EVENT
            DemIndicatorBehaviour = DEM_INDICATOR_CONTINUOUS
            DemIndicatorHealingCycleCounterThreshold = 3
            DemIndicatorHealingCycleRef = PowerCycle
            DemIndicatorRef = WarningIndicator
      DTCClass_VCEvVddmPropFr19Tioutd (DemDTCClass): DemDTCSeverity=DEM_DTC_SEV_IMMEDIATELY, DemUdsDTC=15667456, DemImmediateNvStorage=false
      VcEvMonESpd (DemEventParameter):
        DemEventKind = DEM_EVENT_KIND_SWC
        DemMaxNumberFreezeFrameRecords = 2
        DemEventTimeSeries = DEM_TIMESERIES_SNAPSHOT_NONE
        DemEventAvailable = true
        DemEventId = 193
        DemEventAvailableInVariant = true
        DemEventLatchTestFailed = false
        DemEventCreateInfoPort = true
        DemDTCClassRef = DTCClass_VcEvMonESpd
        DemExtendedDataClassRef = ExtendedDataClass_5ecd55b9
        DemFreezeFrameClassRef = FreezeFrameClass_c3111450
        DemEventClass:
          DemAgingAllowed = true
          DemAgingCycleCounterThreshold = 40
          DemEventDestination = DEM_DTC_ORIGIN_PRIMARY_MEMORY
          DemEventPriority = 1
          DemEventFailureCycleCounterThreshold = 0
          DemConsiderPtoStatus = false
          DemFFPrestorageSupported = false
          DemAgingCycleRef = PowerCycle
          DemEnableConditionGroupRef = EnableConditionGroup_6698c395
          DemOperationCycleRef = PowerCycle
          DemDebounceAlgorithmClass
            DemDebounceCounterBased:
              DemDebounceCounterDecrementStepSize = 128
              DemDebounceCounterIncrementStepSize = 127
              DemDebounceCounterJumpDown = true
              DemDebounceCounterJumpUp = true
              DemDebounceBehavior = DEM_DEBOUNCE_FREEZE
              DemDebounceCounterFailedThreshold = 127
              DemDebounceCounterJumpDownValue = 0
              DemDebounceCounterJumpUpValue = 0
              DemDebounceCounterPassedThreshold = -128
              DemDebounceCounterStorage = false
              DemDebounceContinuous = false
          IndicatorAttribute_WarningIndicator (DemIndicatorAttribute):
            DemIndicatorFailureCycleSource = DEM_FAILURE_CYCLE_EVENT
            DemIndicatorBehaviour = DEM_INDICATOR_CONTINUOUS
            DemIndicatorHealingCycleCounterThreshold = 3
            DemIndicatorHealingCycleRef = PowerCycle
            DemIndicatorRef = WarningIndicator
      DTCClass_INV_RSLVR_SIN_COS_PLAUS_AMP (DemDTCClass): DemDTCSeverity=DEM_DTC_SEV_MAINTENANCE_ONLY, DemUdsDTC=1057122, DemImmediateNvStorage=false
      COM_NotConfig (DemEventParameter):
        DemEventKind = DEM_EVENT_KIND_SWC
        DemMaxNumberFreezeFrameRecords = 2
        DemEventTimeSeries = DEM_TIMESERIES_SNAPSHOT_NONE
        DemEventAvailable = true
        DemEventId = 8
        DemEventAvailableInVariant = true
        DemEventLatchTestFailed = false
        DemEventCreateInfoPort = true
        DemDTCClassRef = DTCClass_COM_NotConfig
        DemExtendedDataClassRef = ExtendedDataClass_5ecd55b9
        DemFreezeFrameClassRef = FreezeFrameClass_c3111450
        DemEventClass:
          DemAgingAllowed = true
          DemAgingCycleCounterThreshold = 1
          DemEventDestination = DEM_DTC_ORIGIN_PRIMARY_MEMORY
          DemEventPriority = 2
          DemEventFailureCycleCounterThreshold = 0
          DemConsiderPtoStatus = false
          DemFFPrestorageSupported = false
          DemAgingCycleRef = PowerCycle
          DemEnableConditionGroupRef = EnableConditionGroup_b321d2d1
          DemOperationCycleRef = PowerCycle
          DemDebounceAlgorithmClass
            DemDebounceCounterBased:
              DemDebounceCounterDecrementStepSize = 128
              DemDebounceCounterIncrementStepSize = 127
              DemDebounceCounterJumpDown = true
              DemDebounceCounterJumpUp = true
              DemDebounceBehavior = DEM_DEBOUNCE_FREEZE
              DemDebounceCounterFailedThreshold = 127
              DemDebounceCounterJumpDownValue = 0
              DemDebounceCounterJumpUpValue = 0
              DemDebounceCounterPassedThreshold = -128
              DemDebounceCounterStorage = false
              DemDebounceContinuous = false
          IndicatorAttribute_WarningIndicator (DemIndicatorAttribute):
            DemIndicatorFailureCycleSource = DEM_FAILURE_CYCLE_EVENT
            DemIndicatorBehaviour = DEM_INDICATOR_CONTINUOUS
            DemIndicatorHealingCycleCounterThreshold = 3
            DemIndicatorHealingCycleRef = PowerCycle
            DemIndicatorRef = WarningIndicator
      DTCClass_PS_BLDC_UV_FLT (DemDTCClass): DemDTCSeverity=DEM_DTC_SEV_IMMEDIATELY, DemUdsDTC=1058582, DemImmediateNvStorage=false
      INV_RSLVR_SIN_RNG_HI (DemEventParameter):
        DemEventKind = DEM_EVENT_KIND_SWC
        DemMaxNumberFreezeFrameRecords = 2
        DemEventTimeSeries = DEM_TIMESERIES_SNAPSHOT_NONE
        DemEventAvailable = true
        DemEventId = 124
        DemEventAvailableInVariant = true
        DemEventLatchTestFailed = false
        DemEventCreateInfoPort = true
        DemDTCClassRef = DTCClass_INV_RSLVR_SIN_RNG_HI
        DemExtendedDataClassRef = ExtendedDataClass_5ecd55b9
        DemFreezeFrameClassRef = FreezeFrameClass_c3111450
        DemEventClass:
          DemAgingAllowed = true
          DemAgingCycleCounterThreshold = 40
          DemEventDestination = DEM_DTC_ORIGIN_PRIMARY_MEMORY
          DemEventPriority = 1
          DemEventFailureCycleCounterThreshold = 0
          DemConsiderPtoStatus = false
          DemFFPrestorageSupported = false
          DemAgingCycleRef = PowerCycle
          DemEnableConditionGroupRef = EnableConditionGroup_1027fc3a
          DemOperationCycleRef = PowerCycle
          DemDebounceAlgorithmClass
            DemDebounceCounterBased:
              DemDebounceCounterDecrementStepSize = 128
              DemDebounceCounterIncrementStepSize = 127
              DemDebounceCounterJumpDown = true
              DemDebounceCounterJumpUp = true
              DemDebounceBehavior = DEM_DEBOUNCE_FREEZE
              DemDebounceCounterFailedThreshold = 127
              DemDebounceCounterJumpDownValue = 0
              DemDebounceCounterJumpUpValue = 0
              DemDebounceCounterPassedThreshold = -128
              DemDebounceCounterStorage = false
              DemDebounceContinuous = false
          IndicatorAttribute_WarningIndicator (DemIndicatorAttribute):
            DemIndicatorFailureCycleSource = DEM_FAILURE_CYCLE_EVENT
            DemIndicatorBehaviour = DEM_INDICATOR_CONTINUOUS
            DemIndicatorHealingCycleCounterThreshold = 3
            DemIndicatorHealingCycleRef = PowerCycle
            DemIndicatorRef = WarningIndicator
      INV_IGBT_TEMP_U_RNG_HI (DemEventParameter):
        DemEventKind = DEM_EVENT_KIND_SWC
        DemMaxNumberFreezeFrameRecords = 2
        DemEventTimeSeries = DEM_TIMESERIES_SNAPSHOT_NONE
        DemEventAvailable = true
        DemEventId = 80
        DemEventAvailableInVariant = true
        DemEventLatchTestFailed = false
        DemEventCreateInfoPort = true
        DemDTCClassRef = DTCClass_INV_IGBT_TEMP_U_RNG_HI
        DemExtendedDataClassRef = ExtendedDataClass_5ecd55b9
        DemFreezeFrameClassRef = FreezeFrameClass_c3111450
        DemEventClass:
          DemAgingAllowed = true
          DemAgingCycleCounterThreshold = 40
          DemEventDestination = DEM_DTC_ORIGIN_PRIMARY_MEMORY
          DemEventPriority = 2
          DemEventFailureCycleCounterThreshold = 0
          DemConsiderPtoStatus = false
          DemFFPrestorageSupported = false
          DemAgingCycleRef = PowerCycle
          DemEnableConditionGroupRef = EnableConditionGroup_7ab46a93
          DemOperationCycleRef = PowerCycle
          DemDebounceAlgorithmClass
            DemDebounceCounterBased:
              DemDebounceCounterDecrementStepSize = 128
              DemDebounceCounterIncrementStepSize = 127
              DemDebounceCounterJumpDown = true
              DemDebounceCounterJumpUp = true
              DemDebounceBehavior = DEM_DEBOUNCE_FREEZE
              DemDebounceCounterFailedThreshold = 127
              DemDebounceCounterJumpDownValue = 0
              DemDebounceCounterJumpUpValue = 0
              DemDebounceCounterPassedThreshold = -128
              DemDebounceCounterStorage = false
              DemDebounceContinuous = false
          IndicatorAttribute_WarningIndicator (DemIndicatorAttribute):
            DemIndicatorFailureCycleSource = DEM_FAILURE_CYCLE_EVENT
            DemIndicatorBehaviour = DEM_INDICATOR_CONTINUOUS
            DemIndicatorHealingCycleCounterThreshold = 3
            DemIndicatorHealingCycleRef = PowerCycle
            DemIndicatorRef = WarningIndicator
      DTCClass_PSnsr_RNG_NOK (DemDTCClass): DemDTCSeverity=DEM_DTC_SEV_IMMEDIATELY, DemUdsDTC=5286940, DemImmediateNvStorage=false
      5 x DemEventParameter, all with DemEventKind=DEM_EVENT_KIND_SWC, DemMaxNumberFreezeFrameRecords=2, DemEventTimeSeries=DEM_TIMESERIES_SNAPSHOT_NONE, DemEventAvailable=true, DemEventAvailableInVariant=true, DemEventLatchTestFailed=false, DemEventCreateInfoPort=true, DemExtendedDataClassRef=ExtendedDataClass_5ecd55b9, DemFreezeFrameClassRef=FreezeFrameClass_c3111450:
        VcEvMonMode_001: DemEventId=198, DemDTCClassRef=DTCClass_VcEvMonMode_001
          DemEventClass:
            DemAgingAllowed = true
            DemAgingCycleCounterThreshold = 40
            DemEventDestination = DEM_DTC_ORIGIN_PRIMARY_MEMORY
            DemEventPriority = 1
            DemEventFailureCycleCounterThreshold = 0
            DemConsiderPtoStatus = false
            DemFFPrestorageSupported = false
            DemAgingCycleRef = PowerCycle
            DemEnableConditionGroupRef = EnableConditionGroup_7ab46a93
            DemOperationCycleRef = PowerCycle
            DemDebounceAlgorithmClass
              DemDebounceCounterBased:
                DemDebounceCounterDecrementStepSize = 128
                DemDebounceCounterIncrementStepSize = 127
                DemDebounceCounterJumpDown = true
                DemDebounceCounterJumpUp = true
                DemDebounceBehavior = DEM_DEBOUNCE_FREEZE
                DemDebounceCounterFailedThreshold = 127
                DemDebounceCounterJumpDownValue = 0
                DemDebounceCounterJumpUpValue = 0
                DemDebounceCounterPassedThreshold = -128
                DemDebounceCounterStorage = false
                DemDebounceContinuous = false
            IndicatorAttribute_WarningIndicator (DemIndicatorAttribute):
              DemIndicatorFailureCycleSource = DEM_FAILURE_CYCLE_EVENT
              DemIndicatorBehaviour = DEM_INDICATOR_CONTINUOUS
              DemIndicatorHealingCycleCounterThreshold = 3
              DemIndicatorHealingCycleRef = PowerCycle
              DemIndicatorRef = WarningIndicator
        PA_ACTION_FLT: DemEventId=137, DemDTCClassRef=DTCClass_PA_ACTION_FLT
          DemEventClass:
            DemAgingAllowed = true
            DemAgingCycleCounterThreshold = 40
            DemEventDestination = DEM_DTC_ORIGIN_PRIMARY_MEMORY
            DemEventPriority = 1
            DemEventFailureCycleCounterThreshold = 0
            DemConsiderPtoStatus = false
            DemFFPrestorageSupported = false
            DemAgingCycleRef = PowerCycle
            DemOperationCycleRef = PowerCycle
            DemDebounceAlgorithmClass
              DemDebounceCounterBased:
                DemDebounceCounterDecrementStepSize = 128
                DemDebounceCounterIncrementStepSize = 127
                DemDebounceCounterJumpDown = true
                DemDebounceCounterJumpUp = true
                DemDebounceBehavior = DEM_DEBOUNCE_FREEZE
                DemDebounceCounterFailedThreshold = 127
                DemDebounceCounterJumpDownValue = 0
                DemDebounceCounterJumpUpValue = 0
                DemDebounceCounterPassedThreshold = -128
                DemDebounceCounterStorage = false
                DemDebounceContinuous = false
        INV_IAC_V_ELEC_HWP: DemEventId=65, DemDTCClassRef=DTCClass_INV_IAC_V_ELEC_HWP
          DemEventClass:
            DemAgingAllowed = true
            DemAgingCycleCounterThreshold = 40
            DemEventDestination = DEM_DTC_ORIGIN_PRIMARY_MEMORY
            DemEventPriority = 1
            DemEventFailureCycleCounterThreshold = 0
            DemConsiderPtoStatus = false
            DemFFPrestorageSupported = false
            DemAgingCycleRef = PowerCycle
            DemOperationCycleRef = PowerCycle
            DemDebounceAlgorithmClass
              DemDebounceCounterBased:
                DemDebounceCounterDecrementStepSize = 128
                DemDebounceCounterIncrementStepSize = 127
                DemDebounceCounterJumpDown = true
                DemDebounceCounterJumpUp = true
                DemDebounceBehavior = DEM_DEBOUNCE_FREEZE
                DemDebounceCounterFailedThreshold = 127
                DemDebounceCounterJumpDownValue = 0
                DemDebounceCounterJumpUpValue = 0
                DemDebounceCounterPassedThreshold = -128
                DemDebounceCounterStorage = false
                DemDebounceContinuous = false
            IndicatorAttribute_WarningIndicator (DemIndicatorAttribute):
              DemIndicatorFailureCycleSource = DEM_FAILURE_CYCLE_EVENT
              DemIndicatorBehaviour = DEM_INDICATOR_CONTINUOUS
              DemIndicatorHealingCycleCounterThreshold = 3
              DemIndicatorHealingCycleRef = PowerCycle
              DemIndicatorRef = WarningIndicator
        CU_TEMP_HW_FLT_001: DemEventId=17, DemDTCClassRef=DTCClass_CU_TEMP_HW_FLT_001
          DemEventClass:
            DemAgingAllowed = true
            DemAgingCycleCounterThreshold = 40
            DemEventDestination = DEM_DTC_ORIGIN_PRIMARY_MEMORY
            DemEventPriority = 2
            DemEventFailureCycleCounterThreshold = 0
            DemConsiderPtoStatus = false
            DemFFPrestorageSupported = false
            DemAgingCycleRef = PowerCycle
            DemOperationCycleRef = PowerCycle
            DemDebounceAlgorithmClass
              DemDebounceCounterBased:
                DemDebounceCounterDecrementStepSize = 128
                DemDebounceCounterIncrementStepSize = 127
                DemDebounceCounterJumpDown = true
                DemDebounceCounterJumpUp = true
                DemDebounceBehavior = DEM_DEBOUNCE_FREEZE
                DemDebounceCounterFailedThreshold = 127
                DemDebounceCounterJumpDownValue = 0
                DemDebounceCounterJumpUpValue = 0
                DemDebounceCounterPassedThreshold = -128
                DemDebounceCounterStorage = false
                DemDebounceContinuous = false
            IndicatorAttribute_WarningIndicator (DemIndicatorAttribute):
              DemIndicatorFailureCycleSource = DEM_FAILURE_CYCLE_EVENT
              DemIndicatorBehaviour = DEM_INDICATOR_CONTINUOUS
              DemIndicatorHealingCycleCounterThreshold = 3
              DemIndicatorHealingCycleRef = PowerCycle
              DemIndicatorRef = WarningIndicator
        VCC_UnderVoltage: DemEventId=164, DemDTCClassRef=DTCClass_VCC_UnderVoltage
          DemEventClass:
            DemAgingAllowed = true
            DemAgingCycleCounterThreshold = 40
            DemEventDestination = DEM_DTC_ORIGIN_PRIMARY_MEMORY
            DemEventPriority = 1
            DemEventFailureCycleCounterThreshold = 0
            DemConsiderPtoStatus = false
            DemFFPrestorageSupported = false
            DemAgingCycleRef = PowerCycle
            DemOperationCycleRef = PowerCycle
            DemDebounceAlgorithmClass
              DemDebounceCounterBased:
                DemDebounceCounterDecrementStepSize = 128
                DemDebounceCounterIncrementStepSize = 127
                DemDebounceCounterJumpDown = true
                DemDebounceCounterJumpUp = true
                DemDebounceBehavior = DEM_DEBOUNCE_FREEZE
                DemDebounceCounterFailedThreshold = 127
                DemDebounceCounterJumpDownValue = 0
                DemDebounceCounterJumpUpValue = 0
                DemDebounceCounterPassedThreshold = -128
                DemDebounceCounterStorage = false
                DemDebounceContinuous = false
      DTCClass_VcEvEMPerfPlaus (DemDTCClass): DemDTCSeverity=DEM_DTC_SEV_IMMEDIATELY, DemUdsDTC=692370, DemImmediateNvStorage=false
      VcEvTsttrPlaus (DemEventParameter):
        DemEventKind = DEM_EVENT_KIND_SWC
        DemMaxNumberFreezeFrameRecords = 2
        DemEventTimeSeries = DEM_TIMESERIES_SNAPSHOT_NONE
        DemEventAvailable = true
        DemEventId = 206
        DemEventAvailableInVariant = true
        DemEventLatchTestFailed = false
        DemEventCreateInfoPort = true
        DemDTCClassRef = DTCClass_VcEvTsttrPlaus
        DemExtendedDataClassRef = ExtendedDataClass_5ecd55b9
        DemFreezeFrameClassRef = FreezeFrameClass_c3111450
        DemEventClass:
          DemAgingAllowed = true
          DemAgingCycleCounterThreshold = 40
          DemEventDestination = DEM_DTC_ORIGIN_PRIMARY_MEMORY
          DemEventPriority = 2
          DemEventFailureCycleCounterThreshold = 0
          DemConsiderPtoStatus = false
          DemFFPrestorageSupported = false
          DemAgingCycleRef = PowerCycle
          DemEnableConditionGroupRef = EnableConditionGroup_7ab46a93
          DemOperationCycleRef = PowerCycle
          DemDebounceAlgorithmClass
            DemDebounceCounterBased:
              DemDebounceCounterDecrementStepSize = 128
              DemDebounceCounterIncrementStepSize = 127
              DemDebounceCounterJumpDown = true
              DemDebounceCounterJumpUp = true
              DemDebounceBehavior = DEM_DEBOUNCE_FREEZE
              DemDebounceCounterFailedThreshold = 127
              DemDebounceCounterJumpDownValue = 0
              DemDebounceCounterJumpUpValue = 0
              DemDebounceCounterPassedThreshold = -128
              DemDebounceCounterStorage = false
              DemDebounceContinuous = false
          IndicatorAttribute_WarningIndicator (DemIndicatorAttribute):
            DemIndicatorFailureCycleSource = DEM_FAILURE_CYCLE_EVENT
            DemIndicatorBehaviour = DEM_INDICATOR_CONTINUOUS
            DemIndicatorHealingCycleCounterThreshold = 3
            DemIndicatorHealingCycleRef = PowerCycle
            DemIndicatorRef = WarningIndicator
      INV_RSLVR_EXCT_ELEC_FLT (DemEventParameter):
        DemEventKind = DEM_EVENT_KIND_SWC
        DemMaxNumberFreezeFrameRecords = 2
        DemEventTimeSeries = DEM_TIMESERIES_SNAPSHOT_NONE
        DemEventAvailable = true
        DemEventId = 102
        DemEventAvailableInVariant = true
        DemEventLatchTestFailed = false
        DemEventCreateInfoPort = true
        DemDTCClassRef = DTCClass_INV_RSLVR_EXCT_ELEC_FLT
        DemExtendedDataClassRef = ExtendedDataClass_5ecd55b9
        DemFreezeFrameClassRef = FreezeFrameClass_c3111450
        DemEventClass:
          DemAgingAllowed = true
          DemAgingCycleCounterThreshold = 40
          DemEventDestination = DEM_DTC_ORIGIN_PRIMARY_MEMORY
          DemEventPriority = 1
          DemEventFailureCycleCounterThreshold = 0
          DemConsiderPtoStatus = false
          DemFFPrestorageSupported = false
          DemAgingCycleRef = PowerCycle
          DemOperationCycleRef = PowerCycle
          DemDebounceAlgorithmClass
            DemDebounceCounterBased:
              DemDebounceCounterDecrementStepSize = 128
              DemDebounceCounterIncrementStepSize = 127
              DemDebounceCounterJumpDown = true
              DemDebounceCounterJumpUp = true
              DemDebounceBehavior = DEM_DEBOUNCE_FREEZE
              DemDebounceCounterFailedThreshold = 127
              DemDebounceCounterJumpDownValue = 0
              DemDebounceCounterJumpUpValue = 0
              DemDebounceCounterPassedThreshold = -128
              DemDebounceCounterStorage = false
              DemDebounceContinuous = false
          IndicatorAttribute_WarningIndicator (DemIndicatorAttribute):
            DemIndicatorFailureCycleSource = DEM_FAILURE_CYCLE_EVENT
            DemIndicatorBehaviour = DEM_INDICATOR_CONTINUOUS
            DemIndicatorHealingCycleCounterThreshold = 3
            DemIndicatorHealingCycleRef = PowerCycle
            DemIndicatorRef = WarningIndicator
      DTCClass_INV_IAC_V_AMP (DemDTCClass): DemDTCSeverity=DEM_DTC_SEV_IMMEDIATELY, DemUdsDTC=679970, DemImmediateNvStorage=false
      DTCClass_AURIX_EEPROM_FLT (DemDTCClass): DemDTCSeverity=DEM_DTC_SEV_IMMEDIATELY, DemUdsDTC=9849088, DemImmediateNvStorage=false
      INV_RSLVR_EXCT_RNG_LO (DemEventParameter):
        DemEventKind = DEM_EVENT_KIND_SWC
        DemMaxNumberFreezeFrameRecords = 2
        DemEventTimeSeries = DEM_TIMESERIES_SNAPSHOT_NONE
        DemEventAvailable = true
        DemEventId = 112
        DemEventAvailableInVariant = true
        DemEventLatchTestFailed = false
        DemEventCreateInfoPort = true
        DemDTCClassRef = DTCClass_INV_RSLVR_EXCT_RNG_LO
        DemExtendedDataClassRef = ExtendedDataClass_5ecd55b9
        DemFreezeFrameClassRef = FreezeFrameClass_c3111450
        DemEventClass:
          DemAgingAllowed = true
          DemAgingCycleCounterThreshold = 40
          DemEventDestination = DEM_DTC_ORIGIN_PRIMARY_MEMORY
          DemEventPriority = 1
          DemEventFailureCycleCounterThreshold = 0
          DemConsiderPtoStatus = false
          DemFFPrestorageSupported = false
          DemAgingCycleRef = PowerCycle
          DemEnableConditionGroupRef = EnableConditionGroup_1027fc3a
          DemOperationCycleRef = PowerCycle
          DemDebounceAlgorithmClass
            DemDebounceCounterBased:
              DemDebounceCounterDecrementStepSize = 128
              DemDebounceCounterIncrementStepSize = 127
              DemDebounceCounterJumpDown = true
              DemDebounceCounterJumpUp = true
              DemDebounceBehavior = DEM_DEBOUNCE_FREEZE
              DemDebounceCounterFailedThreshold = 127
              DemDebounceCounterJumpDownValue = 0
              DemDebounceCounterJumpUpValue = 0
              DemDebounceCounterPassedThreshold = -128
              DemDebounceCounterStorage = false
              DemDebounceContinuous = false
          IndicatorAttribute_WarningIndicator (DemIndicatorAttribute):
            DemIndicatorFailureCycleSource = DEM_FAILURE_CYCLE_EVENT
            DemIndicatorBehaviour = DEM_INDICATOR_CONTINUOUS
            DemIndicatorHealingCycleCounterThreshold = 3
            DemIndicatorHealingCycleRef = PowerCycle
            DemIndicatorRef = WarningIndicator
      INV_EM_STATOR_TEMP2_RNG_HI (DemEventParameter):
        DemEventKind = DEM_EVENT_KIND_SWC
        DemMaxNumberFreezeFrameRecords = 2
        DemEventTimeSeries = DEM_TIMESERIES_SNAPSHOT_NONE
        DemEventAvailable = true
        DemEventId = 39
        DemEventAvailableInVariant = true
        DemEventLatchTestFailed = false
        DemEventCreateInfoPort = true
        DemDTCClassRef = DTCClass_INV_EM_STATOR_TEMP2_RNG_HI
        DemExtendedDataClassRef = ExtendedDataClass_5ecd55b9
        DemFreezeFrameClassRef = FreezeFrameClass_c3111450
        DemEventClass:
          DemAgingAllowed = true
          DemAgingCycleCounterThreshold = 40
          DemEventDestination = DEM_DTC_ORIGIN_PRIMARY_MEMORY
          DemEventPriority = 1
          DemEventFailureCycleCounterThreshold = 0
          DemConsiderPtoStatus = false
          DemFFPrestorageSupported = false
          DemAgingCycleRef = PowerCycle
          DemEnableConditionGroupRef = EnableConditionGroup_7ab46a93
          DemOperationCycleRef = PowerCycle
          DemDebounceAlgorithmClass
            DemDebounceCounterBased:
              DemDebounceCounterDecrementStepSize = 128
              DemDebounceCounterIncrementStepSize = 127
              DemDebounceCounterJumpDown = true
              DemDebounceCounterJumpUp = true
              DemDebounceBehavior = DEM_DEBOUNCE_FREEZE
              DemDebounceCounterFailedThreshold = 127
              DemDebounceCounterJumpDownValue = 0
              DemDebounceCounterJumpUpValue = 0
              DemDebounceCounterPassedThreshold = -128
              DemDebounceCounterStorage = false
              DemDebounceContinuous = false
          IndicatorAttribute_WarningIndicator (DemIndicatorAttribute):
            DemIndicatorFailureCycleSource = DEM_FAILURE_CYCLE_EVENT
            DemIndicatorBehaviour = DEM_INDICATOR_CONTINUOUS
            DemIndicatorHealingCycleCounterThreshold = 3
            DemIndicatorHealingCycleRef = PowerCycle
            DemIndicatorRef = WarningIndicator
      DTCClass_INV_CONTROL_LIMIT (DemDTCClass): DemDTCSeverity=DEM_DTC_SEV_IMMEDIATELY, DemUdsDTC=692372, DemImmediateNvStorage=false
      DTCClass_VcEvChkSum (DemDTCClass): DemDTCSeverity=DEM_DTC_SEV_MAINTENANCE_ONLY, DemUdsDTC=13916035, DemImmediateNvStorage=false
      INV_SHUT_OFF_PAH_START_UP (DemEventParameter):
        DemEventKind = DEM_EVENT_KIND_SWC
        DemMaxNumberFreezeFrameRecords = 2
        DemEventTimeSeries = DEM_TIMESERIES_SNAPSHOT_NONE
        DemEventAvailable = true
        DemEventId = 127
        DemEventAvailableInVariant = true
        DemEventLatchTestFailed = false
        DemEventCreateInfoPort = true
        DemDTCClassRef = DTCClass_INV_SHUT_OFF_PAH_START_UP
        DemExtendedDataClassRef = ExtendedDataClass_5ecd55b9
        DemFreezeFrameClassRef = FreezeFrameClass_c3111450
        DemEventClass:
          DemAgingAllowed = true
          DemAgingCycleCounterThreshold = 40
          DemEventDestination = DEM_DTC_ORIGIN_PRIMARY_MEMORY
          DemEventPriority = 1
          DemEventFailureCycleCounterThreshold = 0
          DemConsiderPtoStatus = false
          DemFFPrestorageSupported = false
          DemAgingCycleRef = PowerCycle
          DemEnableConditionGroupRef = EnableConditionGroup_1027fc3a
          DemOperationCycleRef = PowerCycle
          DemDebounceAlgorithmClass
            DemDebounceCounterBased:
              DemDebounceCounterDecrementStepSize = 128
              DemDebounceCounterIncrementStepSize = 127
              DemDebounceCounterJumpDown = true
              DemDebounceCounterJumpUp = true
              DemDebounceBehavior = DEM_DEBOUNCE_FREEZE
              DemDebounceCounterFailedThreshold = 127
              DemDebounceCounterJumpDownValue = 0
              DemDebounceCounterJumpUpValue = 0
              DemDebounceCounterPassedThreshold = -128
              DemDebounceCounterStorage = false
              DemDebounceContinuous = false
          IndicatorAttribute_WarningIndicator (DemIndicatorAttribute):
            DemIndicatorFailureCycleSource = DEM_FAILURE_CYCLE_EVENT
            DemIndicatorBehaviour = DEM_INDICATOR_CONTINUOUS
            DemIndicatorHealingCycleCounterThreshold = 3
            DemIndicatorHealingCycleRef = PowerCycle
            DemIndicatorRef = WarningIndicator
      3 x DemDTCClass, all with DemDTCSeverity=DEM_DTC_SEV_IMMEDIATELY, DemImmediateNvStorage=false:
        DTCClass_VcEvNodeMisVDDM: DemUdsDTC=12659200
        DTCClass_INV_IGBT_TEMP_V_RNG_HI: DemUdsDTC=1066769
        DTCClass_INV_IGBT_TEMP_W_RNG_HI: DemUdsDTC=1067025
      6 x DemEventParameter, all with DemEventKind=DEM_EVENT_KIND_SWC, DemMaxNumberFreezeFrameRecords=2, DemEventTimeSeries=DEM_TIMESERIES_SNAPSHOT_NONE, DemEventAvailable=true, DemEventAvailableInVariant=true, DemEventLatchTestFailed=false, DemEventCreateInfoPort=true, DemExtendedDataClassRef=ExtendedDataClass_5ecd55b9:
        VCEvVddmPropFr08Tioutd: DemEventId=178, DemDTCClassRef=DTCClass_VCEvVddmPropFr08Tioutd, DemFreezeFrameClassRef=FreezeFrameClass_c3111450
          DemEventClass:
            DemAgingAllowed = true
            DemAgingCycleCounterThreshold = 40
            DemEventDestination = DEM_DTC_ORIGIN_PRIMARY_MEMORY
            DemEventPriority = 1
            DemEventFailureCycleCounterThreshold = 0
            DemConsiderPtoStatus = false
            DemFFPrestorageSupported = false
            DemAgingCycleRef = PowerCycle
            DemOperationCycleRef = PowerCycle
            DemDebounceAlgorithmClass
              DemDebounceCounterBased:
                DemDebounceCounterDecrementStepSize = 128
                DemDebounceCounterIncrementStepSize = 127
                DemDebounceCounterJumpDown = true
                DemDebounceCounterJumpUp = true
                DemDebounceBehavior = DEM_DEBOUNCE_FREEZE
                DemDebounceCounterFailedThreshold = 127
                DemDebounceCounterJumpDownValue = 0
                DemDebounceCounterJumpUpValue = 0
                DemDebounceCounterPassedThreshold = -128
                DemDebounceCounterStorage = false
                DemDebounceContinuous = false
            IndicatorAttribute_WarningIndicator (DemIndicatorAttribute):
              DemIndicatorFailureCycleSource = DEM_FAILURE_CYCLE_EVENT
              DemIndicatorBehaviour = DEM_INDICATOR_CONTINUOUS
              DemIndicatorHealingCycleCounterThreshold = 3
              DemIndicatorHealingCycleRef = PowerCycle
              DemIndicatorRef = WarningIndicator
        INV_RSLVR_EXCT_OC_HWP_001: DemEventId=108, DemDTCClassRef=DTCClass_INV_RSLVR_EXCT_OC_HWP_001, DemFreezeFrameClassRef=FreezeFrameClass_c3111450
          DemEventClass:
            DemAgingAllowed = true
            DemAgingCycleCounterThreshold = 40
            DemEventDestination = DEM_DTC_ORIGIN_PRIMARY_MEMORY
            DemEventPriority = 1
            DemEventFailureCycleCounterThreshold = 0
            DemConsiderPtoStatus = false
            DemFFPrestorageSupported = false
            DemAgingCycleRef = PowerCycle
            DemEnableConditionGroupRef = EnableConditionGroup_830522f7
            DemOperationCycleRef = PowerCycle
            DemDebounceAlgorithmClass
              DemDebounceCounterBased:
                DemDebounceCounterDecrementStepSize = 128
                DemDebounceCounterIncrementStepSize = 127
                DemDebounceCounterJumpDown = true
                DemDebounceCounterJumpUp = true
                DemDebounceBehavior = DEM_DEBOUNCE_FREEZE
                DemDebounceCounterFailedThreshold = 127
                DemDebounceCounterJumpDownValue = 0
                DemDebounceCounterJumpUpValue = 0
                DemDebounceCounterPassedThreshold = -128
                DemDebounceCounterStorage = false
                DemDebounceContinuous = false
            IndicatorAttribute_WarningIndicator (DemIndicatorAttribute):
              DemIndicatorFailureCycleSource = DEM_FAILURE_CYCLE_EVENT
              DemIndicatorBehaviour = DEM_INDICATOR_CONTINUOUS
              DemIndicatorHealingCycleCounterThreshold = 3
              DemIndicatorHealingCycleRef = PowerCycle
              DemIndicatorRef = WarningIndicator
        INV_RSLVR_EXCT_OC_HWP_002: DemEventId=109, DemDTCClassRef=DTCClass_INV_RSLVR_EXCT_OC_HWP_002, DemFreezeFrameClassRef=FreezeFrameClass_c3111450
          DemEventClass:
            DemAgingAllowed = true
            DemAgingCycleCounterThreshold = 40
            DemEventDestination = DEM_DTC_ORIGIN_PRIMARY_MEMORY
            DemEventPriority = 1
            DemEventFailureCycleCounterThreshold = 0
            DemConsiderPtoStatus = false
            DemFFPrestorageSupported = false
            DemAgingCycleRef = PowerCycle
            DemEnableConditionGroupRef = EnableConditionGroup_830522f7
            DemOperationCycleRef = PowerCycle
            DemDebounceAlgorithmClass
              DemDebounceCounterBased:
                DemDebounceCounterDecrementStepSize = 128
                DemDebounceCounterIncrementStepSize = 127
                DemDebounceCounterJumpDown = true
                DemDebounceCounterJumpUp = true
                DemDebounceBehavior = DEM_DEBOUNCE_FREEZE
                DemDebounceCounterFailedThreshold = 127
                DemDebounceCounterJumpDownValue = 0
                DemDebounceCounterJumpUpValue = 0
                DemDebounceCounterPassedThreshold = -128
                DemDebounceCounterStorage = false
                DemDebounceContinuous = false
            IndicatorAttribute_WarningIndicator (DemIndicatorAttribute):
              DemIndicatorFailureCycleSource = DEM_FAILURE_CYCLE_EVENT
              DemIndicatorBehaviour = DEM_INDICATOR_CONTINUOUS
              DemIndicatorHealingCycleCounterThreshold = 3
              DemIndicatorHealingCycleRef = PowerCycle
              DemIndicatorRef = WarningIndicator
        INV_EM_STATOR_TEMP_ELE_FLT: DemEventId=43, DemDTCClassRef=DTCClass_INV_EM_STATOR_TEMP_ELE_FLT, DemFreezeFrameClassRef=FreezeFrameClass_c3111450
          DemEventClass:
            DemAgingAllowed = true
            DemAgingCycleCounterThreshold = 40
            DemEventDestination = DEM_DTC_ORIGIN_PRIMARY_MEMORY
            DemEventPriority = 1
            DemEventFailureCycleCounterThreshold = 0
            DemConsiderPtoStatus = false
            DemFFPrestorageSupported = false
            DemAgingCycleRef = PowerCycle
            DemEnableConditionGroupRef = EnableConditionGroup_7ab46a93
            DemOperationCycleRef = PowerCycle
            DemDebounceAlgorithmClass
              DemDebounceCounterBased:
                DemDebounceCounterDecrementStepSize = 128
                DemDebounceCounterIncrementStepSize = 127
                DemDebounceCounterJumpDown = true
                DemDebounceCounterJumpUp = true
                DemDebounceBehavior = DEM_DEBOUNCE_FREEZE
                DemDebounceCounterFailedThreshold = 127
                DemDebounceCounterJumpDownValue = 0
                DemDebounceCounterJumpUpValue = 0
                DemDebounceCounterPassedThreshold = -128
                DemDebounceCounterStorage = false
                DemDebounceContinuous = false
            IndicatorAttribute_WarningIndicator (DemIndicatorAttribute):
              DemIndicatorFailureCycleSource = DEM_FAILURE_CYCLE_EVENT
              DemIndicatorBehaviour = DEM_INDICATOR_CONTINUOUS
              DemIndicatorHealingCycleCounterThreshold = 3
              DemIndicatorHealingCycleRef = PowerCycle
              DemIndicatorRef = WarningIndicator
        INV_INTERLOCK_FLT: DemEventId=92, DemDTCClassRef=DTCClass_INV_INTERLOCK_FLT, DemFreezeFrameClassRef=FreezeFrameClass_c3111450
          DemEventClass:
            DemAgingAllowed = true
            DemAgingCycleCounterThreshold = 40
            DemEventDestination = DEM_DTC_ORIGIN_PRIMARY_MEMORY
            DemEventPriority = 1
            DemEventFailureCycleCounterThreshold = 0
            DemConsiderPtoStatus = false
            DemFFPrestorageSupported = false
            DemAgingCycleRef = PowerCycle
            DemEnableConditionGroupRef = EnableConditionGroup_7ab46a93
            DemOperationCycleRef = PowerCycle
            DemDebounceAlgorithmClass
              DemDebounceCounterBased:
                DemDebounceCounterDecrementStepSize = 128
                DemDebounceCounterIncrementStepSize = 127
                DemDebounceCounterJumpDown = true
                DemDebounceCounterJumpUp = true
                DemDebounceBehavior = DEM_DEBOUNCE_FREEZE
                DemDebounceCounterFailedThreshold = 127
                DemDebounceCounterJumpDownValue = 0
                DemDebounceCounterJumpUpValue = 0
                DemDebounceCounterPassedThreshold = -128
                DemDebounceCounterStorage = false
                DemDebounceContinuous = false
            IndicatorAttribute_WarningIndicator (DemIndicatorAttribute):
              DemIndicatorFailureCycleSource = DEM_FAILURE_CYCLE_EVENT
              DemIndicatorBehaviour = DEM_INDICATOR_CONTINUOUS
              DemIndicatorHealingCycleCounterThreshold = 3
              DemIndicatorHealingCycleRef = PowerCycle
              DemIndicatorRef = WarningIndicator
        Ga_ZeroFindDistanFailure: DemEventId=30, DemDTCClassRef=DTCClass_Ga_ZeroFindDistanFailure, DemFreezeFrameClassRef=FreezeFrameClass_dc4c3f47
          DemEventClass:
            DemAgingAllowed = true
            DemAgingCycleCounterThreshold = 40
            DemEventDestination = DEM_DTC_ORIGIN_PRIMARY_MEMORY
            DemEventPriority = 1
            DemEventFailureCycleCounterThreshold = 0
            DemConsiderPtoStatus = false
            DemFFPrestorageSupported = false
            DemAgingCycleRef = PowerCycle
            DemEnableConditionGroupRef = EnableConditionGroup_06a6aa19
            DemOperationCycleRef = PowerCycle
            DemDebounceAlgorithmClass
              DemDebounceCounterBased:
                DemDebounceCounterDecrementStepSize = 128
                DemDebounceCounterIncrementStepSize = 127
                DemDebounceCounterJumpDown = true
                DemDebounceCounterJumpUp = true
                DemDebounceBehavior = DEM_DEBOUNCE_FREEZE
                DemDebounceCounterFailedThreshold = 127
                DemDebounceCounterJumpDownValue = 0
                DemDebounceCounterJumpUpValue = 0
                DemDebounceCounterPassedThreshold = -128
                DemDebounceCounterStorage = false
                DemDebounceContinuous = false
            IndicatorAttribute_WarningIndicator (DemIndicatorAttribute):
              DemIndicatorFailureCycleSource = DEM_FAILURE_CYCLE_EVENT
              DemIndicatorBehaviour = DEM_INDICATOR_CONTINUOUS
              DemIndicatorHealingCycleCounterThreshold = 3
              DemIndicatorHealingCycleRef = PowerCycle
              DemIndicatorRef = WarningIndicator
      DTCClass_INV_RSLVR_COS_ELEC_FLT (DemDTCClass): DemDTCSeverity=DEM_DTC_SEV_IMMEDIATELY, DemUdsDTC=842241, DemImmediateNvStorage=false
      PLOCK_Current_RNG_OUT (DemEventParameter):
        DemEventKind = DEM_EVENT_KIND_SWC
        DemMaxNumberFreezeFrameRecords = 2
        DemEventTimeSeries = DEM_TIMESERIES_SNAPSHOT_NONE
        DemEventAvailable = true
        DemEventId = 141
        DemEventAvailableInVariant = true
        DemEventLatchTestFailed = false
        DemEventCreateInfoPort = true
        DemDTCClassRef = DTCClass_PLOCK_Current_RNG_OUT
        DemExtendedDataClassRef = ExtendedDataClass_5ecd55b9
        DemFreezeFrameClassRef = FreezeFrameClass_c3111450
        DemEventClass:
          DemAgingAllowed = true
          DemAgingCycleCounterThreshold = 40
          DemEventDestination = DEM_DTC_ORIGIN_PRIMARY_MEMORY
          DemEventPriority = 1
          DemEventFailureCycleCounterThreshold = 0
          DemConsiderPtoStatus = false
          DemFFPrestorageSupported = false
          DemAgingCycleRef = PowerCycle
          DemOperationCycleRef = PowerCycle
          DemDebounceAlgorithmClass
            DemDebounceCounterBased:
              DemDebounceCounterDecrementStepSize = 128
              DemDebounceCounterIncrementStepSize = 127
              DemDebounceCounterJumpDown = true
              DemDebounceCounterJumpUp = true
              DemDebounceBehavior = DEM_DEBOUNCE_FREEZE
              DemDebounceCounterFailedThreshold = 127
              DemDebounceCounterJumpDownValue = 0
              DemDebounceCounterJumpUpValue = 0
              DemDebounceCounterPassedThreshold = -128
              DemDebounceCounterStorage = false
              DemDebounceContinuous = false
      3 x DemDTCClass, all with DemDTCSeverity=DEM_DTC_SEV_IMMEDIATELY, DemImmediateNvStorage=false:
        DTCClass_INV_IGBT_TEMP_W_GRDT: DemUdsDTC=1067047
        DTCClass_INV_RSLVR_EXCT_RNG_HI: DemUdsDTC=806935
        DTCClass_INV_RSLVR_SIN_AMP: DemUdsDTC=809506
      3 x DemEventParameter, all with DemEventKind=DEM_EVENT_KIND_SWC, DemMaxNumberFreezeFrameRecords=2, DemEventTimeSeries=DEM_TIMESERIES_SNAPSHOT_NONE, DemEventAvailable=true, DemEventAvailableInVariant=true, DemEventLatchTestFailed=false, DemEventCreateInfoPort=true, DemExtendedDataClassRef=ExtendedDataClass_5ecd55b9, DemFreezeFrameClassRef=FreezeFrameClass_c3111450:
        VCEvVddmPropFr05Tioutd: DemEventId=177, DemDTCClassRef=DTCClass_VCEvVddmPropFr05Tioutd
          DemEventClass:
            DemAgingAllowed = true
            DemAgingCycleCounterThreshold = 40
            DemEventDestination = DEM_DTC_ORIGIN_PRIMARY_MEMORY
            DemEventPriority = 1
            DemEventFailureCycleCounterThreshold = 0
            DemConsiderPtoStatus = false
            DemFFPrestorageSupported = false
            DemAgingCycleRef = PowerCycle
            DemEnableConditionGroupRef = EnableConditionGroup_6f8868bd
            DemOperationCycleRef = PowerCycle
            DemDebounceAlgorithmClass
              DemDebounceCounterBased:
                DemDebounceCounterDecrementStepSize = 128
                DemDebounceCounterIncrementStepSize = 127
                DemDebounceCounterJumpDown = true
                DemDebounceCounterJumpUp = true
                DemDebounceBehavior = DEM_DEBOUNCE_FREEZE
                DemDebounceCounterFailedThreshold = 127
                DemDebounceCounterJumpDownValue = 0
                DemDebounceCounterJumpUpValue = 0
                DemDebounceCounterPassedThreshold = -128
                DemDebounceCounterStorage = false
                DemDebounceContinuous = false
            IndicatorAttribute_WarningIndicator (DemIndicatorAttribute):
              DemIndicatorFailureCycleSource = DEM_FAILURE_CYCLE_EVENT
              DemIndicatorBehaviour = DEM_INDICATOR_CONTINUOUS
              DemIndicatorHealingCycleCounterThreshold = 3
              DemIndicatorHealingCycleRef = PowerCycle
              DemIndicatorRef = WarningIndicator
        INV_IGBT_TEMP_V_GRDT: DemEventId=82, DemDTCClassRef=DTCClass_INV_IGBT_TEMP_V_GRDT
          DemEventClass:
            DemAgingAllowed = true
            DemAgingCycleCounterThreshold = 40
            DemEventDestination = DEM_DTC_ORIGIN_PRIMARY_MEMORY
            DemEventPriority = 1
            DemEventFailureCycleCounterThreshold = 0
            DemConsiderPtoStatus = false
            DemFFPrestorageSupported = false
            DemAgingCycleRef = PowerCycle
            DemEnableConditionGroupRef = EnableConditionGroup_7ab46a93
            DemOperationCycleRef = PowerCycle
            DemDebounceAlgorithmClass
              DemDebounceCounterBased:
                DemDebounceCounterDecrementStepSize = 128
                DemDebounceCounterIncrementStepSize = 127
                DemDebounceCounterJumpDown = true
                DemDebounceCounterJumpUp = true
                DemDebounceBehavior = DEM_DEBOUNCE_FREEZE
                DemDebounceCounterFailedThreshold = 127
                DemDebounceCounterJumpDownValue = 0
                DemDebounceCounterJumpUpValue = 0
                DemDebounceCounterPassedThreshold = -128
                DemDebounceCounterStorage = false
                DemDebounceContinuous = false
            IndicatorAttribute_WarningIndicator (DemIndicatorAttribute):
              DemIndicatorFailureCycleSource = DEM_FAILURE_CYCLE_EVENT
              DemIndicatorBehaviour = DEM_INDICATOR_CONTINUOUS
              DemIndicatorHealingCycleCounterThreshold = 3
              DemIndicatorHealingCycleRef = PowerCycle
              DemIndicatorRef = WarningIndicator
        PS_5V_Fault: DemEventId=142, DemDTCClassRef=DTCClass_PS_5V_Fault
          DemEventClass:
            DemAgingAllowed = true
            DemAgingCycleCounterThreshold = 40
            DemEventDestination = DEM_DTC_ORIGIN_PRIMARY_MEMORY
            DemEventPriority = 1
            DemEventFailureCycleCounterThreshold = 0
            DemConsiderPtoStatus = false
            DemFFPrestorageSupported = false
            DemAgingCycleRef = PowerCycle
            DemEnableConditionGroupRef = EnableConditionGroup_7ab46a93
            DemOperationCycleRef = PowerCycle
            DemDebounceAlgorithmClass
              DemDebounceCounterBased:
                DemDebounceCounterDecrementStepSize = 128
                DemDebounceCounterIncrementStepSize = 127
                DemDebounceCounterJumpDown = true
                DemDebounceCounterJumpUp = true
                DemDebounceBehavior = DEM_DEBOUNCE_FREEZE
                DemDebounceCounterFailedThreshold = 127
                DemDebounceCounterJumpDownValue = 0
                DemDebounceCounterJumpUpValue = 0
                DemDebounceCounterPassedThreshold = -128
                DemDebounceCounterStorage = false
                DemDebounceContinuous = false
            IndicatorAttribute_WarningIndicator (DemIndicatorAttribute):
              DemIndicatorFailureCycleSource = DEM_FAILURE_CYCLE_EVENT
              DemIndicatorBehaviour = DEM_INDICATOR_CONTINUOUS
              DemIndicatorHealingCycleCounterThreshold = 3
              DemIndicatorHealingCycleRef = PowerCycle
              DemIndicatorRef = WarningIndicator
          DemCallbackInitMForE
      DTCClass_VCEvVddmPropFr08Tioutd (DemDTCClass): DemDTCSeverity=DEM_DTC_SEV_IMMEDIATELY, DemUdsDTC=15668224, DemImmediateNvStorage=false
      VcEvCntrCrashStsSafe (DemEventParameter):
        DemEventKind = DEM_EVENT_KIND_SWC
        DemMaxNumberFreezeFrameRecords = 2
        DemEventTimeSeries = DEM_TIMESERIES_SNAPSHOT_NONE
        DemEventAvailable = true
        DemEventId = 189
        DemEventAvailableInVariant = true
        DemEventLatchTestFailed = false
        DemEventCreateInfoPort = true
        DemDTCClassRef = DTCClass_VcEvCntrCrashStsSafe
        DemExtendedDataClassRef = ExtendedDataClass_5ecd55b9
        DemFreezeFrameClassRef = FreezeFrameClass_c3111450
        DemEventClass:
          DemAgingAllowed = true
          DemAgingCycleCounterThreshold = 40
          DemEventDestination = DEM_DTC_ORIGIN_PRIMARY_MEMORY
          DemEventPriority = 1
          DemEventFailureCycleCounterThreshold = 0
          DemConsiderPtoStatus = false
          DemFFPrestorageSupported = false
          DemAgingCycleRef = PowerCycle
          DemEnableConditionGroupRef = EnableConditionGroup_06a6aa19
          DemOperationCycleRef = PowerCycle
          DemDebounceAlgorithmClass
            DemDebounceCounterBased:
              DemDebounceCounterDecrementStepSize = 128
              DemDebounceCounterIncrementStepSize = 127
              DemDebounceCounterJumpDown = true
              DemDebounceCounterJumpUp = true
              DemDebounceBehavior = DEM_DEBOUNCE_FREEZE
              DemDebounceCounterFailedThreshold = 127
              DemDebounceCounterJumpDownValue = 0
              DemDebounceCounterJumpUpValue = 0
              DemDebounceCounterPassedThreshold = -128
              DemDebounceCounterStorage = false
              DemDebounceContinuous = false
          IndicatorAttribute_WarningIndicator (DemIndicatorAttribute):
            DemIndicatorFailureCycleSource = DEM_FAILURE_CYCLE_EVENT
            DemIndicatorBehaviour = DEM_INDICATOR_CONTINUOUS
            DemIndicatorHealingCycleCounterThreshold = 3
            DemIndicatorHealingCycleRef = PowerCycle
            DemIndicatorRef = WarningIndicator
      5 x DemDTCClass, all with DemImmediateNvStorage=false:
        DTCClass_INV_RSLVR_SIN_RNG_NOK: DemDTCSeverity=DEM_DTC_SEV_IMMEDIATELY, DemUdsDTC=809500
        DTCClass_PS_KL30_RNG_HI: DemDTCSeverity=DEM_DTC_SEV_IMMEDIATELY, DemUdsDTC=662435
        DTCClass_Ga_TmSpdSyncFailed: DemDTCSeverity=DEM_DTC_SEV_IMMEDIATELY, DemUdsDTC=1580690
        DTCClass_VcEvNodeMisECM: DemDTCSeverity=DEM_DTC_SEV_IMMEDIATELY, DemUdsDTC=12648448
        DTCClass_INV_COOLT_INLET_TEMP_HWP: DemDTCSeverity=DEM_DTC_SEV_MAINTENANCE_ONLY, DemUdsDTC=693067
      INV_EM_STATOR_TEMP_GRDT (DemEventParameter):
        DemEventKind = DEM_EVENT_KIND_SWC
        DemMaxNumberFreezeFrameRecords = 2
        DemEventTimeSeries = DEM_TIMESERIES_SNAPSHOT_NONE
        DemEventAvailable = true
        DemEventId = 44
        DemEventAvailableInVariant = true
        DemEventLatchTestFailed = false
        DemEventCreateInfoPort = true
        DemDTCClassRef = DTCClass_INV_EM_STATOR_TEMP_GRDT
        DemExtendedDataClassRef = ExtendedDataClass_5ecd55b9
        DemFreezeFrameClassRef = FreezeFrameClass_c3111450
        DemEventClass:
          DemAgingAllowed = true
          DemAgingCycleCounterThreshold = 40
          DemEventDestination = DEM_DTC_ORIGIN_PRIMARY_MEMORY
          DemEventPriority = 2
          DemEventFailureCycleCounterThreshold = 0
          DemConsiderPtoStatus = false
          DemFFPrestorageSupported = false
          DemAgingCycleRef = PowerCycle
          DemEnableConditionGroupRef = EnableConditionGroup_90577524
          DemOperationCycleRef = PowerCycle
          DemDebounceAlgorithmClass
            DemDebounceCounterBased:
              DemDebounceCounterDecrementStepSize = 128
              DemDebounceCounterIncrementStepSize = 127
              DemDebounceCounterJumpDown = true
              DemDebounceCounterJumpUp = true
              DemDebounceBehavior = DEM_DEBOUNCE_FREEZE
              DemDebounceCounterFailedThreshold = 127
              DemDebounceCounterJumpDownValue = 0
              DemDebounceCounterJumpUpValue = 0
              DemDebounceCounterPassedThreshold = -128
              DemDebounceCounterStorage = false
              DemDebounceContinuous = false
          IndicatorAttribute_WarningIndicator (DemIndicatorAttribute):
            DemIndicatorFailureCycleSource = DEM_FAILURE_CYCLE_EVENT
            DemIndicatorBehaviour = DEM_INDICATOR_CONTINUOUS
            DemIndicatorHealingCycleCounterThreshold = 3
            DemIndicatorHealingCycleRef = PowerCycle
            DemIndicatorRef = WarningIndicator
      DTCClass_VCEvBecmPropFr02Tioutd (DemDTCClass): DemDTCSeverity=DEM_DTC_SEV_IMMEDIATELY, DemUdsDTC=15663360, DemImmediateNvStorage=false
      PS_P15_V_FLT (DemEventParameter):
        DemEventKind = DEM_EVENT_KIND_SWC
        DemMaxNumberFreezeFrameRecords = 2
        DemEventTimeSeries = DEM_TIMESERIES_SNAPSHOT_NONE
        DemEventAvailable = true
        DemEventId = 156
        DemEventAvailableInVariant = true
        DemEventLatchTestFailed = false
        DemEventCreateInfoPort = true
        DemDTCClassRef = DTCClass_PS_P15_V_FLT
        DemExtendedDataClassRef = ExtendedDataClass_5ecd55b9
        DemFreezeFrameClassRef = FreezeFrameClass_c3111450
        DemEventClass:
          DemAgingAllowed = true
          DemAgingCycleCounterThreshold = 40
          DemEventDestination = DEM_DTC_ORIGIN_PRIMARY_MEMORY
          DemEventPriority = 1
          DemEventFailureCycleCounterThreshold = 0
          DemConsiderPtoStatus = false
          DemFFPrestorageSupported = false
          DemAgingCycleRef = PowerCycle
          DemEnableConditionGroupRef = EnableConditionGroup_7ab46a93
          DemOperationCycleRef = PowerCycle
          DemDebounceAlgorithmClass
            DemDebounceCounterBased:
              DemDebounceCounterDecrementStepSize = 128
              DemDebounceCounterIncrementStepSize = 127
              DemDebounceCounterJumpDown = true
              DemDebounceCounterJumpUp = true
              DemDebounceBehavior = DEM_DEBOUNCE_FREEZE
              DemDebounceCounterFailedThreshold = 127
              DemDebounceCounterJumpDownValue = 0
              DemDebounceCounterJumpUpValue = 0
              DemDebounceCounterPassedThreshold = -128
              DemDebounceCounterStorage = false
              DemDebounceContinuous = false
          IndicatorAttribute_WarningIndicator (DemIndicatorAttribute):
            DemIndicatorFailureCycleSource = DEM_FAILURE_CYCLE_EVENT
            DemIndicatorBehaviour = DEM_INDICATOR_CONTINUOUS
            DemIndicatorHealingCycleCounterThreshold = 3
            DemIndicatorHealingCycleRef = PowerCycle
            DemIndicatorRef = WarningIndicator
      DTCClass_EXT_UC_SPI_FLT (DemDTCClass): DemDTCSeverity=DEM_DTC_SEV_IMMEDIATELY, DemUdsDTC=9849600, DemImmediateNvStorage=false
      INV_EM_STATOR_TEMP_RNG_NOK (DemEventParameter):
        DemEventKind = DEM_EVENT_KIND_SWC
        DemMaxNumberFreezeFrameRecords = 2
        DemEventTimeSeries = DEM_TIMESERIES_SNAPSHOT_NONE
        DemEventAvailable = true
        DemEventId = 48
        DemEventAvailableInVariant = true
        DemEventLatchTestFailed = false
        DemEventCreateInfoPort = true
        DemDTCClassRef = DTCClass_INV_EM_STATOR_TEMP_RNG_NOK
        DemExtendedDataClassRef = ExtendedDataClass_5ecd55b9
        DemFreezeFrameClassRef = FreezeFrameClass_c3111450
        DemEventClass:
          DemAgingAllowed = true
          DemAgingCycleCounterThreshold = 40
          DemEventDestination = DEM_DTC_ORIGIN_PRIMARY_MEMORY
          DemEventPriority = 1
          DemEventFailureCycleCounterThreshold = 0
          DemConsiderPtoStatus = false
          DemFFPrestorageSupported = false
          DemAgingCycleRef = PowerCycle
          DemEnableConditionGroupRef = EnableConditionGroup_7ab46a93
          DemOperationCycleRef = PowerCycle
          DemDebounceAlgorithmClass
            DemDebounceCounterBased:
              DemDebounceCounterDecrementStepSize = 128
              DemDebounceCounterIncrementStepSize = 127
              DemDebounceCounterJumpDown = true
              DemDebounceCounterJumpUp = true
              DemDebounceBehavior = DEM_DEBOUNCE_FREEZE
              DemDebounceCounterFailedThreshold = 127
              DemDebounceCounterJumpDownValue = 0
              DemDebounceCounterJumpUpValue = 0
              DemDebounceCounterPassedThreshold = -128
              DemDebounceCounterStorage = false
              DemDebounceContinuous = false
          IndicatorAttribute_WarningIndicator (DemIndicatorAttribute):
            DemIndicatorFailureCycleSource = DEM_FAILURE_CYCLE_EVENT
            DemIndicatorBehaviour = DEM_INDICATOR_CONTINUOUS
            DemIndicatorHealingCycleCounterThreshold = 3
            DemIndicatorHealingCycleRef = PowerCycle
            DemIndicatorRef = WarningIndicator
      4 x DemDTCClass, all with DemImmediateNvStorage=false:
        DTCClass_INV_RSLVR_OFFS_DFT: DemDTCSeverity=DEM_DTC_SEV_IMMEDIATELY, DemUdsDTC=3147606
        DTCClass_VCEvVddmPropFr08Tioutd_001: DemDTCSeverity=DEM_DTC_SEV_MAINTENANCE_ONLY, DemUdsDTC=15669248
        DTCClass_INV_IMMO_NOKEY: DemDTCSeverity=DEM_DTC_SEV_MAINTENANCE_ONLY, DemUdsDTC=13676881
        DTCClass_VCEvVddmPropFr15Tioutd: DemDTCSeverity=DEM_DTC_SEV_MAINTENANCE_ONLY, DemUdsDTC=15668992
      INV_RSLVR_SIN_RNG_NOK (DemEventParameter):
        DemEventKind = DEM_EVENT_KIND_SWC
        DemMaxNumberFreezeFrameRecords = 2
        DemEventTimeSeries = DEM_TIMESERIES_SNAPSHOT_NONE
        DemEventAvailable = true
        DemEventId = 126
        DemEventAvailableInVariant = true
        DemEventLatchTestFailed = false
        DemEventCreateInfoPort = true
        DemDTCClassRef = DTCClass_INV_RSLVR_SIN_RNG_NOK
        DemExtendedDataClassRef = ExtendedDataClass_5ecd55b9
        DemFreezeFrameClassRef = FreezeFrameClass_c3111450
        DemEventClass:
          DemAgingAllowed = true
          DemAgingCycleCounterThreshold = 40
          DemEventDestination = DEM_DTC_ORIGIN_PRIMARY_MEMORY
          DemEventPriority = 1
          DemEventFailureCycleCounterThreshold = 0
          DemConsiderPtoStatus = false
          DemFFPrestorageSupported = false
          DemAgingCycleRef = PowerCycle
          DemOperationCycleRef = PowerCycle
          DemDebounceAlgorithmClass
            DemDebounceCounterBased:
              DemDebounceCounterDecrementStepSize = 128
              DemDebounceCounterIncrementStepSize = 127
              DemDebounceCounterJumpDown = true
              DemDebounceCounterJumpUp = true
              DemDebounceBehavior = DEM_DEBOUNCE_FREEZE
              DemDebounceCounterFailedThreshold = 127
              DemDebounceCounterJumpDownValue = 0
              DemDebounceCounterJumpUpValue = 0
              DemDebounceCounterPassedThreshold = -128
              DemDebounceCounterStorage = false
              DemDebounceContinuous = false
          IndicatorAttribute_WarningIndicator (DemIndicatorAttribute):
            DemIndicatorFailureCycleSource = DEM_FAILURE_CYCLE_EVENT
            DemIndicatorBehaviour = DEM_INDICATOR_CONTINUOUS
            DemIndicatorHealingCycleCounterThreshold = 3
            DemIndicatorHealingCycleRef = PowerCycle
            DemIndicatorRef = WarningIndicator
      INV_IAC_U_OFFS (DemEventParameter):
        DemEventKind = DEM_EVENT_KIND_SWC
        DemMaxNumberFreezeFrameRecords = 2
        DemEventTimeSeries = DEM_TIMESERIES_SNAPSHOT_NONE
        DemEventAvailable = true
        DemEventId = 60
        DemEventAvailableInVariant = true
        DemEventLatchTestFailed = false
        DemEventCreateInfoPort = true
        DemDTCClassRef = DTCClass_INV_IAC_U_OFFS
        DemExtendedDataClassRef = ExtendedDataClass_5ecd55b9
        DemFreezeFrameClassRef = FreezeFrameClass_c3111450
        DemEventClass:
          DemAgingAllowed = true
          DemAgingCycleCounterThreshold = 40
          DemEventDestination = DEM_DTC_ORIGIN_PRIMARY_MEMORY
          DemEventPriority = 1
          DemEventFailureCycleCounterThreshold = 0
          DemConsiderPtoStatus = false
          DemFFPrestorageSupported = false
          DemAgingCycleRef = PowerCycle
          DemEnableConditionGroupRef = EnableConditionGroup_d8c05f30
          DemOperationCycleRef = PowerCycle
          DemDebounceAlgorithmClass
            DemDebounceCounterBased:
              DemDebounceCounterDecrementStepSize = 128
              DemDebounceCounterIncrementStepSize = 127
              DemDebounceCounterJumpDown = true
              DemDebounceCounterJumpUp = true
              DemDebounceBehavior = DEM_DEBOUNCE_FREEZE
              DemDebounceCounterFailedThreshold = 127
              DemDebounceCounterJumpDownValue = 0
              DemDebounceCounterJumpUpValue = 0
              DemDebounceCounterPassedThreshold = -128
              DemDebounceCounterStorage = false
              DemDebounceContinuous = false
          IndicatorAttribute_WarningIndicator (DemIndicatorAttribute):
            DemIndicatorFailureCycleSource = DEM_FAILURE_CYCLE_EVENT
            DemIndicatorBehaviour = DEM_INDICATOR_CONTINUOUS
            DemIndicatorHealingCycleCounterThreshold = 3
            DemIndicatorHealingCycleRef = PowerCycle
            DemIndicatorRef = WarningIndicator
      DTCClass_INV_IAC_U_ELEC_HI (DemDTCClass): DemDTCSeverity=DEM_DTC_SEV_IMMEDIATELY, DemUdsDTC=779538, DemImmediateNvStorage=false
      DTCClass_INV_EM_STATOR_TEMP2_GRDT (DemDTCClass): DemDTCSeverity=DEM_DTC_SEV_MAINTENANCE_ONLY, DemUdsDTC=667687, DemImmediateNvStorage=false
      5 x DemEventParameter, all with DemEventKind=DEM_EVENT_KIND_SWC, DemMaxNumberFreezeFrameRecords=2, DemEventTimeSeries=DEM_TIMESERIES_SNAPSHOT_NONE, DemEventAvailable=true, DemEventAvailableInVariant=true, DemEventLatchTestFailed=false, DemEventCreateInfoPort=true, DemExtendedDataClassRef=ExtendedDataClass_5ecd55b9, DemFreezeFrameClassRef=FreezeFrameClass_c3111450:
        PS_KL30_BACKUP_FLT: DemEventId=149, DemDTCClassRef=DTCClass_PS_KL30_BACKUP_FLT
          DemEventClass:
            DemAgingAllowed = true
            DemAgingCycleCounterThreshold = 40
            DemEventDestination = DEM_DTC_ORIGIN_PRIMARY_MEMORY
            DemEventPriority = 1
            DemEventFailureCycleCounterThreshold = 0
            DemConsiderPtoStatus = false
            DemFFPrestorageSupported = false
            DemAgingCycleRef = PowerCycle
            DemEnableConditionGroupRef = EnableConditionGroup_7ab46a93
            DemOperationCycleRef = PowerCycle
            DemDebounceAlgorithmClass
              DemDebounceCounterBased:
                DemDebounceCounterDecrementStepSize = 128
                DemDebounceCounterIncrementStepSize = 127
                DemDebounceCounterJumpDown = true
                DemDebounceCounterJumpUp = true
                DemDebounceBehavior = DEM_DEBOUNCE_FREEZE
                DemDebounceCounterFailedThreshold = 127
                DemDebounceCounterJumpDownValue = 0
                DemDebounceCounterJumpUpValue = 0
                DemDebounceCounterPassedThreshold = -128
                DemDebounceCounterStorage = false
                DemDebounceContinuous = false
            IndicatorAttribute_WarningIndicator (DemIndicatorAttribute):
              DemIndicatorFailureCycleSource = DEM_FAILURE_CYCLE_EVENT
              DemIndicatorBehaviour = DEM_INDICATOR_CONTINUOUS
              DemIndicatorHealingCycleCounterThreshold = 3
              DemIndicatorHealingCycleRef = PowerCycle
              DemIndicatorRef = WarningIndicator
        INV_IGBT_TEMP_U_RNG_LO: DemEventId=81, DemDTCClassRef=DTCClass_INV_IGBT_TEMP_U_RNG_LO
          DemEventClass:
            DemAgingAllowed = true
            DemAgingCycleCounterThreshold = 40
            DemEventDestination = DEM_DTC_ORIGIN_PRIMARY_MEMORY
            DemEventPriority = 2
            DemEventFailureCycleCounterThreshold = 0
            DemConsiderPtoStatus = false
            DemFFPrestorageSupported = false
            DemAgingCycleRef = PowerCycle
            DemEnableConditionGroupRef = EnableConditionGroup_7ab46a93
            DemOperationCycleRef = PowerCycle
            DemDebounceAlgorithmClass
              DemDebounceCounterBased:
                DemDebounceCounterDecrementStepSize = 128
                DemDebounceCounterIncrementStepSize = 127
                DemDebounceCounterJumpDown = true
                DemDebounceCounterJumpUp = true
                DemDebounceBehavior = DEM_DEBOUNCE_FREEZE
                DemDebounceCounterFailedThreshold = 127
                DemDebounceCounterJumpDownValue = 0
                DemDebounceCounterJumpUpValue = 0
                DemDebounceCounterPassedThreshold = -128
                DemDebounceCounterStorage = false
                DemDebounceContinuous = false
            IndicatorAttribute_WarningIndicator (DemIndicatorAttribute):
              DemIndicatorFailureCycleSource = DEM_FAILURE_CYCLE_EVENT
              DemIndicatorBehaviour = DEM_INDICATOR_CONTINUOUS
              DemIndicatorHealingCycleCounterThreshold = 3
              DemIndicatorHealingCycleRef = PowerCycle
              DemIndicatorRef = WarningIndicator
        INV_EM_STATOR_TEMP_HWP: DemEventId=45, DemDTCClassRef=DTCClass_INV_EM_STATOR_TEMP_HWP
          DemEventClass:
            DemAgingAllowed = true
            DemAgingCycleCounterThreshold = 40
            DemEventDestination = DEM_DTC_ORIGIN_PRIMARY_MEMORY
            DemEventPriority = 2
            DemEventFailureCycleCounterThreshold = 0
            DemConsiderPtoStatus = false
            DemFFPrestorageSupported = false
            DemAgingCycleRef = PowerCycle
            DemEnableConditionGroupRef = EnableConditionGroup_d13c1487
            DemOperationCycleRef = PowerCycle
            DemDebounceAlgorithmClass
              DemDebounceCounterBased:
                DemDebounceCounterDecrementStepSize = 128
                DemDebounceCounterIncrementStepSize = 127
                DemDebounceCounterJumpDown = true
                DemDebounceCounterJumpUp = true
                DemDebounceBehavior = DEM_DEBOUNCE_FREEZE
                DemDebounceCounterFailedThreshold = 127
                DemDebounceCounterJumpDownValue = 0
                DemDebounceCounterJumpUpValue = 0
                DemDebounceCounterPassedThreshold = -128
                DemDebounceCounterStorage = false
                DemDebounceContinuous = false
            IndicatorAttribute_WarningIndicator (DemIndicatorAttribute):
              DemIndicatorFailureCycleSource = DEM_FAILURE_CYCLE_EVENT
              DemIndicatorBehaviour = DEM_INDICATOR_CONTINUOUS
              DemIndicatorHealingCycleCounterThreshold = 3
              DemIndicatorHealingCycleRef = PowerCycle
              DemIndicatorRef = WarningIndicator
        CU_TEMP1_RNG_HI: DemEventId=10, DemDTCClassRef=DTCClass_CU_TEMP1_RNG_HI
          DemEventClass:
            DemAgingAllowed = true
            DemAgingCycleCounterThreshold = 40
            DemEventDestination = DEM_DTC_ORIGIN_PRIMARY_MEMORY
            DemEventPriority = 1
            DemEventFailureCycleCounterThreshold = 0
            DemConsiderPtoStatus = false
            DemFFPrestorageSupported = false
            DemAgingCycleRef = PowerCycle
            DemEnableConditionGroupRef = EnableConditionGroup_7ab46a93
            DemOperationCycleRef = PowerCycle
            DemDebounceAlgorithmClass
              DemDebounceCounterBased:
                DemDebounceCounterDecrementStepSize = 128
                DemDebounceCounterIncrementStepSize = 127
                DemDebounceCounterJumpDown = true
                DemDebounceCounterJumpUp = true
                DemDebounceBehavior = DEM_DEBOUNCE_FREEZE
                DemDebounceCounterFailedThreshold = 127
                DemDebounceCounterJumpDownValue = 0
                DemDebounceCounterJumpUpValue = 0
                DemDebounceCounterPassedThreshold = -128
                DemDebounceCounterStorage = false
                DemDebounceContinuous = false
            IndicatorAttribute_WarningIndicator (DemIndicatorAttribute):
              DemIndicatorFailureCycleSource = DEM_FAILURE_CYCLE_EVENT
              DemIndicatorBehaviour = DEM_INDICATOR_CONTINUOUS
              DemIndicatorHealingCycleCounterThreshold = 3
              DemIndicatorHealingCycleRef = PowerCycle
              DemIndicatorRef = WarningIndicator
        INV_IGBT_TEMP_V_RNG_HI: DemEventId=84, DemDTCClassRef=DTCClass_INV_IGBT_TEMP_V_RNG_HI
          DemEventClass:
            DemAgingAllowed = true
            DemAgingCycleCounterThreshold = 40
            DemEventDestination = DEM_DTC_ORIGIN_PRIMARY_MEMORY
            DemEventPriority = 2
            DemEventFailureCycleCounterThreshold = 0
            DemConsiderPtoStatus = false
            DemFFPrestorageSupported = false
            DemAgingCycleRef = PowerCycle
            DemEnableConditionGroupRef = EnableConditionGroup_7ab46a93
            DemOperationCycleRef = PowerCycle
            DemDebounceAlgorithmClass
              DemDebounceCounterBased:
                DemDebounceCounterDecrementStepSize = 128
                DemDebounceCounterIncrementStepSize = 127
                DemDebounceCounterJumpDown = true
                DemDebounceCounterJumpUp = true
                DemDebounceBehavior = DEM_DEBOUNCE_FREEZE
                DemDebounceCounterFailedThreshold = 127
                DemDebounceCounterJumpDownValue = 0
                DemDebounceCounterJumpUpValue = 0
                DemDebounceCounterPassedThreshold = -128
                DemDebounceCounterStorage = false
                DemDebounceContinuous = false
            IndicatorAttribute_WarningIndicator (DemIndicatorAttribute):
              DemIndicatorFailureCycleSource = DEM_FAILURE_CYCLE_EVENT
              DemIndicatorBehaviour = DEM_INDICATOR_CONTINUOUS
              DemIndicatorHealingCycleCounterThreshold = 3
              DemIndicatorHealingCycleRef = PowerCycle
              DemIndicatorRef = WarningIndicator
      DTCClass_VCEvBecmPropFr01Tioutd (DemDTCClass): DemDTCSeverity=DEM_DTC_SEV_IMMEDIATELY, DemUdsDTC=15664640, DemImmediateNvStorage=false
      DTCClass_INV_IAC_U_RNG_HI (DemDTCClass): DemDTCSeverity=DEM_DTC_SEV_IMMEDIATELY, DemUdsDTC=779545, DemImmediateNvStorage=false
      VcEvNodeMisVDDM (DemEventParameter):
        DemEventKind = DEM_EVENT_KIND_SWC
        DemMaxNumberFreezeFrameRecords = 2
        DemEventTimeSeries = DEM_TIMESERIES_SNAPSHOT_NONE
        DemEventAvailable = true
        DemEventId = 204
        DemEventAvailableInVariant = true
        DemEventLatchTestFailed = false
        DemEventCreateInfoPort = true
        DemDTCClassRef = DTCClass_VcEvNodeMisVDDM
        DemExtendedDataClassRef = ExtendedDataClass_5ecd55b9
        DemFreezeFrameClassRef = FreezeFrameClass_c3111450
        DemEventClass:
          DemAgingAllowed = true
          DemAgingCycleCounterThreshold = 40
          DemEventDestination = DEM_DTC_ORIGIN_PRIMARY_MEMORY
          DemEventPriority = 1
          DemEventFailureCycleCounterThreshold = 0
          DemConsiderPtoStatus = false
          DemFFPrestorageSupported = false
          DemAgingCycleRef = PowerCycle
          DemEnableConditionGroupRef = EnableConditionGroup_6f8868bd
          DemOperationCycleRef = PowerCycle
          DemDebounceAlgorithmClass
            DemDebounceCounterBased:
              DemDebounceCounterDecrementStepSize = 128
              DemDebounceCounterIncrementStepSize = 127
              DemDebounceCounterJumpDown = true
              DemDebounceCounterJumpUp = true
              DemDebounceBehavior = DEM_DEBOUNCE_FREEZE
              DemDebounceCounterFailedThreshold = 127
              DemDebounceCounterJumpDownValue = 0
              DemDebounceCounterJumpUpValue = 0
              DemDebounceCounterPassedThreshold = -128
              DemDebounceCounterStorage = false
              DemDebounceContinuous = false
          IndicatorAttribute_WarningIndicator (DemIndicatorAttribute):
            DemIndicatorFailureCycleSource = DEM_FAILURE_CYCLE_EVENT
            DemIndicatorBehaviour = DEM_INDICATOR_CONTINUOUS
            DemIndicatorHealingCycleCounterThreshold = 3
            DemIndicatorHealingCycleRef = PowerCycle
            DemIndicatorRef = WarningIndicator
      INV_UHVDC_PLAUS (DemEventParameter):
        DemEventKind = DEM_EVENT_KIND_SWC
        DemMaxNumberFreezeFrameRecords = 2
        DemEventTimeSeries = DEM_TIMESERIES_SNAPSHOT_NONE
        DemEventAvailable = true
        DemEventId = 134
        DemEventAvailableInVariant = true
        DemEventLatchTestFailed = false
        DemEventCreateInfoPort = true
        DemDTCClassRef = DTCClass_INV_UHVDC_PLAUS
        DemExtendedDataClassRef = ExtendedDataClass_5ecd55b9
        DemFreezeFrameClassRef = FreezeFrameClass_c3111450
        DemEventClass:
          DemAgingAllowed = true
          DemAgingCycleCounterThreshold = 40
          DemEventDestination = DEM_DTC_ORIGIN_PRIMARY_MEMORY
          DemEventPriority = 1
          DemEventFailureCycleCounterThreshold = 0
          DemConsiderPtoStatus = false
          DemFFPrestorageSupported = false
          DemAgingCycleRef = PowerCycle
          DemEnableConditionGroupRef = EnableConditionGroup_fecd1d5c
          DemOperationCycleRef = PowerCycle
          DemDebounceAlgorithmClass
            DemDebounceCounterBased:
              DemDebounceCounterDecrementStepSize = 128
              DemDebounceCounterIncrementStepSize = 127
              DemDebounceCounterJumpDown = true
              DemDebounceCounterJumpUp = true
              DemDebounceBehavior = DEM_DEBOUNCE_FREEZE
              DemDebounceCounterFailedThreshold = 127
              DemDebounceCounterJumpDownValue = 0
              DemDebounceCounterJumpUpValue = 0
              DemDebounceCounterPassedThreshold = -128
              DemDebounceCounterStorage = false
              DemDebounceContinuous = false
          IndicatorAttribute_WarningIndicator (DemIndicatorAttribute):
            DemIndicatorFailureCycleSource = DEM_FAILURE_CYCLE_EVENT
            DemIndicatorBehaviour = DEM_INDICATOR_CONTINUOUS
            DemIndicatorHealingCycleCounterThreshold = 3
            DemIndicatorHealingCycleRef = PowerCycle
            DemIndicatorRef = WarningIndicator
      DTCClass_INV_UHVDC_2_RNG_HI (DemDTCClass): DemDTCSeverity=DEM_DTC_SEV_IMMEDIATELY, DemUdsDTC=893719, DemImmediateNvStorage=false
      INV_QUIESCENT_FLT (DemEventParameter):
        DemEventKind = DEM_EVENT_KIND_SWC
        DemMaxNumberFreezeFrameRecords = 2
        DemEventTimeSeries = DEM_TIMESERIES_SNAPSHOT_NONE
        DemEventAvailable = true
        DemEventId = 93
        DemEventAvailableInVariant = true
        DemEventLatchTestFailed = false
        DemEventCreateInfoPort = true
        DemDTCClassRef = DTCClass_INV_QUIESCENT_FLT
        DemExtendedDataClassRef = ExtendedDataClass_5ecd55b9
        DemFreezeFrameClassRef = FreezeFrameClass_c3111450
        DemEventClass:
          DemAgingAllowed = true
          DemAgingCycleCounterThreshold = 40
          DemEventDestination = DEM_DTC_ORIGIN_PRIMARY_MEMORY
          DemEventPriority = 2
          DemEventFailureCycleCounterThreshold = 0
          DemConsiderPtoStatus = false
          DemFFPrestorageSupported = false
          DemAgingCycleRef = PowerCycle
          DemEnableConditionGroupRef = EnableConditionGroup_f496e085
          DemOperationCycleRef = PowerCycle
          DemDebounceAlgorithmClass
            DemDebounceCounterBased:
              DemDebounceCounterDecrementStepSize = 128
              DemDebounceCounterIncrementStepSize = 127
              DemDebounceCounterJumpDown = true
              DemDebounceCounterJumpUp = true
              DemDebounceBehavior = DEM_DEBOUNCE_FREEZE
              DemDebounceCounterFailedThreshold = 127
              DemDebounceCounterJumpDownValue = 0
              DemDebounceCounterJumpUpValue = 0
              DemDebounceCounterPassedThreshold = -128
              DemDebounceCounterStorage = false
              DemDebounceContinuous = false
      INV_RSLVR_EXCT_RNG_HI (DemEventParameter):
        DemEventKind = DEM_EVENT_KIND_SWC
        DemMaxNumberFreezeFrameRecords = 2
        DemEventTimeSeries = DEM_TIMESERIES_SNAPSHOT_NONE
        DemEventAvailable = true
        DemEventId = 111
        DemEventAvailableInVariant = true
        DemEventLatchTestFailed = false
        DemEventCreateInfoPort = true
        DemDTCClassRef = DTCClass_INV_RSLVR_EXCT_RNG_HI
        DemExtendedDataClassRef = ExtendedDataClass_5ecd55b9
        DemFreezeFrameClassRef = FreezeFrameClass_c3111450
        DemEventClass:
          DemAgingAllowed = true
          DemAgingCycleCounterThreshold = 40
          DemEventDestination = DEM_DTC_ORIGIN_PRIMARY_MEMORY
          DemEventPriority = 1
          DemEventFailureCycleCounterThreshold = 0
          DemConsiderPtoStatus = false
          DemFFPrestorageSupported = false
          DemAgingCycleRef = PowerCycle
          DemEnableConditionGroupRef = EnableConditionGroup_1027fc3a
          DemOperationCycleRef = PowerCycle
          DemDebounceAlgorithmClass
            DemDebounceCounterBased:
              DemDebounceCounterDecrementStepSize = 128
              DemDebounceCounterIncrementStepSize = 127
              DemDebounceCounterJumpDown = true
              DemDebounceCounterJumpUp = true
              DemDebounceBehavior = DEM_DEBOUNCE_FREEZE
              DemDebounceCounterFailedThreshold = 127
              DemDebounceCounterJumpDownValue = 0
              DemDebounceCounterJumpUpValue = 0
              DemDebounceCounterPassedThreshold = -128
              DemDebounceCounterStorage = false
              DemDebounceContinuous = false
          IndicatorAttribute_WarningIndicator (DemIndicatorAttribute):
            DemIndicatorFailureCycleSource = DEM_FAILURE_CYCLE_EVENT
            DemIndicatorBehaviour = DEM_INDICATOR_CONTINUOUS
            DemIndicatorHealingCycleCounterThreshold = 3
            DemIndicatorHealingCycleRef = PowerCycle
            DemIndicatorRef = WarningIndicator
      DTCClass_INV_RSLVR_EXCT_FREQ_RNG_NOK (DemDTCClass): DemDTCSeverity=DEM_DTC_SEV_IMMEDIATELY, DemUdsDTC=806968, DemImmediateNvStorage=false
    DemGeneral:
      DemAgingCycleCounterProcessing = DEM_PROCESS_AGINGCTR_INTERN
      DemDebounceCounterBasedSupport = true
      DemDtcStatusAvailabilityMask = 255
      DemEnableConditionSupport = true
      DemMaxNumberEventEntryMirror = 0
      DemPTOSupport = false
      DemTypeOfFreezeFrameRecordNumeration = DEM_FF_RECNUM_CALCULATED
      DemGeneralInterfaceSupport = false
      DemDataElementDefaultEndianness = LITTLE_ENDIAN
      DemAgingRequieresTestedCycle = false
      DemTriggerMonitorInitBeforeClearOk = true
      DemExtendedDataCapture = DEM_TRIGGER_EVENT_MEMORY_STORAGE
      DemFreezeFrameCapture = DEM_TRIGGER_EVENT_MEMORY_STORAGE
      DemOperationCycleProcessing = DEM_PROCESS_OPCYC_STATE
      DemMaxNumberTimeSeriesSnapshots = 0
      DemAvailabilitySupport = DEM_NO_AVAILABILITY
      DemAvailabilityStorage = false
      DemBswErrorBufferSize = 0
      DemClearDTCBehavior = DEM_CLRRESP_VOLATILE
      DemClearDTCLimitation = DEM_ALL_SUPPORTED_DTCS
      DemDebounceTimeBasedSupport = false
      DemDevErrorDetect = true
      DemEventCombinationSupport = DEM_EVCOMB_DISABLED
      DemEventDisplacementStrategy = DEM_DISPLACEMENT_LEGACY_403
      DemEventMemoryEntryStorageTrigger = DEM_STORAGE_ON_TEST_FAILED
      DemMaxNumberEventEntryOBDFreezeFrame = 0
      DemMaxNumberEventEntryPermanent = 0
      DemMaxNumberEventEntryPrimary = 8
      DemMaxNumberEventEntrySecondary = 0
      DemMaxNumberPrestoredFF = 0
      DemOBDSupport = DEM_OBD_NO_OBD_SUPPORT
      DemOccurrenceCounterProcessing = DEM_PROCESS_OCCCTR_TF
      DemOperationCycleStatusStorage = false
      DemResetConfirmedBitOnOverflow = true
      DemStatusBitHandlingTestFailedSinceLastClear = DEM_STATUS_BIT_NORMAL
      DemStatusBitStorageTestFailed = true
      DemStorageConditionSupport = false
      DemSuppressionSupport = DEM_NO_SUPPRESSION
      DemTaskTime = 0.01
      DemTriggerDcmReports = false
      DemTriggerDltReports = false
      DemTriggerFiMReports = false
      DemTriggerFiMReportsExtended = false
      DemTriggerMonitorInitForEnableConditions = false
      DemTypeOfDTCSupported = DEM_DTC_TRANSLATION_ISO14229_1
      DemVersionInfoApi = false
      DemBswApiVersion = DEM_BSW_API_4_XX_XX
      DemBswApiVersionNvM = DEM_BSW_API_4_XX_XX
      DemBswApiVersionFiM = DEM_BSW_API_4_XX_XX
      DemAgingAfterHealing = DEM_AGING_WHILE_HEALING
      DemAgingBehavior = DEM_AGING_TYPE_1
      DemAgingCounterBehavior = DEM_AGING_COUNT_ALWAYS
      DemAgingCounterReporting = DEM_AGING_NORMAL_REPORTING
      DemAgingRetainEnvironmentalData = false
      DemCompiledPostbuildCrc = 4224678627
      DemCompiledPostbuildCrcMode = DEM_POSTBUILD_CRC_AUTOMATIC
      DemEventDisplacementFallbackStrategy = DEM_FALLBACK_DISCARD_NEW_EVENT
      DemGeneralDiagnosticInfoSupport = true
      DemJ1939Support = false
      DemNvSynchronizeSupport = false
      DemPendingDtcProcessing = DEM_PROCESS_PDTC_STOREDONLY
      DemResetDebounceBehavior = DEM_RESET_DEBOUNCE_ON_DISABLE_ENABLE_CONDITIONS
      DemResetTestFailedOnOperationCycleStart = false
      DemRetryStorageSupport = false
      DemSafeBswChecks = false
      DemUseMemcopyMacros = false
      DemUseRte = true
      DemUserControlledWirBehavior = DEM_ENABLED_DURING_CONTROLDTCSETTING
      DemUserDefinedCompareAndSwap = false
      DemWarningIndicatorRequestedProcessing = DEM_PROCESS_WIR_STOREDONLY
      DemUseMultiPartitionFiM = false
      DemUseNvm = true
      DemLatchTestFailedBehavior = DEM_LATCH_TF_CONFIRMED_AND_THIS_CYCLE
      DemReportSuppressedDTCsInService19x0A = false
      DemSupportAgingForAllDTCs = false
      DTCStatusindicator30_DTCStatusindicator30 (DemDataClass): DemDataElementDataSize=1, DemDataElementDataType=UINT8, DemDataElementUsePort=USE_DATA_CLIENT_SERVER_PORT, DemDataElementStoreNonVolatile=true
      DID_0xe310_DID_E310_IEMMGM_Derating_Status (DemDataClass): DemDataElementDataSize=1, DemDataElementDataType=UINT8, DemDataElementUsePort=USE_DATA_CLIENT_SERVER_PORT, DemDataElementStoreNonVolatile=true
      FreezeFrameClass_5b6f811c (DemFreezeFrameClass):
        DemDidClassRef = DID_D003_Vehicle_Speed
        DemDidClassRef = DID_DD00_Global_Real_Time
        DemDidClassRef = DID_DD01_Total_Distance
        DemDidClassRef = DID_DD02_Vehicle_Battery_Voltage
        DemDidClassRef = DID_DD0A_Usage_Mode
        DemDidClassRef = DID_DD0C_Electric_Power_Level
        DemDidClassRef = DID_E300_HVDC_Voltage
        DemDidClassRef = DID_E301_HVDC_Current
        DemDidClassRef = DID_E303_Motor_Speed
        DemDidClassRef = DID_E304_Actual_Torque
        DemDidClassRef = DID_E305_Inverter_IGBT_Junction_Temp
        DemDidClassRef = DID_E306_Motor_Temperature
        DemDidClassRef = DID_E307_System_Mode
        DemDidClassRef = DID_E308_ECM_Torque_Request
        DemDidClassRef = DID_E309_ECM_Mode_Request
        DemDidClassRef = DID_E310_IEM_MGM_Derating_Status
        DemDidClassRef = DID_E311_Crash_Status
        DemDidClassRef = DID_E312_Wheel_Speed
        DemDidClassRef = DID_E313_Active_discharge_status
        DemDidClassRef = DID_E314_Available_Torque_maximum
        DemDidClassRef = DID_E315_Available_Torque_minimum
        DemDidClassRef = DID_E319_Torque_Direction
        DemDidClassRef = DID_E320_System_Mode_Mismatch
        DemDidClassRef = DID_E324_Motor_Derating_reason_of_IEM_MGM
        DemDidClassRef = DID_E333_2002_State
        DemDidClassRef = DID_E335_d_axis_current_setpoint
        DemDidClassRef = DID_E336_d_axis_current_feedback
        DemDidClassRef = DID_E337_q_axis_current_setpoint
        DemDidClassRef = DID_E338_q_axis_current_feedback
        DemDidClassRef = DID_E339_d_axis_voltage
        DemDidClassRef = DID_E341_q_axis_voltage
        DemDidClassRef = DID_E346_ECM_Torque_Allowed_Status
        DemDidClassRef = DID_E347_IGBT_Max_Temperature
        DemDidClassRef = DID_E348_Phase_U_PWM_duty
        DemDidClassRef = DID_E349_Phase_V_PWM_duty
        DemDidClassRef = DID_E350_Phase_W_PWM_duty
        DemDidClassRef = DID_E353_Flux_weakening_correction_factor
        DemDidClassRef = DID_E357_Resolve_compensated_angle
        DemDidClassRef = DID_E358_Resolve_angle
        DemDidClassRef = DID_E363_Modulation_index
        DemDidClassRef = DID_E364_AURIX_Fault_Indication
        DemDidClassRef = DID_EE9A_Inverter_Coolant_Temperature
        DemDidClassRef = DID_EE9C_Transient_Phase_Current_A
        DemDidClassRef = DID_EE9D_Transient_Phase_Current_B
        DemDidClassRef = DID_EE9E_Transient_Phase_Current_C
        DemDidClassRef = DID_EE9F_Gate_Status
        DemDidClassRef = DID_EEB2_Three_Phase_Motor_Current_RMS_Current
        DemDidClassRef = DID_EEB5_IEM_MGM_current_torque
        DemDidClassRef = DID_EEB6_ECM_Power_Limitation_maximum
        DemDidClassRef = DID_EEB7_ECM_Power_Limitation_minimum
        DemDidClassRef = DID_EEB8_HV_voltage_received_from_BECM
        DemDidClassRef = DID_EEBE_Offset_angle_status
        DemDidClassRef = DID_EEBF_HV_Main_Relay_Status
        DemDidClassRef = DID_EEC3_ECU_power_supply_Voltage
        DemDidClassRef = DID_EEC4_Charging_Power_Sustain_Relay_CPSR_Voltage
        DemDidClassRef = DID_EED1_Safty_monitor_Fault_Indication
        DemDidClassRef = DID_0xEEC7_1
        DemDidClassRef = DID_EED3_Safety_speed
        DemDidClassRef = DID_EED4_Safty_Function_Mode
        DemDidClassRef = DID_EED5_Safety_Torque_QF_factor
      DID_0xe301_DID_E301_HVDC_Current_ (DemDataClass):
        DemDataElementDataSize = 2
        DemDataElementDataType = UINT16
        DemDataElementEndianness = BIG_ENDIAN
        DemDataElementUsePort = USE_DATA_CLIENT_SERVER_PORT
        DemDataElementStoreNonVolatile = true
      DID_EEB5_IEM_MGM_current_torque (DemDidClass): DemDidIdentifier=61109, DemDidDataClassRef=DID_0xeeb5_DID_EEB5_IEMMGM_current_torque
      DID_E364_AURIX_Fault_Indication (DemDidClass): DemDidIdentifier=58212, DemDidDataClassRef=DID_0xe364_DID_E364_AURIX_Fault_Indication
      of (DemEnableCondition): DemEnableConditionId=112, DemEnableConditionStatus=true
      DID_E339_d_axis_voltage (DemDidClass): DemDidIdentifier=58169, DemDidDataClassRef=DID_0xe339_DID_E339_d_axis_voltage
      EnableConditionGroup_f496e085 (DemEnableConditionGroup): DemEnableConditionRef=KL15, DemEnableConditionRef=active
      DID_EE9C_Transient_Phase_Current_A (DemDidClass): DemDidIdentifier=61084, DemDidDataClassRef=DID_0xee9c_DID_EE9C_Transient_Phase_Current_A
      motor (DemEnableCondition): DemEnableConditionId=106, DemEnableConditionStatus=true
      DID_E358_Resolve_angle (DemDidClass): DemDidIdentifier=58200, DemDidDataClassRef=DID_0xe358_DID_E358_Resolve_angle
      transition (DemEnableCondition): DemEnableConditionId=148, DemEnableConditionStatus=true
      No (DemEnableCondition): DemEnableConditionId=37, DemEnableConditionStatus=true
      DID_0xe305_DID_E305_Inverter_IGBT_Junction_Temp (DemDataClass): DemDataElementDataSize=1, DemDataElementDataType=UINT8, DemDataElementUsePort=USE_DATA_CLIENT_SERVER_PORT, DemDataElementStoreNonVolatile=true
      Nm (DemEnableCondition): DemEnableConditionId=36, DemEnableConditionStatus=true
      DID_0xe339_DID_E339_d_axis_voltage (DemDataClass):
        DemDataElementDataSize = 2
        DemDataElementDataType = UINT16
        DemDataElementEndianness = BIG_ENDIAN
        DemDataElementUsePort = USE_DATA_CLIENT_SERVER_PORT
        DemDataElementStoreNonVolatile = true
      DID_EEB6_ECM_Power_Limitation_maximum (DemDidClass): DemDidIdentifier=61110, DemDidDataClassRef=DID_0xeeb6_DID_EEB6_ECM_Power_Limitation_maximum
      EnableConditionGroup_377893c9 (DemEnableConditionGroup):
        DemEnableConditionRef = A
        DemEnableConditionRef = A
        DemEnableConditionRef = All_001
        DemEnableConditionRef = All_001
        DemEnableConditionRef = Crash
        DemEnableConditionRef = DTC
        DemEnableConditionRef = DTC
        DemEnableConditionRef = DTC
        DemEnableConditionRef = DTC
        DemEnableConditionRef = ECU
        DemEnableConditionRef = ECU
        DemEnableConditionRef = ElPowerLevel
        DemEnableConditionRef = Factory
        DemEnableConditionRef = The_001
        DemEnableConditionRef = The_001
        DemEnableConditionRef = The_001
        DemEnableConditionRef = Transport
        DemEnableConditionRef = When
        DemEnableConditionRef = a_001
        DemEnableConditionRef = according
        DemEnableConditionRef = active
        DemEnableConditionRef = all
        DemEnableConditionRef = and_001
        DemEnableConditionRef = another
        DemEnableConditionRef = any
        DemEnableConditionRef = any
        DemEnableConditionRef = as
        DemEnableConditionRef = at
        DemEnableConditionRef = availability
        DemEnableConditionRef = be
        DemEnableConditionRef = be
        DemEnableConditionRef = be
        DemEnableConditionRef = be
        DemEnableConditionRef = be
        DemEnableConditionRef = below
        DemEnableConditionRef = below
        DemEnableConditionRef = bus
        DemEnableConditionRef = by
        DemEnableConditionRef = car
        DemEnableConditionRef = car
        DemEnableConditionRef = car
        DemEnableConditionRef = car
        DemEnableConditionRef = change
        DemEnableConditionRef = consumption
        DemEnableConditionRef = criteria
        DemEnableConditionRef = during
        DemEnableConditionRef = electrical
        DemEnableConditionRef = enters
        DemEnableConditionRef = exceptions
        DemEnableConditionRef = exit
        DemEnableConditionRef = for
        DemEnableConditionRef = from
        DemEnableConditionRef = from
        DemEnableConditionRef = fulfilled
        DemEnableConditionRef = generic
        DemEnableConditionRef = in
        DemEnableConditionRef = in
        DemEnableConditionRef = indicated
        DemEnableConditionRef = inhibited
        DemEnableConditionRef = inhibited
        DemEnableConditionRef = inhibited
        DemEnableConditionRef = inhibition
        DemEnableConditionRef = is
        DemEnableConditionRef = is
        DemEnableConditionRef = is
        DemEnableConditionRef = is
        DemEnableConditionRef = limited
        DemEnableConditionRef = mode
        DemEnableConditionRef = mode
        DemEnableConditionRef = mode
        DemEnableConditionRef = modes
        DemEnableConditionRef = notational
        DemEnableConditionRef = of
        DemEnableConditionRef = of
        DemEnableConditionRef = of
        DemEnableConditionRef = off
        DemEnableConditionRef = one
        DemEnableConditionRef = operation
        DemEnableConditionRef = or
        DemEnableConditionRef = or
        DemEnableConditionRef = power
        DemEnableConditionRef = requested
        DemEnableConditionRef = run
        DemEnableConditionRef = run
        DemEnableConditionRef = s
        DemEnableConditionRef = s
        DemEnableConditionRef = seconds
        DemEnableConditionRef = set
        DemEnableConditionRef = shall
        DemEnableConditionRef = shall
        DemEnableConditionRef = shall
        DemEnableConditionRef = shall
        DemEnableConditionRef = shall
        DemEnableConditionRef = shall
        DemEnableConditionRef = shall
        DemEnableConditionRef = signal
        DemEnableConditionRef = start
        DemEnableConditionRef = state
        DemEnableConditionRef = test
        DemEnableConditionRef = tests
        DemEnableConditionRef = tests
        DemEnableConditionRef = tests
        DemEnableConditionRef = tests
        DemEnableConditionRef = that
        DemEnableConditionRef = the
        DemEnableConditionRef = the
        DemEnableConditionRef = the
        DemEnableConditionRef = the
        DemEnableConditionRef = the
        DemEnableConditionRef = the
        DemEnableConditionRef = the
        DemEnableConditionRef = time
        DemEnableConditionRef = to
        DemEnableConditionRef = to
        DemEnableConditionRef = transition
        DemEnableConditionRef = vehicle
        DemEnableConditionRef = when_001
        DemEnableConditionRef = when_001
        DemEnableConditionRef = when_001
        DemEnableConditionRef = with
      MaxDTCSinClear_MaxDTCSinClear (DemDataClass):
        DemDataElementDataSize = 1
        DemDataElementInternalData = DEM_MAX_FDC_SINCE_LAST_CLEAR
        DemDataElementUsePort = USE_DATA_INTERNAL
        DemDataElementStoreNonVolatile = true
      DID_EED1_Safty_monitor_Fault_Indication (DemDidClass):
        DemDidIdentifier = 61137
        DemDidDataClassRef = DID_0xeed1_EED1_{0..3}
      DID_0xe307_DID_E307_System_Mode (DemDataClass): DemDataElementDataSize=1, DemDataElementDataType=UINT8, DemDataElementUsePort=USE_DATA_CLIENT_SERVER_PORT, DemDataElementStoreNonVolatile=true
      EnableConditionGroup_14eabb2c (DemEnableConditionGroup): DemEnableConditionRef=Inverter, DemEnableConditionRef=LV, DemEnableConditionRef=done, DemEnableConditionRef=initliazation, DemEnableConditionRef=is
      MaxDTCDetCntThisCycle (DemExtendedDataRecordClass): DemExtendedDataRecordNumber=17, DemDataClassRef=MaxDTCDetCntThisCycle_MaxDTCDetCntThisCycle
      3 x DemEnableCondition, all with DemEnableConditionStatus=true:
        and_001: DemEnableConditionId=59
        P5: DemEnableConditionId=39
        resolver: DemEnableConditionId=126
      EnableConditionGroup_6f8868bd (DemEnableConditionGroup):
        DemEnableConditionRef = BusOff
        DemEnableConditionRef = CAN
        DemEnableConditionRef = KL15
        DemEnableConditionRef = KL30
        DemEnableConditionRef = Prop
        DemEnableConditionRef = V
        DemEnableConditionRef = Voltage9
        DemEnableConditionRef = active
        DemEnableConditionRef = no_001
      or (DemEnableCondition): DemEnableConditionId=118, DemEnableConditionStatus=true
      FreezeFrameClass_dc4c3f47 (DemFreezeFrameClass):
        DemDidClassRef = DID_D003_Vehicle_Speed
        DemDidClassRef = DID_DD00_Global_Real_Time
        DemDidClassRef = DID_DD01_Total_Distance
        DemDidClassRef = DID_DD0A_Usage_Mode
        DemDidClassRef = DID_DD0C_Electric_Power_Level
        DemDidClassRef = DID_E303_Motor_Speed
        DemDidClassRef = DID_E304_Actual_Torque
        DemDidClassRef = DID_E307_System_Mode
        DemDidClassRef = DID_E308_ECM_Torque_Request
        DemDidClassRef = DID_E309_ECM_Mode_Request
        DemDidClassRef = DID_E310_IEM_MGM_Derating_Status
        DemDidClassRef = DID_E312_Wheel_Speed
        DemDidClassRef = DID_E314_Available_Torque_maximum
        DemDidClassRef = DID_E315_Available_Torque_minimum
        DemDidClassRef = DID_E333_2002_State
        DemDidClassRef = DID_E335_d_axis_current_setpoint
        DemDidClassRef = DID_E336_d_axis_current_feedback
        DemDidClassRef = DID_E337_q_axis_current_setpoint
        DemDidClassRef = DID_E338_q_axis_current_feedback
        DemDidClassRef = DID_E346_ECM_Torque_Allowed_Status
        DemDidClassRef = DID_EE9A_Inverter_Coolant_Temperature
        DemDidClassRef = DID_EEB2_Three_Phase_Motor_Current_RMS_Current
        DemDidClassRef = DID_EEB8_HV_voltage_received_from_BECM
        DemDidClassRef = DID_EEBF_HV_Main_Relay_Status
        DemDidClassRef = DID_EEC3_ECU_power_supply_Voltage
        DemDidClassRef = DID_EEC4_Charging_Power_Sustain_Relay_CPSR_Voltage
      state (DemEnableCondition): DemEnableConditionId=137, DemEnableConditionStatus=true
      DID_E303_Motor_Speed (DemDidClass): DemDidIdentifier=58115, DemDidDataClassRef=DID_0xe303_DID_E303_Motor_Speed_
      parameter (DemEnableCondition): DemEnableConditionId=119, DemEnableConditionStatus=true
      DID_0xe357_DID_E357_Resolve_compensated_angle (DemDataClass): DemDataElementDataSize=1, DemDataElementDataType=UINT8, DemDataElementUsePort=USE_DATA_CLIENT_SERVER_PORT, DemDataElementStoreNonVolatile=true
      DID_0xe308_DID_E308_ECM_Torque_Request (DemDataClass):
        DemDataElementDataSize = 2
        DemDataElementDataType = UINT16
        DemDataElementEndianness = BIG_ENDIAN
        DemDataElementUsePort = USE_DATA_CLIENT_SERVER_PORT
        DemDataElementStoreNonVolatile = true
      INV_IAC_U_ELEC_LO (DemEnableCondition): DemEnableConditionId=26, DemEnableConditionStatus=true
      DID_E301_HVDC_Current (DemDidClass): DemDidIdentifier=58113, DemDidDataClassRef=DID_0xe301_DID_E301_HVDC_Current_
      seconds (DemEnableCondition): DemEnableConditionId=131, DemEnableConditionStatus=true
      3 x DemDataClass, all with DemDataElementUsePort=USE_DATA_CLIENT_SERVER_PORT, DemDataElementStoreNonVolatile=true:
        DID_0xe335_DID_E335_d_axis_current_setpoint: DemDataElementDataSize=2, DemDataElementDataType=UINT16, DemDataElementEndianness=BIG_ENDIAN
        DID_0xe319_DID_E319_Torque_Direction: DemDataElementDataSize=1, DemDataElementDataType=UINT8
        DID_0xe309_DID_E309_ECM_Mode_Request: DemDataElementDataSize=1, DemDataElementDataType=UINT8
      IgnitionCycle (DemOperationCycle): DemOperationCycleType=DEM_OPCYC_IGNITION, DemOperationCycleAutomaticEnd=false, DemOperationCycleAutostart=false
      DID_0xdd0a_DID_DD0A_Usage_Mode (DemDataClass): DemDataElementDataSize=1, DemDataElementDataType=UINT8, DemDataElementUsePort=USE_DATA_CLIENT_SERVER_PORT, DemDataElementStoreNonVolatile=true
      6 x DemEnableCondition, all with DemEnableConditionStatus=true:
        LV: DemEnableConditionId=34
        ElPowerLevel: DemEnableConditionId=17
        faults: DemEnableConditionId=88
        NO_002: DemEnableConditionId=35
        initliazation: DemEnableConditionId=100
        while: DemEnableConditionId=153
      DID_0xeec3_DID_EEC3_ECU_power_supply_Voltage (DemDataClass): DemDataElementDataSize=1, DemDataElementDataType=UINT8, DemDataElementUsePort=USE_DATA_CLIENT_SERVER_PORT, DemDataElementStoreNonVolatile=true
      start (DemEnableCondition): DemEnableConditionId=136, DemEnableConditionStatus=true
      fault (DemEnableCondition): DemEnableConditionId=86, DemEnableConditionStatus=true
      DID_E305_Inverter_IGBT_Junction_Temp (DemDidClass): DemDidIdentifier=58117, DemDidDataClassRef=DID_0xe305_DID_E305_Inverter_IGBT_Junction_Temp
      faulte (DemEnableCondition): DemEnableConditionId=87, DemEnableConditionStatus=true
      DID_0xdd00_DID_DD00_Global_Real_Time (DemDataClass):
        DemDataElementDataSize = 4
        DemDataElementDataType = UINT32
        DemDataElementEndianness = BIG_ENDIAN
        DemDataElementUsePort = USE_DATA_CLIENT_SERVER_PORT
        DemDataElementStoreNonVolatile = true
      3 x DemEnableCondition, all with DemEnableConditionStatus=true:
        a_001: DemEnableConditionId=54
        consumption: DemEnableConditionId=73
        BusOff: DemEnableConditionId=6
      DID_E313_Active_discharge_status (DemDidClass): DemDidIdentifier=58131, DemDidDataClassRef=DID_0xe313_DID_E313_Active_discharge_status
      DID_0xee9e_DID_EE9E_Transient_Phase_Current_C (DemDataClass):
        DemDataElementDataSize = 2
        DemDataElementDataType = UINT16
        DemDataElementEndianness = BIG_ENDIAN
        DemDataElementUsePort = USE_DATA_CLIENT_SERVER_PORT
        DemDataElementStoreNonVolatile = true
      DID_0xEEC7_1 (DemDidClass): DemDidIdentifier=61138, DemDidDataClassRef=DID_0xeed2_DID_EED2_SaftyTorque
      once (DemEnableCondition): DemEnableConditionId=115, DemEnableConditionStatus=true
      DID_E306_Motor_Temperature (DemDidClass): DemDidIdentifier=58118, DemDidDataClassRef=DID_0xe306_DID_E306_Motor_Temperature
      below (DemEnableCondition): DemEnableConditionId=66, DemEnableConditionStatus=true
      DID_E346_ECM_Torque_Allowed_Status (DemDidClass): DemDidIdentifier=58182, DemDidDataClassRef=DID_0xe346_DID_E346_ECM_Torque_Allowed_Status
      DID_0xe333_2002_Hu (DemDataClass):
        DemDataElementDataSize = 1
        DemDataElementDataType = UINT8_N
        DemDataElementEndianness = opaque
        DemDataElementUsePort = USE_DATA_CLIENT_SERVER_PORT
        DemDataElementStoreNonVolatile = true
      system (DemEnableCondition): DemEnableConditionId=138, DemEnableConditionStatus=true
      DID_0xe333_2002_Hw (DemDataClass):
        DemDataElementDataSize = 1
        DemDataElementDataType = UINT8_N
        DemDataElementEndianness = opaque
        DemDataElementUsePort = USE_DATA_CLIENT_SERVER_PORT
        DemDataElementStoreNonVolatile = true
      EnableConditionGroup_30df4d87 (DemEnableConditionGroup):
        DemEnableConditionRef = Inverter
        DemEnableConditionRef = KL15
        DemEnableConditionRef = LV
        DemEnableConditionRef = No
        DemEnableConditionRef = active
        DemEnableConditionRef = done
        DemEnableConditionRef = fault
        DemEnableConditionRef = initliazation
        DemEnableConditionRef = is
        DemEnableConditionRef = resolver
      DID_0xe333_2002_Hv (DemDataClass):
        DemDataElementDataSize = 1
        DemDataElementDataType = UINT8_N
        DemDataElementEndianness = opaque
        DemDataElementUsePort = USE_DATA_CLIENT_SERVER_PORT
        DemDataElementStoreNonVolatile = true
      4 x DemEnableCondition, all with DemEnableConditionStatus=true:
        Voltage9: DemEnableConditionId=52
        for: DemEnableConditionId=89
        error: DemEnableConditionId=83
        INV_IAC_V_ELEC_HI: DemEnableConditionId=27
      DID_0xe314_DID_E314_Available_Torque_maximum (DemDataClass):
        DemDataElementDataSize = 2
        DemDataElementDataType = UINT16
        DemDataElementEndianness = BIG_ENDIAN
        DemDataElementUsePort = USE_DATA_CLIENT_SERVER_PORT
        DemDataElementStoreNonVolatile = true
      passed (DemEnableCondition): DemEnableConditionId=120, DemEnableConditionStatus=true
      OperCycCnt5_OperCycCnt5 (DemDataClass): DemDataElementDataSize=1, DemDataElementInternalData=DEM_OCCCTR, DemDataElementUsePort=USE_DATA_INTERNAL, DemDataElementStoreNonVolatile=true
      AND (DemEnableCondition): DemEnableConditionId=2, DemEnableConditionStatus=true
      test (DemEnableCondition): DemEnableConditionId=140, DemEnableConditionStatus=true
      DID_E363_Modulation_index (DemDidClass): DemDidIdentifier=58211, DemDidDataClassRef=DID_0xe363_DID_E363_Modulation_index
      OperCycCnt1_OperCycCnt1 (DemDataClass): DemDataElementDataSize=1, DemDataElementInternalData=DEM_OCCCTR, DemDataElementUsePort=USE_DATA_INTERNAL, DemDataElementStoreNonVolatile=true
      be (DemEnableCondition): DemEnableConditionId=65, DemEnableConditionStatus=true
      CAN (DemEnableCondition): DemEnableConditionId=7, DemEnableConditionStatus=true
      DID_EED4_Safty_Function_Mode (DemDidClass): DemDidIdentifier=61140, DemDidDataClassRef=DID_0xeed4_DID_EED4_Safty_Function_Mode
      DID_0xeed4_DID_EED4_Safty_Function_Mode (DemDataClass):
        DemDataElementDataSize = 1
        DemDataElementDataType = UINT8_N
        DemDataElementEndianness = opaque
        DemDataElementUsePort = USE_DATA_CLIENT_SERVER_PORT
        DemDataElementStoreNonVolatile = true
      power (DemEnableCondition): DemEnableConditionId=122, DemEnableConditionStatus=true
      OperCycCnt3_OperCycCnt3 (DemDataClass): DemDataElementDataSize=1, DemDataElementInternalData=DEM_OCCCTR, DemDataElementUsePort=USE_DATA_INTERNAL, DemDataElementStoreNonVolatile=true
      DID_EE9D_Transient_Phase_Current_B (DemDidClass): DemDidIdentifier=61085, DemDidDataClassRef=DID_0xee9d_DID_EE9D_Transient_Phase_Current_B
      DemEventMemorySet
      FreezeFrameClass_c3111450 (DemFreezeFrameClass):
        DemDidClassRef = DID_D003_Vehicle_Speed
        DemDidClassRef = DID_DD00_Global_Real_Time
        DemDidClassRef = DID_DD01_Total_Distance
        DemDidClassRef = DID_DD02_Vehicle_Battery_Voltage
        DemDidClassRef = DID_DD0A_Usage_Mode
        DemDidClassRef = DID_DD0C_Electric_Power_Level
        DemDidClassRef = DID_E300_HVDC_Voltage
        DemDidClassRef = DID_E301_HVDC_Current
        DemDidClassRef = DID_E303_Motor_Speed
        DemDidClassRef = DID_E304_Actual_Torque
        DemDidClassRef = DID_E305_Inverter_IGBT_Junction_Temp
        DemDidClassRef = DID_E306_Motor_Temperature
        DemDidClassRef = DID_E307_System_Mode
        DemDidClassRef = DID_E308_ECM_Torque_Request
        DemDidClassRef = DID_E309_ECM_Mode_Request
        DemDidClassRef = DID_E310_IEM_MGM_Derating_Status
        DemDidClassRef = DID_E311_Crash_Status
        DemDidClassRef = DID_E312_Wheel_Speed
        DemDidClassRef = DID_E313_Active_discharge_status
        DemDidClassRef = DID_E314_Available_Torque_maximum
        DemDidClassRef = DID_E315_Available_Torque_minimum
        DemDidClassRef = DID_E319_Torque_Direction
        DemDidClassRef = DID_E320_System_Mode_Mismatch
        DemDidClassRef = DID_E324_Motor_Derating_reason_of_IEM_MGM
        DemDidClassRef = DID_E333_2002_State
        DemDidClassRef = DID_E335_d_axis_current_setpoint
        DemDidClassRef = DID_E336_d_axis_current_feedback
        DemDidClassRef = DID_E337_q_axis_current_setpoint
        DemDidClassRef = DID_E338_q_axis_current_feedback
        DemDidClassRef = DID_E339_d_axis_voltage
        DemDidClassRef = DID_E341_q_axis_voltage
        DemDidClassRef = DID_E346_ECM_Torque_Allowed_Status
        DemDidClassRef = DID_E347_IGBT_Max_Temperature
        DemDidClassRef = DID_E348_Phase_U_PWM_duty
        DemDidClassRef = DID_E349_Phase_V_PWM_duty
        DemDidClassRef = DID_E350_Phase_W_PWM_duty
        DemDidClassRef = DID_E353_Flux_weakening_correction_factor
        DemDidClassRef = DID_E357_Resolve_compensated_angle
        DemDidClassRef = DID_E358_Resolve_angle
        DemDidClassRef = DID_E363_Modulation_index
        DemDidClassRef = DID_E364_AURIX_Fault_Indication
        DemDidClassRef = DID_EE9A_Inverter_Coolant_Temperature
        DemDidClassRef = DID_EE9C_Transient_Phase_Current_A
        DemDidClassRef = DID_EE9D_Transient_Phase_Current_B
        DemDidClassRef = DID_EE9E_Transient_Phase_Current_C
        DemDidClassRef = DID_EE9F_Gate_Status
        DemDidClassRef = DID_EEB2_Three_Phase_Motor_Current_RMS_Current
        DemDidClassRef = DID_EEB5_IEM_MGM_current_torque
        DemDidClassRef = DID_EEB6_ECM_Power_Limitation_maximum
        DemDidClassRef = DID_EEB7_ECM_Power_Limitation_minimum
        DemDidClassRef = DID_EEB8_HV_voltage_received_from_BECM
        DemDidClassRef = DID_EEBE_Offset_angle_status
        DemDidClassRef = DID_EEBF_HV_Main_Relay_Status
        DemDidClassRef = DID_EEC3_ECU_power_supply_Voltage
        DemDidClassRef = DID_EEC4_Charging_Power_Sustain_Relay_CPSR_Voltage
      3 x DemEnableCondition, all with DemEnableConditionStatus=true:
        DTC: DemEnableConditionId=13
        torque: DemEnableConditionId=146
        no_001: DemEnableConditionId=107
      DID_0xd003_DID_D003_Vehicle_Speed (DemDataClass):
        DemDataElementDataSize = 2
        DemDataElementDataType = UINT16
        DemDataElementEndianness = BIG_ENDIAN
        DemDataElementUsePort = USE_DATA_CLIENT_SERVER_PORT
        DemDataElementStoreNonVolatile = true
      DID_DD02_Vehicle_Battery_Voltage (DemDidClass): DemDidIdentifier=56578, DemDidDataClassRef=DID_0xdd02_DID_DD02_Vehicle_Battery_Voltage
      by (DemEnableCondition): DemEnableConditionId=69, DemEnableConditionStatus=true
      DID_0xe303_DID_E303_Motor_Speed_ (DemDataClass):
        DemDataElementDataSize = 2
        DemDataElementDataType = UINT16
        DemDataElementEndianness = BIG_ENDIAN
        DemDataElementUsePort = USE_DATA_CLIENT_SERVER_PORT
        DemDataElementStoreNonVolatile = true
      DID_E312_Wheel_Speed (DemDidClass): DemDidIdentifier=58130, DemDidDataClassRef=DID_0xe312_DID_E312_Wheel_Speed
      EnableConditionGroup_3b30fb61 (DemEnableConditionGroup):
        DemEnableConditionRef = Request
        DemEnableConditionRef = active
        DemEnableConditionRef = active
        DemEnableConditionRef = discharge
        DemEnableConditionRef = for
        DemEnableConditionRef = is
      Factory (DemEnableCondition): DemEnableConditionId=20, DemEnableConditionStatus=true
      DID_EEB8_HV_voltage_received_from_BECM (DemDidClass): DemDidIdentifier=61112, DemDidDataClassRef=DID_0xeeb8_DID_EEB8_HV_voltage_received_from_BECM
      DID_0xe353_DID_E353_Flux_weakening_correction_factor (DemDataClass):
        DemDataElementDataSize = 2
        DemDataElementDataType = UINT16
        DemDataElementEndianness = BIG_ENDIAN
        DemDataElementUsePort = USE_DATA_CLIENT_SERVER_PORT
        DemDataElementStoreNonVolatile = true
      4 x DemEnableCondition, all with DemEnableConditionStatus=true:
        Crash: DemEnableConditionId=12
        shall: DemEnableConditionId=134
        vehicle: DemEnableConditionId=151
        range: DemEnableConditionId=123
      EnableConditionGroup_f2368ecb (DemEnableConditionGroup):
        DemEnableConditionRef = CU
        DemEnableConditionRef = CU
        DemEnableConditionRef = Inverter
        DemEnableConditionRef = KL15
        DemEnableConditionRef = LV
        DemEnableConditionRef = No
        DemEnableConditionRef = No
        DemEnableConditionRef = active
        DemEnableConditionRef = done
        DemEnableConditionRef = fault
        DemEnableConditionRef = fault
        DemEnableConditionRef = high
        DemEnableConditionRef = initliazation
        DemEnableConditionRef = is
        DemEnableConditionRef = low
        DemEnableConditionRef = range
        DemEnableConditionRef = range
        DemEnableConditionRef = temp
        DemEnableConditionRef = temp
      3 x DemEnableCondition, all with DemEnableConditionStatus=true:
        all: DemEnableConditionId=58
        Inverter: DemEnableConditionId=31
        Car_001: DemEnableConditionId=10
      DID_0xe306_DID_E306_Motor_Temperature (DemDataClass): DemDataElementDataSize=1, DemDataElementDataType=UINT8, DemDataElementUsePort=USE_DATA_CLIENT_SERVER_PORT, DemDataElementStoreNonVolatile=true
      DID_0xe363_DID_E363_Modulation_index (DemDataClass): DemDataElementDataSize=1, DemDataElementDataType=UINT8, DemDataElementUsePort=USE_DATA_CLIENT_SERVER_PORT, DemDataElementStoreNonVolatile=true
      Request (DemEnableCondition): DemEnableConditionId=43, DemEnableConditionStatus=true
      EnableConditionGroup_d8c05f30 (DemEnableConditionGroup):
        DemEnableConditionRef = HVAC
        DemEnableConditionRef = Inverter
        DemEnableConditionRef = KL15
        DemEnableConditionRef = LV
        DemEnableConditionRef = NO_002
        DemEnableConditionRef = SpdAct
        DemEnableConditionRef = abs
        DemEnableConditionRef = active
        DemEnableConditionRef = current
        DemEnableConditionRef = done
        DemEnableConditionRef = fault
        DemEnableConditionRef = initliazation
        DemEnableConditionRef = is
        DemEnableConditionRef = rpm
        DemEnableConditionRef = sensor
      DID_0xe349_DID_E349_Phase_V_PWM_duty (DemDataClass): DemDataElementDataSize=1, DemDataElementDataType=UINT8, DemDataElementUsePort=USE_DATA_CLIENT_SERVER_PORT, DemDataElementStoreNonVolatile=true
      DID_E341_q_axis_voltage (DemDidClass): DemDidIdentifier=58177, DemDidDataClassRef=DID_0xe341_DID_E341_q_axis_voltage
      EnableConditionGroup_b321d2d1 (DemEnableConditionGroup):
        DemEnableConditionRef = Bulk
        DemEnableConditionRef = Car_001
        DemEnableConditionRef = Configuration
        DemEnableConditionRef = ECU
        DemEnableConditionRef = Enabled
        DemEnableConditionRef = Test_001
        DemEnableConditionRef = Test_001
        DemEnableConditionRef = a_001
        DemEnableConditionRef = block
        DemEnableConditionRef = each
        DemEnableConditionRef = in
        DemEnableConditionRef = inhibited
        DemEnableConditionRef = is
        DemEnableConditionRef = is
        DemEnableConditionRef = is
        DemEnableConditionRef = once
        DemEnableConditionRef = passed
        DemEnableConditionRef = received
        DemEnableConditionRef = runs
        DemEnableConditionRef = state
        DemEnableConditionRef = time
        DemEnableConditionRef = while
      DID_E357_Resolve_compensated_angle (DemDidClass): DemDidIdentifier=58199, DemDidDataClassRef=DID_0xe357_DID_E357_Resolve_compensated_angle
      SPI (DemEnableCondition): DemEnableConditionId=44, DemEnableConditionStatus=true
      DID_0xdd02_DID_DD02_Vehicle_Battery_Voltage (DemDataClass): DemDataElementDataSize=1, DemDataElementDataType=UINT8, DemDataElementUsePort=USE_DATA_CLIENT_SERVER_PORT, DemDataElementStoreNonVolatile=true
      CU (DemEnableCondition): DemEnableConditionId=8, DemEnableConditionStatus=true
      EnableConditionGroup_7cfce1b1 (DemEnableConditionGroup):
        DemEnableConditionRef = Inverter
        DemEnableConditionRef = LV
        DemEnableConditionRef = PS
        DemEnableConditionRef = V
        DemEnableConditionRef = done
        DemEnableConditionRef = fault
        DemEnableConditionRef = initliazation
        DemEnableConditionRef = is
        DemEnableConditionRef = no_001
      5 x DemEnableCondition, all with DemEnableConditionStatus=true:
        change: DemEnableConditionId=71
        INV_IAC_W_ELEC_LO: DemEnableConditionId=30
        exceptions: DemEnableConditionId=84
        to: DemEnableConditionId=145
        ECU: DemEnableConditionId=16
      DemPostbuild: DemEventAvailableDefaultSupport=true, DemMaxSizeFreezeFrame=102, DemMaxNumberDtr=0, DemMaxSizeGlobalFreezeFrame=0
      DID_DD0C_Electric_Power_Level (DemDidClass): DemDidIdentifier=56588, DemDidDataClassRef=DID_0xdd0c_DID_DD0C_Electric_Power_Level
      DTCTimeStamp21_DTCTimeStamp21 (DemDataClass):
        DemDataElementDataSize = 4
        DemDataElementDataType = UINT32
        DemDataElementEndianness = BIG_ENDIAN
        DemDataElementUsePort = USE_DATA_CLIENT_SERVER_PORT
        DemDataElementStoreNonVolatile = true
      DID_0xe347_DID_E347_IGBT_Max_Temperature (DemDataClass): DemDataElementDataSize=1, DemDataElementDataType=UINT8, DemDataElementUsePort=USE_DATA_CLIENT_SERVER_PORT, DemDataElementStoreNonVolatile=true
      PS (DemEnableCondition): DemEnableConditionId=41, DemEnableConditionStatus=true
      DID_E319_Torque_Direction (DemDidClass): DemDidIdentifier=58137, DemDidDataClassRef=DID_0xe319_DID_E319_Torque_Direction
      DID_0xeeb5_DID_EEB5_IEMMGM_current_torque (DemDataClass):
        DemDataElementDataSize = 2
        DemDataElementDataType = UINT16
        DemDataElementEndianness = BIG_ENDIAN
        DemDataElementUsePort = USE_DATA_CLIENT_SERVER_PORT
        DemDataElementStoreNonVolatile = true
      DID_0xeebe_DID_EEBE_Offset_angle_status (DemDataClass): DemDataElementDataSize=1, DemDataElementDataType=UINT8, DemDataElementUsePort=USE_DATA_CLIENT_SERVER_PORT, DemDataElementStoreNonVolatile=true
      off (DemEnableCondition): DemEnableConditionId=113, DemEnableConditionStatus=true
      DID_0xe338_DID_E338_q_axis_current_feedback (DemDataClass):
        DemDataElementDataSize = 2
        DemDataElementDataType = UINT16
        DemDataElementEndianness = BIG_ENDIAN
        DemDataElementUsePort = USE_DATA_CLIENT_SERVER_PORT
        DemDataElementStoreNonVolatile = true
      5 x DemEnableCondition, all with DemEnableConditionStatus=true:
        Bulk: DemEnableConditionId=5
        availability: DemEnableConditionId=64
        generic: DemEnableConditionId=92
        with: DemEnableConditionId=154
        modes: DemEnableConditionId=105
      DID_DD0A_Usage_Mode (DemDidClass): DemDidIdentifier=56586, DemDidDataClassRef=DID_0xdd0a_DID_DD0A_Usage_Mode
      EnableConditionGroup_361fad53 (DemEnableConditionGroup):
        DemEnableConditionRef = IGBT
        DemEnableConditionRef = Inverter
        DemEnableConditionRef = LV
        DemEnableConditionRef = No
        DemEnableConditionRef = No
        DemEnableConditionRef = control
        DemEnableConditionRef = current
        DemEnableConditionRef = done
        DemEnableConditionRef = error
        DemEnableConditionRef = faults
        DemEnableConditionRef = faults
        DemEnableConditionRef = in
        DemEnableConditionRef = initliazation
        DemEnableConditionRef = is
        DemEnableConditionRef = mode
        DemEnableConditionRef = no_001
        DemEnableConditionRef = resolver
        DemEnableConditionRef = sensor
        DemEnableConditionRef = system
        DemEnableConditionRef = torque
      Driving (DemEnableCondition): DemEnableConditionId=14, DemEnableConditionStatus=true
      notational (DemEnableCondition): DemEnableConditionId=111, DemEnableConditionStatus=true
      DID_E324_Motor_Derating_reason_of_IEM_MGM (DemDidClass): DemDidIdentifier=58148, DemDidDataClassRef=DID_0xe324_DID_E324_Motor_Derating_reason_of_IEMMGM
      All_001 (DemEnableCondition): DemEnableConditionId=4, DemEnableConditionStatus=true
      Test_001 (DemEnableCondition): DemEnableConditionId=46, DemEnableConditionStatus=true
      DID_0xee9d_DID_EE9D_Transient_Phase_Current_B (DemDataClass):
        DemDataElementDataSize = 2
        DemDataElementDataType = UINT16
        DemDataElementEndianness = BIG_ENDIAN
        DemDataElementUsePort = USE_DATA_CLIENT_SERVER_PORT
        DemDataElementStoreNonVolatile = true
      DID_0xe336_DID_E336_d_axis_current_feedback (DemDataClass):
        DemDataElementDataSize = 2
        DemDataElementDataType = UINT16
        DemDataElementEndianness = BIG_ENDIAN
        DemDataElementUsePort = USE_DATA_CLIENT_SERVER_PORT
        DemDataElementStoreNonVolatile = true
      3 x DemEnableCondition, all with DemEnableConditionStatus=true:
        signal: DemEnableConditionId=135
        time: DemEnableConditionId=144
        operation: DemEnableConditionId=117
      DID_E348_Phase_U_PWM_duty (DemDidClass): DemDidIdentifier=58184, DemDidDataClassRef=DID_0xe348_DID_E348_Phase_U_PWM_duty
      FreezeFrameClass_79980272 (DemFreezeFrameClass):
        DemDidClassRef = DID_D003_Vehicle_Speed
        DemDidClassRef = DID_DD00_Global_Real_Time
        DemDidClassRef = DID_DD01_Total_Distance
        DemDidClassRef = DID_DD02_Vehicle_Battery_Voltage
        DemDidClassRef = DID_DD0A_Usage_Mode
        DemDidClassRef = DID_DD0C_Electric_Power_Level
        DemDidClassRef = DID_E300_HVDC_Voltage
        DemDidClassRef = DID_E301_HVDC_Current
        DemDidClassRef = DID_E303_Motor_Speed
        DemDidClassRef = DID_E304_Actual_Torque
        DemDidClassRef = DID_E305_Inverter_IGBT_Junction_Temp
        DemDidClassRef = DID_E306_Motor_Temperature
        DemDidClassRef = DID_E307_System_Mode
        DemDidClassRef = DID_E308_ECM_Torque_Request
        DemDidClassRef = DID_E309_ECM_Mode_Request
        DemDidClassRef = DID_E310_IEM_MGM_Derating_Status
        DemDidClassRef = DID_E311_Crash_Status
        DemDidClassRef = DID_E312_Wheel_Speed
        DemDidClassRef = DID_E313_Active_discharge_status
        DemDidClassRef = DID_E314_Available_Torque_maximum
        DemDidClassRef = DID_E315_Available_Torque_minimum
        DemDidClassRef = DID_E319_Torque_Direction
        DemDidClassRef = DID_E320_System_Mode_Mismatch
        DemDidClassRef = DID_E324_Motor_Derating_reason_of_IEM_MGM
        DemDidClassRef = DID_E333_2002_State
        DemDidClassRef = DID_E335_d_axis_current_setpoint
        DemDidClassRef = DID_E336_d_axis_current_feedback
        DemDidClassRef = DID_E337_q_axis_current_setpoint
        DemDidClassRef = DID_E338_q_axis_current_feedback
        DemDidClassRef = DID_E339_d_axis_voltage
        DemDidClassRef = DID_E341_q_axis_voltage
        DemDidClassRef = DID_E346_ECM_Torque_Allowed_Status
        DemDidClassRef = DID_E347_IGBT_Max_Temperature
        DemDidClassRef = DID_E348_Phase_U_PWM_duty
        DemDidClassRef = DID_E349_Phase_V_PWM_duty
        DemDidClassRef = DID_E350_Phase_W_PWM_duty
        DemDidClassRef = DID_E353_Flux_weakening_correction_factor
        DemDidClassRef = DID_E357_Resolve_compensated_angle
        DemDidClassRef = DID_E358_Resolve_angle
        DemDidClassRef = DID_E363_Modulation_index
        DemDidClassRef = DID_E364_AURIX_Fault_Indication
        DemDidClassRef = DID_EE9A_Inverter_Coolant_Temperature
        DemDidClassRef = DID_EE9C_Transient_Phase_Current_A
        DemDidClassRef = DID_EE9D_Transient_Phase_Current_B
        DemDidClassRef = DID_EE9E_Transient_Phase_Current_C
        DemDidClassRef = DID_EE9F_Gate_Status
        DemDidClassRef = DID_EEB2_Three_Phase_Motor_Current_RMS_Current
        DemDidClassRef = DID_EEB5_IEM_MGM_current_torque
      EnableConditionGroup_57b85250 (DemEnableConditionGroup):
        DemEnableConditionRef = CU_temp
        DemEnableConditionRef = Inverter
        DemEnableConditionRef = KL15
        DemEnableConditionRef = LV
        DemEnableConditionRef = No
        DemEnableConditionRef = active
        DemEnableConditionRef = done
        DemEnableConditionRef = fault
        DemEnableConditionRef = initliazation
        DemEnableConditionRef = is
      indicated (DemEnableCondition): DemEnableConditionId=96, DemEnableConditionStatus=true
      DTCfaultdetectioncounter_DTCFltDetCnt (DemDataClass): DemDataElementDataSize=1, DemDataElementInternalData=DEM_CURRENT_FDC, DemDataElementUsePort=USE_DATA_INTERNAL, DemDataElementStoreNonVolatile=true
      3 x DemEnableCondition, all with DemEnableConditionStatus=true:
        UsageMode: DemEnableConditionId=50
        low: DemEnableConditionId=103
        inhibited: DemEnableConditionId=97
      DID_EE9A_Inverter_Coolant_Temperature (DemDidClass): DemDidIdentifier=61082, DemDidDataClassRef=DID_0xee9a_DID_EE9A_Inverter_Coolant_Temperature
      OperCycCnt5 (DemExtendedDataRecordClass): DemExtendedDataRecordNumber=5, DemDataClassRef=OperCycCnt5_OperCycCnt5
      OperCycCnt4 (DemExtendedDataRecordClass): DemExtendedDataRecordNumber=4, DemDataClassRef=OperCycCnt4_OperCycCnt4
      as (DemEnableCondition): DemEnableConditionId=62, DemEnableConditionStatus=true
      OperCycCnt6 (DemExtendedDataRecordClass): DemExtendedDataRecordNumber=6, DemDataClassRef=OperCycCnt6_OperCycCnt6
      at (DemEnableCondition): DemEnableConditionId=63, DemEnableConditionStatus=true
      DID_0xe348_DID_E348_Phase_U_PWM_duty (DemDataClass): DemDataElementDataSize=1, DemDataElementDataType=UINT8, DemDataElementUsePort=USE_DATA_CLIENT_SERVER_PORT, DemDataElementStoreNonVolatile=true
      OperCycCnt1 (DemExtendedDataRecordClass): DemExtendedDataRecordNumber=1, DemDataClassRef=OperCycCnt1_OperCycCnt1
      INV_EM_STATOR_TEMP_RNG_LO (DemEnableCondition): DemEnableConditionId=24, DemEnableConditionStatus=true
      OperCycCnt3 (DemExtendedDataRecordClass): DemExtendedDataRecordNumber=3, DemDataClassRef=OperCycCnt3_OperCycCnt3
      OperCycCnt2 (DemExtendedDataRecordClass): DemExtendedDataRecordNumber=2, DemDataClassRef=OperCycCnt2_OperCycCnt2
      DID_E349_Phase_V_PWM_duty (DemDidClass): DemDidIdentifier=58185, DemDidDataClassRef=DID_0xe349_DID_E349_Phase_V_PWM_duty
      init (DemEnableCondition): DemEnableConditionId=99, DemEnableConditionStatus=true
      DID_EE9F_Gate_Status (DemDidClass): DemDidIdentifier=61087, DemDidDataClassRef=DID_0xee9f_DID_EE9F_Gate_Status
      DID_EEC3_ECU_power_supply_Voltage (DemDidClass): DemDidIdentifier=61123, DemDidDataClassRef=DID_0xeec3_DID_EEC3_ECU_power_supply_Voltage
      normallye (DemEnableCondition): DemEnableConditionId=109, DemEnableConditionStatus=true
      DID_0xe350_DID_E350_Phase_W_PWM_duty (DemDataClass): DemDataElementDataSize=1, DemDataElementDataType=UINT8, DemDataElementUsePort=USE_DATA_CLIENT_SERVER_PORT, DemDataElementStoreNonVolatile=true
      requested (DemEnableCondition): DemEnableConditionId=125, DemEnableConditionStatus=true
      current (DemEnableCondition): DemEnableConditionId=76, DemEnableConditionStatus=true
      DTCTimeStamp20_DTCTimeStamp20 (DemDataClass):
        DemDataElementDataSize = 4
        DemDataElementDataType = UINT32
        DemDataElementEndianness = BIG_ENDIAN
        DemDataElementUsePort = USE_DATA_CLIENT_SERVER_PORT
        DemDataElementStoreNonVolatile = true
      EnableConditionGroup_0cc796ea (DemEnableConditionGroup):
        DemEnableConditionRef = KL15
        DemEnableConditionRef = active
        DemEnableConditionRef = in
        DemEnableConditionRef = mode
        DemEnableConditionRef = mode
        DemEnableConditionRef = operation
      EnableConditionGroup_16bf7de5 (DemEnableConditionGroup):
        DemEnableConditionRef = ECU
        DemEnableConditionRef = Every
        DemEnableConditionRef = a_001
        DemEnableConditionRef = configuration_001
        DemEnableConditionRef = configuration_001
        DemEnableConditionRef = for
        DemEnableConditionRef = global
        DemEnableConditionRef = is
        DemEnableConditionRef = of
        DemEnableConditionRef = parameter
        DemEnableConditionRef = passed
        DemEnableConditionRef = received
        DemEnableConditionRef = test
        DemEnableConditionRef = the
        DemEnableConditionRef = time
        DemEnableConditionRef = until
        DemEnableConditionRef = used
      DID_DD00_Global_Real_Time (DemDidClass): DemDidIdentifier=56576, DemDidDataClassRef=DID_0xdd00_DID_DD00_Global_Real_Time
      exit (DemEnableCondition): DemEnableConditionId=85, DemEnableConditionStatus=true
      DID_0xe333_2002_H_Ser (DemDataClass): DemDataElementDataSize=1, DemDataElementDataType=UINT8, DemDataElementUsePort=USE_DATA_CLIENT_SERVER_PORT, DemDataElementStoreNonVolatile=true
      toruqe (DemEnableCondition): DemEnableConditionId=147, DemEnableConditionStatus=true
      EnableConditionGroup_2747052a (DemEnableConditionGroup):
        DemEnableConditionRef = Inverter
        DemEnableConditionRef = KL15
        DemEnableConditionRef = LV
        DemEnableConditionRef = P5
        DemEnableConditionRef = active
        DemEnableConditionRef = done
        DemEnableConditionRef = initliazation
        DemEnableConditionRef = is
        DemEnableConditionRef = normally
        DemEnableConditionRef = work
      work (DemEnableCondition): DemEnableConditionId=155, DemEnableConditionStatus=true
      DID_0xeec4_DID_EEC4_Charging_Power_Sustain_RelayCPSR_Voltage (DemDataClass): DemDataElementDataSize=1, DemDataElementDataType=UINT8, DemDataElementUsePort=USE_DATA_CLIENT_SERVER_PORT, DemDataElementStoreNonVolatile=true
      configuration_001 (DemEnableCondition): DemEnableConditionId=72, DemEnableConditionStatus=true
      according (DemEnableCondition): DemEnableConditionId=56, DemEnableConditionStatus=true
      EnableConditionGroup_90577524 (DemEnableConditionGroup):
        DemEnableConditionRef = DemGeneral/INV_EM_STATOR_TEMP_RNG_HI
        DemEnableConditionRef = DemGeneral/INV_EM_STATOR_TEMP_RNG_LO
        DemEnableConditionRef = Inverter
        DemEnableConditionRef = KL15
        DemEnableConditionRef = LV
        DemEnableConditionRef = No
        DemEnableConditionRef = No
        DemEnableConditionRef = active
        DemEnableConditionRef = done
        DemEnableConditionRef = initliazation
        DemEnableConditionRef = is
      7 x DemDidClass:
        DID_E315_Available_Torque_minimum: DemDidIdentifier=58133, DemDidDataClassRef=DID_0xe315_DID_E315_Available_Torque_minimum
        DID_E311_Crash_Status: DemDidIdentifier=58129, DemDidDataClassRef=DID_0xe311_DID_E311_Crash_Status
        DID_EEBE_Offset_angle_status: DemDidIdentifier=61118, DemDidDataClassRef=DID_0xeebe_DID_EEBE_Offset_angle_status
        DID_E338_q_axis_current_feedback: DemDidIdentifier=58168, DemDidDataClassRef=DID_0xe338_DID_E338_q_axis_current_feedback
        DID_E308_ECM_Torque_Request: DemDidIdentifier=58120, DemDidDataClassRef=DID_0xe308_DID_E308_ECM_Torque_Request
        DID_E347_IGBT_Max_Temperature: DemDidIdentifier=58183, DemDidDataClassRef=DID_0xe347_DID_E347_IGBT_Max_Temperature
        DID_E314_Available_Torque_maximum: DemDidIdentifier=58132, DemDidDataClassRef=DID_0xe314_DID_E314_Available_Torque_maximum
      electrical (DemEnableCondition): DemEnableConditionId=81, DemEnableConditionStatus=true
      DID_0xe346_DID_E346_ECM_Torque_Allowed_Status (DemDataClass): DemDataElementDataSize=1, DemDataElementDataType=UINT8, DemDataElementUsePort=USE_DATA_CLIENT_SERVER_PORT, DemDataElementStoreNonVolatile=true
      MaxDTCSinClear (DemExtendedDataRecordClass): DemExtendedDataRecordNumber=18, DemDataClassRef=MaxDTCSinClear_MaxDTCSinClear
      DID_0xe313_DID_E313_Active_discharge_status (DemDataClass): DemDataElementDataSize=1, DemDataElementDataType=UINT8, DemDataElementUsePort=USE_DATA_CLIENT_SERVER_PORT, DemDataElementStoreNonVolatile=true
      INV_IAC_W_ELEC_HI (DemEnableCondition): DemEnableConditionId=29, DemEnableConditionStatus=true
      DID_EE9E_Transient_Phase_Current_C (DemDidClass): DemDidIdentifier=61086, DemDidDataClassRef=DID_0xee9e_DID_EE9E_Transient_Phase_Current_C
      3 x DemEnableCondition, all with DemEnableConditionStatus=true:
        KL15: DemEnableConditionId=32
        Every: DemEnableConditionId=19
        rpm: DemEnableConditionId=127
      DID_EEB2_Three_Phase_Motor_Current_RMS_Current (DemDidClass): DemDidIdentifier=61106, DemDidDataClassRef=DID_0xeeb2_DID_EEB2_Three_Phase_Motor_Current_RMS_Current
      EnableConditionGroup_d38dfb27 (DemEnableConditionGroup):
        DemEnableConditionRef = Inverter
        DemEnableConditionRef = KL15
        DemEnableConditionRef = LV
        DemEnableConditionRef = P5
        DemEnableConditionRef = active
        DemEnableConditionRef = done
        DemEnableConditionRef = initliazation
        DemEnableConditionRef = is
        DemEnableConditionRef = normallye
        DemEnableConditionRef = work
      any (DemEnableCondition): DemEnableConditionId=61, DemEnableConditionStatus=true
      DID_E304_Actual_Torque (DemDidClass): DemDidIdentifier=58116, DemDidDataClassRef=DID_0xe304_DID_E304_Actual_Torque
      runs (DemEnableCondition): DemEnableConditionId=129, DemEnableConditionStatus=true
      ExtendedDataClass_5ecd55b9 (DemExtendedDataClass):
        DemExtendedDataRecordClassRef = OperCycCnt{1..6}
        DemExtendedDataRecordClassRef = DTCfaultdetectioncounter
        DemExtendedDataRecordClassRef = MaxDTCDetCntThisCycle
        DemExtendedDataRecordClassRef = MaxDTCSinClear
        DemExtendedDataRecordClassRef = DTCTimeStamp20
        DemExtendedDataRecordClassRef = DTCTimeStamp21
        DemExtendedDataRecordClassRef = DTCStatusindicator30
      EnableConditionGroup_9e78dd86 (DemEnableConditionGroup):
        DemEnableConditionRef = Inverter
        DemEnableConditionRef = KL15
        DemEnableConditionRef = LV
        DemEnableConditionRef = No
        DemEnableConditionRef = P5
        DemEnableConditionRef = active
        DemEnableConditionRef = current
        DemEnableConditionRef = done
        DemEnableConditionRef = faults
        DemEnableConditionRef = initliazation
        DemEnableConditionRef = is
        DemEnableConditionRef = normally
        DemEnableConditionRef = sensor
        DemEnableConditionRef = work
      EnableConditionGroup_6698c395 (DemEnableConditionGroup):
        DemEnableConditionRef = Inverter
        DemEnableConditionRef = KL15
        DemEnableConditionRef = LV
        DemEnableConditionRef = active
        DemEnableConditionRef = done
        DemEnableConditionRef = error
        DemEnableConditionRef = initliazation
        DemEnableConditionRef = is
        DemEnableConditionRef = no_001
        DemEnableConditionRef = resolver
      DID_E350_Phase_W_PWM_duty (DemDidClass): DemDidIdentifier=58192, DemDidDataClassRef=DID_0xe350_DID_E350_Phase_W_PWM_duty
      When (DemEnableCondition): DemEnableConditionId=53, DemEnableConditionStatus=true
      car (DemEnableCondition): DemEnableConditionId=70, DemEnableConditionStatus=true
      DID_E335_d_axis_current_setpoint (DemDidClass): DemDidIdentifier=58165, DemDidDataClassRef=DID_0xe335_DID_E335_d_axis_current_setpoint
      EnableConditionGroup_c56dc4a6 (DemEnableConditionGroup): DemEnableConditionRef=KL15, DemEnableConditionRef=active, DemEnableConditionRef=init, DemEnableConditionRef=test
      DID_E320_System_Mode_Mismatch (DemDidClass): DemDidIdentifier=58144, DemDidDataClassRef=DID_0xe320_DID_E320_System_Mode_Mismatch
      DID_0xe311_DID_E311_Crash_Status (DemDataClass): DemDataElementDataSize=1, DemDataElementDataType=UINT8, DemDataElementUsePort=USE_DATA_CLIENT_SERVER_PORT, DemDataElementStoreNonVolatile=true
      EnableConditionGroup_d13c1487 (DemEnableConditionGroup):
        DemEnableConditionRef = E
        DemEnableConditionRef = Inverter
        DemEnableConditionRef = KL15
        DemEnableConditionRef = LV
        DemEnableConditionRef = No
        DemEnableConditionRef = active
        DemEnableConditionRef = done
        DemEnableConditionRef = faults
        DemEnableConditionRef = initliazation
        DemEnableConditionRef = is
        DemEnableConditionRef = motor
        DemEnableConditionRef = sensor
      EnableConditionGroup_830522f7 (DemEnableConditionGroup): DemEnableConditionRef=AND, DemEnableConditionRef=Driving, DemEnableConditionRef=Ubat, DemEnableConditionRef=UsageMode, DemEnableConditionRef=V
      not_001 (DemEnableCondition): DemEnableConditionId=110, DemEnableConditionStatus=true
      WarningIndicator (DemIndicator): DemIndicatorID=0
      DID_E310_IEM_MGM_Derating_Status (DemDidClass): DemDidIdentifier=58128, DemDidDataClassRef=DID_0xe310_DID_E310_IEMMGM_Derating_Status
      DID_0xe300_DID_E300_HVDC_Voltage (DemDataClass):
        DemDataElementDataSize = 2
        DemDataElementDataType = UINT16
        DemDataElementEndianness = BIG_ENDIAN
        DemDataElementUsePort = USE_DATA_CLIENT_SERVER_PORT
        DemDataElementStoreNonVolatile = true
      DID_0xe324_DID_E324_Motor_Derating_reason_of_IEMMGM (DemDataClass): DemDataElementDataSize=1, DemDataElementDataType=UINT8, DemDataElementUsePort=USE_DATA_CLIENT_SERVER_PORT, DemDataElementStoreNonVolatile=true
      4 x DemEnableCondition, all with DemEnableConditionStatus=true:
        phase: DemEnableConditionId=121
        active: DemEnableConditionId=57
        normally: DemEnableConditionId=108
        enters: DemEnableConditionId=82
      DID_0xee9f_DID_EE9F_Gate_Status (DemDataClass): DemDataElementDataSize=1, DemDataElementDataType=UINT8, DemDataElementUsePort=USE_DATA_CLIENT_SERVER_PORT, DemDataElementStoreNonVolatile=true
      KL30 (DemEnableCondition): DemEnableConditionId=33, DemEnableConditionStatus=true
      INV_EM_STATOR_TEMP_RNG_HI (DemEnableCondition): DemEnableConditionId=23, DemEnableConditionStatus=true
      3 x DemDataClass, all with DemDataElementStoreNonVolatile=true:
        DID_0xe304_DID_E304_Actual_Torque: DemDataElementDataSize=2, DemDataElementDataType=UINT16, DemDataElementEndianness=BIG_ENDIAN, DemDataElementUsePort=USE_DATA_CLIENT_SERVER_PORT
        OperCycCnt6_OperCycCnt6: DemDataElementDataSize=1, DemDataElementInternalData=DEM_OCCCTR, DemDataElementUsePort=USE_DATA_INTERNAL
        DID_0xe315_DID_E315_Available_Torque_minimum: DemDataElementDataSize=2, DemDataElementDataType=UINT16, DemDataElementEndianness=BIG_ENDIAN, DemDataElementUsePort=USE_DATA_CLIENT_SERVER_PORT
      Configuration (DemEnableCondition): DemEnableConditionId=11, DemEnableConditionStatus=true
      DID_0xeeb8_DID_EEB8_HV_voltage_received_from_BECM (DemDataClass):
        DemDataElementDataSize = 2
        DemDataElementDataType = UINT16
        DemDataElementEndianness = BIG_ENDIAN
        DemDataElementUsePort = USE_DATA_CLIENT_SERVER_PORT
        DemDataElementStoreNonVolatile = true
      Prop (DemEnableCondition): DemEnableConditionId=42, DemEnableConditionStatus=true
      DID_EED3_Safety_speed (DemDidClass): DemDidIdentifier=61139, DemDidDataClassRef=DID_0xeed3_DID_EED3_Safety_speed
      OperCycCnt4_OperCycCnt4 (DemDataClass): DemDataElementDataSize=1, DemDataElementInternalData=DEM_OCCCTR, DemDataElementUsePort=USE_DATA_INTERNAL, DemDataElementStoreNonVolatile=true
      EnableConditionGroup_500f9dc2 (DemEnableConditionGroup):
        DemEnableConditionRef = Inverter
        DemEnableConditionRef = KL15
        DemEnableConditionRef = LV
        DemEnableConditionRef = active
        DemEnableConditionRef = control
        DemEnableConditionRef = done
        DemEnableConditionRef = in
        DemEnableConditionRef = initliazation
        DemEnableConditionRef = is
        DemEnableConditionRef = mode
        DemEnableConditionRef = system
        DemEnableConditionRef = torque
      inhibition (DemEnableCondition): DemEnableConditionId=98, DemEnableConditionStatus=true
      criteria (DemEnableCondition): DemEnableConditionId=75, DemEnableConditionStatus=true
      EnableConditionGroup_06a6aa19 (DemEnableConditionGroup): DemEnableConditionRef=KL15, DemEnableConditionRef=KL30, DemEnableConditionRef=V, DemEnableConditionRef=Voltage9, DemEnableConditionRef=active
      global (DemEnableCondition): DemEnableConditionId=93, DemEnableConditionStatus=true
      OperCycCnt2_OperCycCnt2 (DemDataClass): DemDataElementDataSize=1, DemDataElementInternalData=DEM_OCCCTR, DemDataElementUsePort=USE_DATA_INTERNAL, DemDataElementStoreNonVolatile=true
      CU_temp (DemEnableCondition): DemEnableConditionId=9, DemEnableConditionStatus=true
      done (DemEnableCondition): DemEnableConditionId=78, DemEnableConditionStatus=true
      DID_0xeed5_EED5_Safety_Torque_Quality_factor (DemDataClass):
        DemDataElementDataSize = 1
        DemDataElementDataType = UINT8_N
        DemDataElementEndianness = opaque
        DemDataElementUsePort = USE_DATA_CLIENT_SERVER_PORT
        DemDataElementStoreNonVolatile = true
      Not (DemEnableCondition): DemEnableConditionId=38, DemEnableConditionStatus=true
      DID_EEC4_Charging_Power_Sustain_Relay_CPSR_Voltage (DemDidClass): DemDidIdentifier=61124, DemDidDataClassRef=DID_0xeec4_DID_EEC4_Charging_Power_Sustain_RelayCPSR_Voltage
      DID_E337_q_axis_current_setpoint (DemDidClass): DemDidIdentifier=58167, DemDidDataClassRef=DID_0xe337_DID_E337_q_axis_current_setpoint
      DID_0xe320_DID_E320_System_Mode_Mismatch (DemDataClass): DemDataElementDataSize=1, DemDataElementDataType=UINT8, DemDataElementUsePort=USE_DATA_CLIENT_SERVER_PORT, DemDataElementStoreNonVolatile=true
      another (DemEnableCondition): DemEnableConditionId=60, DemEnableConditionStatus=true
      DID_0xeeb7_DID_EEB7_ECM_Power_Limitation_minimum (DemDataClass):
        DemDataElementDataSize = 2
        DemDataElementDataType = UINT16
        DemDataElementEndianness = BIG_ENDIAN
        DemDataElementUsePort = USE_DATA_CLIENT_SERVER_PORT
        DemDataElementStoreNonVolatile = true
      DID_E300_HVDC_Voltage (DemDidClass): DemDidIdentifier=58112, DemDidDataClassRef=DID_0xe300_DID_E300_HVDC_Voltage
      DID_0xe364_DID_E364_AURIX_Fault_Indication (DemDataClass):
        DemDataElementDataSize = 1
        DemDataElementDataType = UINT8_N
        DemDataElementEndianness = opaque
        DemDataElementUsePort = USE_DATA_CLIENT_SERVER_PORT
        DemDataElementStoreNonVolatile = true
      EnableConditionGroup_1027fc3a (DemEnableConditionGroup):
        DemEnableConditionRef = Inverter
        DemEnableConditionRef = KL15
        DemEnableConditionRef = LV
        DemEnableConditionRef = P15
        DemEnableConditionRef = active
        DemEnableConditionRef = done
        DemEnableConditionRef = fault
        DemEnableConditionRef = initliazation
        DemEnableConditionRef = is
        DemEnableConditionRef = no_001
      Ubat (DemEnableCondition): DemEnableConditionId=49, DemEnableConditionStatus=true
      received (DemEnableCondition): DemEnableConditionId=124, DemEnableConditionStatus=true
      DID_0xeed1_EED1_1 (DemDataClass): DemDataElementDataSize=1, DemDataElementDataType=UINT8, DemDataElementUsePort=USE_DATA_CLIENT_SERVER_PORT, DemDataElementStoreNonVolatile=true
      tests (DemEnableCondition): DemEnableConditionId=141, DemEnableConditionStatus=true
      DID_0xeed1_EED1_0 (DemDataClass): DemDataElementDataSize=1, DemDataElementDataType=UINT8, DemDataElementUsePort=USE_DATA_CLIENT_SERVER_PORT, DemDataElementStoreNonVolatile=true
      DID_0xeed1_EED1_3 (DemDataClass): DemDataElementDataSize=1, DemDataElementDataType=UINT8, DemDataElementUsePort=USE_DATA_CLIENT_SERVER_PORT, DemDataElementStoreNonVolatile=true
      DID_E353_Flux_weakening_correction_factor (DemDidClass): DemDidIdentifier=58195, DemDidDataClassRef=DID_0xe353_DID_E353_Flux_weakening_correction_factor
      DID_0xeed1_EED1_2 (DemDataClass): DemDataElementDataSize=1, DemDataElementDataType=UINT8, DemDataElementUsePort=USE_DATA_CLIENT_SERVER_PORT, DemDataElementStoreNonVolatile=true
      EnableConditionGroup_87177a06 (DemEnableConditionGroup):
        DemEnableConditionRef = CU
        DemEnableConditionRef = Inverter
        DemEnableConditionRef = KL15
        DemEnableConditionRef = LV
        DemEnableConditionRef = active
        DemEnableConditionRef = done
        DemEnableConditionRef = faulte
        DemEnableConditionRef = initliazation
        DemEnableConditionRef = is
        DemEnableConditionRef = no_001
        DemEnableConditionRef = sensor
        DemEnableConditionRef = temp
      from (DemEnableCondition): DemEnableConditionId=90, DemEnableConditionStatus=true
      MaxDTCDetCntThisCycle_MaxDTCDetCntThisCycle (DemDataClass):
        DemDataElementDataSize = 1
        DemDataElementInternalData = DEM_MAX_FDC_DURING_CURRENT_CYCLE
        DemDataElementUsePort = USE_DATA_INTERNAL
        DemDataElementStoreNonVolatile = true
      DID_0xe312_DID_E312_Wheel_Speed (DemDataClass):
        DemDataElementDataSize = 2
        DemDataElementDataType = UINT16
        DemDataElementEndianness = BIG_ENDIAN
        DemDataElementUsePort = USE_DATA_CLIENT_SERVER_PORT
        DemDataElementStoreNonVolatile = true
      DID_EEBF_HV_Main_Relay_Status (DemDidClass): DemDidIdentifier=61119, DemDidDataClassRef=DID_0xeebf_DID_EEBF_HV_Main_Relay_Status
      EnableConditionGroup_fecd1d5c (DemEnableConditionGroup): DemEnableConditionRef=KL15, DemEnableConditionRef=SPI, DemEnableConditionRef=active, DemEnableConditionRef=faults, DemEnableConditionRef=no_001
      EnableConditionGroup_4c1ef766 (DemEnableConditionGroup):
        DemEnableConditionRef = Inverter
        DemEnableConditionRef = KL15
        DemEnableConditionRef = LV
        DemEnableConditionRef = No
        DemEnableConditionRef = P15
        DemEnableConditionRef = P5
        DemEnableConditionRef = active
        DemEnableConditionRef = current
        DemEnableConditionRef = done
        DemEnableConditionRef = faults
        DemEnableConditionRef = initliazation
        DemEnableConditionRef = is
        DemEnableConditionRef = normally
        DemEnableConditionRef = sensor
        DemEnableConditionRef = work
      4 x DemEnableCondition, all with DemEnableConditionStatus=true:
        used: DemEnableConditionId=150
        HVAC: DemEnableConditionId=21
        high: DemEnableConditionId=94
        mode: DemEnableConditionId=104
      EnableConditionGroup_02c4dcbd (DemEnableConditionGroup):
        DemEnableConditionRef = Inverter
        DemEnableConditionRef = LV
        DemEnableConditionRef = control
        DemEnableConditionRef = done
        DemEnableConditionRef = in
        DemEnableConditionRef = initliazation
        DemEnableConditionRef = is
        DemEnableConditionRef = mode
        DemEnableConditionRef = system
        DemEnableConditionRef = torque
      5 x DemEnableCondition, all with DemEnableConditionStatus=true:
        that: DemEnableConditionId=142
        run: DemEnableConditionId=128
        discharge: DemEnableConditionId=77
        until: DemEnableConditionId=149
        during: DemEnableConditionId=79
      EnableConditionGroup_0d30bf3f (DemEnableConditionGroup):
        DemEnableConditionRef = AND
        DemEnableConditionRef = Inverter
        DemEnableConditionRef = KL15
        DemEnableConditionRef = LV
        DemEnableConditionRef = SpdAct
        DemEnableConditionRef = abs
        DemEnableConditionRef = active
        DemEnableConditionRef = any
        DemEnableConditionRef = done
        DemEnableConditionRef = error
        DemEnableConditionRef = in
        DemEnableConditionRef = initliazation
        DemEnableConditionRef = is
        DemEnableConditionRef = no_001
        DemEnableConditionRef = offset
        DemEnableConditionRef = phase
        DemEnableConditionRef = rpm
      SpdAct (DemEnableCondition): DemEnableConditionId=45, DemEnableConditionStatus=true
      INV_IAC_U_ELEC_HI (DemEnableCondition): DemEnableConditionId=25, DemEnableConditionStatus=true
      DID_0xe341_DID_E341_q_axis_voltage (DemDataClass):
        DemDataElementDataSize = 2
        DemDataElementDataType = UINT16
        DemDataElementEndianness = BIG_ENDIAN
        DemDataElementUsePort = USE_DATA_CLIENT_SERVER_PORT
        DemDataElementStoreNonVolatile = true
      DID_0xeed3_DID_EED3_Safety_speed (DemDataClass):
        DemDataElementDataSize = 2
        DemDataElementDataType = UINT16
        DemDataElementEndianness = BIG_ENDIAN
        DemDataElementUsePort = USE_DATA_CLIENT_SERVER_PORT
        DemDataElementStoreNonVolatile = true
      Enabled (DemEnableCondition): DemEnableConditionId=18, DemEnableConditionStatus=true
      bus (DemEnableCondition): DemEnableConditionId=68, DemEnableConditionStatus=true
      DID_EEB7_ECM_Power_Limitation_minimum (DemDidClass): DemDidIdentifier=61111, DemDidDataClassRef=DID_0xeeb7_DID_EEB7_ECM_Power_Limitation_minimum
      A (DemEnableCondition): DemEnableConditionId=1, DemEnableConditionStatus=true
      DID_E336_d_axis_current_feedback (DemDidClass): DemDidIdentifier=58166, DemDidDataClassRef=DID_0xe336_DID_E336_d_axis_current_feedback
      3 x DemEnableCondition, all with DemEnableConditionStatus=true:
        temp: DemEnableConditionId=139
        E: DemEnableConditionId=15
        abs: DemEnableConditionId=55
      EnableConditionGroup_7ab46a93 (DemEnableConditionGroup):
        DemEnableConditionRef = Inverter
        DemEnableConditionRef = KL15
        DemEnableConditionRef = LV
        DemEnableConditionRef = active
        DemEnableConditionRef = done
        DemEnableConditionRef = initliazation
        DemEnableConditionRef = is
      block (DemEnableCondition): DemEnableConditionId=67, DemEnableConditionStatus=true
      The_001 (DemEnableCondition): DemEnableConditionId=47, DemEnableConditionStatus=true
      DID_0xee9c_DID_EE9C_Transient_Phase_Current_A (DemDataClass):
        DemDataElementDataSize = 2
        DemDataElementDataType = UINT16
        DemDataElementEndianness = BIG_ENDIAN
        DemDataElementUsePort = USE_DATA_CLIENT_SERVER_PORT
        DemDataElementStoreNonVolatile = true
      P15 (DemEnableCondition): DemEnableConditionId=40, DemEnableConditionStatus=true
      DTCfaultdetectioncounter (DemExtendedDataRecordClass): DemExtendedDataRecordNumber=16, DemDataClassRef=DTCfaultdetectioncounter_DTCFltDetCnt
      the (DemEnableCondition): DemEnableConditionId=143, DemEnableConditionStatus=true
      DID_0xeed2_DID_EED2_SaftyTorque (DemDataClass):
        DemDataElementDataSize = 2
        DemDataElementDataType = UINT16
        DemDataElementEndianness = BIG_ENDIAN
        DemDataElementUsePort = USE_DATA_CLIENT_SERVER_PORT
        DemDataElementStoreNonVolatile = true
      3 x DemEnableCondition, all with DemEnableConditionStatus=true:
        limited: DemEnableConditionId=102
        fulfilled: DemEnableConditionId=91
        one: DemEnableConditionId=116
      DID_0xdd01_DID_DD01_Total_Distance (DemDataClass):
        DemDataElementDataSize = 3
        DemDataElementDataType = UINT8_N
        DemDataElementEndianness = opaque
        DemDataElementUsePort = USE_DATA_CLIENT_SERVER_PORT
        DemDataElementStoreNonVolatile = true
      PowerCycle (DemOperationCycle): DemOperationCycleType=DEM_OPCYC_POWER, DemOperationCycleAutomaticEnd=false, DemOperationCycleAutostart=false
      3 x DemEnableCondition, all with DemEnableConditionStatus=true:
        set: DemEnableConditionId=133
        control: DemEnableConditionId=74
        V: DemEnableConditionId=51
      DTCTimeStamp21 (DemExtendedDataRecordClass): DemExtendedDataRecordNumber=33, DemDataClassRef=DTCTimeStamp21_DTCTimeStamp21
      DID_0xeebf_DID_EEBF_HV_Main_Relay_Status (DemDataClass): DemDataElementDataSize=1, DemDataElementDataType=UINT8, DemDataElementUsePort=USE_DATA_CLIENT_SERVER_PORT, DemDataElementStoreNonVolatile=true
      Transport (DemEnableCondition): DemEnableConditionId=48, DemEnableConditionStatus=true
      DID_0xe333_2002_L_Ser (DemDataClass): DemDataElementDataSize=1, DemDataElementDataType=UINT8, DemDataElementUsePort=USE_DATA_CLIENT_SERVER_PORT, DemDataElementStoreNonVolatile=true
      DTCTimeStamp20 (DemExtendedDataRecordClass): DemExtendedDataRecordNumber=32, DemDataClassRef=DTCTimeStamp20_DTCTimeStamp20
      DTCStatusindicator30 (DemExtendedDataRecordClass): DemExtendedDataRecordNumber=48, DemDataClassRef=DTCStatusindicator30_DTCStatusindicator30
      DID_E307_System_Mode (DemDidClass): DemDidIdentifier=58119, DemDidDataClassRef=DID_0xe307_DID_E307_System_Mode
      EnableConditionGroup_5ab64ab8 (DemEnableConditionGroup):
        DemEnableConditionRef = Inverter
        DemEnableConditionRef = KL15
        DemEnableConditionRef = LV
        DemEnableConditionRef = P5
        DemEnableConditionRef = active
        DemEnableConditionRef = done
        DemEnableConditionRef = fault
        DemEnableConditionRef = initliazation
        DemEnableConditionRef = is
        DemEnableConditionRef = no_001
      4 x DemEnableCondition, all with DemEnableConditionStatus=true:
        in: DemEnableConditionId=95
        when_001: DemEnableConditionId=152
        ASC: DemEnableConditionId=3
        offset: DemEnableConditionId=114
      DID_0xeeb2_DID_EEB2_Three_Phase_Motor_Current_RMS_Current (DemDataClass):
        DemDataElementDataSize = 2
        DemDataElementDataType = UINT16
        DemDataElementEndianness = BIG_ENDIAN
        DemDataElementUsePort = USE_DATA_CLIENT_SERVER_PORT
        DemDataElementStoreNonVolatile = true
      EnableConditionGroup_0e207db3 (DemEnableConditionGroup):
        DemEnableConditionRef = ASC
        DemEnableConditionRef = IGBT
        DemEnableConditionRef = Inverter
        DemEnableConditionRef = LV
        DemEnableConditionRef = Nm
        DemEnableConditionRef = No
        DemEnableConditionRef = No
        DemEnableConditionRef = Not
        DemEnableConditionRef = Request
        DemEnableConditionRef = control
        DemEnableConditionRef = current
        DemEnableConditionRef = done
        DemEnableConditionRef = error
        DemEnableConditionRef = faults
        DemEnableConditionRef = faults
        DemEnableConditionRef = in
        DemEnableConditionRef = in
        DemEnableConditionRef = initliazation
        DemEnableConditionRef = is
        DemEnableConditionRef = mode
        DemEnableConditionRef = no_001
        DemEnableConditionRef = not_001
        DemEnableConditionRef = resolver
        DemEnableConditionRef = sensor
        DemEnableConditionRef = system
        DemEnableConditionRef = torque
        DemEnableConditionRef = toruqe
      DID_EED5_Safety_Torque_QF_factor (DemDidClass): DemDidIdentifier=61141, DemDidDataClassRef=DID_0xeed5_EED5_Safety_Torque_Quality_factor
      IGBT (DemEnableCondition): DemEnableConditionId=22, DemEnableConditionStatus=true
      is (DemEnableCondition): DemEnableConditionId=101, DemEnableConditionStatus=true
      DID_0xe333_2002_Lw (DemDataClass):
        DemDataElementDataSize = 1
        DemDataElementDataType = UINT8_N
        DemDataElementEndianness = opaque
        DemDataElementUsePort = USE_DATA_CLIENT_SERVER_PORT
        DemDataElementStoreNonVolatile = true
      DID_0xe333_2002_Lv (DemDataClass):
        DemDataElementDataSize = 1
        DemDataElementDataType = UINT8_N
        DemDataElementEndianness = opaque
        DemDataElementUsePort = USE_DATA_CLIENT_SERVER_PORT
        DemDataElementStoreNonVolatile = true
      EnableConditionGroup_e2fc0f3d (DemEnableConditionGroup):
        DemEnableConditionRef = DemGeneral/INV_IAC_U_ELEC_HI
        DemEnableConditionRef = DemGeneral/INV_IAC_U_ELEC_LO
        DemEnableConditionRef = DemGeneral/INV_IAC_V_ELEC_HI
        DemEnableConditionRef = DemGeneral/INV_IAC_V_ELEC_LO
        DemEnableConditionRef = DemGeneral/INV_IAC_W_ELEC_HI
        DemEnableConditionRef = DemGeneral/INV_IAC_W_ELEC_LO
        DemEnableConditionRef = Inverter
        DemEnableConditionRef = LV
        DemEnableConditionRef = No
        DemEnableConditionRef = No
        DemEnableConditionRef = No
        DemEnableConditionRef = done
        DemEnableConditionRef = initliazation
        DemEnableConditionRef = is
      each (DemEnableCondition): DemEnableConditionId=80, DemEnableConditionStatus=true
      DID_0xee9a_DID_EE9A_Inverter_Coolant_Temperature (DemDataClass): DemDataElementDataSize=1, DemDataElementDataType=UINT8, DemDataElementUsePort=USE_DATA_CLIENT_SERVER_PORT, DemDataElementStoreNonVolatile=true
      DID_0xdd0c_DID_DD0C_Electric_Power_Level (DemDataClass): DemDataElementDataSize=1, DemDataElementDataType=UINT8, DemDataElementUsePort=USE_DATA_CLIENT_SERVER_PORT, DemDataElementStoreNonVolatile=true
      s (DemEnableCondition): DemEnableConditionId=130, DemEnableConditionStatus=true
      DID_0xe337_DID_E337_q_axis_current_setpoint (DemDataClass):
        DemDataElementDataSize = 2
        DemDataElementDataType = UINT16
        DemDataElementEndianness = BIG_ENDIAN
        DemDataElementUsePort = USE_DATA_CLIENT_SERVER_PORT
        DemDataElementStoreNonVolatile = true
      DID_DD01_Total_Distance (DemDidClass): DemDidIdentifier=56577, DemDidDataClassRef=DID_0xdd01_DID_DD01_Total_Distance
      DID_0xeeb6_DID_EEB6_ECM_Power_Limitation_maximum (DemDataClass):
        DemDataElementDataSize = 2
        DemDataElementDataType = UINT16
        DemDataElementEndianness = BIG_ENDIAN
        DemDataElementUsePort = USE_DATA_CLIENT_SERVER_PORT
        DemDataElementStoreNonVolatile = true
      sensor (DemEnableCondition): DemEnableConditionId=132, DemEnableConditionStatus=true
      DID_0xe358_DID_E358_Resolve_angle (DemDataClass):
        DemDataElementDataSize = 2
        DemDataElementDataType = UINT16
        DemDataElementEndianness = BIG_ENDIAN
        DemDataElementUsePort = USE_DATA_CLIENT_SERVER_PORT
        DemDataElementStoreNonVolatile = true
      INV_IAC_V_ELEC_LO (DemEnableCondition): DemEnableConditionId=28, DemEnableConditionStatus=true
      DID_0xe333_2002_Lu (DemDataClass):
        DemDataElementDataSize = 1
        DemDataElementDataType = UINT8_N
        DemDataElementEndianness = opaque
        DemDataElementUsePort = USE_DATA_CLIENT_SERVER_PORT
        DemDataElementStoreNonVolatile = true
      3 x DemDidClass:
        DID_E333_2002_State: DemDidIdentifier=58163, DemDidDataClassRef=DID_0xe333_2002_Hu, DemDidDataClassRef=DID_0xe333_2002_Hv, DemDidDataClassRef=DID_0xe333_2002_Hw, DemDidDataClassRef=DID_0xe333_2002_Lu, DemDidDataClassRef=DID_0xe333_2002_Lv, DemDidDataClassRef=DID_0xe333_2002_Lw, DemDidDataClassRef=DID_0xe333_2002_H_Ser, DemDidDataClassRef=DID_0xe333_2002_L_Ser
        DID_D003_Vehicle_Speed: DemDidIdentifier=53251, DemDidDataClassRef=DID_0xd003_DID_D003_Vehicle_Speed
        DID_E309_ECM_Mode_Request: DemDidIdentifier=58121, DemDidDataClassRef=DID_0xe309_DID_E309_ECM_Mode_Request
      DemClient_Dcm (DemClient): DemClientId=0
      10 x DemNvRamBlockId:
        Dem_AdminData: DemNvRamBlockIdType=DEM_NVBLOCK_ADMIN, DemNvRamBlockIdRef=DemAdminDataBlock
        Dem_StatusData: DemNvRamBlockIdType=DEM_NVBLOCK_STATUS, DemNvRamBlockIdRef=DemStatusDataBlock
        Dem_PrimaryEntry{0..7}: DemNvRamBlockIdType=DEM_NVBLOCK_PRIMARY, DemNvRamBlockIdIndex={0..7}, DemNvRamBlockIdRef=DemPrimaryDataBlock{0..7}

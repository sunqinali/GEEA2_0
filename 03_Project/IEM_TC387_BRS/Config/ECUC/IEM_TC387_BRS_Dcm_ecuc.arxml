[part 1 of 2: package /ActiveEcuC]
AUTOSAR XML (schema 4-2-2)
package /ActiveEcuC
  module config Dcm: implementation-config-variant=VARIANT-PRE-COMPILE, module-description=Dcm_Impl
    DcmConfigSet
      DcmDsl
        DcmDslProtocol
          DcmDslProtocolRow_29812fbf (DcmDslProtocolRow):
            DcmDslProtocolEndiannessConvEnabled = false
            DcmDslProtocolID = DCM_UDS_ON_CAN
            DcmDslProtocolIsParallelExecutab = false
            DcmDslProtocolPreemptTimeout = 0
            DcmDslProtocolPriority = 0
            DcmSendRespPendOnTransToBoot = true
            DcmTimStrP2ServerAdjust = 0
            DcmTimStrP2StarServerAdjust = 0
            DcmDslProtocolMaximumResponseSize = 4095
            DcmDslProtocolRxBufferID = DcmDslBuffer_Rx
            DcmDslProtocolSIDTable = DcmDsdServiceTable
            DcmDslProtocolTxBufferID = DcmDslBuffer_Rx
            DcmDemClientRef = DemClient_Dcm
            5 x DcmDslConnection:
              DcmDslConnection_eb9dd0b7
                DcmDslMainConnection: DcmDslProtocolRxTesterSourceAddr=128, DcmDslProtocolRxConnectionId=0
                  IemToEtcUudtDcmIpdu2_39d23cc2_Tx_19898c33 (DcmDslProtocolTx): DcmDslTxConfirmationPduId=4, DcmDslProtocolTxPduRef=IemToEtcUudtDcmIpdu2_39d23cc2_Tx
                  DcmDslProtocolRx_Uudt2 (DcmDslProtocolRx):
                    DcmDslProtocolRxAddrType = DCM_PHYSICAL_TYPE
                    DcmDslProtocolRxChannelId = 0
                    DcmDslProtocolRxPduId = 6
                    DcmDslProtocolRxPduRef = UudtDcmRx2
                    DcmDslProtocolRxComMChannelRef = PropulsionCAN_IEM_19020f5a
              DcmDslConnection_95fe38cc
                DcmDslMainConnection: DcmDslProtocolRxTesterSourceAddr=128, DcmDslProtocolRxConnectionId=1
                  EtcToIemJ1979OBDDiagDcmIpdu11_ad182927_Rx_3695805f (DcmDslProtocolRx):
                    DcmDslProtocolRxAddrType = DCM_PHYSICAL_TYPE
                    DcmDslProtocolRxPduId = 3
                    DcmDslProtocolRxChannelId = 0
                    DcmDslProtocolRxComMChannelRef = PropulsionCAN_IEM_19020f5a
                    DcmDslProtocolRxPduRef = EtcToIemJ1979OBDDiagDcmIpdu11_ad182927_Rx
                  EtcToAllJ1979OBDDiagDcmIpdu11_f3f7d8ab_Rx_d2b52588 (DcmDslProtocolRx):
                    DcmDslProtocolRxAddrType = DCM_FUNCTIONAL_TYPE
                    DcmDslProtocolRxPduId = 2
                    DcmDslProtocolRxChannelId = 0
                    DcmDslProtocolRxComMChannelRef = PropulsionCAN_IEM_19020f5a
                    DcmDslProtocolRxPduRef = EtcToAllJ1979OBDDiagDcmIpdu11_f3f7d8ab_Rx
                  IemToEtcJ1979OBDDiagDcmIpdu11_da239b2d_Tx_c7a1943e (DcmDslProtocolTx): DcmDslTxConfirmationPduId=1, DcmDslProtocolTxPduRef=IemToEtcJ1979OBDDiagDcmIpdu11_da239b2d_Tx
              DcmDslConnection_138b1ed2
                DcmDslMainConnection: DcmDslProtocolRxTesterSourceAddr=128, DcmDslProtocolRxConnectionId=2
                  IemToEtcUudtDcmIpdu3_4ed50c54_Tx_e71950c0 (DcmDslProtocolTx): DcmDslTxConfirmationPduId=2, DcmDslProtocolTxPduRef=IemToEtcUudtDcmIpdu3_4ed50c54_Tx
                  DcmDslProtocolRx_Uudt3 (DcmDslProtocolRx):
                    DcmDslProtocolRxAddrType = DCM_PHYSICAL_TYPE
                    DcmDslProtocolRxChannelId = 0
                    DcmDslProtocolRxPduId = 4
                    DcmDslProtocolRxPduRef = UudtDcmRx3
                    DcmDslProtocolRxComMChannelRef = PropulsionCAN_IEM_19020f5a
              DcmDslConnection_a514db1e
                DcmDslMainConnection: DcmDslProtocolRxTesterSourceAddr=128, DcmDslProtocolRxConnectionId=3
                  IemToEtcUudtDcmIpdu1_a0db6d78_Tx_c0b1ca64 (DcmDslProtocolTx): DcmDslTxConfirmationPduId=3, DcmDslProtocolTxPduRef=IemToEtcUudtDcmIpdu1_a0db6d78_Tx
                  DcmDslProtocolRx_Uudt1 (DcmDslProtocolRx):
                    DcmDslProtocolRxAddrType = DCM_PHYSICAL_TYPE
                    DcmDslProtocolRxChannelId = 0
                    DcmDslProtocolRxPduId = 5
                    DcmDslProtocolRxPduRef = UudtDcmRx1
                    DcmDslProtocolRxComMChannelRef = PropulsionCAN_IEM_19020f5a
              DcmDslConnection_2be1d41b
                DcmDslMainConnection: DcmDslProtocolRxTesterSourceAddr=128, DcmDslProtocolRxConnectionId=4
                  VgmToIemDiagDcmIpdu_cbf08236_Rx_05e7e935 (DcmDslProtocolRx):
                    DcmDslProtocolRxAddrType = DCM_PHYSICAL_TYPE
                    DcmDslProtocolRxPduId = 1
                    DcmDslProtocolRxChannelId = 0
                    DcmDslProtocolRxComMChannelRef = PropulsionCAN_IEM_19020f5a
                    DcmDslProtocolRxPduRef = VgmToIemDiagDcmIpdu_cbf08236_Rx
                  IemToVgmDiagDcmIpdu_ce8379a0_Tx_00a03790 (DcmDslProtocolTx): DcmDslTxConfirmationPduId=0, DcmDslProtocolTxPduRef=IemToVgmDiagDcmIpdu_ce8379a0_Tx
                  DcmDslProtocolRx_Func (DcmDslProtocolRx):
                    DcmDslProtocolRxAddrType = DCM_FUNCTIONAL_TYPE
                    DcmDslProtocolRxChannelId = 0
                    DcmDslProtocolRxPduId = 0
                    DcmDslProtocolRxPduRef = VgmToAllFuncDiagDcmIpdu_89c72e24_Rx
                    DcmDslProtocolRxComMChannelRef = PropulsionCAN_IEM_19020f5a
        DcmDslDiagResp: DcmDslDiagRespMaxNumRespPend=0, DcmDslDiagRespOnSecondDeclinedRequest=false, DcmDslDiagRespMaxNumOfDeclinedRequests=3
        DcmDslBuffer_Rx (DcmDslBuffer): DcmDslBufferSize=4095
        DcmDslBuffer_Tx (DcmDslBuffer): DcmDslBufferSize=4095
      DcmGeneral:
        DcmDevErrorDetect = true
        DcmRequestManufacturerNotificationEnabled = false
        DcmRequestSupplierNotificationEnabled = false
        DcmRespondAllRequest = true
        DcmTaskTime = 0.01
        DcmVersionInfoApi = false
        DcmDspDataDefaultEndianness = LITTLE_ENDIAN
        DcmSafeBswChecks = false
        DcmSupportedIDCalculationSuppressionEnabled = false
        DcmDtrDataProvisionViaDemEnabled = true
        DcmForeignDiagnosticRequestDetectionEnabled = false
        DcmSuppressResponseOnCanTpFuncMixedAddrRequests = false
        DcmSenderReceiverPRPortsEnabled = false
        DcmDemApiVersion = DCM_DEM_API_4_03_00
      DcmDsd
        DcmDsdServiceTable
          9 x DcmDsdService:
            ReadDtcInfo: DcmDsdSidTabServiceId=25, DcmDsdSidTabSubfuncAvail=true, DcmDsdSidTabSessionLevelRef=defaultSession, DcmDsdSidTabSessionLevelRef=extendedDiagnosticSession
              5 x DcmDsdSubService, all with DcmDsdSubServiceSessionLevelRef=defaultSession, DcmDsdSubServiceSessionLevelRef=extendedDiagnosticSession:
                RDTCEDRBDN: DcmDsdSubServiceId=6
                RDTCSSI: DcmDsdSubServiceId=3
                RSUPDTC: DcmDsdSubServiceId=10
                RDTCBSM: DcmDsdSubServiceId=2
                RDTCSSBDTC: DcmDsdSubServiceId=4
            ClearDiagInfo: DcmDsdSidTabServiceId=20, DcmDsdSidTabSubfuncAvail=false, DcmDsdSidTabSessionLevelRef=defaultSession, DcmDsdSidTabSessionLevelRef=extendedDiagnosticSession
            EcuReset: DcmDsdSidTabServiceId=17, DcmDsdSidTabSubfuncAvail=true
              Hard (DcmDsdSubService): DcmDsdSubServiceId=1
            TesterPresent: DcmDsdSidTabServiceId=62, DcmDsdSidTabSubfuncAvail=true
              TesterPresent (DcmDsdSubService): DcmDsdSubServiceId=0
            WriteDataById: DcmDsdSidTabServiceId=46, DcmDsdSidTabSubfuncAvail=false, DcmDsdSidTabSessionLevelRef=extendedDiagnosticSession
            ReadDataById: DcmDsdSidTabServiceId=34, DcmDsdSidTabSubfuncAvail=false
            SecurityAccess: DcmDsdSidTabServiceId=39, DcmDsdSidTabSubfuncAvail=true, DcmDsdSidTabSessionLevelRef=extendedDiagnosticSession
              4 x DcmDsdSubService, all with DcmDsdSubServiceSessionLevelRef=extendedDiagnosticSession:
                SeedLevel1_Request: DcmDsdSubServiceId=5
                Level_4_SendKeyImmo_Send: DcmDsdSubServiceId=18
                Level_4_RequestSeedImmo_Request: DcmDsdSubServiceId=17
                KeyLevel1_Send: DcmDsdSubServiceId=6
            RoutineControl: DcmDsdSidTabServiceId=49, DcmDsdSidTabSubfuncAvail=true, DcmDsdSidTabSessionLevelRef=defaultSession, DcmDsdSidTabSessionLevelRef=extendedDiagnosticSession
            DiagSessionControl: DcmDsdSidTabServiceId=16, DcmDsdSidTabSubfuncAvail=true
              3 x DcmDsdSubService:
                Programming: DcmDsdSubServiceId=2
                Default: DcmDsdSubServiceId=1
                Extended: DcmDsdSubServiceId=3, DcmDsdSubServiceSessionLevelRef=defaultSession, DcmDsdSubServiceSessionLevelRef=extendedDiagnosticSession
      DcmDsp: DcmDspMaxDidToRead=5, DcmDspReadDIDReportsNODIByte=false
        DID_E300_HVDC_Voltage (DcmDspDid):
          DcmDspDidIdentifier = 58112
          DcmDspDidUsed = true
          DcmDspDidUsePort = USE_DATA_ELEMENT_SPECIFIC_INTERFACES
          DcmDspDidInfoRef = DidInfo_DID_E300_HVDC_Voltage
          DID_E300_HVDC_Voltage (DcmDspDidSignal): DcmDspDidDataPos=0, DcmDspDidDataRef=DID_E300_HVDC_Voltage_DID_E300_HVDC_Voltage
        DID_EDA0_Complete_ECU_Part_Serial_Number_s_DID_F12E_1_Total_number_of_ECU_Software_Part_Numbers (DcmDspData):
          DcmDspDataSize = 8
          DcmDspDataType = UINT8
          DcmDspDataUsePort = USE_DATA_ASYNCH_CLIENT_SERVER
          DcmDspDataInfoRef = DataInfo_DID_EDA0_Complete_ECU_Part_Serial_Number_s_DID_F12E_1_Total_number_of_ECU_Software_Part_Numbers
        DID_EED5_Safety_Torque_QF_factor (DcmDspDid):
          DcmDspDidIdentifier = 61141
          DcmDspDidUsed = true
          DcmDspDidUsePort = USE_DATA_ELEMENT_SPECIFIC_INTERFACES
          DcmDspDidInfoRef = DidInfo_DID_EED5_Safety_Torque_QF_factor
          EED5_Safety_Torque_Quality_factor (DcmDspDidSignal): DcmDspDidDataPos=0, DcmDspDidDataRef=DID_EED5_Safety_Torque_QF_factor_EED5_Safety_Torque_Quality_factor
        DID_F126_Autosar_BSW_Cluster_Versions_DID_F126_26_CAN_CLUSTER_SW_MAJOR_VERSION (DcmDspData):
          DcmDspDataSize = 8
          DcmDspDataType = UINT8
          DcmDspDataUsePort = USE_DATA_ASYNCH_CLIENT_SERVER
          DcmDspDataInfoRef = DataInfo_DID_F126_Autosar_BSW_Cluster_Versions_DID_F126_26_CAN_CLUSTER_SW_MAJOR_VERSION
        DidInfo_DID_E346_ECM_Torque_Allowed_Status (DcmDspDidInfo)
          DcmDspDidAccess
            DcmDspDidRead: DcmDspDidReadSessionRef=defaultSession, DcmDspDidReadSessionRef=extendedDiagnosticSession
        DidInfo_DID_E339_d_axis_voltage (DcmDspDidInfo)
          DcmDspDidAccess
            DcmDspDidRead: DcmDspDidReadSessionRef=defaultSession, DcmDspDidReadSessionRef=extendedDiagnosticSession
        DID_F1A1_Primary_Bootloader_Diagnostic_Database_Part_Number_Geely (DcmDspDid):
          DcmDspDidIdentifier = 61857
          DcmDspDidUsed = true
          DcmDspDidUsePort = USE_DATA_ELEMENT_SPECIFIC_INTERFACES
          DcmDspDidInfoRef = DidInfo_DID_F1A1_Primary_Bootloader_Diagnostic_Database_Part_Number_Geely
          ASCII_part (DcmDspDidSignal): DcmDspDidDataPos=40, DcmDspDidDataRef=DID_F1A1_Primary_Bootloader_Diagnostic_Database_Part_Number_Geely_ASCII_part
          BCD_part (DcmDspDidSignal): DcmDspDidDataPos=0, DcmDspDidDataRef=DID_F1A1_Primary_Bootloader_Diagnostic_Database_Part_Number_Geely_BCD_part
        DataInfo_DID_E346_ECM_Torque_Allowed_Status_DID_E346_ECM_Torque_Allowed_Status (DcmDspDataInfo): DcmDspDataFixedLength=true
        DID_E347_IGBT_Max_Temperature_DID_E347_IGBT_Max_Temperature (DcmDspData):
          DcmDspDataSize = 8
          DcmDspDataType = UINT8
          DcmDspDataUsePort = USE_DATA_ASYNCH_CLIENT_SERVER
          DcmDspDataInfoRef = DataInfo_DID_E347_IGBT_Max_Temperature_DID_E347_IGBT_Max_Temperature
        DID_E103_Car_Configuration_Parameter_Faults_DID_E103_4_2nd_parameter_number_of_the_car_configuration_data_that_is_invalid (DcmDspData):
          DcmDspDataSize = 16
          DcmDspDataType = UINT16
          DcmDspDataUsePort = USE_DATA_ASYNCH_CLIENT_SERVER
          DcmDspDataInfoRef = DataInfo_DID_E103_Car_Configuration_Parameter_Faults_DID_E103_4_2nd_parameter_number_of_the_car_configuration_data_that_461cabb1
        DataInfo_DID_F126_Autosar_BSW_Cluster_Versions_DID_F126_29_CAN_CLUSTER_AR_RELEASE_MAJOR_VERSION (DcmDspDataInfo): DcmDspDataFixedLength=true
        DidInfo_DID_F1AA_ECU_Core_Assembly_Part_Number_Geely (DcmDspDidInfo)
          DcmDspDidAccess
            DcmDspDidRead: DcmDspDidReadSessionRef=defaultSession, DcmDspDidReadSessionRef=extendedDiagnosticSession
        3 x DcmDspDataInfo, all with DcmDspDataFixedLength=true:
          DataInfo_DID_EED5_Safety_Torque_QF_factor_EED5_Safety_Torque_Quality_factor
          DataInfo_DID_E103_Car_Configuration_Parameter_Faults_DID_E103_12_6th_parameter_number_of_the_car_configuration_data_that1ba11a61
          DataInfo_DID_E103_Car_Configuration_Parameter_Faults_DID_E103_4_2nd_parameter_number_of_the_car_configuration_data_that_461cabb1
        DID_F126_Autosar_BSW_Cluster_Versions_DID_F126_32_FLEXRAY_CLUSTER_VENDOR_ID (DcmDspData):
          DcmDspDataSize = 16
          DcmDspDataType = UINT16
          DcmDspDataUsePort = USE_DATA_ASYNCH_CLIENT_SERVER
          DcmDspDataInfoRef = DataInfo_DID_F126_Autosar_BSW_Cluster_Versions_DID_F126_32_FLEXRAY_CLUSTER_VENDOR_ID
        DID_D005_High_Quiescent_Current_Fault_Identification_Data_Functionality_Activity_Level_Detect_CPSR_Keep_Active_5st (DcmDspData):
          DcmDspDataSize = 8
          DcmDspDataType = UINT8
          DcmDspDataUsePort = USE_DATA_ASYNCH_CLIENT_SERVER
          DcmDspDataInfoRef = DataInfo_DID_D005_High_Quiescent_Current_Fault_Identification_Data_Functionality_Activity_Level_Detect_CPSR_Keep_Active_5st
        DataInfo_DID_F1AB_ECU_Delivery_Assembly_Part_Number_Geely_ASCII_part (DcmDspDataInfo): DcmDspDataFixedLength=true
        DID_D09A_High_Quiescent_Current_Function_Activation_Deactivation_DID_D09A_High_Quiescent_Current_Function_ActivationDeactivation (DcmDspData):
          DcmDspDataSize = 8
          DcmDspDataType = UINT8
          DcmDspDataUsePort = USE_DATA_ASYNCH_CLIENT_SERVER
          DcmDspDataInfoRef = DataInfo_DID_D09A_High_Quiescent_Current_Function_Activation_Deactivation_DID_D09A_High_Quiescent_Current_Function_Activ93b79a05
        DID_E353_Flux_weakening_correction_factor (DcmDspDid):
          DcmDspDidIdentifier = 58195
          DcmDspDidUsed = true
          DcmDspDidUsePort = USE_DATA_ELEMENT_SPECIFIC_INTERFACES
          DcmDspDidInfoRef = DidInfo_DID_E353_Flux_weakening_correction_factor
          DID_E353_Flux_weakening_correction_factor (DcmDspDidSignal): DcmDspDidDataPos=0, DcmDspDidDataRef=DID_E353_Flux_weakening_correction_factor_DID_E353_Flux_weakening_correction_factor
        DID_DD00_Global_Real_Time (DcmDspDid):
          DcmDspDidIdentifier = 56576
          DcmDspDidUsed = true
          DcmDspDidUsePort = USE_DATA_ELEMENT_SPECIFIC_INTERFACES
          DcmDspDidInfoRef = DidInfo_DID_DD00_Global_Real_Time
          DID_DD00_Global_Real_Time (DcmDspDidSignal): DcmDspDidDataPos=0, DcmDspDidDataRef=DID_DD00_Global_Real_Time_DID_DD00_Global_Real_Time
        DID_D005_High_Quiescent_Current_Fault_Identification_Data_DID_D005_5st_System_Global_Time_the_time_when_the_DID_is_triggered (DcmDspData):
          DcmDspDataSize = 32
          DcmDspDataType = UINT32
          DcmDspDataUsePort = USE_DATA_ASYNCH_CLIENT_SERVER
          DcmDspDataInfoRef = DataInfo_DID_D005_High_Quiescent_Current_Fault_Identification_Data_DID_D005_5st_System_Global_Time_the_time_when_the_DIDba8286b
        DID_F1AB_ECU_Delivery_Assembly_Part_Number_Geely_BCD_part (DcmDspData):
          DcmDspDataSize = 40
          DcmDspDataType = UINT8_N
          DcmDspDataUsePort = USE_DATA_ASYNCH_CLIENT_SERVER
          DcmDspDataInfoRef = DataInfo_DID_F1AB_ECU_Delivery_Assembly_Part_Number_Geely_BCD_part
        DataInfo_DID_EEB7_ECM_Power_Limitation_minimum_DID_EEB7_ECM_Power_Limitation_minimum (DcmDspDataInfo): DcmDspDataFixedLength=true
        DataInfo_DID_D211_Network_Management_History_Propulsion_CAN_DID_D211_13_7th_Latest_State_NM_History (DcmDspDataInfo): DcmDspDataFixedLength=true
        DidInfo_DID_E341_q_axis_voltage (DcmDspDidInfo)
          DcmDspDidAccess
            DcmDspDidRead: DcmDspDidReadSessionRef=defaultSession, DcmDspDidReadSessionRef=extendedDiagnosticSession
        DataInfo_DID_E333_2002_State_2002_H_Ser (DcmDspDataInfo): DcmDspDataFixedLength=true
        DID_D0B5_SDB_version_SDB_version (DcmDspData):
          DcmDspDataSize = 24
          DcmDspDataType = UINT8_N
          DcmDspDataUsePort = USE_DATA_ASYNCH_CLIENT_SERVER
          DcmDspDataInfoRef = DataInfo_DID_D0B5_SDB_version_SDB_version
        DataInfo_DID_E310_IEM_MGM_Derating_Status_DID_E310_IEMMGM_Derating_Status (DcmDspDataInfo): DcmDspDataFixedLength=true
        DataInfo_DID_E364_AURIX_Fault_Indication_DID_E364_AURIX_Fault_Indication (DcmDspDataInfo): DcmDspDataFixedLength=true
        DidInfo_DID_F125_Primary_Bootloader_Software_Part_Number (DcmDspDidInfo)
          DcmDspDidAccess
            DcmDspDidRead: DcmDspDidReadSessionRef=defaultSession, DcmDspDidReadSessionRef=extendedDiagnosticSession
        DidInfo_DID_E304_Actual_Torque (DcmDspDidInfo)
          DcmDspDidAccess
            DcmDspDidRead: DcmDspDidReadSessionRef=defaultSession, DcmDspDidReadSessionRef=extendedDiagnosticSession
        DataInfo_DID_F186_Active_Diagnostic_Session_DID_F186_Active_Diagnostic_Session (DcmDspDataInfo): DcmDspDataFixedLength=true
        DataInfo_DID_D211_Network_Management_History_Propulsion_CAN_DID_D211_4_2nd_Latest_State_Global_Real_Time (DcmDspDataInfo): DcmDspDataFixedLength=true
        DID_EEFD_Sofware_Project_Version_DID_EEFD_Clutch_Control_Fault_Indication (DcmDspData):
          DcmDspDataSize = 192
          DcmDspDataType = UINT8_N
          DcmDspDataUsePort = USE_DATA_ASYNCH_CLIENT_SERVER
          DcmDspDataInfoRef = DataInfo_DID_EEFD_Sofware_Project_Version_DID_EEFD_Clutch_Control_Fault_Indication
        DID_F186_Active_Diagnostic_Session (DcmDspDid):
          DcmDspDidIdentifier = 61830
          DcmDspDidUsed = true
          DcmDspDidUsePort = USE_DATA_ELEMENT_SPECIFIC_INTERFACES
          DcmDspDidInfoRef = DidInfo_DID_F186_Active_Diagnostic_Session
          DID_F186_Active_Diagnostic_Session (DcmDspDidSignal): DcmDspDidDataPos=0, DcmDspDidDataRef=DID_F186_Active_Diagnostic_Session_DID_F186_Active_Diagnostic_Session
        DID_E319_Torque_Direction (DcmDspDid):
          DcmDspDidIdentifier = 58137
          DcmDspDidUsed = true
          DcmDspDidUsePort = USE_DATA_ELEMENT_SPECIFIC_INTERFACES
          DcmDspDidInfoRef = DidInfo_DID_E319_Torque_Direction
          DID_E319_Torque_Direction (DcmDspDidSignal): DcmDspDidDataPos=0, DcmDspDidDataRef=DID_E319_Torque_Direction_DID_E319_Torque_Direction
        DidInfo_DID_E314_Available_Torque_maximum (DcmDspDidInfo)
          DcmDspDidAccess
            DcmDspDidRead: DcmDspDidReadSessionRef=defaultSession, DcmDspDidReadSessionRef=extendedDiagnosticSession
        DataInfo_DID_ED20_Complete_set_of_ECU_part_serial_numbers_Geely_DID_F18C_ECU_Serial_Number (DcmDspDataInfo): DcmDspDataFixedLength=true
        DidInfo_DID_EEC3_ECU_power_supply_Voltage (DcmDspDidInfo)
          DcmDspDidAccess
            DcmDspDidRead: DcmDspDidReadSessionRef=defaultSession, DcmDspDidReadSessionRef=extendedDiagnosticSession
        DID_DD0C_Electric_Power_Level_DID_DD0C_Electric_Power_Level (DcmDspData):
          DcmDspDataSize = 8
          DcmDspDataType = UINT8
          DcmDspDataUsePort = USE_DATA_ASYNCH_CLIENT_SERVER
          DcmDspDataInfoRef = DataInfo_DID_DD0C_Electric_Power_Level_DID_DD0C_Electric_Power_Level
        DID_D005_High_Quiescent_Current_Fault_Identification_Data_Functionality_Activity_Level_Detect_DC_Bus_voltage_Abnormal3st (DcmDspData):
          DcmDspDataSize = 8
          DcmDspDataType = UINT8
          DcmDspDataUsePort = USE_DATA_ASYNCH_CLIENT_SERVER
          DcmDspDataInfoRef = DataInfo_DID_D005_High_Quiescent_Current_Fault_Identification_Data_Functionality_Activity_Level_Detect_DC_Bus_voltage_Ab9f04d8ab
        3 x DcmDspDidInfo:
          DidInfo_DID_E333_2002_State
            DcmDspDidAccess
              DcmDspDidWrite: DcmDspDidWriteSessionRef=extendedDiagnosticSession
              DcmDspDidRead
          DidInfo_DID_E353_Flux_weakening_correction_factor
            DcmDspDidAccess
              DcmDspDidRead: DcmDspDidReadSessionRef=defaultSession, DcmDspDidReadSessionRef=extendedDiagnosticSession
          DidInfo_DID_EF1C_EOL_config_word_B
            DcmDspDidAccess
              DcmDspDidWrite: DcmDspDidWriteSessionRef=extendedDiagnosticSession, DcmDspDidWriteSecurityLevelRef=CommonUnlock_Level_3
              DcmDspDidRead
        DID_F12E_ECU_Software_Part_Numbers_DID_F12E_1_ECU_Software (DcmDspData):
          DcmDspDataSize = 8
          DcmDspDataType = UINT8
          DcmDspDataUsePort = USE_DATA_ASYNCH_CLIENT_SERVER
          DcmDspDataInfoRef = DataInfo_DID_F12E_ECU_Software_Part_Numbers_DID_F12E_1_ECU_Software
        DID_E338_q_axis_current_feedback (DcmDspDid):
          DcmDspDidIdentifier = 58168
          DcmDspDidUsed = true
          DcmDspDidUsePort = USE_DATA_ELEMENT_SPECIFIC_INTERFACES
          DcmDspDidInfoRef = DidInfo_DID_E338_q_axis_current_feedback
          DID_E338_q_axis_current_feedback (DcmDspDidSignal): DcmDspDidDataPos=0, DcmDspDidDataRef=DID_E338_q_axis_current_feedback_DID_E338_q_axis_current_feedback
        DataInfo_DID_E331_Software_Version_DID_E331_1_ASW_Software_Version (DcmDspDataInfo): DcmDspDataFixedLength=true
        DID_F18C_ECU_Serial_Number_DID_F18C_ECU_Serial_Number (DcmDspData):
          DcmDspDataSize = 32
          DcmDspDataType = UINT32
          DcmDspDataUsePort = USE_DATA_ASYNCH_CLIENT_SERVER
          DcmDspDataInfoRef = DataInfo_DID_F18C_ECU_Serial_Number_DID_F18C_ECU_Serial_Number
        3 x DcmDspDataInfo, all with DcmDspDataFixedLength=true:
          DataInfo_DID_D005_High_Quiescent_Current_Fault_Identification_Data_D005_5st_Functionality_Activity_Level_PNC29
          DataInfo_DID_D005_High_Quiescent_Current_Fault_Identification_Data_D005_5st_Functionality_Activity_Level_PNC27
          DataInfo_DID_D005_High_Quiescent_Current_Fault_Identification_Data_Functionality_Activity_Level_Detect_DC_Bus_voltage_Ab9f04d8ab
        DID_F126_Autosar_BSW_Cluster_Versions_DID_F126_29_CAN_CLUSTER_AR_RELEASE_MAJOR_VERSION (DcmDspData):
          DcmDspDataSize = 8
          DcmDspDataType = UINT8
          DcmDspDataUsePort = USE_DATA_ASYNCH_CLIENT_SERVER
          DcmDspDataInfoRef = DataInfo_DID_F126_Autosar_BSW_Cluster_Versions_DID_F126_29_CAN_CLUSTER_AR_RELEASE_MAJOR_VERSION
        DID_E103_Car_Configuration_Parameter_Faults_DID_E103_10_5th_parameter_number_of_the_car_configuration_data_that_is_invalid (DcmDspData):
          DcmDspDataSize = 16
          DcmDspDataType = UINT16
          DcmDspDataUsePort = USE_DATA_ASYNCH_CLIENT_SERVER
          DcmDspDataInfoRef = DataInfo_DID_E103_Car_Configuration_Parameter_Faults_DID_E103_10_5th_parameter_number_of_the_car_configuration_data_thatbe0dd04
        3 x DcmDspDataInfo, all with DcmDspDataFixedLength=true:
          DataInfo_DID_D005_High_Quiescent_Current_Fault_Identification_Data_D005_5st_Functionality_Activity_Level_PNC25
          DataInfo_DID_D005_High_Quiescent_Current_Fault_Identification_Data_D005_5st_Functionality_Activity_Level_PNC26
          DataInfo_DID_D005_High_Quiescent_Current_Fault_Identification_Data_D005_5st_Functionality_Activity_Level_PNC24
        DID_E308_ECM_Torque_Request (DcmDspDid):
          DcmDspDidIdentifier = 58120
          DcmDspDidUsed = true
          DcmDspDidUsePort = USE_DATA_ELEMENT_SPECIFIC_INTERFACES
          DcmDspDidInfoRef = DidInfo_DID_E308_ECM_Torque_Request
          DID_E308_ECM_Torque_Request (DcmDspDidSignal): DcmDspDidDataPos=0, DcmDspDidDataRef=DID_E308_ECM_Torque_Request_DID_E308_ECM_Torque_Request
        DID_F126_Autosar_BSW_Cluster_Versions_DID_F126_6_DIAG_CLUSTER_AR_RELEASE_MINOR_VERSION (DcmDspData):
          DcmDspDataSize = 8
          DcmDspDataType = UINT8
          DcmDspDataUsePort = USE_DATA_ASYNCH_CLIENT_SERVER
          DcmDspDataInfoRef = DataInfo_DID_F126_Autosar_BSW_Cluster_Versions_DID_F126_6_DIAG_CLUSTER_AR_RELEASE_MINOR_VERSION
        DID_F1A5_Primary_Bootloader_Software_Part_Number_Geely (DcmDspDid):
          DcmDspDidIdentifier = 61861
          DcmDspDidUsed = true
          DcmDspDidUsePort = USE_DATA_ELEMENT_SPECIFIC_INTERFACES
          DcmDspDidInfoRef = DidInfo_DID_F1A5_Primary_Bootloader_Software_Part_Number_Geely
          ASCII_part (DcmDspDidSignal): DcmDspDidDataPos=40, DcmDspDidDataRef=DID_F1A5_Primary_Bootloader_Software_Part_Number_Geely_ASCII_part
          BCD_part (DcmDspDidSignal): DcmDspDidDataPos=0, DcmDspDidDataRef=DID_F1A5_Primary_Bootloader_Software_Part_Number_Geely_BCD_part
        DataInfo_DID_EE9C_Transient_Phase_Current_A_DID_EE9C_Transient_Phase_Current_A (DcmDspDataInfo): DcmDspDataFixedLength=true
        DataInfo_DID_F12B_ECU_Delivery_Assembly_Part_Number_BCD_part (DcmDspDataInfo): DcmDspDataFixedLength=true
        DidInfo_DID_E309_ECM_Mode_Request (DcmDspDidInfo)
          DcmDspDidAccess
            DcmDspDidRead: DcmDspDidReadSessionRef=defaultSession, DcmDspDidReadSessionRef=extendedDiagnosticSession
        5 x DcmDspData, all with DcmDspDataUsePort=USE_DATA_ASYNCH_CLIENT_SERVER:
          DID_EED1_Safty_monitor_Fault_Indication_EED1_0: DcmDspDataSize=8, DcmDspDataType=UINT8, DcmDspDataInfoRef=DataInfo_DID_EED1_Safty_monitor_Fault_Indication_EED1_0
          DID_EED1_Safty_monitor_Fault_Indication_EED1_1: DcmDspDataSize=8, DcmDspDataType=UINT8, DcmDspDataInfoRef=DataInfo_DID_EED1_Safty_monitor_Fault_Indication_EED1_1
          DID_E103_Car_Configuration_Parameter_Faults_DID_E103_18_9th_parameter_number_of_the_car_configuration_data_that_is_invalid: DcmDspDataSize=16, DcmDspDataType=UINT16, DcmDspDataInfoRef=DataInfo_DID_E103_Car_Configuration_Parameter_Faults_DID_E103_18_9th_parameter_number_of_the_car_configuration_data_that4ae7c090
          DID_EED1_Safty_monitor_Fault_Indication_EED1_2: DcmDspDataSize=8, DcmDspDataType=UINT8, DcmDspDataInfoRef=DataInfo_DID_EED1_Safty_monitor_Fault_Indication_EED1_2
          DID_EED1_Safty_monitor_Fault_Indication_EED1_3: DcmDspDataSize=8, DcmDspDataType=UINT8, DcmDspDataInfoRef=DataInfo_DID_EED1_Safty_monitor_Fault_Indication_EED1_3
        DataInfo_DID_D005_High_Quiescent_Current_Fault_Identification_Data_D005_5st_Functionality_Activity_Level_PNC39 (DcmDspDataInfo): DcmDspDataFixedLength=true
        DID_ED20_Complete_set_of_ECU_part_serial_numbers_Geely_DID_F18C_ECU_Serial_Number (DcmDspData):
          DcmDspDataSize = 32
          DcmDspDataType = UINT32
          DcmDspDataUsePort = USE_DATA_ASYNCH_CLIENT_SERVER
          DcmDspDataInfoRef = DataInfo_DID_ED20_Complete_set_of_ECU_part_serial_numbers_Geely_DID_F18C_ECU_Serial_Number
        DID_EF1D_EOL_config_word_C (DcmDspDid):
          DcmDspDidIdentifier = 61213
          DcmDspDidUsed = true
          DcmDspDidUsePort = USE_DATA_ELEMENT_SPECIFIC_INTERFACES
          DcmDspDidInfoRef = DidInfo_DID_EF1D_EOL_config_word_C
          DID_EF1D_EOL_config_word_C (DcmDspDidSignal): DcmDspDidDataPos=0, DcmDspDidDataRef=DID_EF1D_EOL_config_word_C_DID_EF1D_EOL_config_word_C
        DataInfo_DID_D005_High_Quiescent_Current_Fault_Identification_Data_D005_5st_Functionality_Activity_Level_PNC30 (DcmDspDataInfo): DcmDspDataFixedLength=true
        DID_E300_HVDC_Voltage_DID_E300_HVDC_Voltage (DcmDspData):
          DcmDspDataSize = 16
          DcmDspDataType = UINT16
          DcmDspDataUsePort = USE_DATA_ASYNCH_CLIENT_SERVER
          DcmDspDataInfoRef = DataInfo_DID_E300_HVDC_Voltage_DID_E300_HVDC_Voltage
        3 x DcmDspDataInfo, all with DcmDspDataFixedLength=true:
          DataInfo_DID_F126_Autosar_BSW_Cluster_Versions_DID_F126_3_DIAG_CLUSTER_SW_MINOR_VERSION
          DataInfo_DID_EE9D_Transient_Phase_Current_B_DID_EE9D_Transient_Phase_Current_B
          DataInfo_DID_D005_High_Quiescent_Current_Fault_Identification_Data_D005_5st_Functionality_Activity_Level_PNC35
        DID_E349_Phase_V_PWM_duty_DID_E349_Phase_V_PWM_duty (DcmDspData):
          DcmDspDataSize = 8
          DcmDspDataType = UINT8
          DcmDspDataUsePort = USE_DATA_ASYNCH_CLIENT_SERVER
          DcmDspDataInfoRef = DataInfo_DID_E349_Phase_V_PWM_duty_DID_E349_Phase_V_PWM_duty
        DID_ED20_Complete_set_of_ECU_part_serial_numbers_Geely_BCD_part (DcmDspData):
          DcmDspDataSize = 40
          DcmDspDataType = UINT8_N
          DcmDspDataUsePort = USE_DATA_ASYNCH_CLIENT_SERVER
          DcmDspDataInfoRef = DataInfo_DID_ED20_Complete_set_of_ECU_part_serial_numbers_Geely_BCD_part
        3 x DcmDspRoutineInfo:
          RoutineInfo_Routine_Reserved_2
            DcmDspRoutineRequestResOut
              3 x DcmDspRoutineRequestResOutSignal, all with DcmDspRoutineSignalLength=8, DcmDspRoutineSignalType=UINT8:
                Out_Data_03_3: DcmDspRoutineSignalPos=16
                Out_Data_03_1: DcmDspRoutineSignalPos=0
                Out_Data_03_2: DcmDspRoutineSignalPos=8
            DcmDspStartRoutineIn
              3 x DcmDspStartRoutineInSignal, all with DcmDspRoutineSignalLength=8, DcmDspRoutineSignalType=UINT8:
                In_InputData3: DcmDspRoutineSignalPos=16
                In_InputData1: DcmDspRoutineSignalPos=0
                In_InputData2: DcmDspRoutineSignalPos=8
            DcmDspRoutineAuthorization: DcmDspRoutineSessionRef=extendedDiagnosticSession, DcmDspRoutineSecurityLevelRef=CommonUnlock_Level_3
            DcmDspRoutineStopOut
              Out_New_Bit_Field (DcmDspRoutineStopOutSignal): DcmDspRoutineSignalLength=8, DcmDspRoutineSignalType=UINT8, DcmDspRoutineSignalPos=0
            DcmDspStartRoutineOut
              3 x DcmDspStartRoutineOutSignal, all with DcmDspRoutineSignalLength=8, DcmDspRoutineSignalType=UINT8:
                Out_Data_01_3: DcmDspRoutineSignalPos=16
                Out_Data_01_2: DcmDspRoutineSignalPos=8
                Out_Data_01_1: DcmDspRoutineSignalPos=0
          RoutineInfo_Routine_Reserved_3
            DcmDspRoutineRequestResOut
              3 x DcmDspRoutineRequestResOutSignal, all with DcmDspRoutineSignalLength=8, DcmDspRoutineSignalType=UINT8:
                Out_Data_03_3: DcmDspRoutineSignalPos=16
                Out_Data_03_1: DcmDspRoutineSignalPos=0
                Out_Data_03_2: DcmDspRoutineSignalPos=8
            DcmDspStartRoutineIn
              3 x DcmDspStartRoutineInSignal, all with DcmDspRoutineSignalLength=8, DcmDspRoutineSignalType=UINT8:
                In_InputData3: DcmDspRoutineSignalPos=16
                In_InputData1: DcmDspRoutineSignalPos=0
                In_InputData2: DcmDspRoutineSignalPos=8
            DcmDspRoutineAuthorization: DcmDspRoutineSessionRef=extendedDiagnosticSession
            DcmDspRoutineStopOut
              Out_New_Bit_Field (DcmDspRoutineStopOutSignal): DcmDspRoutineSignalLength=8, DcmDspRoutineSignalType=UINT8, DcmDspRoutineSignalPos=0
            DcmDspStartRoutineOut
              3 x DcmDspStartRoutineOutSignal, all with DcmDspRoutineSignalLength=8, DcmDspRoutineSignalType=UINT8:
                Out_Data_01_3: DcmDspRoutineSignalPos=16
                Out_Data_01_2: DcmDspRoutineSignalPos=8
                Out_Data_01_1: DcmDspRoutineSignalPos=0
          RoutineInfo_Routine_Reserved_1
            DcmDspRoutineRequestResOut
              3 x DcmDspRoutineRequestResOutSignal, all with DcmDspRoutineSignalLength=8, DcmDspRoutineSignalType=UINT8:
                Out_Data_03_3: DcmDspRoutineSignalPos=16
                Out_Data_03_1: DcmDspRoutineSignalPos=0
                Out_Data_03_2: DcmDspRoutineSignalPos=8
            DcmDspStartRoutineIn
              3 x DcmDspStartRoutineInSignal, all with DcmDspRoutineSignalLength=8, DcmDspRoutineSignalType=UINT8:
                In_InputData3: DcmDspRoutineSignalPos=16
                In_InputData1: DcmDspRoutineSignalPos=0
                In_InputData2: DcmDspRoutineSignalPos=8
            DcmDspRoutineAuthorization: DcmDspRoutineSessionRef=extendedDiagnosticSession, DcmDspRoutineSecurityLevelRef=CommonUnlock_Level_3
            DcmDspRoutineStopOut
              Out_New_Bit_Field (DcmDspRoutineStopOutSignal): DcmDspRoutineSignalLength=8, DcmDspRoutineSignalType=UINT8, DcmDspRoutineSignalPos=0
            DcmDspStartRoutineOut
              3 x DcmDspStartRoutineOutSignal, all with DcmDspRoutineSignalLength=8, DcmDspRoutineSignalType=UINT8:
                Out_Data_01_3: DcmDspRoutineSignalPos=16
                Out_Data_01_2: DcmDspRoutineSignalPos=8
                Out_Data_01_1: DcmDspRoutineSignalPos=0
        DID_EEC5_ImobEng2_node_status_DID_EEC5_ImobEng2_node_status (DcmDspData):
          DcmDspDataSize = 8
          DcmDspDataType = UINT8
          DcmDspDataUsePort = USE_DATA_ASYNCH_CLIENT_SERVER
          DcmDspDataInfoRef = DataInfo_DID_EEC5_ImobEng2_node_status_DID_EEC5_ImobEng2_node_status
        DataInfo_DID_F126_Autosar_BSW_Cluster_Versions_DID_F126_27_CAN_CLUSTER_SW_MINOR_VERSION (DcmDspDataInfo): DcmDspDataFixedLength=true
        DID_D005_High_Quiescent_Current_Fault_Identification_Data_D005_2st_Functionality_Activity_Level_PNC30 (DcmDspData):
          DcmDspDataSize = 8
          DcmDspDataType = UINT8
          DcmDspDataUsePort = USE_DATA_ASYNCH_CLIENT_SERVER
          DcmDspDataInfoRef = DataInfo_DID_D005_High_Quiescent_Current_Fault_Identification_Data_D005_2st_Functionality_Activity_Level_PNC30
        DID_DD0A_Usage_Mode (DcmDspDid): DcmDspDidIdentifier=56586, DcmDspDidUsed=true, DcmDspDidUsePort=USE_DATA_ELEMENT_SPECIFIC_INTERFACES, DcmDspDidInfoRef=DidInfo_DID_DD0A_Usage_Mode
          DID_DD0A_Usage_Mode (DcmDspDidSignal): DcmDspDidDataPos=0, DcmDspDidDataRef=DID_DD0A_Usage_Mode_DID_DD0A_Usage_Mode
        DID_D003_Vehicle_Speed (DcmDspDid):
          DcmDspDidIdentifier = 53251
          DcmDspDidUsed = true
          DcmDspDidUsePort = USE_DATA_ELEMENT_SPECIFIC_INTERFACES
          DcmDspDidInfoRef = DidInfo_DID_D003_Vehicle_Speed
          DID_D003_Vehicle_Speed (DcmDspDidSignal): DcmDspDidDataPos=0, DcmDspDidDataRef=DID_D003_Vehicle_Speed_DID_D003_Vehicle_Speed
        DataInfo_DID_EDA0_Complete_ECU_Part_Serial_Number_s_DID_F12B_ECU_Delivery_Assembly_Part_Number1 (DcmDspDataInfo): DcmDspDataFixedLength=true
        5 x DcmDspData, all with DcmDspDataUsePort=USE_DATA_ASYNCH_CLIENT_SERVER:
          DID_D005_High_Quiescent_Current_Fault_Identification_Data_D005_2st_Functionality_Activity_Level_PNC39: DcmDspDataSize=8, DcmDspDataType=UINT8, DcmDspDataInfoRef=DataInfo_DID_D005_High_Quiescent_Current_Fault_Identification_Data_D005_2st_Functionality_Activity_Level_PNC39
          DID_E103_Car_Configuration_Parameter_Faults_DID_E103_8_4th_parameter_number_of_the_car_configuration_data_that_is_invalid: DcmDspDataSize=16, DcmDspDataType=UINT16, DcmDspDataInfoRef=DataInfo_DID_E103_Car_Configuration_Parameter_Faults_DID_E103_8_4th_parameter_number_of_the_car_configuration_data_that_6f100f46
          DID_EEB8_HV_voltage_received_from_BECM_DID_EEB8_HV_voltage_received_from_BECM: DcmDspDataSize=16, DcmDspDataType=UINT16, DcmDspDataInfoRef=DataInfo_DID_EEB8_HV_voltage_received_from_BECM_DID_EEB8_HV_voltage_received_from_BECM
          DID_F1AA_ECU_Core_Assembly_Part_Number_Geely_ASCII_part: DcmDspDataSize=24, DcmDspDataType=UINT8_N, DcmDspDataInfoRef=DataInfo_DID_F1AA_ECU_Core_Assembly_Part_Number_Geely_ASCII_part
          DID_D005_High_Quiescent_Current_Fault_Identification_Data_D005_2st_Functionality_Activity_Level_PNC35: DcmDspDataSize=8, DcmDspDataType=UINT8, DcmDspDataInfoRef=DataInfo_DID_D005_High_Quiescent_Current_Fault_Identification_Data_D005_2st_Functionality_Activity_Level_PNC35
        DidInfo_DID_D134_Car_Mode (DcmDspDidInfo)
          DcmDspDidAccess
            DcmDspDidRead: DcmDspDidReadSessionRef=defaultSession, DcmDspDidReadSessionRef=extendedDiagnosticSession
        DID_F126_Autosar_BSW_Cluster_Versions_DID_F126_11_MODEMGMT_CLUSTER_VENDOR_ID (DcmDspData):
          DcmDspDataSize = 16
          DcmDspDataType = UINT16
          DcmDspDataUsePort = USE_DATA_ASYNCH_CLIENT_SERVER
          DcmDspDataInfoRef = DataInfo_DID_F126_Autosar_BSW_Cluster_Versions_DID_F126_11_MODEMGMT_CLUSTER_VENDOR_ID
        DID_E364_AURIX_Fault_Indication (DcmDspDid):
          DcmDspDidIdentifier = 58212
          DcmDspDidUsed = true
          DcmDspDidUsePort = USE_DATA_ELEMENT_SPECIFIC_INTERFACES
          DcmDspDidInfoRef = DidInfo_DID_E364_AURIX_Fault_Indication
          DID_E364_AURIX_Fault_Indication (DcmDspDidSignal): DcmDspDidDataPos=0, DcmDspDidDataRef=DID_E364_AURIX_Fault_Indication_DID_E364_AURIX_Fault_Indication
        DID_D005_High_Quiescent_Current_Fault_Identification_Data_DID_D005_3st_Global_time_when_Functionality_Activity_level_Slefec137d1 (DcmDspData):
          DcmDspDataSize = 32
          DcmDspDataType = UINT32
          DcmDspDataUsePort = USE_DATA_ASYNCH_CLIENT_SERVER
          DcmDspDataInfoRef = DataInfo_DID_D005_High_Quiescent_Current_Fault_Identification_Data_DID_D005_3st_Global_time_when_Functionality_Activity_8e955659
        DataInfo_DID_F1A5_Primary_Bootloader_Software_Part_Number_Geely_ASCII_part (DcmDspDataInfo): DcmDspDataFixedLength=true
        DataInfo_DID_E357_Resolve_compensated_angle_DID_E357_Resolve_compensated_angle (DcmDspDataInfo): DcmDspDataFixedLength=true
        DID_F18C_ECU_Serial_Number (DcmDspDid):
          DcmDspDidIdentifier = 61836
          DcmDspDidUsed = true
          DcmDspDidUsePort = USE_DATA_ELEMENT_SPECIFIC_INTERFACES
          DcmDspDidInfoRef = DidInfo_DID_F18C_ECU_Serial_Number
          DID_F18C_ECU_Serial_Number (DcmDspDidSignal): DcmDspDidDataPos=0, DcmDspDidDataRef=DID_F18C_ECU_Serial_Number_DID_F18C_ECU_Serial_Number
        DataInfo_DID_D005_High_Quiescent_Current_Fault_Identification_Data_Functionality_Activity_Level_Detect_DC_Bus_voltage_Ab8f956129 (DcmDspDataInfo): DcmDspDataFixedLength=true
        DataInfo_DID_EDA0_Complete_ECU_Part_Serial_Number_s_DID_F12A_ECU_Delivery_Assembly_Part_Number1_1 (DcmDspDataInfo): DcmDspDataFixedLength=true
        DID_D09A_High_Quiescent_Current_Function_Activation_Deactivation (DcmDspDid):
          DcmDspDidIdentifier = 53402
          DcmDspDidUsed = true
          DcmDspDidUsePort = USE_DATA_ELEMENT_SPECIFIC_INTERFACES
          DcmDspDidInfoRef = DidInfo_DID_D09A_High_Quiescent_Current_Function_Activation_Deactivation
          DID_D09A_High_Quiescent_Current_Function_ActivationDeactivation (DcmDspDidSignal):
            DcmDspDidDataPos = 0
            DcmDspDidDataRef = DID_D09A_High_Quiescent_Current_Function_Activation_Deactivation_DID_D09A_High_Quiescent_Current_Function_ActivationDeactivation
        3 x DcmDspDataInfo, all with DcmDspDataFixedLength=true:
          DataInfo_DID_E324_Motor_Derating_reason_of_IEM_MGM_DID_E324_Motor_Derating_reason_of_IEMMGM
          DataInfo_DID_D005_High_Quiescent_Current_Fault_Identification_Data_Functionality_Activity_Level_Detect_DC_Bus_voltage_Ab8b181d9b
          DataInfo_DID_E301_HVDC_Current_DID_E301_HVDC_Current_
        7 x DcmDspData, all with DcmDspDataUsePort=USE_DATA_ASYNCH_CLIENT_SERVER:
          DID_D211_Network_Management_History_Propulsion_CAN_DID_D211_2_Latest_State_Global_Real_Time: DcmDspDataSize=32, DcmDspDataType=UINT32, DcmDspDataInfoRef=DataInfo_DID_D211_Network_Management_History_Propulsion_CAN_DID_D211_2_Latest_State_Global_Real_Time
          DID_D005_High_Quiescent_Current_Fault_Identification_Data_D005_2st_Functionality_Activity_Level_PNC27: DcmDspDataSize=8, DcmDspDataType=UINT8, DcmDspDataInfoRef=DataInfo_DID_D005_High_Quiescent_Current_Fault_Identification_Data_D005_2st_Functionality_Activity_Level_PNC27
          DID_F186_Active_Diagnostic_Session_DID_F186_Active_Diagnostic_Session: DcmDspDataSize=8, DcmDspDataType=UINT8, DcmDspDataInfoRef=DataInfo_DID_F186_Active_Diagnostic_Session_DID_F186_Active_Diagnostic_Session
          DID_E103_Car_Configuration_Parameter_Faults_DID_E103_17_8th_parameter_invalid_value: DcmDspDataSize=8, DcmDspDataType=UINT8, DcmDspDataInfoRef=DataInfo_DID_E103_Car_Configuration_Parameter_Faults_DID_E103_17_8th_parameter_invalid_value
          DID_D005_High_Quiescent_Current_Fault_Identification_Data_D005_2st_Functionality_Activity_Level_PNC26: DcmDspDataSize=8, DcmDspDataType=UINT8, DcmDspDataInfoRef=DataInfo_DID_D005_High_Quiescent_Current_Fault_Identification_Data_D005_2st_Functionality_Activity_Level_PNC26
          DID_D005_High_Quiescent_Current_Fault_Identification_Data_D005_2st_Functionality_Activity_Level_PNC25: DcmDspDataSize=8, DcmDspDataType=UINT8, DcmDspDataInfoRef=DataInfo_DID_D005_High_Quiescent_Current_Fault_Identification_Data_D005_2st_Functionality_Activity_Level_PNC25
          DID_D005_High_Quiescent_Current_Fault_Identification_Data_D005_2st_Functionality_Activity_Level_PNC24: DcmDspDataSize=8, DcmDspDataType=UINT8, DcmDspDataInfoRef=DataInfo_DID_D005_High_Quiescent_Current_Fault_Identification_Data_D005_2st_Functionality_Activity_Level_PNC24
        DidInfo_DID_E310_IEM_MGM_Derating_Status (DcmDspDidInfo)
          DcmDspDidAccess
            DcmDspDidRead: DcmDspDidReadSessionRef=defaultSession, DcmDspDidReadSessionRef=extendedDiagnosticSession
        DataInfo_DID_F126_Autosar_BSW_Cluster_Versions_DID_F126_2_DIAG_CLUSTER_SW_MAJOR_VERSION (DcmDspDataInfo): DcmDspDataFixedLength=true
        DataInfo_DID_F126_Autosar_BSW_Cluster_Versions_DID_F126_36_FLEXRAY_CLUSTER_AR_RELEASE_MAJOR_VERSION (DcmDspDataInfo): DcmDspDataFixedLength=true
        DID_D005_High_Quiescent_Current_Fault_Identification_Data_D005_2st_Functionality_Activity_Level_PNC29 (DcmDspData):
          DcmDspDataSize = 8
          DcmDspDataType = UINT8
          DcmDspDataUsePort = USE_DATA_ASYNCH_CLIENT_SERVER
          DcmDspDataInfoRef = DataInfo_DID_D005_High_Quiescent_Current_Fault_Identification_Data_D005_2st_Functionality_Activity_Level_PNC29
        DID_F121_Primary_Bootloader_Diagnostic_Database_Part_Number_ASCII_part (DcmDspData):
          DcmDspDataSize = 24
          DcmDspDataType = UINT8_N
          DcmDspDataUsePort = USE_DATA_ASYNCH_CLIENT_SERVER
          DcmDspDataInfoRef = DataInfo_DID_F121_Primary_Bootloader_Diagnostic_Database_Part_Number_ASCII_part
        DataInfo_DID_F126_Autosar_BSW_Cluster_Versions_DID_F126_6_DIAG_CLUSTER_AR_RELEASE_MINOR_VERSION (DcmDspDataInfo): DcmDspDataFixedLength=true
        DidInfo_DID_E313_Active_discharge_status (DcmDspDidInfo)
          DcmDspDidAccess
            DcmDspDidRead: DcmDspDidReadSessionRef=defaultSession, DcmDspDidReadSessionRef=extendedDiagnosticSession
        DidInfo_DID_E305_Inverter_IGBT_Junction_Temp (DcmDspDidInfo)
          DcmDspDidAccess
            DcmDspDidRead: DcmDspDidReadSessionRef=defaultSession, DcmDspDidReadSessionRef=extendedDiagnosticSession
        DataInfo_DID_EEBE_Offset_angle_status_DID_EEBE_Offset_angle_status (DcmDspDataInfo): DcmDspDataFixedLength=true
        DataInfo_DID_D211_Network_Management_History_Propulsion_CAN_DID_D211_18_9th_Latest_State_Global_Real_Time (DcmDspDataInfo): DcmDspDataFixedLength=true
        DidInfo_DID_E358_Resolve_angle (DcmDspDidInfo)
          DcmDspDidAccess
            DcmDspDidRead: DcmDspDidReadSessionRef=defaultSession, DcmDspDidReadSessionRef=extendedDiagnosticSession
        DID_F126_Autosar_BSW_Cluster_Versions_DID_F126_2_DIAG_CLUSTER_SW_MAJOR_VERSION (DcmDspData):
          DcmDspDataSize = 8
          DcmDspDataType = UINT8
          DcmDspDataUsePort = USE_DATA_ASYNCH_CLIENT_SERVER
          DcmDspDataInfoRef = DataInfo_DID_F126_Autosar_BSW_Cluster_Versions_DID_F126_2_DIAG_CLUSTER_SW_MAJOR_VERSION
        DID_D005_High_Quiescent_Current_Fault_Identification_Data_Functionality_Activity_Level_Detect_DC_Bus_voltage_Abnormal_4st (DcmDspData):
          DcmDspDataSize = 8
          DcmDspDataType = UINT8
          DcmDspDataUsePort = USE_DATA_ASYNCH_CLIENT_SERVER
          DcmDspDataInfoRef = DataInfo_DID_D005_High_Quiescent_Current_Fault_Identification_Data_Functionality_Activity_Level_Detect_DC_Bus_voltage_Ab8f956129
        DataInfo_DID_D211_Network_Management_History_Propulsion_CAN_DID_D211_16_8th_Latest_State_Global_Real_Time (DcmDspDataInfo): DcmDspDataFixedLength=true
        DidInfo_DID_E320_System_Mode_Mismatch (DcmDspDidInfo)
          DcmDspDidAccess
            DcmDspDidRead: DcmDspDidReadSessionRef=defaultSession, DcmDspDidReadSessionRef=extendedDiagnosticSession
        6 x DcmDspDataInfo, all with DcmDspDataFixedLength=true:
          DataInfo_DID_F12F_ECU_Software_Extended_Part_Numbers_BCD_part_006
          DataInfo_DID_F12F_ECU_Software_Extended_Part_Numbers_BCD_part_005
          DataInfo_DID_E315_Available_Torque_minimum_DID_E315_Available_Torque_minimum
          DataInfo_DID_F12F_ECU_Software_Extended_Part_Numbers_BCD_part_008
          DataInfo_DID_F12F_ECU_Software_Extended_Part_Numbers_BCD_part_007
          DataInfo_DID_F12F_ECU_Software_Extended_Part_Numbers_BCD_part_009
        DID_EE9C_Transient_Phase_Current_A (DcmDspDid):
          DcmDspDidIdentifier = 61084
          DcmDspDidUsed = true
          DcmDspDidUsePort = USE_DATA_ELEMENT_SPECIFIC_INTERFACES
          DcmDspDidInfoRef = DidInfo_DID_EE9C_Transient_Phase_Current_A
          DID_EE9C_Transient_Phase_Current_A (DcmDspDidSignal): DcmDspDidDataPos=0, DcmDspDidDataRef=DID_EE9C_Transient_Phase_Current_A_DID_EE9C_Transient_Phase_Current_A
        DataInfo_DID_EDA0_Complete_ECU_Part_Serial_Number_s_F120_Application_Diagnostic_Database_Part_Number (DcmDspDataInfo): DcmDspDataFixedLength=true
        DID_E349_Phase_V_PWM_duty (DcmDspDid):
          DcmDspDidIdentifier = 58185
          DcmDspDidUsed = true
          DcmDspDidUsePort = USE_DATA_ELEMENT_SPECIFIC_INTERFACES
          DcmDspDidInfoRef = DidInfo_DID_E349_Phase_V_PWM_duty
          DID_E349_Phase_V_PWM_duty (DcmDspDidSignal): DcmDspDidDataPos=0, DcmDspDidDataRef=DID_E349_Phase_V_PWM_duty_DID_E349_Phase_V_PWM_duty
        4 x DcmDspDataInfo, all with DcmDspDataFixedLength=true:
          DataInfo_DID_F12F_ECU_Software_Extended_Part_Numbers_BCD_part_002
          DataInfo_DID_F12F_ECU_Software_Extended_Part_Numbers_BCD_part_001
          DataInfo_DID_F12F_ECU_Software_Extended_Part_Numbers_BCD_part_004
          DataInfo_DID_F12F_ECU_Software_Extended_Part_Numbers_BCD_part_003
        DID_D211_Network_Management_History_Propulsion_CAN_DID_D211_17_9th_Latest_State_NM_History (DcmDspData):
          DcmDspDataSize = 8
          DcmDspDataType = UINT8
          DcmDspDataUsePort = USE_DATA_ASYNCH_CLIENT_SERVER
          DcmDspDataInfoRef = DataInfo_DID_D211_Network_Management_History_Propulsion_CAN_DID_D211_17_9th_Latest_State_NM_History
        DataInfo_DID_E103_Car_Configuration_Parameter_Faults_DID_E103_3_1st_parameter_invalid_value (DcmDspDataInfo): DcmDspDataFixedLength=true
        DID_D211_Network_Management_History_Propulsion_CAN_DID_D211_20_10th_Latest_State_Global_Real_Time (DcmDspData):
          DcmDspDataSize = 32
          DcmDspDataType = UINT32
          DcmDspDataUsePort = USE_DATA_ASYNCH_CLIENT_SERVER
          DcmDspDataInfoRef = DataInfo_DID_D211_Network_Management_History_Propulsion_CAN_DID_D211_20_10th_Latest_State_Global_Real_Time
        DID_D005_High_Quiescent_Current_Fault_Identification_Data_Reserved_Data_Field_1st (DcmDspData):
          DcmDspDataSize = 176
          DcmDspDataType = UINT8_N
          DcmDspDataUsePort = USE_DATA_ASYNCH_CLIENT_SERVER
          DcmDspDataInfoRef = DataInfo_DID_D005_High_Quiescent_Current_Fault_Identification_Data_Reserved_Data_Field_1st
        DataInfo_DID_E312_Wheel_Speed_DID_E312_Wheel_Speed (DcmDspDataInfo): DcmDspDataFixedLength=true
        DID_F1AF_ECU_Software_Extended_Part_Numbers_Geely_BCD_part (DcmDspData):
          DcmDspDataSize = 40
          DcmDspDataType = UINT8_N
          DcmDspDataUsePort = USE_DATA_ASYNCH_CLIENT_SERVER
          DcmDspDataInfoRef = DataInfo_DID_F1AF_ECU_Software_Extended_Part_Numbers_Geely_BCD_part
        DidInfo_DID_EEBD_IEM_MGM_rotor_offset_angle (DcmDspDidInfo)
          DcmDspDidAccess
            DcmDspDidWrite: DcmDspDidWriteSessionRef=extendedDiagnosticSession, DcmDspDidWriteSecurityLevelRef=CommonUnlock_Level_3
            DcmDspDidRead: DcmDspDidReadSessionRef=defaultSession, DcmDspDidReadSessionRef=extendedDiagnosticSession
        DataInfo_DID_E103_Car_Configuration_Parameter_Faults_DID_E103_8_4th_parameter_number_of_the_car_configuration_data_that_6f100f46 (DcmDspDataInfo): DcmDspDataFixedLength=true
        3 x DcmDspDid, all with DcmDspDidUsed=true, DcmDspDidUsePort=USE_DATA_ELEMENT_SPECIFIC_INTERFACES:
          DID_E315_Available_Torque_minimum: DcmDspDidIdentifier=58133, DcmDspDidInfoRef=DidInfo_DID_E315_Available_Torque_minimum
            DID_E315_Available_Torque_minimum (DcmDspDidSignal): DcmDspDidDataPos=0, DcmDspDidDataRef=DID_E315_Available_Torque_minimum_DID_E315_Available_Torque_minimum
          DID_E314_Available_Torque_maximum: DcmDspDidIdentifier=58132, DcmDspDidInfoRef=DidInfo_DID_E314_Available_Torque_maximum
            DID_E314_Available_Torque_maximum (DcmDspDidSignal): DcmDspDidDataPos=0, DcmDspDidDataRef=DID_E314_Available_Torque_maximum_DID_E314_Available_Torque_maximum
          DID_EDA0_Complete_ECU_Part_Serial_Number_s: DcmDspDidIdentifier=60832, DcmDspDidInfoRef=DidInfo_DID_EDA0_Complete_ECU_Part_Serial_Number_s
            11 x DcmDspDidSignal:
              DID_F12E_1_Total_number_of_ECU_Software_Part_Numbers: DcmDspDidDataPos=200, DcmDspDidDataRef=DID_EDA0_Complete_ECU_Part_Serial_Number_s_DID_F12E_1_Total_number_of_ECU_Software_Part_Numbers
              DID_F12A_ECU_Delivery_Assembly_Part_Number1_1: DcmDspDidDataPos=88, DcmDspDidDataRef=DID_EDA0_Complete_ECU_Part_Serial_Number_s_DID_F12A_ECU_Delivery_Assembly_Part_Number1_1
              Reserved: DcmDspDidDataPos=264, DcmDspDidDataRef=DID_EDA0_Complete_ECU_Part_Serial_Number_s_Reserved
              DID_F12B_ECU_Delivery_Assembly_Part_Number: DcmDspDidDataPos=112, DcmDspDidDataRef=DID_EDA0_Complete_ECU_Part_Serial_Number_s_DID_F12B_ECU_Delivery_Assembly_Part_Number
              DID_F18C_ECU_Serial_Number: DcmDspDidDataPos=168, DcmDspDidDataRef=DID_EDA0_Complete_ECU_Part_Serial_Number_s_DID_F18C_ECU_Serial_Number
              ASCII_part: DcmDspDidDataPos=240, DcmDspDidDataRef=DID_EDA0_Complete_ECU_Part_Serial_Number_s_ASCII_part
              DID_F12B_ECU_Delivery_Assembly_Part_Number1: DcmDspDidDataPos=144, DcmDspDidDataRef=DID_EDA0_Complete_ECU_Part_Serial_Number_s_DID_F12B_ECU_Delivery_Assembly_Part_Number1
              F120_Application_Diagnostic_Database_Part_Number1: DcmDspDidDataPos=32, DcmDspDidDataRef=DID_EDA0_Complete_ECU_Part_Serial_Number_s_F120_Application_Diagnostic_Database_Part_Number1
              F120_Application_Diagnostic_Database_Part_Number: DcmDspDidDataPos=0, DcmDspDidDataRef=DID_EDA0_Complete_ECU_Part_Serial_Number_s_F120_Application_Diagnostic_Database_Part_Number
              BCD_part: DcmDspDidDataPos=208, DcmDspDidDataRef=DID_EDA0_Complete_ECU_Part_Serial_Number_s_BCD_part
              DID_F12A_ECU_Delivery_Assembly_Part_Number_1: DcmDspDidDataPos=56, DcmDspDidDataRef=DID_EDA0_Complete_ECU_Part_Serial_Number_s_DID_F12A_ECU_Delivery_Assembly_Part_Number_1
        DID_E353_Flux_weakening_correction_factor_DID_E353_Flux_weakening_correction_factor (DcmDspData):
          DcmDspDataSize = 16
          DcmDspDataType = UINT16
          DcmDspDataUsePort = USE_DATA_ASYNCH_CLIENT_SERVER
          DcmDspDataInfoRef = DataInfo_DID_E353_Flux_weakening_correction_factor_DID_E353_Flux_weakening_correction_factor
        DataInfo_DID_D134_Car_Mode_DID_D134_Car_Mode (DcmDspDataInfo): DcmDspDataFixedLength=true
        DataInfo_DID_E103_Car_Configuration_Parameter_Faults_DID_E103_2_1st_parameter_number_of_the_car_configuration_data_that_d6896c26 (DcmDspDataInfo): DcmDspDataFixedLength=true
        3 x DcmDspData, all with DcmDspDataUsePort=USE_DATA_ASYNCH_CLIENT_SERVER:
          DID_E320_System_Mode_Mismatch_DID_E320_System_Mode_Mismatch: DcmDspDataSize=8, DcmDspDataType=UINT8, DcmDspDataInfoRef=DataInfo_DID_E320_System_Mode_Mismatch_DID_E320_System_Mode_Mismatch
          DID_F126_Autosar_BSW_Cluster_Versions_DID_F126_22_COM_CLUSTER_AR_RELEASE_MAJOR_VERSION: DcmDspDataSize=8, DcmDspDataType=UINT8, DcmDspDataInfoRef=DataInfo_DID_F126_Autosar_BSW_Cluster_Versions_DID_F126_22_COM_CLUSTER_AR_RELEASE_MAJOR_VERSION
          DID_EEB6_ECM_Power_Limitation_maximum_DID_EEB6_ECM_Power_Limitation_maximum: DcmDspDataSize=16, DcmDspDataType=UINT16, DcmDspDataInfoRef=DataInfo_DID_EEB6_ECM_Power_Limitation_maximum_DID_EEB6_ECM_Power_Limitation_maximum
        DID_EED4_Safty_Function_Mode (DcmDspDid):
          DcmDspDidIdentifier = 61140
          DcmDspDidUsed = true
          DcmDspDidUsePort = USE_DATA_ELEMENT_SPECIFIC_INTERFACES
          DcmDspDidInfoRef = DidInfo_DID_EED4_Safty_Function_Mode
          DID_EED4_Safty_Function_Mode (DcmDspDidSignal): DcmDspDidDataPos=0, DcmDspDidDataRef=DID_EED4_Safty_Function_Mode_DID_EED4_Safty_Function_Mode
        DataInfo_DID_F126_Autosar_BSW_Cluster_Versions_DID_F126_18_COM_CLUSTER_VENDOR_ID (DcmDspDataInfo): DcmDspDataFixedLength=true
        DataInfo_DID_D005_High_Quiescent_Current_Fault_Identification_Data_Functionality_Activity_Level_Detect_CPSR_Keep_Active_3st (DcmDspDataInfo): DcmDspDataFixedLength=true
        DID_EEC3_ECU_power_supply_Voltage (DcmDspDid):
          DcmDspDidIdentifier = 61123
          DcmDspDidUsed = true
          DcmDspDidUsePort = USE_DATA_ELEMENT_SPECIFIC_INTERFACES
          DcmDspDidInfoRef = DidInfo_DID_EEC3_ECU_power_supply_Voltage
          DID_EEC3_ECU_power_supply_Voltage (DcmDspDidSignal): DcmDspDidDataPos=0, DcmDspDidDataRef=DID_EEC3_ECU_power_supply_Voltage_DID_EEC3_ECU_power_supply_Voltage
        DID_F121_Primary_Bootloader_Diagnostic_Database_Part_Number_BCD_part (DcmDspData):
          DcmDspDataSize = 32
          DcmDspDataType = UINT32
          DcmDspDataUsePort = USE_DATA_ASYNCH_CLIENT_SERVER
          DcmDspDataInfoRef = DataInfo_DID_F121_Primary_Bootloader_Diagnostic_Database_Part_Number_BCD_part
        DID_F125_Primary_Bootloader_Software_Part_Number_ASCII_part (DcmDspData):
          DcmDspDataSize = 24
          DcmDspDataType = UINT8_N
          DcmDspDataUsePort = USE_DATA_ASYNCH_CLIENT_SERVER
          DcmDspDataInfoRef = DataInfo_DID_F125_Primary_Bootloader_Software_Part_Number_ASCII_part
        DataInfo_DID_E353_Flux_weakening_correction_factor_DID_E353_Flux_weakening_correction_factor (DcmDspDataInfo): DcmDspDataFixedLength=true
        DidInfo_DID_D12F_Security_Constant_Level_11_12 (DcmDspDidInfo)
          DcmDspDidAccess
            DcmDspDidWrite: DcmDspDidWriteSessionRef=extendedDiagnosticSession, DcmDspDidWriteSecurityLevelRef=ImmoUnlocked_Level_4
            DcmDspDidRead: DcmDspDidReadSessionRef=extendedDiagnosticSession, DcmDspDidReadSecurityLevelRef=ImmoUnlocked_Level_4
        DataInfo_DID_EED4_Safty_Function_Mode_DID_EED4_Safty_Function_Mode (DcmDspDataInfo): DcmDspDataFixedLength=true
        DID_E331_Software_Version_DID_E331_2_BSW_Software_Version (DcmDspData):
          DcmDspDataSize = 64
          DcmDspDataType = UINT8_N
          DcmDspDataUsePort = USE_DATA_ASYNCH_CLIENT_SERVER
          DcmDspDataInfoRef = DataInfo_DID_E331_Software_Version_DID_E331_2_BSW_Software_Version
        DataInfo_DID_D211_Network_Management_History_Propulsion_CAN_DID_D211_10_5th_Latest_State_Global_Real_Time (DcmDspDataInfo): DcmDspDataFixedLength=true
        DataInfo_DID_D005_High_Quiescent_Current_Fault_Identification_Data_DID_D005_2st_Usage_Mode_when_DID_is_triggered (DcmDspDataInfo): DcmDspDataFixedLength=true
        DidInfo_DID_E348_Phase_U_PWM_duty (DcmDspDidInfo)
          DcmDspDidAccess
            DcmDspDidRead: DcmDspDidReadSessionRef=defaultSession, DcmDspDidReadSessionRef=extendedDiagnosticSession
        DataInfo_DID_E103_Car_Configuration_Parameter_Faults_DID_E103_7_3rd_parameter_invalid_value (DcmDspDataInfo): DcmDspDataFixedLength=true
        DidInfo_DID_F1AB_ECU_Delivery_Assembly_Part_Number_Geely (DcmDspDidInfo)
          DcmDspDidAccess
            DcmDspDidRead: DcmDspDidReadSessionRef=defaultSession, DcmDspDidReadSessionRef=extendedDiagnosticSession
        DID_EF1B_EOL_config_word_A (DcmDspDid):
          DcmDspDidIdentifier = 61211
          DcmDspDidUsed = true
          DcmDspDidUsePort = USE_DATA_ELEMENT_SPECIFIC_INTERFACES
          DcmDspDidInfoRef = DidInfo_DID_EF1B_EOL_config_word_A
          DID_EF1B_EOL_config_word_A (DcmDspDidSignal): DcmDspDidDataPos=0, DcmDspDidDataRef=DID_EF1B_EOL_config_word_A_DID_EF1B_EOL_config_word_A
        DID_EE9E_Transient_Phase_Current_C_DID_EE9E_Transient_Phase_Current_C (DcmDspData):
          DcmDspDataSize = 16
          DcmDspDataType = UINT16
          DcmDspDataUsePort = USE_DATA_ASYNCH_CLIENT_SERVER
          DcmDspDataInfoRef = DataInfo_DID_EE9E_Transient_Phase_Current_C_DID_EE9E_Transient_Phase_Current_C
        DidInfo_DID_EED5_Safety_Torque_QF_factor (DcmDspDidInfo)
          DcmDspDidAccess
            DcmDspDidRead
        6 x DcmDspData, all with DcmDspDataUsePort=USE_DATA_ASYNCH_CLIENT_SERVER:
          DID_D005_High_Quiescent_Current_Fault_Identification_Data_Functionality_Activity_Level_Detect_DC_Bus_voltage_Abnormal_2st: DcmDspDataSize=8, DcmDspDataType=UINT8, DcmDspDataInfoRef=DataInfo_DID_D005_High_Quiescent_Current_Fault_Identification_Data_Functionality_Activity_Level_Detect_DC_Bus_voltage_Ab8b181d9b
          DID_D211_Network_Management_History_Propulsion_CAN_DID_D211_7_4th_Latest_State_NM_History: DcmDspDataSize=8, DcmDspDataType=UINT8, DcmDspDataInfoRef=DataInfo_DID_D211_Network_Management_History_Propulsion_CAN_DID_D211_7_4th_Latest_State_NM_History
          DID_D005_High_Quiescent_Current_Fault_Identification_Data_DID_D005_2st_Usage_Mode_when_DID_is_triggered: DcmDspDataSize=8, DcmDspDataType=UINT8, DcmDspDataInfoRef=DataInfo_DID_D005_High_Quiescent_Current_Fault_Identification_Data_DID_D005_2st_Usage_Mode_when_DID_is_triggered
          DID_E311_Crash_Status_DID_E311_Crash_Status: DcmDspDataSize=8, DcmDspDataType=UINT8, DcmDspDataInfoRef=DataInfo_DID_E311_Crash_Status_DID_E311_Crash_Status
          DID_F126_Autosar_BSW_Cluster_Versions_DID_F126_42_LIN_CLUSTER_SW_PATCH_VERSION: DcmDspDataSize=8, DcmDspDataType=UINT8, DcmDspDataInfoRef=DataInfo_DID_F126_Autosar_BSW_Cluster_Versions_DID_F126_42_LIN_CLUSTER_SW_PATCH_VERSION
          DID_E303_Motor_Speed_DID_E303_Motor_Speed_: DcmDspDataSize=16, DcmDspDataType=UINT16, DcmDspDataInfoRef=DataInfo_DID_E303_Motor_Speed_DID_E303_Motor_Speed_
        DidInfo_DID_EEB2_Three_Phase_Motor_Current_RMS_Current (DcmDspDidInfo)
          DcmDspDidAccess
            DcmDspDidRead: DcmDspDidReadSessionRef=defaultSession, DcmDspDidReadSessionRef=extendedDiagnosticSession
        DataInfo_DID_D211_Network_Management_History_Propulsion_CAN_DID_D211_9_5th_Latest_State_NM_History (DcmDspDataInfo): DcmDspDataFixedLength=true
        DID_EEBF_HV_Main_Relay_Status (DcmDspDid):
          DcmDspDidIdentifier = 61119
          DcmDspDidUsed = true
          DcmDspDidUsePort = USE_DATA_ELEMENT_SPECIFIC_INTERFACES
          DcmDspDidInfoRef = DidInfo_DID_EEBF_HV_Main_Relay_Status
          DID_EEBF_HV_Main_Relay_Status (DcmDspDidSignal): DcmDspDidDataPos=0, DcmDspDidDataRef=DID_EEBF_HV_Main_Relay_Status_DID_EEBF_HV_Main_Relay_Status
        DID_D005_High_Quiescent_Current_Fault_Identification_Data_Reserved_Data_Field_3st (DcmDspData):
          DcmDspDataSize = 176
          DcmDspDataType = UINT8_N
          DcmDspDataUsePort = USE_DATA_ASYNCH_CLIENT_SERVER
          DcmDspDataInfoRef = DataInfo_DID_D005_High_Quiescent_Current_Fault_Identification_Data_Reserved_Data_Field_3st
        DataInfo_DID_D005_High_Quiescent_Current_Fault_Identification_Data_Functionality_Activity_Level_Detect_Motor_Speed_Abnormal_2st (DcmDspDataInfo): DcmDspDataFixedLength=true
        DID_D211_Network_Management_History_Propulsion_CAN_DID_D211_18_9th_Latest_State_Global_Real_Time (DcmDspData):
          DcmDspDataSize = 32
          DcmDspDataType = UINT32
          DcmDspDataUsePort = USE_DATA_ASYNCH_CLIENT_SERVER
          DcmDspDataInfoRef = DataInfo_DID_D211_Network_Management_History_Propulsion_CAN_DID_D211_18_9th_Latest_State_Global_Real_Time
        DataInfo_DID_EF1C_EOL_config_word_B_DID_EF1C_EOL_config_word_B (DcmDspDataInfo): DcmDspDataFixedLength=true
        5 x DcmDspData, all with DcmDspDataUsePort=USE_DATA_ASYNCH_CLIENT_SERVER:
          DID_F12F_ECU_Software_Extended_Part_Numbers_BCD_part: DcmDspDataSize=32, DcmDspDataType=UINT32, DcmDspDataInfoRef=DataInfo_DID_F12F_ECU_Software_Extended_Part_Numbers_BCD_part
          DID_E315_Available_Torque_minimum_DID_E315_Available_Torque_minimum: DcmDspDataSize=16, DcmDspDataType=UINT16, DcmDspDataInfoRef=DataInfo_DID_E315_Available_Torque_minimum_DID_E315_Available_Torque_minimum
          DID_F126_Autosar_BSW_Cluster_Versions_DID_F126_3_DIAG_CLUSTER_SW_MINOR_VERSION: DcmDspDataSize=8, DcmDspDataType=UINT8, DcmDspDataInfoRef=DataInfo_DID_F126_Autosar_BSW_Cluster_Versions_DID_F126_3_DIAG_CLUSTER_SW_MINOR_VERSION
          DID_E319_Torque_Direction_DID_E319_Torque_Direction: DcmDspDataSize=8, DcmDspDataType=UINT8, DcmDspDataInfoRef=DataInfo_DID_E319_Torque_Direction_DID_E319_Torque_Direction
          DID_EDA0_Complete_ECU_Part_Serial_Number_s_DID_F18C_ECU_Serial_Number: DcmDspDataSize=32, DcmDspDataType=UINT32, DcmDspDataInfoRef=DataInfo_DID_EDA0_Complete_ECU_Part_Serial_Number_s_DID_F18C_ECU_Serial_Number
        DidInfo_DID_DD0C_Electric_Power_Level (DcmDspDidInfo)
          DcmDspDidAccess
            DcmDspDidRead: DcmDspDidReadSessionRef=defaultSession, DcmDspDidReadSessionRef=extendedDiagnosticSession
        DID_EF1B_EOL_config_word_A_DID_EF1B_EOL_config_word_A (DcmDspData):
          DcmDspDataSize = 16
          DcmDspDataType = UINT16
          DcmDspDataUsePort = USE_DATA_ASYNCH_CLIENT_SERVER
          DcmDspDataInfoRef = DataInfo_DID_EF1B_EOL_config_word_A_DID_EF1B_EOL_config_word_A
        DID_D005_High_Quiescent_Current_Fault_Identification_Data_DID_D005_4st_Global_time_when_Functionality_Activity_level_Sled82c72cd (DcmDspData):
          DcmDspDataSize = 32
          DcmDspDataType = UINT32
          DcmDspDataUsePort = USE_DATA_ASYNCH_CLIENT_SERVER
          DcmDspDataInfoRef = DataInfo_DID_D005_High_Quiescent_Current_Fault_Identification_Data_DID_D005_4st_Global_time_when_Functionality_Activity_a8781345
        3 x DcmDspDataInfo, all with DcmDspDataFixedLength=true:
          DataInfo_DID_EEB8_HV_voltage_received_from_BECM_DID_EEB8_HV_voltage_received_from_BECM
          DataInfo_DID_F126_Autosar_BSW_Cluster_Versions_DID_F126_39_LIN_CLUSTER_VENDOR_ID
          DataInfo_DID_D005_High_Quiescent_Current_Fault_Identification_Data_Functionality_Activity_Level_Detect_CPSR_Keep_Active_5st
        DidInfo_DID_EEBE_Offset_angle_status (DcmDspDidInfo)
          DcmDspDidAccess
            DcmDspDidRead: DcmDspDidReadSessionRef=defaultSession, DcmDspDidReadSessionRef=extendedDiagnosticSession
        DataInfo_DID_E311_Crash_Status_DID_E311_Crash_Status (DcmDspDataInfo): DcmDspDataFixedLength=true
        DID_EEC3_ECU_power_supply_Voltage_DID_EEC3_ECU_power_supply_Voltage (DcmDspData):
          DcmDspDataSize = 8
          DcmDspDataType = UINT8
          DcmDspDataUsePort = USE_DATA_ASYNCH_CLIENT_SERVER
          DcmDspDataInfoRef = DataInfo_DID_EEC3_ECU_power_supply_Voltage_DID_EEC3_ECU_power_supply_Voltage
        DID_DD0A_Usage_Mode_DID_DD0A_Usage_Mode (DcmDspData):
          DcmDspDataSize = 8
          DcmDspDataType = UINT8
          DcmDspDataUsePort = USE_DATA_ASYNCH_CLIENT_SERVER
          DcmDspDataInfoRef = DataInfo_DID_DD0A_Usage_Mode_DID_DD0A_Usage_Mode
        DID_E350_Phase_W_PWM_duty (DcmDspDid):
          DcmDspDidIdentifier = 58192
          DcmDspDidUsed = true
          DcmDspDidUsePort = USE_DATA_ELEMENT_SPECIFIC_INTERFACES
          DcmDspDidInfoRef = DidInfo_DID_E350_Phase_W_PWM_duty
          DID_E350_Phase_W_PWM_duty (DcmDspDidSignal): DcmDspDidDataPos=0, DcmDspDidDataRef=DID_E350_Phase_W_PWM_duty_DID_E350_Phase_W_PWM_duty
        DID_ED20_Complete_set_of_ECU_part_serial_numbers_Geely_DID_F1AE_1_Total_number_of_ECU_Software_Part_Numbers (DcmDspData):
          DcmDspDataSize = 8
          DcmDspDataType = UINT8
          DcmDspDataUsePort = USE_DATA_ASYNCH_CLIENT_SERVER
          DcmDspDataInfoRef = DataInfo_DID_ED20_Complete_set_of_ECU_part_serial_numbers_Geely_DID_F1AE_1_Total_number_of_ECU_Software_Part_Numbers
        DataInfo_DID_D211_Network_Management_History_Propulsion_CAN_DID_D211_6_3rd_Latest_State_Global_Real_Time (DcmDspDataInfo): DcmDspDataFixedLength=true
        DID_F126_Autosar_BSW_Cluster_Versions_DID_F126_10_DIAG_CLUSTER_VCC_FIM_VERSION (DcmDspData):
          DcmDspDataSize = 8
          DcmDspDataType = UINT8
          DcmDspDataUsePort = USE_DATA_ASYNCH_CLIENT_SERVER
          DcmDspDataInfoRef = DataInfo_DID_F126_Autosar_BSW_Cluster_Versions_DID_F126_10_DIAG_CLUSTER_VCC_FIM_VERSION
        DataInfo_DID_EEC4_Charging_Power_Sustain_Relay_CPSR_Voltage_DID_EEC4_Charging_Power_Sustain_RelayCPSR_Voltage (DcmDspDataInfo): DcmDspDataFixedLength=true
        DID_EEBF_HV_Main_Relay_Status_DID_EEBF_HV_Main_Relay_Status (DcmDspData):
          DcmDspDataSize = 8
          DcmDspDataType = UINT8
          DcmDspDataUsePort = USE_DATA_ASYNCH_CLIENT_SERVER
          DcmDspDataInfoRef = DataInfo_DID_EEBF_HV_Main_Relay_Status_DID_EEBF_HV_Main_Relay_Status
        DID_F126_Autosar_BSW_Cluster_Versions (DcmDspDid):
          DcmDspDidIdentifier = 61734
          DcmDspDidUsed = true
          DcmDspDidUsePort = USE_DATA_ELEMENT_SPECIFIC_INTERFACES
          DcmDspDidInfoRef = DidInfo_DID_F126_Autosar_BSW_Cluster_Versions
          45 x DcmDspDidSignal:
            DID_F126_24_COM_CLUSTER_AR_RELEASE_REVISION_VERSION: DcmDspDidDataPos=208, DcmDspDidDataRef=DID_F126_Autosar_BSW_Cluster_Versions_DID_F126_24_COM_CLUSTER_AR_RELEASE_REVISION_VERSION
            DID_F126_36_FLEXRAY_CLUSTER_AR_RELEASE_MAJOR_VERSION: DcmDspDidDataPos=320, DcmDspDidDataRef=DID_F126_Autosar_BSW_Cluster_Versions_DID_F126_36_FLEXRAY_CLUSTER_AR_RELEASE_MAJOR_VERSION
            DID_F126_31_CAN_CLUSTER_AR_RELEASE_REVISION_VERSION: DcmDspDidDataPos=272, DcmDspDidDataRef=DID_F126_Autosar_BSW_Cluster_Versions_DID_F126_31_CAN_CLUSTER_AR_RELEASE_REVISION_VERSION
            DID_F126_26_CAN_CLUSTER_SW_MAJOR_VERSION: DcmDspDidDataPos=232, DcmDspDidDataRef=DID_F126_Autosar_BSW_Cluster_Versions_DID_F126_26_CAN_CLUSTER_SW_MAJOR_VERSION
            DID_F126_9_DIAG_CLUSTER_VCC_DCM_VERSION: DcmDspDidDataPos=72, DcmDspDidDataRef=DID_F126_Autosar_BSW_Cluster_Versions_DID_F126_9_DIAG_CLUSTER_VCC_DCM_VERSION
            DID_F126_40_LIN_CLUSTER_SW_MAJOR_VERSION: DcmDspDidDataPos=360, DcmDspDidDataRef=DID_F126_Autosar_BSW_Cluster_Versions_DID_F126_40_LIN_CLUSTER_SW_MAJOR_VERSION
            DID_F126_15_MODEMGMT_CLUSTER_AR_RELEASE_MAJOR_VERSION: DcmDspDidDataPos=128, DcmDspDidDataRef=DID_F126_Autosar_BSW_Cluster_Versions_DID_F126_15_MODEMGMT_CLUSTER_AR_RELEASE_MAJOR_VERSION
            DID_F126_6_DIAG_CLUSTER_AR_RELEASE_MINOR_VERSION: DcmDspDidDataPos=48, DcmDspDidDataRef=DID_F126_Autosar_BSW_Cluster_Versions_DID_F126_6_DIAG_CLUSTER_AR_RELEASE_MINOR_VERSION
            DID_F126_3_DIAG_CLUSTER_SW_MINOR_VERSION: DcmDspDidDataPos=24, DcmDspDidDataRef=DID_F126_Autosar_BSW_Cluster_Versions_DID_F126_3_DIAG_CLUSTER_SW_MINOR_VERSION
            DID_F126_8_DIAG_CLUSTER_VCC_DEM_VERSION: DcmDspDidDataPos=64, DcmDspDidDataRef=DID_F126_Autosar_BSW_Cluster_Versions_DID_F126_8_DIAG_CLUSTER_VCC_DEM_VERSION
            DID_F126_39_LIN_CLUSTER_VENDOR_ID: DcmDspDidDataPos=344, DcmDspDidDataRef=DID_F126_Autosar_BSW_Cluster_Versions_DID_F126_39_LIN_CLUSTER_VENDOR_ID
            DID_F126_43_LIN_CLUSTER_AR_RELEASE_MAJOR_VERSION: DcmDspDidDataPos=384, DcmDspDidDataRef=DID_F126_Autosar_BSW_Cluster_Versions_DID_F126_43_LIN_CLUSTER_AR_RELEASE_MAJOR_VERSION
            DID_F126_13_MODEMGMT_CLUSTER_SW_MINOR_VERSION: DcmDspDidDataPos=112, DcmDspDidDataRef=DID_F126_Autosar_BSW_Cluster_Versions_DID_F126_13_MODEMGMT_CLUSTER_SW_MINOR_VERSION
            DID_F126_23_COM_CLUSTER_AR_RELEASE_MINOR_VERSION: DcmDspDidDataPos=200, DcmDspDidDataRef=DID_F126_Autosar_BSW_Cluster_Versions_DID_F126_23_COM_CLUSTER_AR_RELEASE_MINOR_VERSION
            DID_F126_20_COM_CLUSTER_SW_MINOR_VERSION: DcmDspDidDataPos=176, DcmDspDidDataRef=DID_F126_Autosar_BSW_Cluster_Versions_DID_F126_20_COM_CLUSTER_SW_MINOR_VERSION
            DID_F126_16_MODEMGMT_CLUSTER_AR_RELEASE_MINOR_VERSION: DcmDspDidDataPos=136, DcmDspDidDataRef=DID_F126_Autosar_BSW_Cluster_Versions_DID_F126_16_MODEMGMT_CLUSTER_AR_RELEASE_MINOR_VERSION
            DID_F126_2_DIAG_CLUSTER_SW_MAJOR_VERSION: DcmDspDidDataPos=16, DcmDspDidDataRef=DID_F126_Autosar_BSW_Cluster_Versions_DID_F126_2_DIAG_CLUSTER_SW_MAJOR_VERSION
            DID_F126_35_FLEXRAY_CLUSTER_SW_PATCH_VERSION: DcmDspDidDataPos=312, DcmDspDidDataRef=DID_F126_Autosar_BSW_Cluster_Versions_DID_F126_35_FLEXRAY_CLUSTER_SW_PATCH_VERSION
            DID_F126_17_MODEMGMT_CLUSTER_AR_RELEASE_REVISION_VERSION: DcmDspDidDataPos=144, DcmDspDidDataRef=DID_F126_Autosar_BSW_Cluster_Versions_DID_F126_17_MODEMGMT_CLUSTER_AR_RELEASE_REVISION_VERSION
            DID_F126_4_DIAG_CLUSTER_SW_PATCH_VERSION: DcmDspDidDataPos=32, DcmDspDidDataRef=DID_F126_Autosar_BSW_Cluster_Versions_DID_F126_4_DIAG_CLUSTER_SW_PATCH_VERSION
            DID_F126_27_CAN_CLUSTER_SW_MINOR_VERSION: DcmDspDidDataPos=240, DcmDspDidDataRef=DID_F126_Autosar_BSW_Cluster_Versions_DID_F126_27_CAN_CLUSTER_SW_MINOR_VERSION
            DID_F126_7_DIAG_CLUSTER_AR_RELEASE_REVISION_VERSION: DcmDspDidDataPos=56, DcmDspDidDataRef=DID_F126_Autosar_BSW_Cluster_Versions_DID_F126_7_DIAG_CLUSTER_AR_RELEASE_REVISION_VERSION
            DID_F126_11_MODEMGMT_CLUSTER_VENDOR_ID: DcmDspDidDataPos=88, DcmDspDidDataRef=DID_F126_Autosar_BSW_Cluster_Versions_DID_F126_11_MODEMGMT_CLUSTER_VENDOR_ID
            DID_F126_34_FLEXRAY_CLUSTER_SW_MINOR_VERSION: DcmDspDidDataPos=304, DcmDspDidDataRef=DID_F126_Autosar_BSW_Cluster_Versions_DID_F126_34_FLEXRAY_CLUSTER_SW_MINOR_VERSION
            DID_F126_5_DIAG_CLUSTER_AR_RELEASE_MAJOR_VERSION: DcmDspDidDataPos=40, DcmDspDidDataRef=DID_F126_Autosar_BSW_Cluster_Versions_DID_F126_5_DIAG_CLUSTER_AR_RELEASE_MAJOR_VERSION
            DID_F126_28_CAN_CLUSTER_SW_PATCH_VERSION: DcmDspDidDataPos=248, DcmDspDidDataRef=DID_F126_Autosar_BSW_Cluster_Versions_DID_F126_28_CAN_CLUSTER_SW_PATCH_VERSION
            DID_F126_25_CAN_CLUSTER_VENDOR_ID: DcmDspDidDataPos=216, DcmDspDidDataRef=DID_F126_Autosar_BSW_Cluster_Versions_DID_F126_25_CAN_CLUSTER_VENDOR_ID
            DID_F126_42_LIN_CLUSTER_SW_PATCH_VERSION: DcmDspDidDataPos=376, DcmDspDidDataRef=DID_F126_Autosar_BSW_Cluster_Versions_DID_F126_42_LIN_CLUSTER_SW_PATCH_VERSION
            DID_F126_19_COM_CLUSTER_SW_MAJOR_VERSION: DcmDspDidDataPos=168, DcmDspDidDataRef=DID_F126_Autosar_BSW_Cluster_Versions_DID_F126_19_COM_CLUSTER_SW_MAJOR_VERSION
            DID_F126_30_CAN_CLUSTER_AR_RELEASE_MINOR_VERSION: DcmDspDidDataPos=264, DcmDspDidDataRef=DID_F126_Autosar_BSW_Cluster_Versions_DID_F126_30_CAN_CLUSTER_AR_RELEASE_MINOR_VERSION
            DID_F126_21_COM_CLUSTER_SW_PATCH_VERSION: DcmDspDidDataPos=184, DcmDspDidDataRef=DID_F126_Autosar_BSW_Cluster_Versions_DID_F126_21_COM_CLUSTER_SW_PATCH_VERSION
            DID_F126_14_MODEMGMT_CLUSTER_SW_PATCH_VERSION: DcmDspDidDataPos=120, DcmDspDidDataRef=DID_F126_Autosar_BSW_Cluster_Versions_DID_F126_14_MODEMGMT_CLUSTER_SW_PATCH_VERSION
            DID_F126_1_DIAG_CLUSTER_VENDOR_ID: DcmDspDidDataPos=0, DcmDspDidDataRef=DID_F126_Autosar_BSW_Cluster_Versions_DID_F126_1_DIAG_CLUSTER_VENDOR_ID
            DID_F126_41_LIN_CLUSTER_SW_MINOR_VERSION: DcmDspDidDataPos=368, DcmDspDidDataRef=DID_F126_Autosar_BSW_Cluster_Versions_DID_F126_41_LIN_CLUSTER_SW_MINOR_VERSION
            DID_F126_10_DIAG_CLUSTER_VCC_FIM_VERSION: DcmDspDidDataPos=80, DcmDspDidDataRef=DID_F126_Autosar_BSW_Cluster_Versions_DID_F126_10_DIAG_CLUSTER_VCC_FIM_VERSION
            DID_F126_18_COM_CLUSTER_VENDOR_ID: DcmDspDidDataPos=152, DcmDspDidDataRef=DID_F126_Autosar_BSW_Cluster_Versions_DID_F126_18_COM_CLUSTER_VENDOR_ID
            DID_F126_38_FLEXRAY_CLUSTER_AR_RELEASE_REVISION_VERSION: DcmDspDidDataPos=336, DcmDspDidDataRef=DID_F126_Autosar_BSW_Cluster_Versions_DID_F126_38_FLEXRAY_CLUSTER_AR_RELEASE_REVISION_VERSION
            DID_F126_32_FLEXRAY_CLUSTER_VENDOR_ID: DcmDspDidDataPos=280, DcmDspDidDataRef=DID_F126_Autosar_BSW_Cluster_Versions_DID_F126_32_FLEXRAY_CLUSTER_VENDOR_ID
            DID_F126_12_MODEMGMT_CLUSTER_SW_MAJOR_VERSION: DcmDspDidDataPos=104, DcmDspDidDataRef=DID_F126_Autosar_BSW_Cluster_Versions_DID_F126_12_MODEMGMT_CLUSTER_SW_MAJOR_VERSION
            DID_F126_29_CAN_CLUSTER_AR_RELEASE_MAJOR_VERSION: DcmDspDidDataPos=256, DcmDspDidDataRef=DID_F126_Autosar_BSW_Cluster_Versions_DID_F126_29_CAN_CLUSTER_AR_RELEASE_MAJOR_VERSION
            DID_F126_22_COM_CLUSTER_AR_RELEASE_MAJOR_VERSION: DcmDspDidDataPos=192, DcmDspDidDataRef=DID_F126_Autosar_BSW_Cluster_Versions_DID_F126_22_COM_CLUSTER_AR_RELEASE_MAJOR_VERSION
            DID_F126_44_LIN_CLUSTER_AR_RELEASE_MINOR_VERSION: DcmDspDidDataPos=392, DcmDspDidDataRef=DID_F126_Autosar_BSW_Cluster_Versions_DID_F126_44_LIN_CLUSTER_AR_RELEASE_MINOR_VERSION
            DID_F126_37_FLEXRAY_CLUSTER_AR_RELEASE_MINOR_VERSION: DcmDspDidDataPos=328, DcmDspDidDataRef=DID_F126_Autosar_BSW_Cluster_Versions_DID_F126_37_FLEXRAY_CLUSTER_AR_RELEASE_MINOR_VERSION
            DID_F126_45_LIN_CLUSTER_AR_RELEASE_REVISION_VERSION: DcmDspDidDataPos=400, DcmDspDidDataRef=DID_F126_Autosar_BSW_Cluster_Versions_DID_F126_45_LIN_CLUSTER_AR_RELEASE_REVISION_VERSION
            DID_F126_33_FLEXRAY_CLUSTER_SW_MAJOR_VERSION: DcmDspDidDataPos=296, DcmDspDidDataRef=DID_F126_Autosar_BSW_Cluster_Versions_DID_F126_33_FLEXRAY_CLUSTER_SW_MAJOR_VERSION
        3 x DcmDspDataInfo, all with DcmDspDataFixedLength=true:
          DataInfo_DID_DD01_Total_Distance_DID_DD01_Total_Distance
          DataInfo_DID_F126_Autosar_BSW_Cluster_Versions_DID_F126_42_LIN_CLUSTER_SW_PATCH_VERSION
          DataInfo_DID_E319_Torque_Direction_DID_E319_Torque_Direction
        DidInfo_DID_F1A1_Primary_Bootloader_Diagnostic_Database_Part_Number_Geely (DcmDspDidInfo)
          DcmDspDidAccess
            DcmDspDidRead: DcmDspDidReadSessionRef=defaultSession, DcmDspDidReadSessionRef=extendedDiagnosticSession
        DID_E310_IEM_MGM_Derating_Status_DID_E310_IEMMGM_Derating_Status (DcmDspData):
          DcmDspDataSize = 8
          DcmDspDataType = UINT8
          DcmDspDataUsePort = USE_DATA_ASYNCH_CLIENT_SERVER
          DcmDspDataInfoRef = DataInfo_DID_E310_IEM_MGM_Derating_Status_DID_E310_IEMMGM_Derating_Status
        DidInfo_DID_E335_d_axis_current_setpoint (DcmDspDidInfo)
          DcmDspDidAccess
            DcmDspDidRead: DcmDspDidReadSessionRef=defaultSession, DcmDspDidReadSessionRef=extendedDiagnosticSession
        DidInfo_DID_E308_ECM_Torque_Request (DcmDspDidInfo)
          DcmDspDidAccess
            DcmDspDidRead: DcmDspDidReadSessionRef=defaultSession, DcmDspDidReadSessionRef=extendedDiagnosticSession
        DID_E308_ECM_Torque_Request_DID_E308_ECM_Torque_Request (DcmDspData):
          DcmDspDataSize = 16
          DcmDspDataType = UINT16
          DcmDspDataUsePort = USE_DATA_ASYNCH_CLIENT_SERVER
          DcmDspDataInfoRef = DataInfo_DID_E308_ECM_Torque_Request_DID_E308_ECM_Torque_Request
        DataInfo_DID_EF0A_Active_Discharge_Time_DID_EF0A_Active_Discharge_Time (DcmDspDataInfo): DcmDspDataFixedLength=true
        DID_E337_q_axis_current_setpoint (DcmDspDid):
          DcmDspDidIdentifier = 58167
          DcmDspDidUsed = true
          DcmDspDidUsePort = USE_DATA_ELEMENT_SPECIFIC_INTERFACES
          DcmDspDidInfoRef = DidInfo_DID_E337_q_axis_current_setpoint
          DID_E337_q_axis_current_setpoint (DcmDspDidSignal): DcmDspDidDataPos=0, DcmDspDidDataRef=DID_E337_q_axis_current_setpoint_DID_E337_q_axis_current_setpoint
        DID_E331_Software_Version_DID_E331_3_Calibration_Data_Software_Version (DcmDspData):
          DcmDspDataSize = 64
          DcmDspDataType = UINT8_N
          DcmDspDataUsePort = USE_DATA_ASYNCH_CLIENT_SERVER
          DcmDspDataInfoRef = DataInfo_DID_E331_Software_Version_DID_E331_3_Calibration_Data_Software_Version
        DataInfo_DID_F12F_ECU_Software_Extended_Part_Numbers_DID_F12F_1_Total_number_of_ECU_Software_Part_Numbers (DcmDspDataInfo): DcmDspDataFixedLength=true
        DID_ED20_Complete_set_of_ECU_part_serial_numbers_Geely (DcmDspDid):
          DcmDspDidIdentifier = 60704
          DcmDspDidUsed = true
          DcmDspDidUsePort = USE_DATA_ELEMENT_SPECIFIC_INTERFACES
          DcmDspDidInfoRef = DidInfo_DID_ED20_Complete_set_of_ECU_part_serial_numbers_Geely
          11 x DcmDspDidSignal:
            BCD_part_003: DcmDspDidDataPos=232, DcmDspDidDataRef=DID_ED20_Complete_set_of_ECU_part_serial_numbers_Geely_BCD_part_003
            BCD_part_001: DcmDspDidDataPos=64, DcmDspDidDataRef=DID_ED20_Complete_set_of_ECU_part_serial_numbers_Geely_BCD_part_001
            BCD_part_002: DcmDspDidDataPos=128, DcmDspDidDataRef=DID_ED20_Complete_set_of_ECU_part_serial_numbers_Geely_BCD_part_002
            Reserved: DcmDspDidDataPos=296, DcmDspDidDataRef=DID_ED20_Complete_set_of_ECU_part_serial_numbers_Geely_Reserved
            DID_F1AE_1_Total_number_of_ECU_Software_Part_Numbers: DcmDspDidDataPos=224, DcmDspDidDataRef=DID_ED20_Complete_set_of_ECU_part_serial_numbers_Geely_DID_F1AE_1_Total_number_of_ECU_Software_Part_Numbers
            DID_F18C_ECU_Serial_Number: DcmDspDidDataPos=192, DcmDspDidDataRef=DID_ED20_Complete_set_of_ECU_part_serial_numbers_Geely_DID_F18C_ECU_Serial_Number
            ASCII_part_001: DcmDspDidDataPos=104, DcmDspDidDataRef=DID_ED20_Complete_set_of_ECU_part_serial_numbers_Geely_ASCII_part_001
            ASCII_part_002: DcmDspDidDataPos=168, DcmDspDidDataRef=DID_ED20_Complete_set_of_ECU_part_serial_numbers_Geely_ASCII_part_002
            ASCII_part_003: DcmDspDidDataPos=272, DcmDspDidDataRef=DID_ED20_Complete_set_of_ECU_part_serial_numbers_Geely_ASCII_part_003
            ASCII_part: DcmDspDidDataPos=40, DcmDspDidDataRef=DID_ED20_Complete_set_of_ECU_part_serial_numbers_Geely_ASCII_part
            BCD_part: DcmDspDidDataPos=0, DcmDspDidDataRef=DID_ED20_Complete_set_of_ECU_part_serial_numbers_Geely_BCD_part
        3 x DcmDspData, all with DcmDspDataSize=8, DcmDspDataType=UINT8, DcmDspDataUsePort=USE_DATA_ASYNCH_CLIENT_SERVER:
          DID_D005_High_Quiescent_Current_Fault_Identification_Data_Functionality_Activity_Level_Detect_Motor_Speed_Abnormal_5st: DcmDspDataInfoRef=DataInfo_DID_D005_High_Quiescent_Current_Fault_Identification_Data_Functionality_Activity_Level_Detect_Motor_Speed_Abnormal_5st
          DID_F1AF_ECU_Software_Extended_Part_Numbers_Geely_DID_F1AF_1_Total_number_of_ECU_Software_Part_Numbers: DcmDspDataInfoRef=DataInfo_DID_F1AF_ECU_Software_Extended_Part_Numbers_Geely_DID_F1AF_1_Total_number_of_ECU_Software_Part_Numbers
          DID_D211_Network_Management_History_Propulsion_CAN_DID_D211_1_Latest_State_NM_History: DcmDspDataInfoRef=DataInfo_DID_D211_Network_Management_History_Propulsion_CAN_DID_D211_1_Latest_State_NM_History
        DidInfo_DID_E364_AURIX_Fault_Indication (DcmDspDidInfo)
          DcmDspDidAccess
            DcmDspDidRead: DcmDspDidReadSessionRef=defaultSession, DcmDspDidReadSessionRef=extendedDiagnosticSession
        DID_E339_d_axis_voltage_DID_E339_d_axis_voltage (DcmDspData):
          DcmDspDataSize = 16
          DcmDspDataType = UINT16
          DcmDspDataUsePort = USE_DATA_ASYNCH_CLIENT_SERVER
          DcmDspDataInfoRef = DataInfo_DID_E339_d_axis_voltage_DID_E339_d_axis_voltage
        DataInfo_DID_E333_2002_State_2002_L_Ser (DcmDspDataInfo): DcmDspDataFixedLength=true
        DID_E339_d_axis_voltage (DcmDspDid):
          DcmDspDidIdentifier = 58169
          DcmDspDidUsed = true
          DcmDspDidUsePort = USE_DATA_ELEMENT_SPECIFIC_INTERFACES
          DcmDspDidInfoRef = DidInfo_DID_E339_d_axis_voltage
          DID_E339_d_axis_voltage (DcmDspDidSignal): DcmDspDidDataPos=0, DcmDspDidDataRef=DID_E339_d_axis_voltage_DID_E339_d_axis_voltage
        DID_F125_Primary_Bootloader_Software_Part_Number_BCD_part (DcmDspData):
          DcmDspDataSize = 32
          DcmDspDataType = UINT32
          DcmDspDataUsePort = USE_DATA_ASYNCH_CLIENT_SERVER
          DcmDspDataInfoRef = DataInfo_DID_F125_Primary_Bootloader_Software_Part_Number_BCD_part
        DidInfo_DID_EED4_Safty_Function_Mode (DcmDspDidInfo)
          DcmDspDidAccess
            DcmDspDidRead
        DataInfo_DID_D005_High_Quiescent_Current_Fault_Identification_Data_Bitfield_4th (DcmDspDataInfo): DcmDspDataFixedLength=true
        DID_D005_High_Quiescent_Current_Fault_Identification_Data_Bitfield_5th (DcmDspData):
          DcmDspDataSize = 8
          DcmDspDataType = UINT8_N
          DcmDspDataUsePort = USE_DATA_ASYNCH_CLIENT_SERVER
          DcmDspDataInfoRef = DataInfo_DID_D005_High_Quiescent_Current_Fault_Identification_Data_Bitfield_5th
        DID_EEB5_IEM_MGM_current_torque (DcmDspDid):
          DcmDspDidIdentifier = 61109
          DcmDspDidUsed = true
          DcmDspDidUsePort = USE_DATA_ELEMENT_SPECIFIC_INTERFACES
          DcmDspDidInfoRef = DidInfo_DID_EEB5_IEM_MGM_current_torque
          DID_EEB5_IEMMGM_current_torque (DcmDspDidSignal): DcmDspDidDataPos=0, DcmDspDidDataRef=DID_EEB5_IEM_MGM_current_torque_DID_EEB5_IEMMGM_current_torque
        DID_EDA0_Complete_ECU_Part_Serial_Number_s_F120_Application_Diagnostic_Database_Part_Number1 (DcmDspData):
          DcmDspDataSize = 24
          DcmDspDataType = UINT8_N
          DcmDspDataUsePort = USE_DATA_ASYNCH_CLIENT_SERVER
          DcmDspDataInfoRef = DataInfo_DID_EDA0_Complete_ECU_Part_Serial_Number_s_F120_Application_Diagnostic_Database_Part_Number1
        DidInfo_DID_0xEEC7_1 (DcmDspDidInfo)
          DcmDspDidAccess
            DcmDspDidRead
        DataInfo_DID_D005_High_Quiescent_Current_Fault_Identification_Data_Functionality_Activity_Level_Detect_Motor_Speed_Abnormal_4st (DcmDspDataInfo): DcmDspDataFixedLength=true
        DataInfo_DID_D005_High_Quiescent_Current_Fault_Identification_Data_D005_2st_Functionality_Activity_Level_PNC30 (DcmDspDataInfo): DcmDspDataFixedLength=true
        DID_F121_Primary_Bootloader_Diagnostic_Database_Part_Number (DcmDspDid):
          DcmDspDidIdentifier = 61729
          DcmDspDidUsed = true
          DcmDspDidUsePort = USE_DATA_ELEMENT_SPECIFIC_INTERFACES
          DcmDspDidInfoRef = DidInfo_DID_F121_Primary_Bootloader_Diagnostic_Database_Part_Number
          ASCII_part (DcmDspDidSignal): DcmDspDidDataPos=32, DcmDspDidDataRef=DID_F121_Primary_Bootloader_Diagnostic_Database_Part_Number_ASCII_part
          BCD_part (DcmDspDidSignal): DcmDspDidDataPos=0, DcmDspDidDataRef=DID_F121_Primary_Bootloader_Diagnostic_Database_Part_Number_BCD_part
        DID_F12A_ECU_Core_Assembly_Part_Number_BCD_part (DcmDspData):
          DcmDspDataSize = 32
          DcmDspDataType = UINT32
          DcmDspDataUsePort = USE_DATA_ASYNCH_CLIENT_SERVER
          DcmDspDataInfoRef = DataInfo_DID_F12A_ECU_Core_Assembly_Part_Number_BCD_part
        DataInfo_DID_D005_High_Quiescent_Current_Fault_Identification_Data_D005_2st_Functionality_Activity_Level_PNC35 (DcmDspDataInfo): DcmDspDataFixedLength=true
        DID_F126_Autosar_BSW_Cluster_Versions_DID_F126_9_DIAG_CLUSTER_VCC_DCM_VERSION (DcmDspData):
          DcmDspDataSize = 8
          DcmDspDataType = UINT8
          DcmDspDataUsePort = USE_DATA_ASYNCH_CLIENT_SERVER
          DcmDspDataInfoRef = DataInfo_DID_F126_Autosar_BSW_Cluster_Versions_DID_F126_9_DIAG_CLUSTER_VCC_DCM_VERSION
        DID_E364_AURIX_Fault_Indication_DID_E364_AURIX_Fault_Indication (DcmDspData):
          DcmDspDataSize = 8
          DcmDspDataType = UINT8_N
          DcmDspDataUsePort = USE_DATA_ASYNCH_CLIENT_SERVER
          DcmDspDataInfoRef = DataInfo_DID_E364_AURIX_Fault_Indication_DID_E364_AURIX_Fault_Indication
        DataInfo_DID_D005_High_Quiescent_Current_Fault_Identification_Data_D005_2st_Functionality_Activity_Level_PNC39 (DcmDspDataInfo): DcmDspDataFixedLength=true
        DID_D0B5_SDB_version (DcmDspDid):
          DcmDspDidIdentifier = 53429
          DcmDspDidUsed = true
          DcmDspDidUsePort = USE_DATA_ELEMENT_SPECIFIC_INTERFACES
          DcmDspDidInfoRef = DidInfo_DID_D0B5_SDB_version
          SDB_version (DcmDspDidSignal): DcmDspDidDataPos=0, DcmDspDidDataRef=DID_D0B5_SDB_version_SDB_version
        DataInfo_DID_F1AE_ECU_Software_Part_Numbers_Geely_ASCII_part (DcmDspDataInfo): DcmDspDataFixedLength=true
        Routine_Reserved_1 (DcmDspRoutine):
          DcmDspRequestResultsRoutineSupported = true
          DcmDspStopRoutineSupported = true
          DcmDspRoutineIdentifier = 16397
          DcmDspRoutineFixedLength = false
          DcmDspRoutineUsePort = true
          DcmDspRoutineUsed = true
          DcmDspRoutineInfoRef = RoutineInfo_Routine_Reserved_1
        Routine_Reserved_2 (DcmDspRoutine):
          DcmDspRequestResultsRoutineSupported = true
          DcmDspStopRoutineSupported = true
          DcmDspRoutineIdentifier = 16398
          DcmDspRoutineFixedLength = false
          DcmDspRoutineUsePort = true
          DcmDspRoutineUsed = true
          DcmDspRoutineInfoRef = RoutineInfo_Routine_Reserved_2
        DID_F126_Autosar_BSW_Cluster_Versions_DID_F126_44_LIN_CLUSTER_AR_RELEASE_MINOR_VERSION (DcmDspData):
          DcmDspDataSize = 8
          DcmDspDataType = UINT8
          DcmDspDataUsePort = USE_DATA_ASYNCH_CLIENT_SERVER
          DcmDspDataInfoRef = DataInfo_DID_F126_Autosar_BSW_Cluster_Versions_DID_F126_44_LIN_CLUSTER_AR_RELEASE_MINOR_VERSION
        DID_D005_High_Quiescent_Current_Fault_Identification_Data_DID_D005_4st_Usage_Mode_when_DID_is_triggered (DcmDspData):
          DcmDspDataSize = 8
          DcmDspDataType = UINT8
          DcmDspDataUsePort = USE_DATA_ASYNCH_CLIENT_SERVER
          DcmDspDataInfoRef = DataInfo_DID_D005_High_Quiescent_Current_Fault_Identification_Data_DID_D005_4st_Usage_Mode_when_DID_is_triggered
        DidInfo_DID_EEC5_ImobEng2_node_status (DcmDspDidInfo)
          DcmDspDidAccess
            DcmDspDidRead: DcmDspDidReadSessionRef=defaultSession, DcmDspDidReadSessionRef=extendedDiagnosticSession
        DidInfo_DID_F12F_ECU_Software_Extended_Part_Numbers (DcmDspDidInfo)
          DcmDspDidAccess
            DcmDspDidRead: DcmDspDidReadSessionRef=defaultSession, DcmDspDidReadSessionRef=extendedDiagnosticSession
        DataInfo_DID_EDA0_Complete_ECU_Part_Serial_Number_s_DID_F18C_ECU_Serial_Number (DcmDspDataInfo): DcmDspDataFixedLength=true
        DidInfo_DID_E331_Software_Version (DcmDspDidInfo)
          DcmDspDidAccess
            DcmDspDidRead: DcmDspDidReadSessionRef=defaultSession, DcmDspDidReadSessionRef=extendedDiagnosticSession
        3 x DcmDspDataInfo, all with DcmDspDataFixedLength=true:
          DataInfo_DID_E333_2002_State_2002_Hv
          DataInfo_DID_E333_2002_State_2002_Hu
          DataInfo_DID_E333_2002_State_2002_Hw
        DID_F126_Autosar_BSW_Cluster_Versions_DID_F126_35_FLEXRAY_CLUSTER_SW_PATCH_VERSION (DcmDspData):
          DcmDspDataSize = 8
          DcmDspDataType = UINT8
          DcmDspDataUsePort = USE_DATA_ASYNCH_CLIENT_SERVER
          DcmDspDataInfoRef = DataInfo_DID_F126_Autosar_BSW_Cluster_Versions_DID_F126_35_FLEXRAY_CLUSTER_SW_PATCH_VERSION
        DID_D211_Network_Management_History_Propulsion_CAN_DID_D211_5_3rd_Latest_State_NM_History (DcmDspData):
          DcmDspDataSize = 8
          DcmDspDataType = UINT8
          DcmDspDataUsePort = USE_DATA_ASYNCH_CLIENT_SERVER
          DcmDspDataInfoRef = DataInfo_DID_D211_Network_Management_History_Propulsion_CAN_DID_D211_5_3rd_Latest_State_NM_History
        RoutineInfo_P_Lock (DcmDspRoutineInfo)
          DcmDspRoutineRequestResOut
            Out_P_Lock_Status (DcmDspRoutineRequestResOutSignal): DcmDspRoutineSignalLength=8, DcmDspRoutineSignalType=UINT8, DcmDspRoutineSignalPos=8
            Out_New_Bit_Field (DcmDspRoutineRequestResOutSignal): DcmDspRoutineSignalLength=8, DcmDspRoutineSignalType=UINT8, DcmDspRoutineSignalPos=0
          DcmDspStartRoutineIn
            In_P_Lock_State_Request (DcmDspStartRoutineInSignal): DcmDspRoutineSignalLength=8, DcmDspRoutineSignalType=UINT8, DcmDspRoutineSignalPos=0
          DcmDspRoutineAuthorization: DcmDspRoutineSessionRef=extendedDiagnosticSession, DcmDspRoutineSecurityLevelRef=CommonUnlock_Level_3
          DcmDspRoutineStopOut
            Out_New_Bit_Field (DcmDspRoutineStopOutSignal): DcmDspRoutineSignalLength=8, DcmDspRoutineSignalType=UINT8, DcmDspRoutineSignalPos=0
          DcmDspStartRoutineOut
            Out_New_Bit_Field (DcmDspStartRoutineOutSignal): DcmDspRoutineSignalLength=8, DcmDspRoutineSignalType=UINT8, DcmDspRoutineSignalPos=0
        DID_D12F_Security_Constant_Level_11_12 (DcmDspDid):
          DcmDspDidIdentifier = 53551
          DcmDspDidUsed = true
          DcmDspDidUsePort = USE_DATA_ELEMENT_SPECIFIC_INTERFACES
          DcmDspDidInfoRef = DidInfo_DID_D12F_Security_Constant_Level_11_12
          DID_D12F_Security_Constant_Level_1112 (DcmDspDidSignal): DcmDspDidDataPos=0, DcmDspDidDataRef=DID_D12F_Security_Constant_Level_11_12_DID_D12F_Security_Constant_Level_1112
        DID_D211_Network_Management_History_Propulsion_CAN_DID_D211_8_4th_Latest_State_Global_Real_Time (DcmDspData):
          DcmDspDataSize = 32
          DcmDspDataType = UINT32
          DcmDspDataUsePort = USE_DATA_ASYNCH_CLIENT_SERVER
          DcmDspDataInfoRef = DataInfo_DID_D211_Network_Management_History_Propulsion_CAN_DID_D211_8_4th_Latest_State_Global_Real_Time
        DataInfo_DID_E103_Car_Configuration_Parameter_Faults_DID_E103_1_Number_of_invalid_car_configuration_parameter_values_recognised (DcmDspDataInfo): DcmDspDataFixedLength=true
        DID_F1A1_Primary_Bootloader_Diagnostic_Database_Part_Number_Geely_BCD_part (DcmDspData):
          DcmDspDataSize = 40
          DcmDspDataType = UINT8_N
          DcmDspDataUsePort = USE_DATA_ASYNCH_CLIENT_SERVER
          DcmDspDataInfoRef = DataInfo_DID_F1A1_Primary_Bootloader_Diagnostic_Database_Part_Number_Geely_BCD_part
        DataInfo_DID_EF1B_EOL_config_word_A_DID_EF1B_EOL_config_word_A (DcmDspDataInfo): DcmDspDataFixedLength=true
        DataInfo_DID_DD0A_Usage_Mode_DID_DD0A_Usage_Mode (DcmDspDataInfo): DcmDspDataFixedLength=true
        DID_E313_Active_discharge_status (DcmDspDid):
          DcmDspDidIdentifier = 58131
          DcmDspDidUsed = true
          DcmDspDidUsePort = USE_DATA_ELEMENT_SPECIFIC_INTERFACES
          DcmDspDidInfoRef = DidInfo_DID_E313_Active_discharge_status
          DID_E313_Active_discharge_status (DcmDspDidSignal): DcmDspDidDataPos=0, DcmDspDidDataRef=DID_E313_Active_discharge_status_DID_E313_Active_discharge_status
        DataInfo_DID_F126_Autosar_BSW_Cluster_Versions_DID_F126_20_COM_CLUSTER_SW_MINOR_VERSION (DcmDspDataInfo): DcmDspDataFixedLength=true
        DidInfo_DID_F186_Active_Diagnostic_Session (DcmDspDidInfo)
          DcmDspDidAccess
            DcmDspDidRead: DcmDspDidReadSessionRef=defaultSession, DcmDspDidReadSessionRef=extendedDiagnosticSession
        DID_DD02_Vehicle_Battery_Voltage_DID_DD02_Vehicle_Battery_Voltage (DcmDspData):
          DcmDspDataSize = 8
          DcmDspDataType = UINT8
          DcmDspDataUsePort = USE_DATA_ASYNCH_CLIENT_SERVER
          DcmDspDataInfoRef = DataInfo_DID_DD02_Vehicle_Battery_Voltage_DID_DD02_Vehicle_Battery_Voltage
        DID_D005_High_Quiescent_Current_Fault_Identification_Data_Functionality_Activity_Level_Detect_Motor_Speed_Abnormal_3st (DcmDspData):
          DcmDspDataSize = 8
          DcmDspDataType = UINT8
          DcmDspDataUsePort = USE_DATA_ASYNCH_CLIENT_SERVER
          DcmDspDataInfoRef = DataInfo_DID_D005_High_Quiescent_Current_Fault_Identification_Data_Functionality_Activity_Level_Detect_Motor_Speed_Abnormal_3st
        DidInfo_DID_D0B5_SDB_version (DcmDspDidInfo)
          DcmDspDidAccess
            DcmDspDidRead: DcmDspDidReadSessionRef=defaultSession, DcmDspDidReadSessionRef=extendedDiagnosticSession
        DID_E313_Active_discharge_status_DID_E313_Active_discharge_status (DcmDspData):
          DcmDspDataSize = 8
          DcmDspDataType = UINT8
          DcmDspDataUsePort = USE_DATA_ASYNCH_CLIENT_SERVER
          DcmDspDataInfoRef = DataInfo_DID_E313_Active_discharge_status_DID_E313_Active_discharge_status
        DID_F12B_ECU_Delivery_Assembly_Part_Number_BCD_part (DcmDspData):
          DcmDspDataSize = 32
          DcmDspDataType = UINT32
          DcmDspDataUsePort = USE_DATA_ASYNCH_CLIENT_SERVER
          DcmDspDataInfoRef = DataInfo_DID_F12B_ECU_Delivery_Assembly_Part_Number_BCD_part
        DataInfo_DID_D005_High_Quiescent_Current_Fault_Identification_Data_D005_2st_Functionality_Activity_Level_PNC26 (DcmDspDataInfo): DcmDspDataFixedLength=true
        DataInfo_DID_D005_High_Quiescent_Current_Fault_Identification_Data_D005_2st_Functionality_Activity_Level_PNC27 (DcmDspDataInfo): DcmDspDataFixedLength=true
        Routine_Reserved_3 (DcmDspRoutine):
          DcmDspRequestResultsRoutineSupported = true
          DcmDspStopRoutineSupported = true
          DcmDspRoutineIdentifier = 16399
          DcmDspRoutineFixedLength = false
          DcmDspRoutineUsePort = true
          DcmDspRoutineUsed = true
          DcmDspRoutineInfoRef = RoutineInfo_Routine_Reserved_3
        DataInfo_DID_D005_High_Quiescent_Current_Fault_Identification_Data_D005_2st_Functionality_Activity_Level_PNC24 (DcmDspDataInfo): DcmDspDataFixedLength=true
        DataInfo_DID_D005_High_Quiescent_Current_Fault_Identification_Data_D005_2st_Functionality_Activity_Level_PNC25 (DcmDspDataInfo): DcmDspDataFixedLength=true
        DID_D005_High_Quiescent_Current_Fault_Identification_Data_Reserved_PNC_1st (DcmDspData):
          DcmDspDataSize = 56
          DcmDspDataType = UINT8_N
          DcmDspDataUsePort = USE_DATA_ASYNCH_CLIENT_SERVER
          DcmDspDataInfoRef = DataInfo_DID_D005_High_Quiescent_Current_Fault_Identification_Data_Reserved_PNC_1st
        DataInfo_DID_D03A_swAuth_Public_Key_CheckSum_DID_D03A_swAuth_Public_Key_CheckSum (DcmDspDataInfo): DcmDspDataFixedLength=true
        DataInfo_DID_D005_High_Quiescent_Current_Fault_Identification_Data_D005_2st_Functionality_Activity_Level_PNC29 (DcmDspDataInfo): DcmDspDataFixedLength=true
        3 x DcmDspData, all with DcmDspDataUsePort=USE_DATA_ASYNCH_CLIENT_SERVER:
          DID_D005_High_Quiescent_Current_Fault_Identification_Data_DID_D005_1_1st_System_Global_Time_the_time_when_the_DID_is_triggered: DcmDspDataSize=32, DcmDspDataType=UINT32, DcmDspDataInfoRef=DataInfo_DID_D005_High_Quiescent_Current_Fault_Identification_Data_DID_D005_1_1st_System_Global_Time_the_time_when_the_D1ec8d60e
          DID_D005_High_Quiescent_Current_Fault_Identification_Data_Bitfield_3th: DcmDspDataSize=8, DcmDspDataType=UINT8_N, DcmDspDataInfoRef=DataInfo_DID_D005_High_Quiescent_Current_Fault_Identification_Data_Bitfield_3th
          DID_E103_Car_Configuration_Parameter_Faults_DID_E103_5_2nd_parameter_invalid_value: DcmDspDataSize=8, DcmDspDataType=UINT8, DcmDspDataInfoRef=DataInfo_DID_E103_Car_Configuration_Parameter_Faults_DID_E103_5_2nd_parameter_invalid_value
        DataInfo_DID_E103_Car_Configuration_Parameter_Faults_DID_E103_17_8th_parameter_invalid_value (DcmDspDataInfo): DcmDspDataFixedLength=true
        3 x DcmDspData, all with DcmDspDataUsePort=USE_DATA_ASYNCH_CLIENT_SERVER:
          DID_EED3_Safety_speed_DID_EED3_Safety_speed: DcmDspDataSize=16, DcmDspDataType=UINT16, DcmDspDataInfoRef=DataInfo_DID_EED3_Safety_speed_DID_EED3_Safety_speed
          DID_E103_Car_Configuration_Parameter_Faults_DID_E103_12_6th_parameter_number_of_the_car_configuration_data_that_is_invalid: DcmDspDataSize=16, DcmDspDataType=UINT16, DcmDspDataInfoRef=DataInfo_DID_E103_Car_Configuration_Parameter_Faults_DID_E103_12_6th_parameter_number_of_the_car_configuration_data_that1ba11a61
          DID_D005_High_Quiescent_Current_Fault_Identification_Data_D005_5st_Functionality_Activity_Level_PNC39: DcmDspDataSize=8, DcmDspDataType=UINT8, DcmDspDataInfoRef=DataInfo_DID_D005_High_Quiescent_Current_Fault_Identification_Data_D005_5st_Functionality_Activity_Level_PNC39
        DID_DD02_Vehicle_Battery_Voltage (DcmDspDid):
          DcmDspDidIdentifier = 56578
          DcmDspDidUsed = true
          DcmDspDidUsePort = USE_DATA_ELEMENT_SPECIFIC_INTERFACES
          DcmDspDidInfoRef = DidInfo_DID_DD02_Vehicle_Battery_Voltage
          DID_DD02_Vehicle_Battery_Voltage (DcmDspDidSignal): DcmDspDidDataPos=0, DcmDspDidDataRef=DID_DD02_Vehicle_Battery_Voltage_DID_DD02_Vehicle_Battery_Voltage
        DID_D005_High_Quiescent_Current_Fault_Identification_Data_D005_5st_Functionality_Activity_Level_PNC35 (DcmDspData):
          DcmDspDataSize = 8
          DcmDspDataType = UINT8
          DcmDspDataUsePort = USE_DATA_ASYNCH_CLIENT_SERVER
          DcmDspDataInfoRef = DataInfo_DID_D005_High_Quiescent_Current_Fault_Identification_Data_D005_5st_Functionality_Activity_Level_PNC35
        DataInfo_DID_F126_Autosar_BSW_Cluster_Versions_DID_F126_7_DIAG_CLUSTER_AR_RELEASE_REVISION_VERSION (DcmDspDataInfo): DcmDspDataFixedLength=true
        DataInfo_DID_D005_High_Quiescent_Current_Fault_Identification_Data_Functionality_Activity_Level_Detect_CPSR_Keep_Active_1st (DcmDspDataInfo): DcmDspDataFixedLength=true
        DID_D005_High_Quiescent_Current_Fault_Identification_Data_D005_5st_Functionality_Activity_Level_PNC30 (DcmDspData):
          DcmDspDataSize = 8
          DcmDspDataType = UINT8
          DcmDspDataUsePort = USE_DATA_ASYNCH_CLIENT_SERVER
          DcmDspDataInfoRef = DataInfo_DID_D005_High_Quiescent_Current_Fault_Identification_Data_D005_5st_Functionality_Activity_Level_PNC30
        3 x DcmDspDataInfo, all with DcmDspDataFixedLength=true:
          DataInfo_DID_F125_Primary_Bootloader_Software_Part_Number_ASCII_part
          DataInfo_DID_F126_Autosar_BSW_Cluster_Versions_DID_F126_10_DIAG_CLUSTER_VCC_FIM_VERSION
          DataInfo_DID_D005_High_Quiescent_Current_Fault_Identification_Data_Reserved_Data_Field_5st
        DID_E103_Car_Configuration_Parameter_Faults_DID_E103_16_8th_parameter_number_of_the_car_configuration_data_that_is_invalid (DcmDspData):
          DcmDspDataSize = 16
          DcmDspDataType = UINT16
          DcmDspDataUsePort = USE_DATA_ASYNCH_CLIENT_SERVER
          DcmDspDataInfoRef = DataInfo_DID_E103_Car_Configuration_Parameter_Faults_DID_E103_16_8th_parameter_number_of_the_car_configuration_data_that19fcf690
        DID_E312_Wheel_Speed (DcmDspDid):
          DcmDspDidIdentifier = 58130
          DcmDspDidUsed = true
          DcmDspDidUsePort = USE_DATA_ELEMENT_SPECIFIC_INTERFACES
          DcmDspDidInfoRef = DidInfo_DID_E312_Wheel_Speed
          DID_E312_Wheel_Speed (DcmDspDidSignal): DcmDspDidDataPos=0, DcmDspDidDataRef=DID_E312_Wheel_Speed_DID_E312_Wheel_Speed
        DID_E363_Modulation_index (DcmDspDid):
          DcmDspDidIdentifier = 58211
          DcmDspDidUsed = true
          DcmDspDidUsePort = USE_DATA_ELEMENT_SPECIFIC_INTERFACES
          DcmDspDidInfoRef = DidInfo_DID_E363_Modulation_index
          DID_E363_Modulation_index (DcmDspDidSignal): DcmDspDidDataPos=0, DcmDspDidDataRef=DID_E363_Modulation_index_DID_E363_Modulation_index
        DidInfo_DID_ED20_Complete_set_of_ECU_part_serial_numbers_Geely (DcmDspDidInfo)
          DcmDspDidAccess
            DcmDspDidRead: DcmDspDidReadSessionRef=defaultSession, DcmDspDidReadSessionRef=extendedDiagnosticSession
        DidInfo_DID_E324_Motor_Derating_reason_of_IEM_MGM (DcmDspDidInfo)
          DcmDspDidAccess
            DcmDspDidRead: DcmDspDidReadSessionRef=defaultSession, DcmDspDidReadSessionRef=extendedDiagnosticSession
        DataInfo_DID_F1A0_Application_Diagnostic_Database_Part_Number_Geely_BCD_part (DcmDspDataInfo): DcmDspDataFixedLength=true
        DidInfo_DID_EE9A_Inverter_Coolant_Temperature (DcmDspDidInfo)
          DcmDspDidAccess
            DcmDspDidRead: DcmDspDidReadSessionRef=defaultSession, DcmDspDidReadSessionRef=extendedDiagnosticSession
        DID_F1A1_Primary_Bootloader_Diagnostic_Database_Part_Number_Geely_ASCII_part (DcmDspData):
          DcmDspDataSize = 24
          DcmDspDataType = UINT8_N
          DcmDspDataUsePort = USE_DATA_ASYNCH_CLIENT_SERVER
          DcmDspDataInfoRef = DataInfo_DID_F1A1_Primary_Bootloader_Diagnostic_Database_Part_Number_Geely_ASCII_part
        DID_D03A_swAuth_Public_Key_CheckSum (DcmDspDid):
          DcmDspDidIdentifier = 53306
          DcmDspDidUsed = true
          DcmDspDidUsePort = USE_DATA_ELEMENT_SPECIFIC_INTERFACES
          DcmDspDidInfoRef = DidInfo_DID_D03A_swAuth_Public_Key_CheckSum
          DID_D03A_swAuth_Public_Key_CheckSum (DcmDspDidSignal): DcmDspDidDataPos=0, DcmDspDidDataRef=DID_D03A_swAuth_Public_Key_CheckSum_DID_D03A_swAuth_Public_Key_CheckSum
        DataInfo_DID_F12F_ECU_Software_Extended_Part_Numbers_ASCII_part (DcmDspDataInfo): DcmDspDataFixedLength=true
        DID_EE9C_Transient_Phase_Current_A_DID_EE9C_Transient_Phase_Current_A (DcmDspData):
          DcmDspDataSize = 16
          DcmDspDataType = UINT16
          DcmDspDataUsePort = USE_DATA_ASYNCH_CLIENT_SERVER
          DcmDspDataInfoRef = DataInfo_DID_EE9C_Transient_Phase_Current_A_DID_EE9C_Transient_Phase_Current_A
        DataInfo_DID_D0B5_SDB_version_SDB_version (DcmDspDataInfo): DcmDspDataFixedLength=true
        DID_ED20_Complete_set_of_ECU_part_serial_numbers_Geely_ASCII_part (DcmDspData):
          DcmDspDataSize = 24
          DcmDspDataType = UINT8_N
          DcmDspDataUsePort = USE_DATA_ASYNCH_CLIENT_SERVER
          DcmDspDataInfoRef = DataInfo_DID_ED20_Complete_set_of_ECU_part_serial_numbers_Geely_ASCII_part
        DID_F1AA_ECU_Core_Assembly_Part_Number_Geely_BCD_part (DcmDspData):
          DcmDspDataSize = 40
          DcmDspDataType = UINT8_N
          DcmDspDataUsePort = USE_DATA_ASYNCH_CLIENT_SERVER
          DcmDspDataInfoRef = DataInfo_DID_F1AA_ECU_Core_Assembly_Part_Number_Geely_BCD_part
        DataInfo_DID_D211_Network_Management_History_Propulsion_CAN_DID_D211_5_3rd_Latest_State_NM_History (DcmDspDataInfo): DcmDspDataFixedLength=true
        DID_E103_Car_Configuration_Parameter_Faults_DID_E103_20_10th_parameter_number_of_the_car_configuration_data_that_is_invalid (DcmDspData):
          DcmDspDataSize = 16
          DcmDspDataType = UINT16
          DcmDspDataUsePort = USE_DATA_ASYNCH_CLIENT_SERVER
          DcmDspDataInfoRef = DataInfo_DID_E103_Car_Configuration_Parameter_Faults_DID_E103_20_10th_parameter_number_of_the_car_configuration_data_thace4964ec
        3 x DcmDspDataInfo, all with DcmDspDataFixedLength=true:
          DataInfo_DID_D005_High_Quiescent_Current_Fault_Identification_Data_D005_3st_Functionality_Activity_Level_PNC35
          DataInfo_DID_F12E_ECU_Software_Part_Numbers_DID_F12E_1_ECU_Software
          DataInfo_DID_D005_High_Quiescent_Current_Fault_Identification_Data_D005_3st_Functionality_Activity_Level_PNC30
        DidInfo_Application_Diagnostic_Database_Part_Number (DcmDspDidInfo)
          DcmDspDidAccess
            DcmDspDidRead: DcmDspDidReadSessionRef=defaultSession, DcmDspDidReadSessionRef=extendedDiagnosticSession
        DID_D005_High_Quiescent_Current_Fault_Identification_Data_DID_D005_2_1st_Global_time_when_Functionality_Activity_level_Sa38038bb (DcmDspData):
          DcmDspDataSize = 32
          DcmDspDataType = UINT32
          DcmDspDataUsePort = USE_DATA_ASYNCH_CLIENT_SERVER
          DcmDspDataInfoRef = DataInfo_DID_D005_High_Quiescent_Current_Fault_Identification_Data_DID_D005_2_1st_Global_time_when_Functionality_Activit6a6f0b62
        DID_D211_Network_Management_History_Propulsion_CAN_DID_D211_3_2nd_Latest_State_NM_History (DcmDspData):
          DcmDspDataSize = 8
          DcmDspDataType = UINT8
          DcmDspDataUsePort = USE_DATA_ASYNCH_CLIENT_SERVER
          DcmDspDataInfoRef = DataInfo_DID_D211_Network_Management_History_Propulsion_CAN_DID_D211_3_2nd_Latest_State_NM_History
        DataInfo_DID_D005_High_Quiescent_Current_Fault_Identification_Data_D005_3st_Functionality_Activity_Level_PNC39 (DcmDspDataInfo): DcmDspDataFixedLength=true
        DID_E346_ECM_Torque_Allowed_Status_DID_E346_ECM_Torque_Allowed_Status (DcmDspData):
          DcmDspDataSize = 8
          DcmDspDataType = UINT8
          DcmDspDataUsePort = USE_DATA_ASYNCH_CLIENT_SERVER
          DcmDspDataInfoRef = DataInfo_DID_E346_ECM_Torque_Allowed_Status_DID_E346_ECM_Torque_Allowed_Status
        DataInfo_DID_F126_Autosar_BSW_Cluster_Versions_DID_F126_15_MODEMGMT_CLUSTER_AR_RELEASE_MAJOR_VERSION (DcmDspDataInfo): DcmDspDataFixedLength=true
        DID_EE9A_Inverter_Coolant_Temperature_DID_EE9A_Inverter_Coolant_Temperature (DcmDspData):
          DcmDspDataSize = 8
          DcmDspDataType = UINT8
          DcmDspDataUsePort = USE_DATA_ASYNCH_CLIENT_SERVER
          DcmDspDataInfoRef = DataInfo_DID_EE9A_Inverter_Coolant_Temperature_DID_EE9A_Inverter_Coolant_Temperature
        DID_D005_High_Quiescent_Current_Fault_Identification_Data_D005_5st_Functionality_Activity_Level_PNC29 (DcmDspData):
          DcmDspDataSize = 8
          DcmDspDataType = UINT8
          DcmDspDataUsePort = USE_DATA_ASYNCH_CLIENT_SERVER
          DcmDspDataInfoRef = DataInfo_DID_D005_High_Quiescent_Current_Fault_Identification_Data_D005_5st_Functionality_Activity_Level_PNC29
        DataInfo_DID_D005_High_Quiescent_Current_Fault_Identification_Data_Reserved_PNC_2st (DcmDspDataInfo): DcmDspDataFixedLength=true
        4 x DcmDspData, all with DcmDspDataUsePort=USE_DATA_ASYNCH_CLIENT_SERVER:
          DID_D005_High_Quiescent_Current_Fault_Identification_Data_D005_5st_Functionality_Activity_Level_PNC27: DcmDspDataSize=8, DcmDspDataType=UINT8, DcmDspDataInfoRef=DataInfo_DID_D005_High_Quiescent_Current_Fault_Identification_Data_D005_5st_Functionality_Activity_Level_PNC27
          DID_D005_High_Quiescent_Current_Fault_Identification_Data_D005_5st_Functionality_Activity_Level_PNC26: DcmDspDataSize=8, DcmDspDataType=UINT8, DcmDspDataInfoRef=DataInfo_DID_D005_High_Quiescent_Current_Fault_Identification_Data_D005_5st_Functionality_Activity_Level_PNC26
          DID_D005_High_Quiescent_Current_Fault_Identification_Data_Reserved_PNC_3st: DcmDspDataSize=56, DcmDspDataType=UINT8_N, DcmDspDataInfoRef=DataInfo_DID_D005_High_Quiescent_Current_Fault_Identification_Data_Reserved_PNC_3st
          DID_D005_High_Quiescent_Current_Fault_Identification_Data_D005_5st_Functionality_Activity_Level_PNC25: DcmDspDataSize=8, DcmDspDataType=UINT8, DcmDspDataInfoRef=DataInfo_DID_D005_High_Quiescent_Current_Fault_Identification_Data_D005_5st_Functionality_Activity_Level_PNC25
        DidInfo_DID_EE9E_Transient_Phase_Current_C (DcmDspDidInfo)
          DcmDspDidAccess
            DcmDspDidRead: DcmDspDidReadSessionRef=defaultSession, DcmDspDidReadSessionRef=extendedDiagnosticSession
        DID_D005_High_Quiescent_Current_Fault_Identification_Data_D005_5st_Functionality_Activity_Level_PNC24 (DcmDspData):
          DcmDspDataSize = 8
          DcmDspDataType = UINT8
          DcmDspDataUsePort = USE_DATA_ASYNCH_CLIENT_SERVER
          DcmDspDataInfoRef = DataInfo_DID_D005_High_Quiescent_Current_Fault_Identification_Data_D005_5st_Functionality_Activity_Level_PNC24
        DataInfo_DID_D005_High_Quiescent_Current_Fault_Identification_Data_D005_3st_Functionality_Activity_Level_PNC24 (DcmDspDataInfo): DcmDspDataFixedLength=true
        DID_E347_IGBT_Max_Temperature (DcmDspDid):
          DcmDspDidIdentifier = 58183
          DcmDspDidUsed = true
          DcmDspDidUsePort = USE_DATA_ELEMENT_SPECIFIC_INTERFACES
          DcmDspDidInfoRef = DidInfo_DID_E347_IGBT_Max_Temperature
          DID_E347_IGBT_Max_Temperature (DcmDspDidSignal): DcmDspDidDataPos=0, DcmDspDidDataRef=DID_E347_IGBT_Max_Temperature_DID_E347_IGBT_Max_Temperature
        DidInfo_DID_D09A_High_Quiescent_Current_Function_Activation_Deactivation (DcmDspDidInfo)
          DcmDspDidAccess
            DcmDspDidWrite: DcmDspDidWriteSessionRef=extendedDiagnosticSession, DcmDspDidWriteSecurityLevelRef=CommonUnlock_Level_3
            DcmDspDidRead: DcmDspDidReadSessionRef=defaultSession, DcmDspDidReadSessionRef=extendedDiagnosticSession
        DataInfo_DID_ED20_Complete_set_of_ECU_part_serial_numbers_Geely_BCD_part_002 (DcmDspDataInfo): DcmDspDataFixedLength=true
        DataInfo_DID_ED20_Complete_set_of_ECU_part_serial_numbers_Geely_BCD_part_003 (DcmDspDataInfo): DcmDspDataFixedLength=true
        DID_D005_High_Quiescent_Current_Fault_Identification_Data_Bitfield_1th (DcmDspData):
          DcmDspDataSize = 8
          DcmDspDataType = UINT8_N
          DcmDspDataUsePort = USE_DATA_ASYNCH_CLIENT_SERVER
          DcmDspDataInfoRef = DataInfo_DID_D005_High_Quiescent_Current_Fault_Identification_Data_Bitfield_1th
        7 x DcmDspDataInfo, all with DcmDspDataFixedLength=true:
          DataInfo_DID_D005_High_Quiescent_Current_Fault_Identification_Data_D005_3st_Functionality_Activity_Level_PNC29
          DataInfo_DID_ED20_Complete_set_of_ECU_part_serial_numbers_Geely_BCD_part_001
          DataInfo_DID_D005_High_Quiescent_Current_Fault_Identification_Data_D005_3st_Functionality_Activity_Level_PNC26
          DataInfo_DID_D005_High_Quiescent_Current_Fault_Identification_Data_D005_3st_Functionality_Activity_Level_PNC25
          DataInfo_DID_D005_High_Quiescent_Current_Fault_Identification_Data_D005_3st_Functionality_Activity_Level_PNC27
          DataInfo_DID_EED3_Safety_speed_DID_EED3_Safety_speed
          DataInfo_DID_E300_HVDC_Voltage_DID_E300_HVDC_Voltage
        DID_E336_d_axis_current_feedback_DID_E336_d_axis_current_feedback (DcmDspData):
          DcmDspDataSize = 16
          DcmDspDataType = UINT16
          DcmDspDataUsePort = USE_DATA_ASYNCH_CLIENT_SERVER
          DcmDspDataInfoRef = DataInfo_DID_E336_d_axis_current_feedback_DID_E336_d_axis_current_feedback
        DidInfo_DID_E311_Crash_Status (DcmDspDidInfo)
          DcmDspDidAccess
            DcmDspDidRead: DcmDspDidReadSessionRef=defaultSession, DcmDspDidReadSessionRef=extendedDiagnosticSession
        DataInfo_DID_F1AF_ECU_Software_Extended_Part_Numbers_Geely_ASCII_part_003 (DcmDspDataInfo): DcmDspDataFixedLength=true
        DID_D005_High_Quiescent_Current_Fault_Identification_Data_Functionality_Activity_Level_Detect_CPSR_Keep_Active_1st (DcmDspData):
          DcmDspDataSize = 8
          DcmDspDataType = UINT8
          DcmDspDataUsePort = USE_DATA_ASYNCH_CLIENT_SERVER
          DcmDspDataInfoRef = DataInfo_DID_D005_High_Quiescent_Current_Fault_Identification_Data_Functionality_Activity_Level_Detect_CPSR_Keep_Active_1st
        3 x DcmDspDataInfo, all with DcmDspDataFixedLength=true:
          DataInfo_DID_F126_Autosar_BSW_Cluster_Versions_DID_F126_37_FLEXRAY_CLUSTER_AR_RELEASE_MINOR_VERSION
          DataInfo_DID_F1AF_ECU_Software_Extended_Part_Numbers_Geely_ASCII_part_001
          DataInfo_DID_F1AF_ECU_Software_Extended_Part_Numbers_Geely_ASCII_part_002
        DID_E350_Phase_W_PWM_duty_DID_E350_Phase_W_PWM_duty (DcmDspData):
          DcmDspDataSize = 8
          DcmDspDataType = UINT8
          DcmDspDataUsePort = USE_DATA_ASYNCH_CLIENT_SERVER
          DcmDspDataInfoRef = DataInfo_DID_E350_Phase_W_PWM_duty_DID_E350_Phase_W_PWM_duty
        3 x DcmDspDataInfo, all with DcmDspDataFixedLength=true:
          DataInfo_DID_D211_Network_Management_History_Propulsion_CAN_DID_D211_12_6th_Latest_State_Global_Real_Time
          DataInfo_DID_D005_High_Quiescent_Current_Fault_Identification_Data_Reserved_Data_Field_3st
          DataInfo_DID_EEB2_Three_Phase_Motor_Current_RMS_Current_DID_EEB2_Three_Phase_Motor_Current_RMS_Current
        DidInfo_DID_E363_Modulation_index (DcmDspDidInfo)
          DcmDspDidAccess
            DcmDspDidRead: DcmDspDidReadSessionRef=defaultSession, DcmDspDidReadSessionRef=extendedDiagnosticSession
        3 x DcmDspData, all with DcmDspDataUsePort=USE_DATA_ASYNCH_CLIENT_SERVER:
          DID_F126_Autosar_BSW_Cluster_Versions_DID_F126_31_CAN_CLUSTER_AR_RELEASE_REVISION_VERSION: DcmDspDataSize=8, DcmDspDataType=UINT8, DcmDspDataInfoRef=DataInfo_DID_F126_Autosar_BSW_Cluster_Versions_DID_F126_31_CAN_CLUSTER_AR_RELEASE_REVISION_VERSION
          DID_E357_Resolve_compensated_angle_DID_E357_Resolve_compensated_angle: DcmDspDataSize=8, DcmDspDataType=UINT8, DcmDspDataInfoRef=DataInfo_DID_E357_Resolve_compensated_angle_DID_E357_Resolve_compensated_angle
          DID_EEBD_IEM_MGM_rotor_offset_angle_DID_EEBD_IEMMGM_rotor_offset_angle: DcmDspDataSize=32, DcmDspDataType=UINT32, DcmDspDataInfoRef=DataInfo_DID_EEBD_IEM_MGM_rotor_offset_angle_DID_EEBD_IEMMGM_rotor_offset_angle
        DataInfo_DID_E303_Motor_Speed_DID_E303_Motor_Speed_ (DcmDspDataInfo): DcmDspDataFixedLength=true
        DataInfo_DID_D211_Network_Management_History_Propulsion_CAN_DID_D211_14_7th_Latest_State_Global_Real_Time (DcmDspDataInfo): DcmDspDataFixedLength=true
        DID_EDA0_Complete_ECU_Part_Serial_Number_s_DID_F12A_ECU_Delivery_Assembly_Part_Number1_1 (DcmDspData):
          DcmDspDataSize = 24
          DcmDspDataType = UINT8_N
          DcmDspDataUsePort = USE_DATA_ASYNCH_CLIENT_SERVER
          DcmDspDataInfoRef = DataInfo_DID_EDA0_Complete_ECU_Part_Serial_Number_s_DID_F12A_ECU_Delivery_Assembly_Part_Number1_1
        DataInfo_DID_D211_Network_Management_History_Propulsion_CAN_DID_D211_2_Latest_State_Global_Real_Time (DcmDspDataInfo): DcmDspDataFixedLength=true
        DID_D005_High_Quiescent_Current_Fault_Identification_Data_DID_D005_3st_System_Global_Time_the_time_when_the_DID_is_triggered (DcmDspData):
          DcmDspDataSize = 32
          DcmDspDataType = UINT32
          DcmDspDataUsePort = USE_DATA_ASYNCH_CLIENT_SERVER
          DcmDspDataInfoRef = DataInfo_DID_D005_High_Quiescent_Current_Fault_Identification_Data_DID_D005_3st_System_Global_Time_the_time_when_the_DID5856c533
        DidInfo_DID_EED3_Safety_speed (DcmDspDidInfo)
          DcmDspDidAccess
            DcmDspDidRead
        DID_F1AB_ECU_Delivery_Assembly_Part_Number_Geely (DcmDspDid):
          DcmDspDidIdentifier = 61867
          DcmDspDidUsed = true
          DcmDspDidUsePort = USE_DATA_ELEMENT_SPECIFIC_INTERFACES
          DcmDspDidInfoRef = DidInfo_DID_F1AB_ECU_Delivery_Assembly_Part_Number_Geely
          ASCII_part (DcmDspDidSignal): DcmDspDidDataPos=40, DcmDspDidDataRef=DID_F1AB_ECU_Delivery_Assembly_Part_Number_Geely_ASCII_part
          BCD_part (DcmDspDidSignal): DcmDspDidDataPos=0, DcmDspDidDataRef=DID_F1AB_ECU_Delivery_Assembly_Part_Number_Geely_BCD_part
        5 x DcmDspData, all with DcmDspDataUsePort=USE_DATA_ASYNCH_CLIENT_SERVER:
          DID_EDA0_Complete_ECU_Part_Serial_Number_s_DID_F12A_ECU_Delivery_Assembly_Part_Number_1: DcmDspDataSize=32, DcmDspDataType=UINT32, DcmDspDataInfoRef=DataInfo_DID_EDA0_Complete_ECU_Part_Serial_Number_s_DID_F12A_ECU_Delivery_Assembly_Part_Number_1
          DID_F1AF_ECU_Software_Extended_Part_Numbers_Geely_ASCII_part_002: DcmDspDataSize=24, DcmDspDataType=UINT8_N, DcmDspDataInfoRef=DataInfo_DID_F1AF_ECU_Software_Extended_Part_Numbers_Geely_ASCII_part_002
          DID_F126_Autosar_BSW_Cluster_Versions_DID_F126_38_FLEXRAY_CLUSTER_AR_RELEASE_REVISION_VERSION: DcmDspDataSize=8, DcmDspDataType=UINT8, DcmDspDataInfoRef=DataInfo_DID_F126_Autosar_BSW_Cluster_Versions_DID_F126_38_FLEXRAY_CLUSTER_AR_RELEASE_REVISION_VERSION
          DID_F1AF_ECU_Software_Extended_Part_Numbers_Geely_ASCII_part_003: DcmDspDataSize=24, DcmDspDataType=UINT8_N, DcmDspDataInfoRef=DataInfo_DID_F1AF_ECU_Software_Extended_Part_Numbers_Geely_ASCII_part_003
          DID_F1AF_ECU_Software_Extended_Part_Numbers_Geely_ASCII_part_001: DcmDspDataSize=24, DcmDspDataType=UINT8_N, DcmDspDataInfoRef=DataInfo_DID_F1AF_ECU_Software_Extended_Part_Numbers_Geely_ASCII_part_001
        DataInfo_DID_D211_Network_Management_History_Propulsion_CAN_DID_D211_19_10th_Latest_State_NM_History (DcmDspDataInfo): DcmDspDataFixedLength=true
        DataInfo_DID_EE9F_Gate_Status_DID_EE9F_Gate_Status (DcmDspDataInfo): DcmDspDataFixedLength=true
        DID_E336_d_axis_current_feedback (DcmDspDid):
          DcmDspDidIdentifier = 58166
          DcmDspDidUsed = true
          DcmDspDidUsePort = USE_DATA_ELEMENT_SPECIFIC_INTERFACES
          DcmDspDidInfoRef = DidInfo_DID_E336_d_axis_current_feedback
          DID_E336_d_axis_current_feedback (DcmDspDidSignal): DcmDspDidDataPos=0, DcmDspDidDataRef=DID_E336_d_axis_current_feedback_DID_E336_d_axis_current_feedback
        DID_E103_Car_Configuration_Parameter_Faults_DID_E103_6_3rd_parameter_number_of_the_car_configuration_data_that_is_invalid (DcmDspData):
          DcmDspDataSize = 16
          DcmDspDataType = UINT16
          DcmDspDataUsePort = USE_DATA_ASYNCH_CLIENT_SERVER
          DcmDspDataInfoRef = DataInfo_DID_E103_Car_Configuration_Parameter_Faults_DID_E103_6_3rd_parameter_number_of_the_car_configuration_data_that_1458f62a
        DID_EE9F_Gate_Status_DID_EE9F_Gate_Status (DcmDspData):
          DcmDspDataSize = 8
          DcmDspDataType = UINT8
          DcmDspDataUsePort = USE_DATA_ASYNCH_CLIENT_SERVER
          DcmDspDataInfoRef = DataInfo_DID_EE9F_Gate_Status_DID_EE9F_Gate_Status
        DidInfo_DID_E303_Motor_Speed (DcmDspDidInfo)
          DcmDspDidAccess
            DcmDspDidRead: DcmDspDidReadSessionRef=defaultSession, DcmDspDidReadSessionRef=extendedDiagnosticSession
        DID_F12E_ECU_Software_Part_Numbers_ASCII_part (DcmDspData):
          DcmDspDataSize = 24
          DcmDspDataType = UINT8_N
          DcmDspDataUsePort = USE_DATA_ASYNCH_CLIENT_SERVER
          DcmDspDataInfoRef = DataInfo_DID_F12E_ECU_Software_Part_Numbers_ASCII_part
        DID_E337_q_axis_current_setpoint_DID_E337_q_axis_current_setpoint (DcmDspData):
          DcmDspDataSize = 16
          DcmDspDataType = UINT16
          DcmDspDataUsePort = USE_DATA_ASYNCH_CLIENT_SERVER
          DcmDspDataInfoRef = DataInfo_DID_E337_q_axis_current_setpoint_DID_E337_q_axis_current_setpoint
        DataInfo_DID_EEBF_HV_Main_Relay_Status_DID_EEBF_HV_Main_Relay_Status (DcmDspDataInfo): DcmDspDataFixedLength=true
        DataInfo_DID_EDA0_Complete_ECU_Part_Serial_Number_s_BCD_part (DcmDspDataInfo): DcmDspDataFixedLength=true
        DidInfo_DID_F1AF_ECU_Software_Extended_Part_Numbers_Geely (DcmDspDidInfo)
          DcmDspDidAccess
            DcmDspDidRead: DcmDspDidReadSessionRef=defaultSession, DcmDspDidReadSessionRef=extendedDiagnosticSession
        DataInfo_DID_EE9E_Transient_Phase_Current_C_DID_EE9E_Transient_Phase_Current_C (DcmDspDataInfo): DcmDspDataFixedLength=true
        DID_EE9D_Transient_Phase_Current_B (DcmDspDid):
          DcmDspDidIdentifier = 61085
          DcmDspDidUsed = true
          DcmDspDidUsePort = USE_DATA_ELEMENT_SPECIFIC_INTERFACES
          DcmDspDidInfoRef = DidInfo_DID_EE9D_Transient_Phase_Current_B
          DID_EE9D_Transient_Phase_Current_B (DcmDspDidSignal): DcmDspDidDataPos=0, DcmDspDidDataRef=DID_EE9D_Transient_Phase_Current_B_DID_EE9D_Transient_Phase_Current_B
        DataInfo_DID_D211_Network_Management_History_Propulsion_CAN_DID_D211_15_8th_Latest_State_NM_History (DcmDspDataInfo): DcmDspDataFixedLength=true
        DID_F126_Autosar_BSW_Cluster_Versions_DID_F126_1_DIAG_CLUSTER_VENDOR_ID (DcmDspData):
          DcmDspDataSize = 16
          DcmDspDataType = UINT16
          DcmDspDataUsePort = USE_DATA_ASYNCH_CLIENT_SERVER
          DcmDspDataInfoRef = DataInfo_DID_F126_Autosar_BSW_Cluster_Versions_DID_F126_1_DIAG_CLUSTER_VENDOR_ID
        DidInfo_DID_F1A5_Primary_Bootloader_Software_Part_Number_Geely (DcmDspDidInfo)
          DcmDspDidAccess
            DcmDspDidRead: DcmDspDidReadSessionRef=defaultSession, DcmDspDidReadSessionRef=extendedDiagnosticSession
        DidInfo_DID_E103_Car_Configuration_Parameter_Faults (DcmDspDidInfo)
          DcmDspDidAccess
            DcmDspDidRead: DcmDspDidReadSessionRef=defaultSession, DcmDspDidReadSessionRef=extendedDiagnosticSession
        DataInfo_DID_D005_High_Quiescent_Current_Fault_Identification_Data_DID_D005_4st_Usage_Mode_when_DID_is_triggered (DcmDspDataInfo): DcmDspDataFixedLength=true
        DID_E103_Car_Configuration_Parameter_Faults_DID_E103_7_3rd_parameter_invalid_value (DcmDspData):
          DcmDspDataSize = 8
          DcmDspDataType = UINT8
          DcmDspDataUsePort = USE_DATA_ASYNCH_CLIENT_SERVER
          DcmDspDataInfoRef = DataInfo_DID_E103_Car_Configuration_Parameter_Faults_DID_E103_7_3rd_parameter_invalid_value
        DID_F126_Autosar_BSW_Cluster_Versions_DID_F126_19_COM_CLUSTER_SW_MAJOR_VERSION (DcmDspData):
          DcmDspDataSize = 8
          DcmDspDataType = UINT8
          DcmDspDataUsePort = USE_DATA_ASYNCH_CLIENT_SERVER
          DcmDspDataInfoRef = DataInfo_DID_F126_Autosar_BSW_Cluster_Versions_DID_F126_19_COM_CLUSTER_SW_MAJOR_VERSION
        3 x DcmDspDataInfo, all with DcmDspDataFixedLength=true:
          DataInfo_DID_D005_High_Quiescent_Current_Fault_Identification_Data_Reserved_PNC_4st
          DataInfo_DID_D005_High_Quiescent_Current_Fault_Identification_Data_DID_D005_2_1st_Global_time_when_Functionality_Activit6a6f0b62
          DataInfo_DID_F126_Autosar_BSW_Cluster_Versions_DID_F126_22_COM_CLUSTER_AR_RELEASE_MAJOR_VERSION
        DID_D005_High_Quiescent_Current_Fault_Identification_Data_Reserved_PNC_5st (DcmDspData):
          DcmDspDataSize = 56
          DcmDspDataType = UINT8_N
          DcmDspDataUsePort = USE_DATA_ASYNCH_CLIENT_SERVER
          DcmDspDataInfoRef = DataInfo_DID_D005_High_Quiescent_Current_Fault_Identification_Data_Reserved_PNC_5st
        DID_F126_Autosar_BSW_Cluster_Versions_DID_F126_23_COM_CLUSTER_AR_RELEASE_MINOR_VERSION (DcmDspData):
          DcmDspDataSize = 8
          DcmDspDataType = UINT8
          DcmDspDataUsePort = USE_DATA_ASYNCH_CLIENT_SERVER
          DcmDspDataInfoRef = DataInfo_DID_F126_Autosar_BSW_Cluster_Versions_DID_F126_23_COM_CLUSTER_AR_RELEASE_MINOR_VERSION
        DID_EE9F_Gate_Status (DcmDspDid):
          DcmDspDidIdentifier = 61087
          DcmDspDidUsed = true
          DcmDspDidUsePort = USE_DATA_ELEMENT_SPECIFIC_INTERFACES
          DcmDspDidInfoRef = DidInfo_DID_EE9F_Gate_Status
          DID_EE9F_Gate_Status (DcmDspDidSignal): DcmDspDidDataPos=0, DcmDspDidDataRef=DID_EE9F_Gate_Status_DID_EE9F_Gate_Status
        DataInfo_DID_E338_q_axis_current_feedback_DID_E338_q_axis_current_feedback (DcmDspDataInfo): DcmDspDataFixedLength=true
        DataInfo_DID_E103_Car_Configuration_Parameter_Faults_DID_E103_11_5th_parameter_invalid_value (DcmDspDataInfo): DcmDspDataFixedLength=true
        DID_F126_Autosar_BSW_Cluster_Versions_DID_F126_7_DIAG_CLUSTER_AR_RELEASE_REVISION_VERSION (DcmDspData):
          DcmDspDataSize = 8
          DcmDspDataType = UINT8
          DcmDspDataUsePort = USE_DATA_ASYNCH_CLIENT_SERVER
          DcmDspDataInfoRef = DataInfo_DID_F126_Autosar_BSW_Cluster_Versions_DID_F126_7_DIAG_CLUSTER_AR_RELEASE_REVISION_VERSION
        DataInfo_DID_D005_High_Quiescent_Current_Fault_Identification_Data_Bitfield_2th (DcmDspDataInfo): DcmDspDataFixedLength=true
        DID_E333_2002_State (DcmDspDid): DcmDspDidIdentifier=58163, DcmDspDidUsed=true, DcmDspDidUsePort=USE_DATA_ELEMENT_SPECIFIC_INTERFACES, DcmDspDidInfoRef=DidInfo_DID_E333_2002_State
          8 x DcmDspDidSignal:
            INVALID_SHORTNAME_2002_H_Ser: DcmDspDidDataPos=48, DcmDspDidDataRef=DID_E333_2002_State_2002_H_Ser
            INVALID_SHORTNAME_2002_Lu: DcmDspDidDataPos=24, DcmDspDidDataRef=DID_E333_2002_State_2002_Lu
            INVALID_SHORTNAME_2002_L_Ser: DcmDspDidDataPos=56, DcmDspDidDataRef=DID_E333_2002_State_2002_L_Ser
            INVALID_SHORTNAME_2002_Hu: DcmDspDidDataPos=0, DcmDspDidDataRef=DID_E333_2002_State_2002_Hu
            INVALID_SHORTNAME_2002_Lv: DcmDspDidDataPos=32, DcmDspDidDataRef=DID_E333_2002_State_2002_Lv
            INVALID_SHORTNAME_2002_Lw: DcmDspDidDataPos=40, DcmDspDidDataRef=DID_E333_2002_State_2002_Lw
            INVALID_SHORTNAME_2002_Hv: DcmDspDidDataPos=8, DcmDspDidDataRef=DID_E333_2002_State_2002_Hv
            INVALID_SHORTNAME_2002_Hw: DcmDspDidDataPos=16, DcmDspDidDataRef=DID_E333_2002_State_2002_Hw
        3 x DcmDspDataInfo, all with DcmDspDataFixedLength=true:
          DataInfo_DID_F126_Autosar_BSW_Cluster_Versions_DID_F126_13_MODEMGMT_CLUSTER_SW_MINOR_VERSION
          DataInfo_DID_F18C_ECU_Serial_Number_DID_F18C_ECU_Serial_Number
          DataInfo_DID_D005_High_Quiescent_Current_Fault_Identification_Data_DID_D005_2st_Global_time_when_Functionality_Activity_c77cfb46
        5 x DcmDspData, all with DcmDspDataUsePort=USE_DATA_ASYNCH_CLIENT_SERVER:
          DID_D005_High_Quiescent_Current_Fault_Identification_Data_Functionality_Activity_Level_Detect_CPSR_Keep_Active_3st: DcmDspDataSize=8, DcmDspDataType=UINT8, DcmDspDataInfoRef=DataInfo_DID_D005_High_Quiescent_Current_Fault_Identification_Data_Functionality_Activity_Level_Detect_CPSR_Keep_Active_3st
          DID_F126_Autosar_BSW_Cluster_Versions_DID_F126_13_MODEMGMT_CLUSTER_SW_MINOR_VERSION: DcmDspDataSize=8, DcmDspDataType=UINT8, DcmDspDataInfoRef=DataInfo_DID_F126_Autosar_BSW_Cluster_Versions_DID_F126_13_MODEMGMT_CLUSTER_SW_MINOR_VERSION
          DID_E348_Phase_U_PWM_duty_DID_E348_Phase_U_PWM_duty: DcmDspDataSize=8, DcmDspDataType=UINT8, DcmDspDataInfoRef=DataInfo_DID_E348_Phase_U_PWM_duty_DID_E348_Phase_U_PWM_duty
          DID_D134_Car_Mode_DID_D134_Car_Mode: DcmDspDataSize=8, DcmDspDataType=UINT8, DcmDspDataInfoRef=DataInfo_DID_D134_Car_Mode_DID_D134_Car_Mode
          DID_F126_Autosar_BSW_Cluster_Versions_DID_F126_25_CAN_CLUSTER_VENDOR_ID: DcmDspDataSize=16, DcmDspDataType=UINT16, DcmDspDataInfoRef=DataInfo_DID_F126_Autosar_BSW_Cluster_Versions_DID_F126_25_CAN_CLUSTER_VENDOR_ID
        DataInfo_DID_F1AE_ECU_Software_Part_Numbers_Geely_DID_F1AE_1_Total_number_of_ECU_Software_Part_Numbers (DcmDspDataInfo): DcmDspDataFixedLength=true
        DID_E103_Car_Configuration_Parameter_Faults_DID_E103_11_5th_parameter_invalid_value (DcmDspData):
          DcmDspDataSize = 8
          DcmDspDataType = UINT8
          DcmDspDataUsePort = USE_DATA_ASYNCH_CLIENT_SERVER
          DcmDspDataInfoRef = DataInfo_DID_E103_Car_Configuration_Parameter_Faults_DID_E103_11_5th_parameter_invalid_value
        DID_E309_ECM_Mode_Request_DID_E309_ECM_Mode_Request (DcmDspData):
          DcmDspDataSize = 8
          DcmDspDataType = UINT8
          DcmDspDataUsePort = USE_DATA_ASYNCH_CLIENT_SERVER
          DcmDspDataInfoRef = DataInfo_DID_E309_ECM_Mode_Request_DID_E309_ECM_Mode_Request
        6 x DcmDspDataInfo, all with DcmDspDataFixedLength=true:
          DataInfo_DID_F1AF_ECU_Software_Extended_Part_Numbers_Geely_DID_F1AF_1_Total_number_of_ECU_Software_Part_Numbers
          DataInfo_DID_E333_2002_State_2002_Lv
          DataInfo_DID_D005_High_Quiescent_Current_Fault_Identification_Data_Reserved_Data_Field_1st
          DataInfo_DID_E333_2002_State_2002_Lu
          DataInfo_DID_E103_Car_Configuration_Parameter_Faults_DID_E103_5_2nd_parameter_invalid_value
          DataInfo_DID_E333_2002_State_2002_Lw
        DidInfo_DID_E319_Torque_Direction (DcmDspDidInfo)
          DcmDspDidAccess
            DcmDspDidRead: DcmDspDidReadSessionRef=defaultSession, DcmDspDidReadSessionRef=extendedDiagnosticSession
        DID_E310_IEM_MGM_Derating_Status (DcmDspDid):
          DcmDspDidIdentifier = 58128
          DcmDspDidUsed = true
          DcmDspDidUsePort = USE_DATA_ELEMENT_SPECIFIC_INTERFACES
          DcmDspDidInfoRef = DidInfo_DID_E310_IEM_MGM_Derating_Status
          DID_E310_IEMMGM_Derating_Status (DcmDspDidSignal): DcmDspDidDataPos=0, DcmDspDidDataRef=DID_E310_IEM_MGM_Derating_Status_DID_E310_IEMMGM_Derating_Status
        DID_D211_Network_Management_History_Propulsion_CAN_DID_D211_11_6th_Latest_State_NM_History (DcmDspData):
          DcmDspDataSize = 8
          DcmDspDataType = UINT8
          DcmDspDataUsePort = USE_DATA_ASYNCH_CLIENT_SERVER
          DcmDspDataInfoRef = DataInfo_DID_D211_Network_Management_History_Propulsion_CAN_DID_D211_11_6th_Latest_State_NM_History
        DidInfo_DID_EEB7_ECM_Power_Limitation_minimum (DcmDspDidInfo)
          DcmDspDidAccess
            DcmDspDidRead: DcmDspDidReadSessionRef=defaultSession, DcmDspDidReadSessionRef=extendedDiagnosticSession
        DataInfo_DID_DD00_Global_Real_Time_DID_DD00_Global_Real_Time (DcmDspDataInfo): DcmDspDataFixedLength=true
        DidInfo_DID_E301_HVDC_Current (DcmDspDidInfo)
          DcmDspDidAccess
            DcmDspDidRead: DcmDspDidReadSessionRef=defaultSession, DcmDspDidReadSessionRef=extendedDiagnosticSession
        DID_EDA0_Complete_ECU_Part_Serial_Number_s_DID_F12B_ECU_Delivery_Assembly_Part_Number1 (DcmDspData):
          DcmDspDataSize = 24
          DcmDspDataType = UINT8_N
          DcmDspDataUsePort = USE_DATA_ASYNCH_CLIENT_SERVER
          DcmDspDataInfoRef = DataInfo_DID_EDA0_Complete_ECU_Part_Serial_Number_s_DID_F12B_ECU_Delivery_Assembly_Part_Number1
        DataInfo_DID_F126_Autosar_BSW_Cluster_Versions_DID_F126_30_CAN_CLUSTER_AR_RELEASE_MINOR_VERSION (DcmDspDataInfo): DcmDspDataFixedLength=true
        DidInfo_DID_F12E_ECU_Software_Part_Numbers (DcmDspDidInfo)
          DcmDspDidAccess
            DcmDspDidRead: DcmDspDidReadSessionRef=defaultSession, DcmDspDidReadSessionRef=extendedDiagnosticSession
        DataInfo_DID_F126_Autosar_BSW_Cluster_Versions_DID_F126_21_COM_CLUSTER_SW_PATCH_VERSION (DcmDspDataInfo): DcmDspDataFixedLength=true
        DID_EEBE_Offset_angle_status (DcmDspDid):
          DcmDspDidIdentifier = 61118
          DcmDspDidUsed = true
          DcmDspDidUsePort = USE_DATA_ELEMENT_SPECIFIC_INTERFACES
          DcmDspDidInfoRef = DidInfo_DID_EEBE_Offset_angle_status
          DID_EEBE_Offset_angle_status (DcmDspDidSignal): DcmDspDidDataPos=0, DcmDspDidDataRef=DID_EEBE_Offset_angle_status_DID_EEBE_Offset_angle_status
        DID_EDA0_Complete_ECU_Part_Serial_Number_s_DID_F12B_ECU_Delivery_Assembly_Part_Number (DcmDspData):
          DcmDspDataSize = 32
          DcmDspDataType = UINT32
          DcmDspDataUsePort = USE_DATA_ASYNCH_CLIENT_SERVER
          DcmDspDataInfoRef = DataInfo_DID_EDA0_Complete_ECU_Part_Serial_Number_s_DID_F12B_ECU_Delivery_Assembly_Part_Number
        DID_D005_High_Quiescent_Current_Fault_Identification_Data_D005_1st_Functionality_Activity_Level_PNC35 (DcmDspData):
          DcmDspDataSize = 8
          DcmDspDataType = UINT8
          DcmDspDataUsePort = USE_DATA_ASYNCH_CLIENT_SERVER
          DcmDspDataInfoRef = DataInfo_DID_D005_High_Quiescent_Current_Fault_Identification_Data_D005_1st_Functionality_Activity_Level_PNC35
        DataInfo_DID_F126_Autosar_BSW_Cluster_Versions_DID_F126_14_MODEMGMT_CLUSTER_SW_PATCH_VERSION (DcmDspDataInfo): DcmDspDataFixedLength=true
        DataInfo_DID_D005_High_Quiescent_Current_Fault_Identification_Data_DID_D005_3st_Global_time_when_Functionality_Activity_8e955659 (DcmDspDataInfo): DcmDspDataFixedLength=true
        DID_E103_Car_Configuration_Parameter_Faults_DID_E103_9_4th_parameter_invalid_value (DcmDspData):
          DcmDspDataSize = 8
          DcmDspDataType = UINT8
          DcmDspDataUsePort = USE_DATA_ASYNCH_CLIENT_SERVER
          DcmDspDataInfoRef = DataInfo_DID_E103_Car_Configuration_Parameter_Faults_DID_E103_9_4th_parameter_invalid_value
        DID_D005_High_Quiescent_Current_Fault_Identification_Data_D005_1st_Functionality_Activity_Level_PNC39 (DcmDspData):
          DcmDspDataSize = 8
          DcmDspDataType = UINT8
          DcmDspDataUsePort = USE_DATA_ASYNCH_CLIENT_SERVER
          DcmDspDataInfoRef = DataInfo_DID_D005_High_Quiescent_Current_Fault_Identification_Data_D005_1st_Functionality_Activity_Level_PNC39
        Application_Diagnostic_Database_Part_Number (DcmDspDid):
          DcmDspDidIdentifier = 61728
          DcmDspDidUsed = true
          DcmDspDidUsePort = USE_DATA_ELEMENT_SPECIFIC_INTERFACES
          DcmDspDidInfoRef = DidInfo_Application_Diagnostic_Database_Part_Number
          Partnumber_Variant (DcmDspDidSignal): DcmDspDidDataPos=32, DcmDspDidDataRef=Application_Diagnostic_Database_Part_Number_Partnumber_Variant
          Partnumber_Main (DcmDspDidSignal): DcmDspDidDataPos=0, DcmDspDidDataRef=Application_Diagnostic_Database_Part_Number_Partnumber_Main
        DID_EED5_Safety_Torque_QF_factor_EED5_Safety_Torque_Quality_factor (DcmDspData):
          DcmDspDataSize = 8
          DcmDspDataType = UINT8_N
          DcmDspDataUsePort = USE_DATA_ASYNCH_CLIENT_SERVER
          DcmDspDataInfoRef = DataInfo_DID_EED5_Safety_Torque_QF_factor_EED5_Safety_Torque_Quality_factor
        3 x DcmDspDataInfo, all with DcmDspDataFixedLength=true:
          DataInfo_DID_E337_q_axis_current_setpoint_DID_E337_q_axis_current_setpoint
          DataInfo_DID_EEB5_IEM_MGM_current_torque_DID_EEB5_IEMMGM_current_torque
          DataInfo_DID_EEB6_ECM_Power_Limitation_maximum_DID_EEB6_ECM_Power_Limitation_maximum
        DID_D005_High_Quiescent_Current_Fault_Identification_Data_Functionality_Activity_Level_Detect_CPSR_Keep_Active_4st (DcmDspData):
          DcmDspDataSize = 8
          DcmDspDataType = UINT8
          DcmDspDataUsePort = USE_DATA_ASYNCH_CLIENT_SERVER
          DcmDspDataInfoRef = DataInfo_DID_D005_High_Quiescent_Current_Fault_Identification_Data_Functionality_Activity_Level_Detect_CPSR_Keep_Active_4st
        DID_0xEEC7_1 (DcmDspDid): DcmDspDidIdentifier=61138, DcmDspDidUsed=true, DcmDspDidUsePort=USE_DATA_ELEMENT_SPECIFIC_INTERFACES, DcmDspDidInfoRef=DidInfo_DID_0xEEC7_1
          DID_EED2_SaftyTorque (DcmDspDidSignal): DcmDspDidDataPos=0, DcmDspDidDataRef=DID_0xEEC7_1_DID_EED2_SaftyTorque
        DID_F126_Autosar_BSW_Cluster_Versions_DID_F126_36_FLEXRAY_CLUSTER_AR_RELEASE_MAJOR_VERSION (DcmDspData):
          DcmDspDataSize = 8
          DcmDspDataType = UINT8
          DcmDspDataUsePort = USE_DATA_ASYNCH_CLIENT_SERVER
          DcmDspDataInfoRef = DataInfo_DID_F126_Autosar_BSW_Cluster_Versions_DID_F126_36_FLEXRAY_CLUSTER_AR_RELEASE_MAJOR_VERSION
        DID_F126_Autosar_BSW_Cluster_Versions_DID_F126_15_MODEMGMT_CLUSTER_AR_RELEASE_MAJOR_VERSION (DcmDspData):
          DcmDspDataSize = 8
          DcmDspDataType = UINT8
          DcmDspDataUsePort = USE_DATA_ASYNCH_CLIENT_SERVER
          DcmDspDataInfoRef = DataInfo_DID_F126_Autosar_BSW_Cluster_Versions_DID_F126_15_MODEMGMT_CLUSTER_AR_RELEASE_MAJOR_VERSION
        DidInfo_DID_EEB5_IEM_MGM_current_torque (DcmDspDidInfo)
          DcmDspDidAccess
            DcmDspDidRead: DcmDspDidReadSessionRef=defaultSession, DcmDspDidReadSessionRef=extendedDiagnosticSession
        DID_D005_High_Quiescent_Current_Fault_Identification_Data_D005_1st_Functionality_Activity_Level_PNC30 (DcmDspData):
          DcmDspDataSize = 8
          DcmDspDataType = UINT8
          DcmDspDataUsePort = USE_DATA_ASYNCH_CLIENT_SERVER
          DcmDspDataInfoRef = DataInfo_DID_D005_High_Quiescent_Current_Fault_Identification_Data_D005_1st_Functionality_Activity_Level_PNC30
        DidInfo_DID_DD0A_Usage_Mode (DcmDspDidInfo)
          DcmDspDidAccess
            DcmDspDidRead: DcmDspDidReadSessionRef=defaultSession, DcmDspDidReadSessionRef=extendedDiagnosticSession
        RoutineInfo_Check_programming_pre_conditions (DcmDspRoutineInfo)
          DcmDspRoutineAuthorization: DcmDspRoutineSessionRef=defaultSession
          DcmDspStartRoutineOut
            Out_RID_0206_Start_Pr_3_Condition_Fullfilled_To_Enter_Programming_Session (DcmDspStartRoutineOutSignal): DcmDspRoutineSignalLength=8, DcmDspRoutineSignalType=UINT8, DcmDspRoutineSignalPos=8
            Out_New_Bit_Field (DcmDspStartRoutineOutSignal): DcmDspRoutineSignalLength=8, DcmDspRoutineSignalType=UINT8, DcmDspRoutineSignalPos=0
        DataInfo_DID_EE9A_Inverter_Coolant_Temperature_DID_EE9A_Inverter_Coolant_Temperature (DcmDspDataInfo): DcmDspDataFixedLength=true
        DataInfo_DID_DD02_Vehicle_Battery_Voltage_DID_DD02_Vehicle_Battery_Voltage (DcmDspDataInfo): DcmDspDataFixedLength=true

[part 2 of 2: package /ActiveEcuC]
AUTOSAR XML (schema 4-2-2)
package /ActiveEcuC  (continued)
  module config Dcm: implementation-config-variant=VARIANT-PRE-COMPILE, module-description=Dcm_Impl  (continued)
    DcmConfigSet  (continued)
      DcmDsp: DcmDspMaxDidToRead=5, DcmDspReadDIDReportsNODIByte=false  (continued)
        DcmDspSecurity
          CommonUnlock_Level_3 (DcmDspSecurityRow):
            DcmDspSecurityDelayTime = 10
            DcmDspSecurityDelayTimeOnBoot = 0
            DcmDspSecurityKeySize = 3
            DcmDspSecurityLevel = 3
            DcmDspSecurityNumAttDelay = 3
            DcmDspSecuritySeedSize = 3
            DcmDspSecurityAttemptCounterEnabled = false
            DcmDspSecurityUsePort = USE_ASYNCH_CLIENT_SERVER
          ImmoUnlocked_Level_4 (DcmDspSecurityRow):
            DcmDspSecurityDelayTime = 10
            DcmDspSecurityDelayTimeOnBoot = 0
            DcmDspSecurityKeySize = 3
            DcmDspSecurityLevel = 9
            DcmDspSecurityNumAttDelay = 3
            DcmDspSecuritySeedSize = 3
            DcmDspSecurityAttemptCounterEnabled = false
            DcmDspSecurityUsePort = USE_ASYNCH_CLIENT_SERVER
        DID_EF1D_EOL_config_word_C_DID_EF1D_EOL_config_word_C (DcmDspData):
          DcmDspDataSize = 16
          DcmDspDataType = UINT16
          DcmDspDataUsePort = USE_DATA_ASYNCH_CLIENT_SERVER
          DcmDspDataInfoRef = DataInfo_DID_EF1D_EOL_config_word_C_DID_EF1D_EOL_config_word_C
        DataInfo_DID_D005_High_Quiescent_Current_Fault_Identification_Data_DID_D005_5st_Usage_Mode_when_DID_is_triggered (DcmDspDataInfo): DcmDspDataFixedLength=true
        DidInfo_DID_EEB8_HV_voltage_received_from_BECM (DcmDspDidInfo)
          DcmDspDidAccess
            DcmDspDidRead: DcmDspDidReadSessionRef=defaultSession, DcmDspDidReadSessionRef=extendedDiagnosticSession
        DataInfo_DID_F126_Autosar_BSW_Cluster_Versions_DID_F126_19_COM_CLUSTER_SW_MAJOR_VERSION (DcmDspDataInfo): DcmDspDataFixedLength=true
        DID_F1AE_ECU_Software_Part_Numbers_Geely_BCD_part (DcmDspData):
          DcmDspDataSize = 40
          DcmDspDataType = UINT8_N
          DcmDspDataUsePort = USE_DATA_ASYNCH_CLIENT_SERVER
          DcmDspDataInfoRef = DataInfo_DID_F1AE_ECU_Software_Part_Numbers_Geely_BCD_part
        DID_E358_Resolve_angle (DcmDspDid):
          DcmDspDidIdentifier = 58200
          DcmDspDidUsed = true
          DcmDspDidUsePort = USE_DATA_ELEMENT_SPECIFIC_INTERFACES
          DcmDspDidInfoRef = DidInfo_DID_E358_Resolve_angle
          DID_E358_Resolve_angle (DcmDspDidSignal): DcmDspDidDataPos=0, DcmDspDidDataRef=DID_E358_Resolve_angle_DID_E358_Resolve_angle
        3 x DcmDspData, all with DcmDspDataUsePort=USE_DATA_ASYNCH_CLIENT_SERVER:
          DID_E333_2002_State_2002_L_Ser: DcmDspDataSize=8, DcmDspDataType=UINT8, DcmDspDataInfoRef=DataInfo_DID_E333_2002_State_2002_L_Ser
          DID_E103_Car_Configuration_Parameter_Faults_DID_E103_13_6th_parameter_invalid_value: DcmDspDataSize=8, DcmDspDataType=UINT8, DcmDspDataInfoRef=DataInfo_DID_E103_Car_Configuration_Parameter_Faults_DID_E103_13_6th_parameter_invalid_value
          DID_E331_Software_Version_DID_E331_1_ASW_Software_Version: DcmDspDataSize=64, DcmDspDataType=UINT8_N, DcmDspDataInfoRef=DataInfo_DID_E331_Software_Version_DID_E331_1_ASW_Software_Version
        DataInfo_DID_ED20_Complete_set_of_ECU_part_serial_numbers_Geely_DID_F1AE_1_Total_number_of_ECU_Software_Part_Numbers (DcmDspDataInfo): DcmDspDataFixedLength=true
        DidInfo_DID_EEBF_HV_Main_Relay_Status (DcmDspDidInfo)
          DcmDspDidAccess
            DcmDspDidRead: DcmDspDidReadSessionRef=defaultSession, DcmDspDidReadSessionRef=extendedDiagnosticSession
        3 x DcmDspData, all with DcmDspDataSize=8, DcmDspDataUsePort=USE_DATA_ASYNCH_CLIENT_SERVER:
          DID_E333_2002_State_2002_Hw: DcmDspDataType=UINT8_N, DcmDspDataInfoRef=DataInfo_DID_E333_2002_State_2002_Hw
          DID_E333_2002_State_2002_Hv: DcmDspDataType=UINT8_N, DcmDspDataInfoRef=DataInfo_DID_E333_2002_State_2002_Hv
          DID_D005_High_Quiescent_Current_Fault_Identification_Data_Functionality_Activity_Level_Detect_DC_Bus_voltage_Abnormal_1st: DcmDspDataType=UINT8, DcmDspDataInfoRef=DataInfo_DID_D005_High_Quiescent_Current_Fault_Identification_Data_Functionality_Activity_Level_Detect_DC_Bus_voltage_Ab895ea3c2
        DID_E357_Resolve_compensated_angle (DcmDspDid):
          DcmDspDidIdentifier = 58199
          DcmDspDidUsed = true
          DcmDspDidUsePort = USE_DATA_ELEMENT_SPECIFIC_INTERFACES
          DcmDspDidInfoRef = DidInfo_DID_E357_Resolve_compensated_angle
          DID_E357_Resolve_compensated_angle (DcmDspDidSignal): DcmDspDidDataPos=0, DcmDspDidDataRef=DID_E357_Resolve_compensated_angle_DID_E357_Resolve_compensated_angle
        DID_E333_2002_State_2002_Hu (DcmDspData): DcmDspDataSize=8, DcmDspDataType=UINT8_N, DcmDspDataUsePort=USE_DATA_ASYNCH_CLIENT_SERVER, DcmDspDataInfoRef=DataInfo_DID_E333_2002_State_2002_Hu
        DataInfo_DID_F126_Autosar_BSW_Cluster_Versions_DID_F126_5_DIAG_CLUSTER_AR_RELEASE_MAJOR_VERSION (DcmDspDataInfo): DcmDspDataFixedLength=true
        DidInfo_DID_F121_Primary_Bootloader_Diagnostic_Database_Part_Number (DcmDspDidInfo)
          DcmDspDidAccess
            DcmDspDidRead: DcmDspDidReadSessionRef=defaultSession, DcmDspDidReadSessionRef=extendedDiagnosticSession
        DID_E307_System_Mode (DcmDspDid):
          DcmDspDidIdentifier = 58119
          DcmDspDidUsed = true
          DcmDspDidUsePort = USE_DATA_ELEMENT_SPECIFIC_INTERFACES
          DcmDspDidInfoRef = DidInfo_DID_E307_System_Mode
          DID_E307_System_Mode (DcmDspDidSignal): DcmDspDidDataPos=0, DcmDspDidDataRef=DID_E307_System_Mode_DID_E307_System_Mode
        DidInfo_DID_EF1B_EOL_config_word_A (DcmDspDidInfo)
          DcmDspDidAccess
            DcmDspDidWrite: DcmDspDidWriteSessionRef=extendedDiagnosticSession, DcmDspDidWriteSecurityLevelRef=CommonUnlock_Level_3
            DcmDspDidRead
        DID_E305_Inverter_IGBT_Junction_Temp (DcmDspDid):
          DcmDspDidIdentifier = 58117
          DcmDspDidUsed = true
          DcmDspDidUsePort = USE_DATA_ELEMENT_SPECIFIC_INTERFACES
          DcmDspDidInfoRef = DidInfo_DID_E305_Inverter_IGBT_Junction_Temp
          DID_E305_Inverter_IGBT_Junction_Temp (DcmDspDidSignal): DcmDspDidDataPos=0, DcmDspDidDataRef=DID_E305_Inverter_IGBT_Junction_Temp_DID_E305_Inverter_IGBT_Junction_Temp
        DID_E314_Available_Torque_maximum_DID_E314_Available_Torque_maximum (DcmDspData):
          DcmDspDataSize = 16
          DcmDspDataType = UINT16
          DcmDspDataUsePort = USE_DATA_ASYNCH_CLIENT_SERVER
          DcmDspDataInfoRef = DataInfo_DID_E314_Available_Torque_maximum_DID_E314_Available_Torque_maximum
        3 x DcmDspDataInfo, all with DcmDspDataFixedLength=true:
          DataInfo_DID_D211_Network_Management_History_Propulsion_CAN_DID_D211_3_2nd_Latest_State_NM_History
          DataInfo_DID_EEC5_ImobEng2_node_status_DID_EEC5_ImobEng2_node_status
          DataInfo_DID_D005_High_Quiescent_Current_Fault_Identification_Data_DID_D005_3st_System_Global_Time_the_time_when_the_DID5856c533
        DID_F126_Autosar_BSW_Cluster_Versions_DID_F126_5_DIAG_CLUSTER_AR_RELEASE_MAJOR_VERSION (DcmDspData):
          DcmDspDataSize = 8
          DcmDspDataType = UINT8
          DcmDspDataUsePort = USE_DATA_ASYNCH_CLIENT_SERVER
          DcmDspDataInfoRef = DataInfo_DID_F126_Autosar_BSW_Cluster_Versions_DID_F126_5_DIAG_CLUSTER_AR_RELEASE_MAJOR_VERSION
        DataInfo_DID_E349_Phase_V_PWM_duty_DID_E349_Phase_V_PWM_duty (DcmDspDataInfo): DcmDspDataFixedLength=true
        DID_F126_Autosar_BSW_Cluster_Versions_DID_F126_40_LIN_CLUSTER_SW_MAJOR_VERSION (DcmDspData):
          DcmDspDataSize = 8
          DcmDspDataType = UINT8
          DcmDspDataUsePort = USE_DATA_ASYNCH_CLIENT_SERVER
          DcmDspDataInfoRef = DataInfo_DID_F126_Autosar_BSW_Cluster_Versions_DID_F126_40_LIN_CLUSTER_SW_MAJOR_VERSION
        4 x DcmDspDataInfo, all with DcmDspDataFixedLength=true:
          DataInfo_DID_F1AF_ECU_Software_Extended_Part_Numbers_Geely_BCD_part_003
          DataInfo_DID_F1AF_ECU_Software_Extended_Part_Numbers_Geely_BCD_part_002
          DataInfo_DID_F1AF_ECU_Software_Extended_Part_Numbers_Geely_BCD_part_001
          DataInfo_DID_E350_Phase_W_PWM_duty_DID_E350_Phase_W_PWM_duty
        DID_D005_High_Quiescent_Current_Fault_Identification_Data_DID_D005_4st_System_Global_Time_the_time_when_the_DID_is_triggered (DcmDspData):
          DcmDspDataSize = 32
          DcmDspDataType = UINT32
          DcmDspDataUsePort = USE_DATA_ASYNCH_CLIENT_SERVER
          DcmDspDataInfoRef = DataInfo_DID_D005_High_Quiescent_Current_Fault_Identification_Data_DID_D005_4st_System_Global_Time_the_time_when_the_DID1302fa0f
        DataInfo_DID_D005_High_Quiescent_Current_Fault_Identification_Data_DID_D005_3st_Usage_Mode_when_DID_is_triggered (DcmDspDataInfo): DcmDspDataFixedLength=true
        DID_F1AA_ECU_Core_Assembly_Part_Number_Geely (DcmDspDid):
          DcmDspDidIdentifier = 61866
          DcmDspDidUsed = true
          DcmDspDidUsePort = USE_DATA_ELEMENT_SPECIFIC_INTERFACES
          DcmDspDidInfoRef = DidInfo_DID_F1AA_ECU_Core_Assembly_Part_Number_Geely
          ASCII_part (DcmDspDidSignal): DcmDspDidDataPos=40, DcmDspDidDataRef=DID_F1AA_ECU_Core_Assembly_Part_Number_Geely_ASCII_part
          BCD_part (DcmDspDidSignal): DcmDspDidDataPos=0, DcmDspDidDataRef=DID_F1AA_ECU_Core_Assembly_Part_Number_Geely_BCD_part
        3 x DcmDspDataInfo, all with DcmDspDataFixedLength=true:
          DataInfo_DID_D005_High_Quiescent_Current_Fault_Identification_Data_D005_4st_Functionality_Activity_Level_PNC35
          DataInfo_DID_F126_Autosar_BSW_Cluster_Versions_DID_F126_4_DIAG_CLUSTER_SW_PATCH_VERSION
          DataInfo_Application_Diagnostic_Database_Part_Number_Partnumber_Variant
        DID_F1AB_ECU_Delivery_Assembly_Part_Number_Geely_ASCII_part (DcmDspData):
          DcmDspDataSize = 24
          DcmDspDataType = UINT8_N
          DcmDspDataUsePort = USE_DATA_ASYNCH_CLIENT_SERVER
          DcmDspDataInfoRef = DataInfo_DID_F1AB_ECU_Delivery_Assembly_Part_Number_Geely_ASCII_part
        DataInfo_DID_F12E_ECU_Software_Part_Numbers_ASCII_part (DcmDspDataInfo): DcmDspDataFixedLength=true
        DataInfo_DID_D005_High_Quiescent_Current_Fault_Identification_Data_D005_4st_Functionality_Activity_Level_PNC30 (DcmDspDataInfo): DcmDspDataFixedLength=true
        DidInfo_DID_DD01_Total_Distance (DcmDspDidInfo)
          DcmDspDidAccess
            DcmDspDidRead: DcmDspDidReadSessionRef=defaultSession, DcmDspDidReadSessionRef=extendedDiagnosticSession
        DidInfo_DID_F12A_ECU_Core_Assembly_Part_Number (DcmDspDidInfo)
          DcmDspDidAccess
            DcmDspDidRead: DcmDspDidReadSessionRef=defaultSession, DcmDspDidReadSessionRef=extendedDiagnosticSession
        DataInfo_DID_F1AF_ECU_Software_Extended_Part_Numbers_Geely_ASCII_part (DcmDspDataInfo): DcmDspDataFixedLength=true
        DID_F126_Autosar_BSW_Cluster_Versions_DID_F126_41_LIN_CLUSTER_SW_MINOR_VERSION (DcmDspData):
          DcmDspDataSize = 8
          DcmDspDataType = UINT8
          DcmDspDataUsePort = USE_DATA_ASYNCH_CLIENT_SERVER
          DcmDspDataInfoRef = DataInfo_DID_F126_Autosar_BSW_Cluster_Versions_DID_F126_41_LIN_CLUSTER_SW_MINOR_VERSION
        DataInfo_DID_D005_High_Quiescent_Current_Fault_Identification_Data_D005_4st_Functionality_Activity_Level_PNC39 (DcmDspDataInfo): DcmDspDataFixedLength=true
        DID_E301_HVDC_Current (DcmDspDid):
          DcmDspDidIdentifier = 58113
          DcmDspDidUsed = true
          DcmDspDidUsePort = USE_DATA_ELEMENT_SPECIFIC_INTERFACES
          DcmDspDidInfoRef = DidInfo_DID_E301_HVDC_Current
          DID_E301_HVDC_Current_ (DcmDspDidSignal): DcmDspDidDataPos=0, DcmDspDidDataRef=DID_E301_HVDC_Current_DID_E301_HVDC_Current_
        DID_EF1C_EOL_config_word_B (DcmDspDid):
          DcmDspDidIdentifier = 61212
          DcmDspDidUsed = true
          DcmDspDidUsePort = USE_DATA_ELEMENT_SPECIFIC_INTERFACES
          DcmDspDidInfoRef = DidInfo_DID_EF1C_EOL_config_word_B
          DID_EF1C_EOL_config_word_B (DcmDspDidSignal): DcmDspDidDataPos=0, DcmDspDidDataRef=DID_EF1C_EOL_config_word_B_DID_EF1C_EOL_config_word_B
        8 x DcmDspDataInfo, all with DcmDspDataFixedLength=true:
          DataInfo_DID_D12F_Security_Constant_Level_11_12_DID_D12F_Security_Constant_Level_1112
          DataInfo_DID_E306_Motor_Temperature_DID_E306_Motor_Temperature
          DataInfo_DID_E103_Car_Configuration_Parameter_Faults_DID_E103_14_7th_parameter_number_of_the_car_configuration_data_thatd7b4e1f3
          DataInfo_DID_F126_Autosar_BSW_Cluster_Versions_DID_F126_11_MODEMGMT_CLUSTER_VENDOR_ID
          DataInfo_DID_E103_Car_Configuration_Parameter_Faults_DID_E103_20_10th_parameter_number_of_the_car_configuration_data_thace4964ec
          DataInfo_DID_D005_High_Quiescent_Current_Fault_Identification_Data_D005_4st_Functionality_Activity_Level_PNC25
          DataInfo_DID_D005_High_Quiescent_Current_Fault_Identification_Data_D005_4st_Functionality_Activity_Level_PNC24
          DataInfo_DID_F126_Autosar_BSW_Cluster_Versions_DID_F126_35_FLEXRAY_CLUSTER_SW_PATCH_VERSION
        DID_EEBD_IEM_MGM_rotor_offset_angle (DcmDspDid):
          DcmDspDidIdentifier = 61117
          DcmDspDidUsed = true
          DcmDspDidUsePort = USE_DATA_ELEMENT_SPECIFIC_INTERFACES
          DcmDspDidInfoRef = DidInfo_DID_EEBD_IEM_MGM_rotor_offset_angle
          DID_EEBD_IEMMGM_rotor_offset_angle (DcmDspDidSignal): DcmDspDidDataPos=0, DcmDspDidDataRef=DID_EEBD_IEM_MGM_rotor_offset_angle_DID_EEBD_IEMMGM_rotor_offset_angle
        5 x DcmDspDataInfo, all with DcmDspDataFixedLength=true:
          DataInfo_DID_ED20_Complete_set_of_ECU_part_serial_numbers_Geely_Reserved
          DataInfo_DID_F121_Primary_Bootloader_Diagnostic_Database_Part_Number_ASCII_part
          DataInfo_DID_D005_High_Quiescent_Current_Fault_Identification_Data_D005_4st_Functionality_Activity_Level_PNC29
          DataInfo_DID_D005_High_Quiescent_Current_Fault_Identification_Data_D005_4st_Functionality_Activity_Level_PNC27
          DataInfo_DID_D005_High_Quiescent_Current_Fault_Identification_Data_D005_4st_Functionality_Activity_Level_PNC26
        DID_E363_Modulation_index_DID_E363_Modulation_index (DcmDspData):
          DcmDspDataSize = 8
          DcmDspDataType = UINT8
          DcmDspDataUsePort = USE_DATA_ASYNCH_CLIENT_SERVER
          DcmDspDataInfoRef = DataInfo_DID_E363_Modulation_index_DID_E363_Modulation_index
        DidInfo_DID_F1AE_ECU_Software_Part_Numbers_Geely (DcmDspDidInfo)
          DcmDspDidAccess
            DcmDspDidRead: DcmDspDidReadSessionRef=defaultSession, DcmDspDidReadSessionRef=extendedDiagnosticSession
        DidInfo_DID_EF0A_Active_Discharge_Time (DcmDspDidInfo)
          DcmDspDidAccess
            DcmDspDidRead
        DID_E306_Motor_Temperature (DcmDspDid):
          DcmDspDidIdentifier = 58118
          DcmDspDidUsed = true
          DcmDspDidUsePort = USE_DATA_ELEMENT_SPECIFIC_INTERFACES
          DcmDspDidInfoRef = DidInfo_DID_E306_Motor_Temperature
          DID_E306_Motor_Temperature (DcmDspDidSignal): DcmDspDidDataPos=0, DcmDspDidDataRef=DID_E306_Motor_Temperature_DID_E306_Motor_Temperature
        7 x DcmDspData, all with DcmDspDataSize=8, DcmDspDataUsePort=USE_DATA_ASYNCH_CLIENT_SERVER:
          DID_EEC4_Charging_Power_Sustain_Relay_CPSR_Voltage_DID_EEC4_Charging_Power_Sustain_RelayCPSR_Voltage: DcmDspDataType=UINT8, DcmDspDataInfoRef=DataInfo_DID_EEC4_Charging_Power_Sustain_Relay_CPSR_Voltage_DID_EEC4_Charging_Power_Sustain_RelayCPSR_Voltage
          DID_D005_High_Quiescent_Current_Fault_Identification_Data_D005_1st_Functionality_Activity_Level_PNC24: DcmDspDataType=UINT8, DcmDspDataInfoRef=DataInfo_DID_D005_High_Quiescent_Current_Fault_Identification_Data_D005_1st_Functionality_Activity_Level_PNC24
          DID_F126_Autosar_BSW_Cluster_Versions_DID_F126_28_CAN_CLUSTER_SW_PATCH_VERSION: DcmDspDataType=UINT8, DcmDspDataInfoRef=DataInfo_DID_F126_Autosar_BSW_Cluster_Versions_DID_F126_28_CAN_CLUSTER_SW_PATCH_VERSION
          DID_D005_High_Quiescent_Current_Fault_Identification_Data_D005_1st_Functionality_Activity_Level_PNC{25..27}: DcmDspDataType=UINT8, DcmDspDataInfoRef=DataInfo_DID_D005_High_Quiescent_Current_Fault_Identification_Data_D005_1st_Functionality_Activity_Level_PNC{25..27}
          DID_E333_2002_State_2002_Lw: DcmDspDataType=UINT8_N, DcmDspDataInfoRef=DataInfo_DID_E333_2002_State_2002_Lw
        DataInfo_DID_E314_Available_Torque_maximum_DID_E314_Available_Torque_maximum (DcmDspDataInfo): DcmDspDataFixedLength=true
        DID_E333_2002_State_2002_Lv (DcmDspData): DcmDspDataSize=8, DcmDspDataType=UINT8_N, DcmDspDataUsePort=USE_DATA_ASYNCH_CLIENT_SERVER, DcmDspDataInfoRef=DataInfo_DID_E333_2002_State_2002_Lv
        DID_D211_Network_Management_History_Propulsion_CAN_DID_D211_19_10th_Latest_State_NM_History (DcmDspData):
          DcmDspDataSize = 8
          DcmDspDataType = UINT8
          DcmDspDataUsePort = USE_DATA_ASYNCH_CLIENT_SERVER
          DcmDspDataInfoRef = DataInfo_DID_D211_Network_Management_History_Propulsion_CAN_DID_D211_19_10th_Latest_State_NM_History
        DidInfo_DID_F12B_ECU_Delivery_Assembly_Part_Number (DcmDspDidInfo)
          DcmDspDidAccess
            DcmDspDidRead: DcmDspDidReadSessionRef=defaultSession, DcmDspDidReadSessionRef=extendedDiagnosticSession
        DataInfo_DID_D005_High_Quiescent_Current_Fault_Identification_Data_Reserved_PNC_1st (DcmDspDataInfo): DcmDspDataFixedLength=true
        DID_D005_High_Quiescent_Current_Fault_Identification_Data_D005_1st_Functionality_Activity_Level_PNC29 (DcmDspData):
          DcmDspDataSize = 8
          DcmDspDataType = UINT8
          DcmDspDataUsePort = USE_DATA_ASYNCH_CLIENT_SERVER
          DcmDspDataInfoRef = DataInfo_DID_D005_High_Quiescent_Current_Fault_Identification_Data_D005_1st_Functionality_Activity_Level_PNC29
        DataInfo_DID_F126_Autosar_BSW_Cluster_Versions_DID_F126_45_LIN_CLUSTER_AR_RELEASE_REVISION_VERSION (DcmDspDataInfo): DcmDspDataFixedLength=true
        DataInfo_DID_E347_IGBT_Max_Temperature_DID_E347_IGBT_Max_Temperature (DcmDspDataInfo): DcmDspDataFixedLength=true
        DID_E103_Car_Configuration_Parameter_Faults_DID_E103_14_7th_parameter_number_of_the_car_configuration_data_that_is_invalid (DcmDspData):
          DcmDspDataSize = 16
          DcmDspDataType = UINT16
          DcmDspDataUsePort = USE_DATA_ASYNCH_CLIENT_SERVER
          DcmDspDataInfoRef = DataInfo_DID_E103_Car_Configuration_Parameter_Faults_DID_E103_14_7th_parameter_number_of_the_car_configuration_data_thatd7b4e1f3
        DataInfo_DID_E103_Car_Configuration_Parameter_Faults_DID_E103_10_5th_parameter_number_of_the_car_configuration_data_thatbe0dd04 (DcmDspDataInfo): DcmDspDataFixedLength=true
        DID_EEB7_ECM_Power_Limitation_minimum_DID_EEB7_ECM_Power_Limitation_minimum (DcmDspData):
          DcmDspDataSize = 16
          DcmDspDataType = UINT16
          DcmDspDataUsePort = USE_DATA_ASYNCH_CLIENT_SERVER
          DcmDspDataInfoRef = DataInfo_DID_EEB7_ECM_Power_Limitation_minimum_DID_EEB7_ECM_Power_Limitation_minimum
        DID_E333_2002_State_2002_Lu (DcmDspData): DcmDspDataSize=8, DcmDspDataType=UINT8_N, DcmDspDataUsePort=USE_DATA_ASYNCH_CLIENT_SERVER, DcmDspDataInfoRef=DataInfo_DID_E333_2002_State_2002_Lu
        DidInfo_DID_D003_Vehicle_Speed (DcmDspDidInfo)
          DcmDspDidAccess
            DcmDspDidRead: DcmDspDidReadSessionRef=defaultSession, DcmDspDidReadSessionRef=extendedDiagnosticSession
        DataInfo_DID_E320_System_Mode_Mismatch_DID_E320_System_Mode_Mismatch (DcmDspDataInfo): DcmDspDataFixedLength=true
        3 x DcmDspData, all with DcmDspDataSize=24, DcmDspDataType=UINT8_N, DcmDspDataUsePort=USE_DATA_ASYNCH_CLIENT_SERVER:
          DID_F12F_ECU_Software_Extended_Part_Numbers_ASCII_part_003: DcmDspDataInfoRef=DataInfo_DID_F12F_ECU_Software_Extended_Part_Numbers_ASCII_part_003
          DID_F12F_ECU_Software_Extended_Part_Numbers_ASCII_part_002: DcmDspDataInfoRef=DataInfo_DID_F12F_ECU_Software_Extended_Part_Numbers_ASCII_part_002
          DID_F12F_ECU_Software_Extended_Part_Numbers_ASCII_part_005: DcmDspDataInfoRef=DataInfo_DID_F12F_ECU_Software_Extended_Part_Numbers_ASCII_part_005
        DataInfo_DID_F126_Autosar_BSW_Cluster_Versions_DID_F126_12_MODEMGMT_CLUSTER_SW_MAJOR_VERSION (DcmDspDataInfo): DcmDspDataFixedLength=true
        DID_F12F_ECU_Software_Extended_Part_Numbers_ASCII_part_004 (DcmDspData):
          DcmDspDataSize = 24
          DcmDspDataType = UINT8_N
          DcmDspDataUsePort = USE_DATA_ASYNCH_CLIENT_SERVER
          DcmDspDataInfoRef = DataInfo_DID_F12F_ECU_Software_Extended_Part_Numbers_ASCII_part_004
        DID_EED1_Safty_monitor_Fault_Indication (DcmDspDid):
          DcmDspDidIdentifier = 61137
          DcmDspDidUsed = true
          DcmDspDidUsePort = USE_DATA_ELEMENT_SPECIFIC_INTERFACES
          DcmDspDidInfoRef = DidInfo_DID_EED1_Safty_monitor_Fault_Indication
          4 x DcmDspDidSignal:
            EED1_1: DcmDspDidDataPos=8, DcmDspDidDataRef=DID_EED1_Safty_monitor_Fault_Indication_EED1_1
            EED1_2: DcmDspDidDataPos=16, DcmDspDidDataRef=DID_EED1_Safty_monitor_Fault_Indication_EED1_2
            EED1_3: DcmDspDidDataPos=24, DcmDspDidDataRef=DID_EED1_Safty_monitor_Fault_Indication_EED1_3
            EED1_0: DcmDspDidDataPos=0, DcmDspDidDataRef=DID_EED1_Safty_monitor_Fault_Indication_EED1_0
        DataInfo_DID_F1A0_Application_Diagnostic_Database_Part_Number_Geely_ASCII_part (DcmDspDataInfo): DcmDspDataFixedLength=true
        DID_F12F_ECU_Software_Extended_Part_Numbers_ASCII_part_001 (DcmDspData):
          DcmDspDataSize = 24
          DcmDspDataType = UINT8_N
          DcmDspDataUsePort = USE_DATA_ASYNCH_CLIENT_SERVER
          DcmDspDataInfoRef = DataInfo_DID_F12F_ECU_Software_Extended_Part_Numbers_ASCII_part_001
        DID_F12A_ECU_Core_Assembly_Part_Number_ASCII_part (DcmDspData):
          DcmDspDataSize = 24
          DcmDspDataType = UINT8_N
          DcmDspDataUsePort = USE_DATA_ASYNCH_CLIENT_SERVER
          DcmDspDataInfoRef = DataInfo_DID_F12A_ECU_Core_Assembly_Part_Number_ASCII_part
        5 x DcmDspDataInfo, all with DcmDspDataFixedLength=true:
          DataInfo_DID_EDA0_Complete_ECU_Part_Serial_Number_s_Reserved
          DataInfo_DID_F126_Autosar_BSW_Cluster_Versions_DID_F126_43_LIN_CLUSTER_AR_RELEASE_MAJOR_VERSION
          DataInfo_DID_F1AB_ECU_Delivery_Assembly_Part_Number_Geely_BCD_part
          DataInfo_DID_F1A5_Primary_Bootloader_Software_Part_Number_Geely_BCD_part
          DataInfo_DID_F126_Autosar_BSW_Cluster_Versions_DID_F126_40_LIN_CLUSTER_SW_MAJOR_VERSION
        DID_F126_Autosar_BSW_Cluster_Versions_DID_F126_4_DIAG_CLUSTER_SW_PATCH_VERSION (DcmDspData):
          DcmDspDataSize = 8
          DcmDspDataType = UINT8
          DcmDspDataUsePort = USE_DATA_ASYNCH_CLIENT_SERVER
          DcmDspDataInfoRef = DataInfo_DID_F126_Autosar_BSW_Cluster_Versions_DID_F126_4_DIAG_CLUSTER_SW_PATCH_VERSION
        DID_D005_High_Quiescent_Current_Fault_Identification_Data_Functionality_Activity_Level_Detect_Motor_Speed_Abnormal_1st (DcmDspData):
          DcmDspDataSize = 8
          DcmDspDataType = UINT8
          DcmDspDataUsePort = USE_DATA_ASYNCH_CLIENT_SERVER
          DcmDspDataInfoRef = DataInfo_DID_D005_High_Quiescent_Current_Fault_Identification_Data_Functionality_Activity_Level_Detect_Motor_Speed_Abnormal_1st
        DID_EEB7_ECM_Power_Limitation_minimum (DcmDspDid):
          DcmDspDidIdentifier = 61111
          DcmDspDidUsed = true
          DcmDspDidUsePort = USE_DATA_ELEMENT_SPECIFIC_INTERFACES
          DcmDspDidInfoRef = DidInfo_DID_EEB7_ECM_Power_Limitation_minimum
          DID_EEB7_ECM_Power_Limitation_minimum (DcmDspDidSignal): DcmDspDidDataPos=0, DcmDspDidDataRef=DID_EEB7_ECM_Power_Limitation_minimum_DID_EEB7_ECM_Power_Limitation_minimum
        DataInfo_DID_D005_High_Quiescent_Current_Fault_Identification_Data_Functionality_Activity_Level_Detect_CPSR_Keep_Active_4st (DcmDspDataInfo): DcmDspDataFixedLength=true
        DataInfo_DID_F12E_ECU_Software_Part_Numbers_BCD_part (DcmDspDataInfo): DcmDspDataFixedLength=true
        DID_D005_High_Quiescent_Current_Fault_Identification_Data_DID_D005_2st_Global_time_when_Functionality_Activity_level_Sleb7289ace (DcmDspData):
          DcmDspDataSize = 32
          DcmDspDataType = UINT32
          DcmDspDataUsePort = USE_DATA_ASYNCH_CLIENT_SERVER
          DcmDspDataInfoRef = DataInfo_DID_D005_High_Quiescent_Current_Fault_Identification_Data_DID_D005_2st_Global_time_when_Functionality_Activity_c77cfb46
        DataInfo_DID_E103_Car_Configuration_Parameter_Faults_DID_E103_21_10th_parameter_invalid_value (DcmDspDataInfo): DcmDspDataFixedLength=true
        DID_F12E_ECU_Software_Part_Numbers (DcmDspDid):
          DcmDspDidIdentifier = 61742
          DcmDspDidUsed = true
          DcmDspDidUsePort = USE_DATA_ELEMENT_SPECIFIC_INTERFACES
          DcmDspDidInfoRef = DidInfo_DID_F12E_ECU_Software_Part_Numbers
          3 x DcmDspDidSignal:
            ASCII_part: DcmDspDidDataPos=40, DcmDspDidDataRef=DID_F12E_ECU_Software_Part_Numbers_ASCII_part
            DID_F12E_1_ECU_Software: DcmDspDidDataPos=0, DcmDspDidDataRef=DID_F12E_ECU_Software_Part_Numbers_DID_F12E_1_ECU_Software
            BCD_part: DcmDspDidDataPos=8, DcmDspDidDataRef=DID_F12E_ECU_Software_Part_Numbers_BCD_part
        DID_F1AE_ECU_Software_Part_Numbers_Geely_ASCII_part (DcmDspData):
          DcmDspDataSize = 24
          DcmDspDataType = UINT8_N
          DcmDspDataUsePort = USE_DATA_ASYNCH_CLIENT_SERVER
          DcmDspDataInfoRef = DataInfo_DID_F1AE_ECU_Software_Part_Numbers_Geely_ASCII_part
        DID_E103_Car_Configuration_Parameter_Faults_DID_E103_19_9th_parameter_invalid_value (DcmDspData):
          DcmDspDataSize = 8
          DcmDspDataType = UINT8
          DcmDspDataUsePort = USE_DATA_ASYNCH_CLIENT_SERVER
          DcmDspDataInfoRef = DataInfo_DID_E103_Car_Configuration_Parameter_Faults_DID_E103_19_9th_parameter_invalid_value
        DidInfo_DID_E349_Phase_V_PWM_duty (DcmDspDidInfo)
          DcmDspDidAccess
            DcmDspDidRead: DcmDspDidReadSessionRef=defaultSession, DcmDspDidReadSessionRef=extendedDiagnosticSession
        DataInfo_DID_EDA0_Complete_ECU_Part_Serial_Number_s_DID_F12E_1_Total_number_of_ECU_Software_Part_Numbers (DcmDspDataInfo): DcmDspDataFixedLength=true
        DID_D211_Network_Management_History_Propulsion_CAN_DID_D211_13_7th_Latest_State_NM_History (DcmDspData):
          DcmDspDataSize = 8
          DcmDspDataType = UINT8
          DcmDspDataUsePort = USE_DATA_ASYNCH_CLIENT_SERVER
          DcmDspDataInfoRef = DataInfo_DID_D211_Network_Management_History_Propulsion_CAN_DID_D211_13_7th_Latest_State_NM_History
        DID_E341_q_axis_voltage_DID_E341_q_axis_voltage (DcmDspData):
          DcmDspDataSize = 16
          DcmDspDataType = UINT16
          DcmDspDataUsePort = USE_DATA_ASYNCH_CLIENT_SERVER
          DcmDspDataInfoRef = DataInfo_DID_E341_q_axis_voltage_DID_E341_q_axis_voltage
        DataInfo_DID_D005_High_Quiescent_Current_Fault_Identification_Data_DID_D005_4st_Global_time_when_Functionality_Activity_a8781345 (DcmDspDataInfo): DcmDspDataFixedLength=true
        3 x DcmDspData, all with DcmDspDataSize=24, DcmDspDataType=UINT8_N, DcmDspDataUsePort=USE_DATA_ASYNCH_CLIENT_SERVER:
          DID_F12F_ECU_Software_Extended_Part_Numbers_ASCII_part_007: DcmDspDataInfoRef=DataInfo_DID_F12F_ECU_Software_Extended_Part_Numbers_ASCII_part_007
          DID_F12F_ECU_Software_Extended_Part_Numbers_ASCII_part_006: DcmDspDataInfoRef=DataInfo_DID_F12F_ECU_Software_Extended_Part_Numbers_ASCII_part_006
          DID_F12F_ECU_Software_Extended_Part_Numbers_ASCII_part_009: DcmDspDataInfoRef=DataInfo_DID_F12F_ECU_Software_Extended_Part_Numbers_ASCII_part_009
        DataInfo_DID_D211_Network_Management_History_Propulsion_CAN_DID_D211_1_Latest_State_NM_History (DcmDspDataInfo): DcmDspDataFixedLength=true
        DID_F12F_ECU_Software_Extended_Part_Numbers_ASCII_part_008 (DcmDspData):
          DcmDspDataSize = 24
          DcmDspDataType = UINT8_N
          DcmDspDataUsePort = USE_DATA_ASYNCH_CLIENT_SERVER
          DcmDspDataInfoRef = DataInfo_DID_F12F_ECU_Software_Extended_Part_Numbers_ASCII_part_008
        Starter_Generator_Position_Sensors_Calibration (DcmDspRoutine):
          DcmDspRequestResultsRoutineSupported = true
          DcmDspStopRoutineSupported = true
          DcmDspRoutineIdentifier = 16385
          DcmDspRoutineFixedLength = false
          DcmDspRoutineUsePort = true
          DcmDspRoutineUsed = true
          DcmDspRoutineInfoRef = RoutineInfo_Starter_Generator_Position_Sensors_Calibration
        DataInfo_DID_F12B_ECU_Delivery_Assembly_Part_Number_ASCII_part (DcmDspDataInfo): DcmDspDataFixedLength=true
        DID_F1AE_ECU_Software_Part_Numbers_Geely (DcmDspDid):
          DcmDspDidIdentifier = 61870
          DcmDspDidUsed = true
          DcmDspDidUsePort = USE_DATA_ELEMENT_SPECIFIC_INTERFACES
          DcmDspDidInfoRef = DidInfo_DID_F1AE_ECU_Software_Part_Numbers_Geely
          3 x DcmDspDidSignal:
            DID_F1AE_1_Total_number_of_ECU_Software_Part_Numbers: DcmDspDidDataPos=0, DcmDspDidDataRef=DID_F1AE_ECU_Software_Part_Numbers_Geely_DID_F1AE_1_Total_number_of_ECU_Software_Part_Numbers
            ASCII_part: DcmDspDidDataPos=48, DcmDspDidDataRef=DID_F1AE_ECU_Software_Part_Numbers_Geely_ASCII_part
            BCD_part: DcmDspDidDataPos=8, DcmDspDidDataRef=DID_F1AE_ECU_Software_Part_Numbers_Geely_BCD_part
        DataInfo_DID_F1A1_Primary_Bootloader_Diagnostic_Database_Part_Number_Geely_ASCII_part (DcmDspDataInfo): DcmDspDataFixedLength=true
        DataInfo_DID_E103_Car_Configuration_Parameter_Faults_DID_E103_16_8th_parameter_number_of_the_car_configuration_data_that19fcf690 (DcmDspDataInfo): DcmDspDataFixedLength=true
        DidInfo_DID_D211_Network_Management_History_Propulsion_CAN (DcmDspDidInfo)
          DcmDspDidAccess
            DcmDspDidRead: DcmDspDidReadSessionRef=defaultSession, DcmDspDidReadSessionRef=extendedDiagnosticSession
        DID_D005_High_Quiescent_Current_Fault_Identification_Data_Functionality_Activity_Level_Detect_DC_Bus_voltage_Abnormal_5st (DcmDspData):
          DcmDspDataSize = 8
          DcmDspDataType = UINT8
          DcmDspDataUsePort = USE_DATA_ASYNCH_CLIENT_SERVER
          DcmDspDataInfoRef = DataInfo_DID_D005_High_Quiescent_Current_Fault_Identification_Data_Functionality_Activity_Level_Detect_DC_Bus_voltage_Ab8e570b1e
        DataInfo_DID_F126_Autosar_BSW_Cluster_Versions_DID_F126_44_LIN_CLUSTER_AR_RELEASE_MINOR_VERSION (DcmDspDataInfo): DcmDspDataFixedLength=true
        DataInfo_DID_D005_High_Quiescent_Current_Fault_Identification_Data_DID_D005_5st_System_Global_Time_the_time_when_the_DIDba8286b (DcmDspDataInfo): DcmDspDataFixedLength=true
        DID_F125_Primary_Bootloader_Software_Part_Number (DcmDspDid):
          DcmDspDidIdentifier = 61733
          DcmDspDidUsed = true
          DcmDspDidUsePort = USE_DATA_ELEMENT_SPECIFIC_INTERFACES
          DcmDspDidInfoRef = DidInfo_DID_F125_Primary_Bootloader_Software_Part_Number
          ASCII_part (DcmDspDidSignal): DcmDspDidDataPos=32, DcmDspDidDataRef=DID_F125_Primary_Bootloader_Software_Part_Number_ASCII_part
          BCD_part (DcmDspDidSignal): DcmDspDidDataPos=0, DcmDspDidDataRef=DID_F125_Primary_Bootloader_Software_Part_Number_BCD_part
        DID_ED20_Complete_set_of_ECU_part_serial_numbers_Geely_ASCII_part_001 (DcmDspData):
          DcmDspDataSize = 24
          DcmDspDataType = UINT8_N
          DcmDspDataUsePort = USE_DATA_ASYNCH_CLIENT_SERVER
          DcmDspDataInfoRef = DataInfo_DID_ED20_Complete_set_of_ECU_part_serial_numbers_Geely_ASCII_part_001
        DataInfo_DID_E103_Car_Configuration_Parameter_Faults_DID_E103_13_6th_parameter_invalid_value (DcmDspDataInfo): DcmDspDataFixedLength=true
        4 x DcmDspData, all with DcmDspDataUsePort=USE_DATA_ASYNCH_CLIENT_SERVER:
          DID_F126_Autosar_BSW_Cluster_Versions_DID_F126_14_MODEMGMT_CLUSTER_SW_PATCH_VERSION: DcmDspDataSize=8, DcmDspDataType=UINT8, DcmDspDataInfoRef=DataInfo_DID_F126_Autosar_BSW_Cluster_Versions_DID_F126_14_MODEMGMT_CLUSTER_SW_PATCH_VERSION
          DID_ED20_Complete_set_of_ECU_part_serial_numbers_Geely_ASCII_part_002: DcmDspDataSize=24, DcmDspDataType=UINT8_N, DcmDspDataInfoRef=DataInfo_DID_ED20_Complete_set_of_ECU_part_serial_numbers_Geely_ASCII_part_002
          DID_ED20_Complete_set_of_ECU_part_serial_numbers_Geely_ASCII_part_003: DcmDspDataSize=24, DcmDspDataType=UINT8_N, DcmDspDataInfoRef=DataInfo_DID_ED20_Complete_set_of_ECU_part_serial_numbers_Geely_ASCII_part_003
          DID_E103_Car_Configuration_Parameter_Faults_DID_E103_2_1st_parameter_number_of_the_car_configuration_data_that_is_invalid: DcmDspDataSize=16, DcmDspDataType=UINT16, DcmDspDataInfoRef=DataInfo_DID_E103_Car_Configuration_Parameter_Faults_DID_E103_2_1st_parameter_number_of_the_car_configuration_data_that_d6896c26
        DID_EEFD_Sofware_Project_Version (DcmDspDid):
          DcmDspDidIdentifier = 61181
          DcmDspDidUsed = true
          DcmDspDidUsePort = USE_DATA_ELEMENT_SPECIFIC_INTERFACES
          DcmDspDidInfoRef = DidInfo_DID_EEFD_Sofware_Project_Version
          DID_EEFD_Clutch_Control_Fault_Indication (DcmDspDidSignal): DcmDspDidDataPos=0, DcmDspDidDataRef=DID_EEFD_Sofware_Project_Version_DID_EEFD_Clutch_Control_Fault_Indication
        3 x DcmDspDataInfo, all with DcmDspDataFixedLength=true:
          DataInfo_DID_E313_Active_discharge_status_DID_E313_Active_discharge_status
          DataInfo_DID_E103_Car_Configuration_Parameter_Faults_DID_E103_19_9th_parameter_invalid_value
          DataInfo_DID_E335_d_axis_current_setpoint_DID_E335_d_axis_current_setpoint
        DID_D005_High_Quiescent_Current_Fault_Identification_Data_Reserved_Data_Field_2st (DcmDspData):
          DcmDspDataSize = 176
          DcmDspDataType = UINT8_N
          DcmDspDataUsePort = USE_DATA_ASYNCH_CLIENT_SERVER
          DcmDspDataInfoRef = DataInfo_DID_D005_High_Quiescent_Current_Fault_Identification_Data_Reserved_Data_Field_2st
        DID_E304_Actual_Torque (DcmDspDid):
          DcmDspDidIdentifier = 58116
          DcmDspDidUsed = true
          DcmDspDidUsePort = USE_DATA_ELEMENT_SPECIFIC_INTERFACES
          DcmDspDidInfoRef = DidInfo_DID_E304_Actual_Torque
          DID_E304_Actual_Torque (DcmDspDidSignal): DcmDspDidDataPos=0, DcmDspDidDataRef=DID_E304_Actual_Torque_DID_E304_Actual_Torque
        DataInfo_DID_F126_Autosar_BSW_Cluster_Versions_DID_F126_25_CAN_CLUSTER_VENDOR_ID (DcmDspDataInfo): DcmDspDataFixedLength=true
        DID_D005_High_Quiescent_Current_Fault_Identification_Data_DID_D005_1st_Usage_Mode_when_DID_is_triggered (DcmDspData):
          DcmDspDataSize = 8
          DcmDspDataType = UINT8
          DcmDspDataUsePort = USE_DATA_ASYNCH_CLIENT_SERVER
          DcmDspDataInfoRef = DataInfo_DID_D005_High_Quiescent_Current_Fault_Identification_Data_DID_D005_1st_Usage_Mode_when_DID_is_triggered
        DidInfo_DID_D03A_swAuth_Public_Key_CheckSum (DcmDspDidInfo)
          DcmDspDidAccess
            DcmDspDidRead: DcmDspDidReadSessionRef=defaultSession, DcmDspDidReadSessionRef=extendedDiagnosticSession
        DID_F126_Autosar_BSW_Cluster_Versions_DID_F126_17_MODEMGMT_CLUSTER_AR_RELEASE_REVISION_VERSION (DcmDspData):
          DcmDspDataSize = 8
          DcmDspDataType = UINT8
          DcmDspDataUsePort = USE_DATA_ASYNCH_CLIENT_SERVER
          DcmDspDataInfoRef = DataInfo_DID_F126_Autosar_BSW_Cluster_Versions_DID_F126_17_MODEMGMT_CLUSTER_AR_RELEASE_REVISION_VERSION
        DataInfo_DID_F126_Autosar_BSW_Cluster_Versions_DID_F126_28_CAN_CLUSTER_SW_PATCH_VERSION (DcmDspDataInfo): DcmDspDataFixedLength=true
        DataInfo_DID_EEFD_Sofware_Project_Version_DID_EEFD_Clutch_Control_Fault_Indication (DcmDspDataInfo): DcmDspDataFixedLength=true
        DID_D005_High_Quiescent_Current_Fault_Identification_Data_DID_D005_5st_Global_time_when_Functionality_Activity_level_Sle91c5dfd2 (DcmDspData):
          DcmDspDataSize = 32
          DcmDspDataType = UINT32
          DcmDspDataUsePort = USE_DATA_ASYNCH_CLIENT_SERVER
          DcmDspDataInfoRef = DataInfo_DID_D005_High_Quiescent_Current_Fault_Identification_Data_DID_D005_5st_Global_time_when_Functionality_Activity_e191be5a
        DataInfo_DID_EED1_Safty_monitor_Fault_Indication_EED1_0 (DcmDspDataInfo): DcmDspDataFixedLength=true
        DID_D134_Car_Mode (DcmDspDid): DcmDspDidIdentifier=53556, DcmDspDidUsed=true, DcmDspDidUsePort=USE_DATA_ELEMENT_SPECIFIC_INTERFACES, DcmDspDidInfoRef=DidInfo_DID_D134_Car_Mode
          DID_D134_Car_Mode (DcmDspDidSignal): DcmDspDidDataPos=0, DcmDspDidDataRef=DID_D134_Car_Mode_DID_D134_Car_Mode
        DataInfo_DID_EED1_Safty_monitor_Fault_Indication_EED1_3 (DcmDspDataInfo): DcmDspDataFixedLength=true
        DID_E335_d_axis_current_setpoint (DcmDspDid):
          DcmDspDidIdentifier = 58165
          DcmDspDidUsed = true
          DcmDspDidUsePort = USE_DATA_ELEMENT_SPECIFIC_INTERFACES
          DcmDspDidInfoRef = DidInfo_DID_E335_d_axis_current_setpoint
          DID_E335_d_axis_current_setpoint (DcmDspDidSignal): DcmDspDidDataPos=0, DcmDspDidDataRef=DID_E335_d_axis_current_setpoint_DID_E335_d_axis_current_setpoint
        DataInfo_DID_EED1_Safty_monitor_Fault_Indication_EED1_2 (DcmDspDataInfo): DcmDspDataFixedLength=true
        DataInfo_DID_EED1_Safty_monitor_Fault_Indication_EED1_1 (DcmDspDataInfo): DcmDspDataFixedLength=true
        DidInfo_DID_E337_q_axis_current_setpoint (DcmDspDidInfo)
          DcmDspDidAccess
            DcmDspDidRead: DcmDspDidReadSessionRef=defaultSession, DcmDspDidReadSessionRef=extendedDiagnosticSession
        DID_F1A0_Application_Diagnostic_Database_Part_Number_Geely_BCD_part (DcmDspData):
          DcmDspDataSize = 40
          DcmDspDataType = UINT8_N
          DcmDspDataUsePort = USE_DATA_ASYNCH_CLIENT_SERVER
          DcmDspDataInfoRef = DataInfo_DID_F1A0_Application_Diagnostic_Database_Part_Number_Geely_BCD_part
        DidInfo_DID_EE9D_Transient_Phase_Current_B (DcmDspDidInfo)
          DcmDspDidAccess
            DcmDspDidRead: DcmDspDidReadSessionRef=defaultSession, DcmDspDidReadSessionRef=extendedDiagnosticSession
        DID_EEB2_Three_Phase_Motor_Current_RMS_Current (DcmDspDid):
          DcmDspDidIdentifier = 61106
          DcmDspDidUsed = true
          DcmDspDidUsePort = USE_DATA_ELEMENT_SPECIFIC_INTERFACES
          DcmDspDidInfoRef = DidInfo_DID_EEB2_Three_Phase_Motor_Current_RMS_Current
          DID_EEB2_Three_Phase_Motor_Current_RMS_Current (DcmDspDidSignal): DcmDspDidDataPos=0, DcmDspDidDataRef=DID_EEB2_Three_Phase_Motor_Current_RMS_Current_DID_EEB2_Three_Phase_Motor_Current_RMS_Current
        DataInfo_DID_DD0C_Electric_Power_Level_DID_DD0C_Electric_Power_Level (DcmDspDataInfo): DcmDspDataFixedLength=true
        DID_E341_q_axis_voltage (DcmDspDid):
          DcmDspDidIdentifier = 58177
          DcmDspDidUsed = true
          DcmDspDidUsePort = USE_DATA_ELEMENT_SPECIFIC_INTERFACES
          DcmDspDidInfoRef = DidInfo_DID_E341_q_axis_voltage
          DID_E341_q_axis_voltage (DcmDspDidSignal): DcmDspDidDataPos=0, DcmDspDidDataRef=DID_E341_q_axis_voltage_DID_E341_q_axis_voltage
        DID_F12F_ECU_Software_Extended_Part_Numbers_ASCII_part (DcmDspData):
          DcmDspDataSize = 24
          DcmDspDataType = UINT8_N
          DcmDspDataUsePort = USE_DATA_ASYNCH_CLIENT_SERVER
          DcmDspDataInfoRef = DataInfo_DID_F12F_ECU_Software_Extended_Part_Numbers_ASCII_part
        3 x DcmDspDataInfo, all with DcmDspDataFixedLength=true:
          DataInfo_DID_EDA0_Complete_ECU_Part_Serial_Number_s_F120_Application_Diagnostic_Database_Part_Number1
          DataInfo_DID_E341_q_axis_voltage_DID_E341_q_axis_voltage
          DataInfo_DID_F126_Autosar_BSW_Cluster_Versions_DID_F126_9_DIAG_CLUSTER_VCC_DCM_VERSION
        DID_EDA0_Complete_ECU_Part_Serial_Number_s_F120_Application_Diagnostic_Database_Part_Number (DcmDspData):
          DcmDspDataSize = 32
          DcmDspDataType = UINT32
          DcmDspDataUsePort = USE_DATA_ASYNCH_CLIENT_SERVER
          DcmDspDataInfoRef = DataInfo_DID_EDA0_Complete_ECU_Part_Serial_Number_s_F120_Application_Diagnostic_Database_Part_Number
        DID_EE9A_Inverter_Coolant_Temperature (DcmDspDid):
          DcmDspDidIdentifier = 61082
          DcmDspDidUsed = true
          DcmDspDidUsePort = USE_DATA_ELEMENT_SPECIFIC_INTERFACES
          DcmDspDidInfoRef = DidInfo_DID_EE9A_Inverter_Coolant_Temperature
          DID_EE9A_Inverter_Coolant_Temperature (DcmDspDidSignal): DcmDspDidDataPos=0, DcmDspDidDataRef=DID_EE9A_Inverter_Coolant_Temperature_DID_EE9A_Inverter_Coolant_Temperature
        4 x DcmDspDataInfo, all with DcmDspDataFixedLength=true:
          DataInfo_DID_F126_Autosar_BSW_Cluster_Versions_DID_F126_41_LIN_CLUSTER_SW_MINOR_VERSION
          DataInfo_DID_F1AA_ECU_Core_Assembly_Part_Number_Geely_BCD_part
          DataInfo_DID_F126_Autosar_BSW_Cluster_Versions_DID_F126_1_DIAG_CLUSTER_VENDOR_ID
          DataInfo_DID_D211_Network_Management_History_Propulsion_CAN_DID_D211_8_4th_Latest_State_Global_Real_Time
        DidInfo_DID_E357_Resolve_compensated_angle (DcmDspDidInfo)
          DcmDspDidAccess
            DcmDspDidRead: DcmDspDidReadSessionRef=defaultSession, DcmDspDidReadSessionRef=extendedDiagnosticSession
        DID_EEB6_ECM_Power_Limitation_maximum (DcmDspDid):
          DcmDspDidIdentifier = 61110
          DcmDspDidUsed = true
          DcmDspDidUsePort = USE_DATA_ELEMENT_SPECIFIC_INTERFACES
          DcmDspDidInfoRef = DidInfo_DID_EEB6_ECM_Power_Limitation_maximum
          DID_EEB6_ECM_Power_Limitation_maximum (DcmDspDidSignal): DcmDspDidDataPos=0, DcmDspDidDataRef=DID_EEB6_ECM_Power_Limitation_maximum_DID_EEB6_ECM_Power_Limitation_maximum
        DataInfo_DID_F126_Autosar_BSW_Cluster_Versions_DID_F126_17_MODEMGMT_CLUSTER_AR_RELEASE_REVISION_VERSION (DcmDspDataInfo): DcmDspDataFixedLength=true
        DID_F1AF_ECU_Software_Extended_Part_Numbers_Geely (DcmDspDid):
          DcmDspDidIdentifier = 61871
          DcmDspDidUsed = true
          DcmDspDidUsePort = USE_DATA_ELEMENT_SPECIFIC_INTERFACES
          DcmDspDidInfoRef = DidInfo_DID_F1AF_ECU_Software_Extended_Part_Numbers_Geely
          9 x DcmDspDidSignal:
            DID_F1AF_1_Total_number_of_ECU_Software_Part_Numbers: DcmDspDidDataPos=0, DcmDspDidDataRef=DID_F1AF_ECU_Software_Extended_Part_Numbers_Geely_DID_F1AF_1_Total_number_of_ECU_Software_Part_Numbers
            BCD_part_003: DcmDspDidDataPos=200, DcmDspDidDataRef=DID_F1AF_ECU_Software_Extended_Part_Numbers_Geely_BCD_part_003
            BCD_part_001: DcmDspDidDataPos=72, DcmDspDidDataRef=DID_F1AF_ECU_Software_Extended_Part_Numbers_Geely_BCD_part_001
            BCD_part_002: DcmDspDidDataPos=136, DcmDspDidDataRef=DID_F1AF_ECU_Software_Extended_Part_Numbers_Geely_BCD_part_002
            ASCII_part_001: DcmDspDidDataPos=112, DcmDspDidDataRef=DID_F1AF_ECU_Software_Extended_Part_Numbers_Geely_ASCII_part_001
            ASCII_part_002: DcmDspDidDataPos=176, DcmDspDidDataRef=DID_F1AF_ECU_Software_Extended_Part_Numbers_Geely_ASCII_part_002
            ASCII_part_003: DcmDspDidDataPos=240, DcmDspDidDataRef=DID_F1AF_ECU_Software_Extended_Part_Numbers_Geely_ASCII_part_003
            ASCII_part: DcmDspDidDataPos=48, DcmDspDidDataRef=DID_F1AF_ECU_Software_Extended_Part_Numbers_Geely_ASCII_part
            BCD_part: DcmDspDidDataPos=8, DcmDspDidDataRef=DID_F1AF_ECU_Software_Extended_Part_Numbers_Geely_BCD_part
        DidInfo_DID_E307_System_Mode (DcmDspDidInfo)
          DcmDspDidAccess
            DcmDspDidRead: DcmDspDidReadSessionRef=defaultSession, DcmDspDidReadSessionRef=extendedDiagnosticSession
        4 x DcmDspDataInfo, all with DcmDspDataFixedLength=true:
          DataInfo_DID_F126_Autosar_BSW_Cluster_Versions_DID_F126_31_CAN_CLUSTER_AR_RELEASE_REVISION_VERSION
          DataInfo_DID_E331_Software_Version_DID_E331_2_BSW_Software_Version
          DataInfo_DID_D005_High_Quiescent_Current_Fault_Identification_Data_DID_D005_1st_Usage_Mode_when_DID_is_triggered
          DataInfo_DID_D211_Network_Management_History_Propulsion_CAN_DID_D211_17_9th_Latest_State_NM_History
        DID_E331_Software_Version (DcmDspDid):
          DcmDspDidIdentifier = 58161
          DcmDspDidUsed = true
          DcmDspDidUsePort = USE_DATA_ELEMENT_SPECIFIC_INTERFACES
          DcmDspDidInfoRef = DidInfo_DID_E331_Software_Version
          3 x DcmDspDidSignal:
            DID_E331_2_BSW_Software_Version: DcmDspDidDataPos=64, DcmDspDidDataRef=DID_E331_Software_Version_DID_E331_2_BSW_Software_Version
            DID_E331_3_Calibration_Data_Software_Version: DcmDspDidDataPos=128, DcmDspDidDataRef=DID_E331_Software_Version_DID_E331_3_Calibration_Data_Software_Version
            DID_E331_1_ASW_Software_Version: DcmDspDidDataPos=0, DcmDspDidDataRef=DID_E331_Software_Version_DID_E331_1_ASW_Software_Version
        DID_F126_Autosar_BSW_Cluster_Versions_DID_F126_24_COM_CLUSTER_AR_RELEASE_REVISION_VERSION (DcmDspData):
          DcmDspDataSize = 8
          DcmDspDataType = UINT8
          DcmDspDataUsePort = USE_DATA_ASYNCH_CLIENT_SERVER
          DcmDspDataInfoRef = DataInfo_DID_F126_Autosar_BSW_Cluster_Versions_DID_F126_24_COM_CLUSTER_AR_RELEASE_REVISION_VERSION
        DataInfo_DID_EDA0_Complete_ECU_Part_Serial_Number_s_DID_F12B_ECU_Delivery_Assembly_Part_Number (DcmDspDataInfo): DcmDspDataFixedLength=true
        8 x DcmDspData, all with DcmDspDataUsePort=USE_DATA_ASYNCH_CLIENT_SERVER:
          DID_EED4_Safty_Function_Mode_DID_EED4_Safty_Function_Mode: DcmDspDataSize=8, DcmDspDataType=UINT8_N, DcmDspDataInfoRef=DataInfo_DID_EED4_Safty_Function_Mode_DID_EED4_Safty_Function_Mode
          DID_F12F_ECU_Software_Extended_Part_Numbers_BCD_part_005: DcmDspDataSize=32, DcmDspDataType=UINT32, DcmDspDataInfoRef=DataInfo_DID_F12F_ECU_Software_Extended_Part_Numbers_BCD_part_005
          DID_F12F_ECU_Software_Extended_Part_Numbers_BCD_part_004: DcmDspDataSize=32, DcmDspDataType=UINT32, DcmDspDataInfoRef=DataInfo_DID_F12F_ECU_Software_Extended_Part_Numbers_BCD_part_004
          DID_F12F_ECU_Software_Extended_Part_Numbers_BCD_part_007: DcmDspDataSize=32, DcmDspDataType=UINT32, DcmDspDataInfoRef=DataInfo_DID_F12F_ECU_Software_Extended_Part_Numbers_BCD_part_007
          DID_F12F_ECU_Software_Extended_Part_Numbers_BCD_part_006: DcmDspDataSize=32, DcmDspDataType=UINT32, DcmDspDataInfoRef=DataInfo_DID_F12F_ECU_Software_Extended_Part_Numbers_BCD_part_006
          DID_F12F_ECU_Software_Extended_Part_Numbers_BCD_part_001: DcmDspDataSize=32, DcmDspDataType=UINT32, DcmDspDataInfoRef=DataInfo_DID_F12F_ECU_Software_Extended_Part_Numbers_BCD_part_001
          DID_F12F_ECU_Software_Extended_Part_Numbers_BCD_part_003: DcmDspDataSize=32, DcmDspDataType=UINT32, DcmDspDataInfoRef=DataInfo_DID_F12F_ECU_Software_Extended_Part_Numbers_BCD_part_003
          DID_F12F_ECU_Software_Extended_Part_Numbers_BCD_part_002: DcmDspDataSize=32, DcmDspDataType=UINT32, DcmDspDataInfoRef=DataInfo_DID_F12F_ECU_Software_Extended_Part_Numbers_BCD_part_002
        DataInfo_DID_D005_High_Quiescent_Current_Fault_Identification_Data_DID_D005_5st_Global_time_when_Functionality_Activity_e191be5a (DcmDspDataInfo): DcmDspDataFixedLength=true
        5 x DcmDspData, all with DcmDspDataUsePort=USE_DATA_ASYNCH_CLIENT_SERVER:
          DID_E103_Car_Configuration_Parameter_Faults_DID_E103_21_10th_parameter_invalid_value: DcmDspDataSize=8, DcmDspDataType=UINT8, DcmDspDataInfoRef=DataInfo_DID_E103_Car_Configuration_Parameter_Faults_DID_E103_21_10th_parameter_invalid_value
          DID_D005_High_Quiescent_Current_Fault_Identification_Data_DID_D005_2st_System_Global_Time_the_time_when_the_DID_is_triggered: DcmDspDataSize=32, DcmDspDataType=UINT32, DcmDspDataInfoRef=DataInfo_DID_D005_High_Quiescent_Current_Fault_Identification_Data_DID_D005_2st_System_Global_Time_the_time_when_the_DID40fc1757
          DID_F12F_ECU_Software_Extended_Part_Numbers_BCD_part_009: DcmDspDataSize=32, DcmDspDataType=UINT32, DcmDspDataInfoRef=DataInfo_DID_F12F_ECU_Software_Extended_Part_Numbers_BCD_part_009
          DID_F12F_ECU_Software_Extended_Part_Numbers_BCD_part_008: DcmDspDataSize=32, DcmDspDataType=UINT32, DcmDspDataInfoRef=DataInfo_DID_F12F_ECU_Software_Extended_Part_Numbers_BCD_part_008
          DID_D005_High_Quiescent_Current_Fault_Identification_Data_Reserved_Data_Field_4st: DcmDspDataSize=176, DcmDspDataType=UINT8_N, DcmDspDataInfoRef=DataInfo_DID_D005_High_Quiescent_Current_Fault_Identification_Data_Reserved_Data_Field_4st
        DcmDspSession
          3 x DcmDspSessionRow, all with DcmDspSessionP2ServerMax=0.05, DcmDspSessionP2StarServerMax=5, DcmDspSessionForBoot=DCM_NO_BOOT:
            extendedDiagnosticSession: DcmDspSessionLevel=3
            defaultSession: DcmDspSessionLevel=1
            programmingSession: DcmDspSessionLevel=2
        DataInfo_DID_E103_Car_Configuration_Parameter_Faults_DID_E103_9_4th_parameter_invalid_value (DcmDspDataInfo): DcmDspDataFixedLength=true
        DataInfo_DID_D005_High_Quiescent_Current_Fault_Identification_Data_Functionality_Activity_Level_Detect_Motor_Speed_Abnormal_1st (DcmDspDataInfo): DcmDspDataFixedLength=true
        DID_E312_Wheel_Speed_DID_E312_Wheel_Speed (DcmDspData):
          DcmDspDataSize = 16
          DcmDspDataType = UINT16
          DcmDspDataUsePort = USE_DATA_ASYNCH_CLIENT_SERVER
          DcmDspDataInfoRef = DataInfo_DID_E312_Wheel_Speed_DID_E312_Wheel_Speed
        DID_EEBE_Offset_angle_status_DID_EEBE_Offset_angle_status (DcmDspData):
          DcmDspDataSize = 8
          DcmDspDataType = UINT8
          DcmDspDataUsePort = USE_DATA_ASYNCH_CLIENT_SERVER
          DcmDspDataInfoRef = DataInfo_DID_EEBE_Offset_angle_status_DID_EEBE_Offset_angle_status
        DID_EE9E_Transient_Phase_Current_C (DcmDspDid):
          DcmDspDidIdentifier = 61086
          DcmDspDidUsed = true
          DcmDspDidUsePort = USE_DATA_ELEMENT_SPECIFIC_INTERFACES
          DcmDspDidInfoRef = DidInfo_DID_EE9E_Transient_Phase_Current_C
          DID_EE9E_Transient_Phase_Current_C (DcmDspDidSignal): DcmDspDidDataPos=0, DcmDspDidDataRef=DID_EE9E_Transient_Phase_Current_C_DID_EE9E_Transient_Phase_Current_C
        DataInfo_DID_40E0_Secret_Key_Immobilizer_Target_3_DID_40DF_Secret_Key_Immobilizer_Target_2 (DcmDspDataInfo): DcmDspDataFixedLength=true
        DidInfo_DID_DD00_Global_Real_Time (DcmDspDidInfo)
          DcmDspDidAccess
            DcmDspDidRead: DcmDspDidReadSessionRef=defaultSession, DcmDspDidReadSessionRef=extendedDiagnosticSession
        Check_programming_pre_conditions (DcmDspRoutine):
          DcmDspRequestResultsRoutineSupported = false
          DcmDspStopRoutineSupported = false
          DcmDspRoutineIdentifier = 518
          DcmDspRoutineFixedLength = false
          DcmDspRoutineUsePort = true
          DcmDspRoutineUsed = true
          DcmDspRoutineInfoRef = RoutineInfo_Check_programming_pre_conditions
        DID_F126_Autosar_BSW_Cluster_Versions_DID_F126_30_CAN_CLUSTER_AR_RELEASE_MINOR_VERSION (DcmDspData):
          DcmDspDataSize = 8
          DcmDspDataType = UINT8
          DcmDspDataUsePort = USE_DATA_ASYNCH_CLIENT_SERVER
          DcmDspDataInfoRef = DataInfo_DID_F126_Autosar_BSW_Cluster_Versions_DID_F126_30_CAN_CLUSTER_AR_RELEASE_MINOR_VERSION
        DID_F1AF_ECU_Software_Extended_Part_Numbers_Geely_BCD_part_001 (DcmDspData):
          DcmDspDataSize = 40
          DcmDspDataType = UINT8_N
          DcmDspDataUsePort = USE_DATA_ASYNCH_CLIENT_SERVER
          DcmDspDataInfoRef = DataInfo_DID_F1AF_ECU_Software_Extended_Part_Numbers_Geely_BCD_part_001
        DataInfo_DID_E309_ECM_Mode_Request_DID_E309_ECM_Mode_Request (DcmDspDataInfo): DcmDspDataFixedLength=true
        DidInfo_DID_E312_Wheel_Speed (DcmDspDidInfo)
          DcmDspDidAccess
            DcmDspDidRead: DcmDspDidReadSessionRef=defaultSession, DcmDspDidReadSessionRef=extendedDiagnosticSession
        7 x DcmDspData, all with DcmDspDataUsePort=USE_DATA_ASYNCH_CLIENT_SERVER:
          DID_F1AF_ECU_Software_Extended_Part_Numbers_Geely_BCD_part_002: DcmDspDataSize=40, DcmDspDataType=UINT8_N, DcmDspDataInfoRef=DataInfo_DID_F1AF_ECU_Software_Extended_Part_Numbers_Geely_BCD_part_002
          DID_F1AF_ECU_Software_Extended_Part_Numbers_Geely_BCD_part_003: DcmDspDataSize=40, DcmDspDataType=UINT8_N, DcmDspDataInfoRef=DataInfo_DID_F1AF_ECU_Software_Extended_Part_Numbers_Geely_BCD_part_003
          DID_F126_Autosar_BSW_Cluster_Versions_DID_F126_20_COM_CLUSTER_SW_MINOR_VERSION: DcmDspDataSize=8, DcmDspDataType=UINT8, DcmDspDataInfoRef=DataInfo_DID_F126_Autosar_BSW_Cluster_Versions_DID_F126_20_COM_CLUSTER_SW_MINOR_VERSION
          DID_F12B_ECU_Delivery_Assembly_Part_Number_ASCII_part: DcmDspDataSize=24, DcmDspDataType=UINT8_N, DcmDspDataInfoRef=DataInfo_DID_F12B_ECU_Delivery_Assembly_Part_Number_ASCII_part
          DID_E333_2002_State_2002_H_Ser: DcmDspDataSize=8, DcmDspDataType=UINT8, DcmDspDataInfoRef=DataInfo_DID_E333_2002_State_2002_H_Ser
          DID_E335_d_axis_current_setpoint_DID_E335_d_axis_current_setpoint: DcmDspDataSize=16, DcmDspDataType=UINT16, DcmDspDataInfoRef=DataInfo_DID_E335_d_axis_current_setpoint_DID_E335_d_axis_current_setpoint
          DID_D211_Network_Management_History_Propulsion_CAN_DID_D211_10_5th_Latest_State_Global_Real_Time: DcmDspDataSize=32, DcmDspDataType=UINT32, DcmDspDataInfoRef=DataInfo_DID_D211_Network_Management_History_Propulsion_CAN_DID_D211_10_5th_Latest_State_Global_Real_Time
        DataInfo_DID_D005_High_Quiescent_Current_Fault_Identification_Data_DID_D005_1_1st_System_Global_Time_the_time_when_the_D1ec8d60e (DcmDspDataInfo): DcmDspDataFixedLength=true
        DID_F1AF_ECU_Software_Extended_Part_Numbers_Geely_ASCII_part (DcmDspData):
          DcmDspDataSize = 24
          DcmDspDataType = UINT8_N
          DcmDspDataUsePort = USE_DATA_ASYNCH_CLIENT_SERVER
          DcmDspDataInfoRef = DataInfo_DID_F1AF_ECU_Software_Extended_Part_Numbers_Geely_ASCII_part
        DID_EDA0_Complete_ECU_Part_Serial_Number_s_Reserved (DcmDspData):
          DcmDspDataSize = 80
          DcmDspDataType = UINT8_N
          DcmDspDataUsePort = USE_DATA_ASYNCH_CLIENT_SERVER
          DcmDspDataInfoRef = DataInfo_DID_EDA0_Complete_ECU_Part_Serial_Number_s_Reserved
        DID_D005_High_Quiescent_Current_Fault_Identification_Data (DcmDspDid):
          DcmDspDidIdentifier = 53253
          DcmDspDidUsed = true
          DcmDspDidUsePort = USE_DATA_ELEMENT_SPECIFIC_INTERFACES
          DcmDspDidInfoRef = DidInfo_DID_D005_High_Quiescent_Current_Fault_Identification_Data
          85 x DcmDspDidSignal:
            DID_D005_5st_Usage_Mode_when_DID_is_triggered: DcmDspDidDataPos=1992, DcmDspDidDataRef=DID_D005_High_Quiescent_Current_Fault_Identification_Data_DID_D005_5st_Usage_Mode_when_DID_is_triggered
            DID_D005_5st_System_Global_Time_the_time_when_the_DID_is_triggered: DcmDspDidDataPos=1600, DcmDspDidDataRef=DID_D005_High_Quiescent_Current_Fault_Identification_Data_DID_D005_5st_System_Global_Time_the_time_when_the_DID_is_triggered
            DID_D005_1st_Usage_Mode_when_DID_is_triggered: DcmDspDidDataPos=392, DcmDspDidDataRef=DID_D005_High_Quiescent_Current_Fault_Identification_Data_DID_D005_1st_Usage_Mode_when_DID_is_triggered
            D005_4st_Functionality_Activity_Level_PNC39: DcmDspDidDataPos=1320, DcmDspDidDataRef=DID_D005_High_Quiescent_Current_Fault_Identification_Data_D005_4st_Functionality_Activity_Level_PNC39
            Bitfield_4th: DcmDspDidDataPos=1584, DcmDspDidDataRef=DID_D005_High_Quiescent_Current_Fault_Identification_Data_Bitfield_4th
            D005_1st_Functionality_Activity_Level_PNC26: DcmDspDidDataPos=80, DcmDspDidDataRef=DID_D005_High_Quiescent_Current_Fault_Identification_Data_D005_1st_Functionality_Activity_Level_PNC26
            D005_1st_Functionality_Activity_Level_PNC27: DcmDspDidDataPos=88, DcmDspDidDataRef=DID_D005_High_Quiescent_Current_Fault_Identification_Data_D005_1st_Functionality_Activity_Level_PNC27
            Bitfield_2th: DcmDspDidDataPos=784, DcmDspDidDataRef=DID_D005_High_Quiescent_Current_Fault_Identification_Data_Bitfield_2th
            Functionality_Activity_Level_Detect_CPSR_Keep_Active_2st: DcmDspDidDataPos=584, DcmDspDidDataRef=DID_D005_High_Quiescent_Current_Fault_Identification_Data_Functionality_Activity_Level_Detect_CPSR_Keep_Active_2st
            D005_1st_Functionality_Activity_Level_PNC29: DcmDspDidDataPos=96, DcmDspDidDataRef=DID_D005_High_Quiescent_Current_Fault_Identification_Data_D005_1st_Functionality_Activity_Level_PNC29
            D005_1st_Functionality_Activity_Level_PNC24: DcmDspDidDataPos=64, DcmDspDidDataRef=DID_D005_High_Quiescent_Current_Fault_Identification_Data_D005_1st_Functionality_Activity_Level_PNC24
            D005_1st_Functionality_Activity_Level_PNC25: DcmDspDidDataPos=72, DcmDspDidDataRef=DID_D005_High_Quiescent_Current_Fault_Identification_Data_D005_1st_Functionality_Activity_Level_PNC25
            Reserved_PNC_2st: DcmDspDidDataPos=528, DcmDspDidDataRef=DID_D005_High_Quiescent_Current_Fault_Identification_Data_Reserved_PNC_2st
            D005_1st_Functionality_Activity_Level_PNC30: DcmDspDidDataPos=104, DcmDspDidDataRef=DID_D005_High_Quiescent_Current_Fault_Identification_Data_D005_1st_Functionality_Activity_Level_PNC30
            Functionality_Activity_Level_Detect_CPSR_Keep_Active_4st: DcmDspDidDataPos=1384, DcmDspDidDataRef=DID_D005_High_Quiescent_Current_Fault_Identification_Data_Functionality_Activity_Level_Detect_CPSR_Keep_Active_4st
            Reserved_PNC_4st: DcmDspDidDataPos=1328, DcmDspDidDataRef=DID_D005_High_Quiescent_Current_Fault_Identification_Data_Reserved_PNC_4st
            Functionality_Activity_Level_Detect_Motor_Speed_Abnormal_1st: DcmDspDidDataPos=192, DcmDspDidDataRef=DID_D005_High_Quiescent_Current_Fault_Identification_Data_Functionality_Activity_Level_Detect_Motor_Speed_Abnormal_1st
            D005_2st_Functionality_Activity_Level_PNC39: DcmDspDidDataPos=520, DcmDspDidDataRef=DID_D005_High_Quiescent_Current_Fault_Identification_Data_D005_2st_Functionality_Activity_Level_PNC39
            Functionality_Activity_Level_Detect_Motor_Speed_Abnormal_5st: DcmDspDidDataPos=1792, DcmDspDidDataRef=DID_D005_High_Quiescent_Current_Fault_Identification_Data_Functionality_Activity_Level_Detect_Motor_Speed_Abnormal_5st
            Functionality_Activity_Level_Detect_Motor_Speed_Abnormal_3st: DcmDspDidDataPos=992, DcmDspDidDataRef=DID_D005_High_Quiescent_Current_Fault_Identification_Data_Functionality_Activity_Level_Detect_Motor_Speed_Abnormal_3st
            D005_2st_Functionality_Activity_Level_PNC35: DcmDspDidDataPos=512, DcmDspDidDataRef=DID_D005_High_Quiescent_Current_Fault_Identification_Data_D005_2st_Functionality_Activity_Level_PNC35
            D005_4st_Functionality_Activity_Level_PNC29: DcmDspDidDataPos=1296, DcmDspDidDataRef=DID_D005_High_Quiescent_Current_Fault_Identification_Data_D005_4st_Functionality_Activity_Level_PNC29
            DID_D005_5st_Global_time_when_Functionality_Activity_level_Sleep_in_the_ECU: DcmDspDidDataPos=1632, DcmDspDidDataRef=DID_D005_High_Quiescent_Current_Fault_Identification_Data_DID_D005_5st_Global_time_when_Functionality_Activity_level_Sle91c5dfd2
            DID_D005_2st_Usage_Mode_when_DID_is_triggered: DcmDspDidDataPos=792, DcmDspDidDataRef=DID_D005_High_Quiescent_Current_Fault_Identification_Data_DID_D005_2st_Usage_Mode_when_DID_is_triggered
            D005_2st_Functionality_Activity_Level_PNC30: DcmDspDidDataPos=504, DcmDspDidDataRef=DID_D005_High_Quiescent_Current_Fault_Identification_Data_D005_2st_Functionality_Activity_Level_PNC30
            D005_4st_Functionality_Activity_Level_PNC25: DcmDspDidDataPos=1272, DcmDspDidDataRef=DID_D005_High_Quiescent_Current_Fault_Identification_Data_D005_4st_Functionality_Activity_Level_PNC25
            Reserved_Data_Field_4st: DcmDspDidDataPos=1408, DcmDspDidDataRef=DID_D005_High_Quiescent_Current_Fault_Identification_Data_Reserved_Data_Field_4st
            D005_4st_Functionality_Activity_Level_PNC26: DcmDspDidDataPos=1280, DcmDspDidDataRef=DID_D005_High_Quiescent_Current_Fault_Identification_Data_D005_4st_Functionality_Activity_Level_PNC26
            D005_4st_Functionality_Activity_Level_PNC27: DcmDspDidDataPos=1288, DcmDspDidDataRef=DID_D005_High_Quiescent_Current_Fault_Identification_Data_D005_4st_Functionality_Activity_Level_PNC27
            Functionality_Activity_Level_Detect_DC_Bus_voltage_Abnormal_1st: DcmDspDidDataPos=200, DcmDspDidDataRef=DID_D005_High_Quiescent_Current_Fault_Identification_Data_Functionality_Activity_Level_Detect_DC_Bus_voltage_Abnormal_1st
            DID_D005_3st_System_Global_Time_the_time_when_the_DID_is_triggered: DcmDspDidDataPos=800, DcmDspDidDataRef=DID_D005_High_Quiescent_Current_Fault_Identification_Data_DID_D005_3st_System_Global_Time_the_time_when_the_DID_is_triggered
            D005_3st_Functionality_Activity_Level_PNC30: DcmDspDidDataPos=904, DcmDspDidDataRef=DID_D005_High_Quiescent_Current_Fault_Identification_Data_D005_3st_Functionality_Activity_Level_PNC30
            Reserved_Data_Field_2st: DcmDspDidDataPos=608, DcmDspDidDataRef=DID_D005_High_Quiescent_Current_Fault_Identification_Data_Reserved_Data_Field_2st
            DID_D005_2st_Global_time_when_Functionality_Activity_level_Sleep_in_the_ECU: DcmDspDidDataPos=432, DcmDspDidDataRef=DID_D005_High_Quiescent_Current_Fault_Identification_Data_DID_D005_2st_Global_time_when_Functionality_Activity_level_Sleb7289ace
            D005_3st_Functionality_Activity_Level_PNC25: DcmDspDidDataPos=872, DcmDspDidDataRef=DID_D005_High_Quiescent_Current_Fault_Identification_Data_D005_3st_Functionality_Activity_Level_PNC25
            D005_3st_Functionality_Activity_Level_PNC24: DcmDspDidDataPos=864, DcmDspDidDataRef=DID_D005_High_Quiescent_Current_Fault_Identification_Data_D005_3st_Functionality_Activity_Level_PNC24
            D005_3st_Functionality_Activity_Level_PNC27: DcmDspDidDataPos=888, DcmDspDidDataRef=DID_D005_High_Quiescent_Current_Fault_Identification_Data_D005_3st_Functionality_Activity_Level_PNC27
            D005_3st_Functionality_Activity_Level_PNC26: DcmDspDidDataPos=880, DcmDspDidDataRef=DID_D005_High_Quiescent_Current_Fault_Identification_Data_D005_3st_Functionality_Activity_Level_PNC26
            D005_5st_Functionality_Activity_Level_PNC39: DcmDspDidDataPos=1720, DcmDspDidDataRef=DID_D005_High_Quiescent_Current_Fault_Identification_Data_D005_5st_Functionality_Activity_Level_PNC39
            D005_3st_Functionality_Activity_Level_PNC29: DcmDspDidDataPos=896, DcmDspDidDataRef=DID_D005_High_Quiescent_Current_Fault_Identification_Data_D005_3st_Functionality_Activity_Level_PNC29
            DID_D005_1_1st_System_Global_Time_the_time_when_the_DID_is_triggered: DcmDspDidDataPos=0, DcmDspDidDataRef=DID_D005_High_Quiescent_Current_Fault_Identification_Data_DID_D005_1_1st_System_Global_Time_the_time_when_the_DID_is_triggered
            D005_2st_Functionality_Activity_Level_PNC29: DcmDspDidDataPos=496, DcmDspDidDataRef=DID_D005_High_Quiescent_Current_Fault_Identification_Data_D005_2st_Functionality_Activity_Level_PNC29
            Functionality_Activity_Level_Detect_DC_Bus_voltage_Abnormal_5st: DcmDspDidDataPos=1800, DcmDspDidDataRef=DID_D005_High_Quiescent_Current_Fault_Identification_Data_Functionality_Activity_Level_Detect_DC_Bus_voltage_Abnormal_5st
            D005_4st_Functionality_Activity_Level_PNC35: DcmDspDidDataPos=1312, DcmDspDidDataRef=DID_D005_High_Quiescent_Current_Fault_Identification_Data_D005_4st_Functionality_Activity_Level_PNC35
            D005_2st_Functionality_Activity_Level_PNC27: DcmDspDidDataPos=488, DcmDspDidDataRef=DID_D005_High_Quiescent_Current_Fault_Identification_Data_D005_2st_Functionality_Activity_Level_PNC27
            DID_D005_4st_System_Global_Time_the_time_when_the_DID_is_triggered: DcmDspDidDataPos=1200, DcmDspDidDataRef=DID_D005_High_Quiescent_Current_Fault_Identification_Data_DID_D005_4st_System_Global_Time_the_time_when_the_DID_is_triggered
            D005_2st_Functionality_Activity_Level_PNC26: DcmDspDidDataPos=480, DcmDspDidDataRef=DID_D005_High_Quiescent_Current_Fault_Identification_Data_D005_2st_Functionality_Activity_Level_PNC26
            D005_2st_Functionality_Activity_Level_PNC25: DcmDspDidDataPos=472, DcmDspDidDataRef=DID_D005_High_Quiescent_Current_Fault_Identification_Data_D005_2st_Functionality_Activity_Level_PNC25
            D005_4st_Functionality_Activity_Level_PNC30: DcmDspDidDataPos=1304, DcmDspDidDataRef=DID_D005_High_Quiescent_Current_Fault_Identification_Data_D005_4st_Functionality_Activity_Level_PNC30
            D005_2st_Functionality_Activity_Level_PNC24: DcmDspDidDataPos=464, DcmDspDidDataRef=DID_D005_High_Quiescent_Current_Fault_Identification_Data_D005_2st_Functionality_Activity_Level_PNC24
            DID_D005_3st_Global_time_when_Functionality_Activity_level_Sleep_in_the_ECU: DcmDspDidDataPos=832, DcmDspDidDataRef=DID_D005_High_Quiescent_Current_Fault_Identification_Data_DID_D005_3st_Global_time_when_Functionality_Activity_level_Slefec137d1
            D005_5st_Functionality_Activity_Level_PNC35: DcmDspDidDataPos=1712, DcmDspDidDataRef=DID_D005_High_Quiescent_Current_Fault_Identification_Data_D005_5st_Functionality_Activity_Level_PNC35
            Bitfield_3th: DcmDspDidDataPos=1184, DcmDspDidDataRef=DID_D005_High_Quiescent_Current_Fault_Identification_Data_Bitfield_3th
            DID_D005_2st_System_Global_Time_the_time_when_the_DID_is_triggered: DcmDspDidDataPos=400, DcmDspDidDataRef=DID_D005_High_Quiescent_Current_Fault_Identification_Data_DID_D005_2st_System_Global_Time_the_time_when_the_DID_is_triggered
            Functionality_Activity_Level_Detect_CPSR_Keep_Active_1st: DcmDspDidDataPos=184, DcmDspDidDataRef=DID_D005_High_Quiescent_Current_Fault_Identification_Data_Functionality_Activity_Level_Detect_CPSR_Keep_Active_1st
            Bitfield_1th: DcmDspDidDataPos=384, DcmDspDidDataRef=DID_D005_High_Quiescent_Current_Fault_Identification_Data_Bitfield_1th
            DID_D005_3st_Usage_Mode_when_DID_is_triggered: DcmDspDidDataPos=1192, DcmDspDidDataRef=DID_D005_High_Quiescent_Current_Fault_Identification_Data_DID_D005_3st_Usage_Mode_when_DID_is_triggered
            D005_5st_Functionality_Activity_Level_PNC30: DcmDspDidDataPos=1704, DcmDspDidDataRef=DID_D005_High_Quiescent_Current_Fault_Identification_Data_D005_5st_Functionality_Activity_Level_PNC30
            D005_3st_Functionality_Activity_Level_PNC35: DcmDspDidDataPos=912, DcmDspDidDataRef=DID_D005_High_Quiescent_Current_Fault_Identification_Data_D005_3st_Functionality_Activity_Level_PNC35
            Reserved_PNC_1st: DcmDspDidDataPos=128, DcmDspDidDataRef=DID_D005_High_Quiescent_Current_Fault_Identification_Data_Reserved_PNC_1st
            DID_D005_4st_Global_time_when_Functionality_Activity_level_Sleep_in_the_ECU: DcmDspDidDataPos=1232, DcmDspDidDataRef=DID_D005_High_Quiescent_Current_Fault_Identification_Data_DID_D005_4st_Global_time_when_Functionality_Activity_level_Sled82c72cd
            Functionality_Activity_Level_Detect_CPSR_Keep_Active_3st: DcmDspDidDataPos=984, DcmDspDidDataRef=DID_D005_High_Quiescent_Current_Fault_Identification_Data_Functionality_Activity_Level_Detect_CPSR_Keep_Active_3st
            Reserved_PNC_5st: DcmDspDidDataPos=1728, DcmDspDidDataRef=DID_D005_High_Quiescent_Current_Fault_Identification_Data_Reserved_PNC_5st
            D005_5st_Functionality_Activity_Level_PNC29: DcmDspDidDataPos=1696, DcmDspDidDataRef=DID_D005_High_Quiescent_Current_Fault_Identification_Data_D005_5st_Functionality_Activity_Level_PNC29
            Functionality_Activity_Level_Detect_DC_Bus_voltage_Abnormal3st: DcmDspDidDataPos=1000, DcmDspDidDataRef=DID_D005_High_Quiescent_Current_Fault_Identification_Data_Functionality_Activity_Level_Detect_DC_Bus_voltage_Abnormal3st
            D005_3st_Functionality_Activity_Level_PNC39: DcmDspDidDataPos=920, DcmDspDidDataRef=DID_D005_High_Quiescent_Current_Fault_Identification_Data_D005_3st_Functionality_Activity_Level_PNC39
            Functionality_Activity_Level_Detect_CPSR_Keep_Active_5st: DcmDspDidDataPos=1784, DcmDspDidDataRef=DID_D005_High_Quiescent_Current_Fault_Identification_Data_Functionality_Activity_Level_Detect_CPSR_Keep_Active_5st
            D005_5st_Functionality_Activity_Level_PNC26: DcmDspDidDataPos=1680, DcmDspDidDataRef=DID_D005_High_Quiescent_Current_Fault_Identification_Data_D005_5st_Functionality_Activity_Level_PNC26
            D005_5st_Functionality_Activity_Level_PNC27: DcmDspDidDataPos=1688, DcmDspDidDataRef=DID_D005_High_Quiescent_Current_Fault_Identification_Data_D005_5st_Functionality_Activity_Level_PNC27
            Reserved_PNC_3st: DcmDspDidDataPos=928, DcmDspDidDataRef=DID_D005_High_Quiescent_Current_Fault_Identification_Data_Reserved_PNC_3st
            D005_4st_Functionality_Activity_Level_PNC24: DcmDspDidDataPos=1264, DcmDspDidDataRef=DID_D005_High_Quiescent_Current_Fault_Identification_Data_D005_4st_Functionality_Activity_Level_PNC24
            Functionality_Activity_Level_Detect_Motor_Speed_Abnormal_4st: DcmDspDidDataPos=1392, DcmDspDidDataRef=DID_D005_High_Quiescent_Current_Fault_Identification_Data_Functionality_Activity_Level_Detect_Motor_Speed_Abnormal_4st
            Functionality_Activity_Level_Detect_Motor_Speed_Abnormal_2st: DcmDspDidDataPos=592, DcmDspDidDataRef=DID_D005_High_Quiescent_Current_Fault_Identification_Data_Functionality_Activity_Level_Detect_Motor_Speed_Abnormal_2st
            DID_D005_2_1st_Global_time_when_Functionality_Activity_level_Sleep_in_the_ECU: DcmDspDidDataPos=32, DcmDspDidDataRef=DID_D005_High_Quiescent_Current_Fault_Identification_Data_DID_D005_2_1st_Global_time_when_Functionality_Activity_level_Sa38038bb
            Reserved_Data_Field_3st: DcmDspDidDataPos=1008, DcmDspDidDataRef=DID_D005_High_Quiescent_Current_Fault_Identification_Data_Reserved_Data_Field_3st
            Functionality_Activity_Level_Detect_DC_Bus_voltage_Abnormal_2st: DcmDspDidDataPos=600, DcmDspDidDataRef=DID_D005_High_Quiescent_Current_Fault_Identification_Data_Functionality_Activity_Level_Detect_DC_Bus_voltage_Abnormal_2st
            Reserved_Data_Field_5st: DcmDspDidDataPos=1808, DcmDspDidDataRef=DID_D005_High_Quiescent_Current_Fault_Identification_Data_Reserved_Data_Field_5st
            D005_5st_Functionality_Activity_Level_PNC24: DcmDspDidDataPos=1664, DcmDspDidDataRef=DID_D005_High_Quiescent_Current_Fault_Identification_Data_D005_5st_Functionality_Activity_Level_PNC24
            D005_5st_Functionality_Activity_Level_PNC25: DcmDspDidDataPos=1672, DcmDspDidDataRef=DID_D005_High_Quiescent_Current_Fault_Identification_Data_D005_5st_Functionality_Activity_Level_PNC25
            Reserved_Data_Field_1st: DcmDspDidDataPos=208, DcmDspDidDataRef=DID_D005_High_Quiescent_Current_Fault_Identification_Data_Reserved_Data_Field_1st
            D005_1st_Functionality_Activity_Level_PNC39: DcmDspDidDataPos=120, DcmDspDidDataRef=DID_D005_High_Quiescent_Current_Fault_Identification_Data_D005_1st_Functionality_Activity_Level_PNC39
            D005_1st_Functionality_Activity_Level_PNC35: DcmDspDidDataPos=112, DcmDspDidDataRef=DID_D005_High_Quiescent_Current_Fault_Identification_Data_D005_1st_Functionality_Activity_Level_PNC35
            DID_D005_4st_Usage_Mode_when_DID_is_triggered: DcmDspDidDataPos=1592, DcmDspDidDataRef=DID_D005_High_Quiescent_Current_Fault_Identification_Data_DID_D005_4st_Usage_Mode_when_DID_is_triggered
            Bitfield_5th: DcmDspDidDataPos=1984, DcmDspDidDataRef=DID_D005_High_Quiescent_Current_Fault_Identification_Data_Bitfield_5th
            Functionality_Activity_Level_Detect_DC_Bus_voltage_Abnormal_4st: DcmDspDidDataPos=1400, DcmDspDidDataRef=DID_D005_High_Quiescent_Current_Fault_Identification_Data_Functionality_Activity_Level_Detect_DC_Bus_voltage_Abnormal_4st
        DID_D005_High_Quiescent_Current_Fault_Identification_Data_Reserved_Data_Field_5st (DcmDspData):
          DcmDspDataSize = 176
          DcmDspDataType = UINT8_N
          DcmDspDataUsePort = USE_DATA_ASYNCH_CLIENT_SERVER
          DcmDspDataInfoRef = DataInfo_DID_D005_High_Quiescent_Current_Fault_Identification_Data_Reserved_Data_Field_5st
        DidInfo_DID_E338_q_axis_current_feedback (DcmDspDidInfo)
          DcmDspDidAccess
            DcmDspDidRead: DcmDspDidReadSessionRef=defaultSession, DcmDspDidReadSessionRef=extendedDiagnosticSession
        4 x DcmDspData, all with DcmDspDataUsePort=USE_DATA_ASYNCH_CLIENT_SERVER:
          DID_0xEEC7_1_DID_EED2_SaftyTorque: DcmDspDataSize=16, DcmDspDataType=UINT16, DcmDspDataInfoRef=DataInfo_DID_0xEEC7_1_DID_EED2_SaftyTorque
          DID_D211_Network_Management_History_Propulsion_CAN_DID_D211_6_3rd_Latest_State_Global_Real_Time: DcmDspDataSize=32, DcmDspDataType=UINT32, DcmDspDataInfoRef=DataInfo_DID_D211_Network_Management_History_Propulsion_CAN_DID_D211_6_3rd_Latest_State_Global_Real_Time
          DID_F126_Autosar_BSW_Cluster_Versions_DID_F126_39_LIN_CLUSTER_VENDOR_ID: DcmDspDataSize=16, DcmDspDataType=UINT16, DcmDspDataInfoRef=DataInfo_DID_F126_Autosar_BSW_Cluster_Versions_DID_F126_39_LIN_CLUSTER_VENDOR_ID
          DID_F1AE_ECU_Software_Part_Numbers_Geely_DID_F1AE_1_Total_number_of_ECU_Software_Part_Numbers: DcmDspDataSize=8, DcmDspDataType=UINT8, DcmDspDataInfoRef=DataInfo_DID_F1AE_ECU_Software_Part_Numbers_Geely_DID_F1AE_1_Total_number_of_ECU_Software_Part_Numbers
        DataInfo_DID_0xEEC7_1_DID_EED2_SaftyTorque (DcmDspDataInfo): DcmDspDataFixedLength=true
        DID_E305_Inverter_IGBT_Junction_Temp_DID_E305_Inverter_IGBT_Junction_Temp (DcmDspData):
          DcmDspDataSize = 8
          DcmDspDataType = UINT8
          DcmDspDataUsePort = USE_DATA_ASYNCH_CLIENT_SERVER
          DcmDspDataInfoRef = DataInfo_DID_E305_Inverter_IGBT_Junction_Temp_DID_E305_Inverter_IGBT_Junction_Temp
        DidInfo_DID_E315_Available_Torque_minimum (DcmDspDidInfo)
          DcmDspDidAccess
            DcmDspDidRead: DcmDspDidReadSessionRef=defaultSession, DcmDspDidReadSessionRef=extendedDiagnosticSession
        DID_40E0_Secret_Key_Immobilizer_Target_3 (DcmDspDid):
          DcmDspDidIdentifier = 16607
          DcmDspDidUsed = true
          DcmDspDidUsePort = USE_DATA_ELEMENT_SPECIFIC_INTERFACES
          DcmDspDidInfoRef = DidInfo_DID_40E0_Secret_Key_Immobilizer_Target_3
          DID_40DF_Secret_Key_Immobilizer_Target_2 (DcmDspDidSignal): DcmDspDidDataPos=0, DcmDspDidDataRef=DID_40E0_Secret_Key_Immobilizer_Target_3_DID_40DF_Secret_Key_Immobilizer_Target_2
        DID_EEB8_HV_voltage_received_from_BECM (DcmDspDid):
          DcmDspDidIdentifier = 61112
          DcmDspDidUsed = true
          DcmDspDidUsePort = USE_DATA_ELEMENT_SPECIFIC_INTERFACES
          DcmDspDidInfoRef = DidInfo_DID_EEB8_HV_voltage_received_from_BECM
          DID_EEB8_HV_voltage_received_from_BECM (DcmDspDidSignal): DcmDspDidDataPos=0, DcmDspDidDataRef=DID_EEB8_HV_voltage_received_from_BECM_DID_EEB8_HV_voltage_received_from_BECM
        DID_DD01_Total_Distance_DID_DD01_Total_Distance (DcmDspData):
          DcmDspDataSize = 24
          DcmDspDataType = UINT8_N
          DcmDspDataUsePort = USE_DATA_ASYNCH_CLIENT_SERVER
          DcmDspDataInfoRef = DataInfo_DID_DD01_Total_Distance_DID_DD01_Total_Distance
        DidInfo_DID_E350_Phase_W_PWM_duty (DcmDspDidInfo)
          DcmDspDidAccess
            DcmDspDidRead: DcmDspDidReadSessionRef=defaultSession, DcmDspDidReadSessionRef=extendedDiagnosticSession
        DataInfo_DID_E331_Software_Version_DID_E331_3_Calibration_Data_Software_Version (DcmDspDataInfo): DcmDspDataFixedLength=true
        DidInfo_DID_F18C_ECU_Serial_Number (DcmDspDidInfo)
          DcmDspDidAccess
            DcmDspDidRead: DcmDspDidReadSessionRef=defaultSession, DcmDspDidReadSessionRef=extendedDiagnosticSession
        4 x DcmDspDataInfo, all with DcmDspDataFixedLength=true:
          DataInfo_DID_D005_High_Quiescent_Current_Fault_Identification_Data_D005_1st_Functionality_Activity_Level_PNC{24..26}
          DataInfo_DID_F12F_ECU_Software_Extended_Part_Numbers_BCD_part
        DID_D005_High_Quiescent_Current_Fault_Identification_Data_Functionality_Activity_Level_Detect_Motor_Speed_Abnormal_4st (DcmDspData):
          DcmDspDataSize = 8
          DcmDspDataType = UINT8
          DcmDspDataUsePort = USE_DATA_ASYNCH_CLIENT_SERVER
          DcmDspDataInfoRef = DataInfo_DID_D005_High_Quiescent_Current_Fault_Identification_Data_Functionality_Activity_Level_Detect_Motor_Speed_Abnormal_4st
        DataInfo_DID_D005_High_Quiescent_Current_Fault_Identification_Data_D005_1st_Functionality_Activity_Level_PNC27 (DcmDspDataInfo): DcmDspDataFixedLength=true
        DataInfo_DID_D005_High_Quiescent_Current_Fault_Identification_Data_D005_1st_Functionality_Activity_Level_PNC29 (DcmDspDataInfo): DcmDspDataFixedLength=true
        DID_F126_Autosar_BSW_Cluster_Versions_DID_F126_12_MODEMGMT_CLUSTER_SW_MAJOR_VERSION (DcmDspData):
          DcmDspDataSize = 8
          DcmDspDataType = UINT8
          DcmDspDataUsePort = USE_DATA_ASYNCH_CLIENT_SERVER
          DcmDspDataInfoRef = DataInfo_DID_F126_Autosar_BSW_Cluster_Versions_DID_F126_12_MODEMGMT_CLUSTER_SW_MAJOR_VERSION
        DID_D005_High_Quiescent_Current_Fault_Identification_Data_Bitfield_4th (DcmDspData):
          DcmDspDataSize = 8
          DcmDspDataType = UINT8_N
          DcmDspDataUsePort = USE_DATA_ASYNCH_CLIENT_SERVER
          DcmDspDataInfoRef = DataInfo_DID_D005_High_Quiescent_Current_Fault_Identification_Data_Bitfield_4th
        DidInfo_DID_E306_Motor_Temperature (DcmDspDidInfo)
          DcmDspDidAccess
            DcmDspDidRead: DcmDspDidReadSessionRef=defaultSession, DcmDspDidReadSessionRef=extendedDiagnosticSession
        DataInfo_DID_D005_High_Quiescent_Current_Fault_Identification_Data_D005_1st_Functionality_Activity_Level_PNC30 (DcmDspDataInfo): DcmDspDataFixedLength=true
        DID_F1A0_Application_Diagnostic_Database_Part_Number_Geely_ASCII_part (DcmDspData):
          DcmDspDataSize = 24
          DcmDspDataType = UINT8_N
          DcmDspDataUsePort = USE_DATA_ASYNCH_CLIENT_SERVER
          DcmDspDataInfoRef = DataInfo_DID_F1A0_Application_Diagnostic_Database_Part_Number_Geely_ASCII_part
        DidInfo_DID_EEFD_Sofware_Project_Version (DcmDspDidInfo)
          DcmDspDidAccess
            DcmDspDidRead: DcmDspDidReadSessionRef=defaultSession, DcmDspDidReadSessionRef=extendedDiagnosticSession
        5 x DcmDspDataInfo, all with DcmDspDataFixedLength=true:
          DataInfo_DID_D005_High_Quiescent_Current_Fault_Identification_Data_D005_1st_Functionality_Activity_Level_PNC35
          DataInfo_DID_D005_High_Quiescent_Current_Fault_Identification_Data_Functionality_Activity_Level_Detect_Motor_Speed_Abnormal_3st
          DataInfo_DID_D005_High_Quiescent_Current_Fault_Identification_Data_D005_1st_Functionality_Activity_Level_PNC39
          DataInfo_DID_D005_High_Quiescent_Current_Fault_Identification_Data_Bitfield_3th
          DataInfo_DID_F126_Autosar_BSW_Cluster_Versions_DID_F126_24_COM_CLUSTER_AR_RELEASE_REVISION_VERSION
        DID_E103_Car_Configuration_Parameter_Faults_DID_E103_15_7th_parameter_invalid_value (DcmDspData):
          DcmDspDataSize = 8
          DcmDspDataType = UINT8
          DcmDspDataUsePort = USE_DATA_ASYNCH_CLIENT_SERVER
          DcmDspDataInfoRef = DataInfo_DID_E103_Car_Configuration_Parameter_Faults_DID_E103_15_7th_parameter_invalid_value
        DID_E348_Phase_U_PWM_duty (DcmDspDid):
          DcmDspDidIdentifier = 58184
          DcmDspDidUsed = true
          DcmDspDidUsePort = USE_DATA_ELEMENT_SPECIFIC_INTERFACES
          DcmDspDidInfoRef = DidInfo_DID_E348_Phase_U_PWM_duty
          DID_E348_Phase_U_PWM_duty (DcmDspDidSignal): DcmDspDidDataPos=0, DcmDspDidDataRef=DID_E348_Phase_U_PWM_duty_DID_E348_Phase_U_PWM_duty
        DID_D005_High_Quiescent_Current_Fault_Identification_Data_D005_3st_Functionality_Activity_Level_PNC25 (DcmDspData):
          DcmDspDataSize = 8
          DcmDspDataType = UINT8
          DcmDspDataUsePort = USE_DATA_ASYNCH_CLIENT_SERVER
          DcmDspDataInfoRef = DataInfo_DID_D005_High_Quiescent_Current_Fault_Identification_Data_D005_3st_Functionality_Activity_Level_PNC25
        DID_D005_High_Quiescent_Current_Fault_Identification_Data_D005_3st_Functionality_Activity_Level_PNC24 (DcmDspData):
          DcmDspDataSize = 8
          DcmDspDataType = UINT8
          DcmDspDataUsePort = USE_DATA_ASYNCH_CLIENT_SERVER
          DcmDspDataInfoRef = DataInfo_DID_D005_High_Quiescent_Current_Fault_Identification_Data_D005_3st_Functionality_Activity_Level_PNC24
        DID_D211_Network_Management_History_Propulsion_CAN (DcmDspDid):
          DcmDspDidIdentifier = 53777
          DcmDspDidUsed = true
          DcmDspDidUsePort = USE_DATA_ELEMENT_SPECIFIC_INTERFACES
          DcmDspDidInfoRef = DidInfo_DID_D211_Network_Management_History_Propulsion_CAN
          20 x DcmDspDidSignal:
            DID_D211_20_10th_Latest_State_Global_Real_Time: DcmDspDidDataPos=368, DcmDspDidDataRef=DID_D211_Network_Management_History_Propulsion_CAN_DID_D211_20_10th_Latest_State_Global_Real_Time
            DID_D211_1_Latest_State_NM_History: DcmDspDidDataPos=0, DcmDspDidDataRef=DID_D211_Network_Management_History_Propulsion_CAN_DID_D211_1_Latest_State_NM_History
            DID_D211_16_8th_Latest_State_Global_Real_Time: DcmDspDidDataPos=288, DcmDspDidDataRef=DID_D211_Network_Management_History_Propulsion_CAN_DID_D211_16_8th_Latest_State_Global_Real_Time
            DID_D211_11_6th_Latest_State_NM_History: DcmDspDidDataPos=200, DcmDspDidDataRef=DID_D211_Network_Management_History_Propulsion_CAN_DID_D211_11_6th_Latest_State_NM_History
            DID_D211_4_2nd_Latest_State_Global_Real_Time: DcmDspDidDataPos=48, DcmDspDidDataRef=DID_D211_Network_Management_History_Propulsion_CAN_DID_D211_4_2nd_Latest_State_Global_Real_Time
            DID_D211_2_Latest_State_Global_Real_Time: DcmDspDidDataPos=8, DcmDspDidDataRef=DID_D211_Network_Management_History_Propulsion_CAN_DID_D211_2_Latest_State_Global_Real_Time
            DID_D211_12_6th_Latest_State_Global_Real_Time: DcmDspDidDataPos=208, DcmDspDidDataRef=DID_D211_Network_Management_History_Propulsion_CAN_DID_D211_12_6th_Latest_State_Global_Real_Time
            DID_D211_5_3rd_Latest_State_NM_History: DcmDspDidDataPos=80, DcmDspDidDataRef=DID_D211_Network_Management_History_Propulsion_CAN_DID_D211_5_3rd_Latest_State_NM_History
            DID_D211_17_9th_Latest_State_NM_History: DcmDspDidDataPos=320, DcmDspDidDataRef=DID_D211_Network_Management_History_Propulsion_CAN_DID_D211_17_9th_Latest_State_NM_History
            DID_D211_9_5th_Latest_State_NM_History: DcmDspDidDataPos=160, DcmDspDidDataRef=DID_D211_Network_Management_History_Propulsion_CAN_DID_D211_9_5th_Latest_State_NM_History
            DID_D211_13_7th_Latest_State_NM_History: DcmDspDidDataPos=240, DcmDspDidDataRef=DID_D211_Network_Management_History_Propulsion_CAN_DID_D211_13_7th_Latest_State_NM_History
            DID_D211_8_4th_Latest_State_Global_Real_Time: DcmDspDidDataPos=128, DcmDspDidDataRef=DID_D211_Network_Management_History_Propulsion_CAN_DID_D211_8_4th_Latest_State_Global_Real_Time
            DID_D211_10_5th_Latest_State_Global_Real_Time: DcmDspDidDataPos=168, DcmDspDidDataRef=DID_D211_Network_Management_History_Propulsion_CAN_DID_D211_10_5th_Latest_State_Global_Real_Time
            DID_D211_18_9th_Latest_State_Global_Real_Time: DcmDspDidDataPos=328, DcmDspDidDataRef=DID_D211_Network_Management_History_Propulsion_CAN_DID_D211_18_9th_Latest_State_Global_Real_Time
            DID_D211_6_3rd_Latest_State_Global_Real_Time: DcmDspDidDataPos=88, DcmDspDidDataRef=DID_D211_Network_Management_History_Propulsion_CAN_DID_D211_6_3rd_Latest_State_Global_Real_Time
            DID_D211_15_8th_Latest_State_NM_History: DcmDspDidDataPos=280, DcmDspDidDataRef=DID_D211_Network_Management_History_Propulsion_CAN_DID_D211_15_8th_Latest_State_NM_History
            DID_D211_19_10th_Latest_State_NM_History: DcmDspDidDataPos=360, DcmDspDidDataRef=DID_D211_Network_Management_History_Propulsion_CAN_DID_D211_19_10th_Latest_State_NM_History
            DID_D211_14_7th_Latest_State_Global_Real_Time: DcmDspDidDataPos=248, DcmDspDidDataRef=DID_D211_Network_Management_History_Propulsion_CAN_DID_D211_14_7th_Latest_State_Global_Real_Time
            DID_D211_3_2nd_Latest_State_NM_History: DcmDspDidDataPos=40, DcmDspDidDataRef=DID_D211_Network_Management_History_Propulsion_CAN_DID_D211_3_2nd_Latest_State_NM_History
            DID_D211_7_4th_Latest_State_NM_History: DcmDspDidDataPos=120, DcmDspDidDataRef=DID_D211_Network_Management_History_Propulsion_CAN_DID_D211_7_4th_Latest_State_NM_History
        DID_D005_High_Quiescent_Current_Fault_Identification_Data_D005_3st_Functionality_Activity_Level_PNC27 (DcmDspData):
          DcmDspDataSize = 8
          DcmDspDataType = UINT8
          DcmDspDataUsePort = USE_DATA_ASYNCH_CLIENT_SERVER
          DcmDspDataInfoRef = DataInfo_DID_D005_High_Quiescent_Current_Fault_Identification_Data_D005_3st_Functionality_Activity_Level_PNC27
        DataInfo_DID_EEC3_ECU_power_supply_Voltage_DID_EEC3_ECU_power_supply_Voltage (DcmDspDataInfo): DcmDspDataFixedLength=true
        4 x DcmDspData, all with DcmDspDataUsePort=USE_DATA_ASYNCH_CLIENT_SERVER:
          DID_D005_High_Quiescent_Current_Fault_Identification_Data_D005_3st_Functionality_Activity_Level_PNC26: DcmDspDataSize=8, DcmDspDataType=UINT8, DcmDspDataInfoRef=DataInfo_DID_D005_High_Quiescent_Current_Fault_Identification_Data_D005_3st_Functionality_Activity_Level_PNC26
          DID_D005_High_Quiescent_Current_Fault_Identification_Data_D005_3st_Functionality_Activity_Level_PNC29: DcmDspDataSize=8, DcmDspDataType=UINT8, DcmDspDataInfoRef=DataInfo_DID_D005_High_Quiescent_Current_Fault_Identification_Data_D005_3st_Functionality_Activity_Level_PNC29
          DID_EEB5_IEM_MGM_current_torque_DID_EEB5_IEMMGM_current_torque: DcmDspDataSize=16, DcmDspDataType=UINT16, DcmDspDataInfoRef=DataInfo_DID_EEB5_IEM_MGM_current_torque_DID_EEB5_IEMMGM_current_torque
          DID_40E0_Secret_Key_Immobilizer_Target_3_DID_40DF_Secret_Key_Immobilizer_Target_2: DcmDspDataSize=256, DcmDspDataType=UINT8_N, DcmDspDataInfoRef=DataInfo_DID_40E0_Secret_Key_Immobilizer_Target_3_DID_40DF_Secret_Key_Immobilizer_Target_2
        3 x DcmDspDataInfo, all with DcmDspDataFixedLength=true:
          DataInfo_DID_E358_Resolve_angle_DID_E358_Resolve_angle
          DataInfo_DID_F1AA_ECU_Core_Assembly_Part_Number_Geely_ASCII_part
          DataInfo_DID_D005_High_Quiescent_Current_Fault_Identification_Data_Functionality_Activity_Level_Detect_CPSR_Keep_Active_2st
        DidInfo_DID_EEC4_Charging_Power_Sustain_Relay_CPSR_Voltage (DcmDspDidInfo)
          DcmDspDidAccess
            DcmDspDidRead: DcmDspDidReadSessionRef=defaultSession, DcmDspDidReadSessionRef=extendedDiagnosticSession
        DID_E307_System_Mode_DID_E307_System_Mode (DcmDspData):
          DcmDspDataSize = 8
          DcmDspDataType = UINT8
          DcmDspDataUsePort = USE_DATA_ASYNCH_CLIENT_SERVER
          DcmDspDataInfoRef = DataInfo_DID_E307_System_Mode_DID_E307_System_Mode
        DidInfo_DID_EE9F_Gate_Status (DcmDspDidInfo)
          DcmDspDidAccess
            DcmDspDidRead: DcmDspDidReadSessionRef=defaultSession, DcmDspDidReadSessionRef=extendedDiagnosticSession
        DataInfo_DID_EDA0_Complete_ECU_Part_Serial_Number_s_DID_F12A_ECU_Delivery_Assembly_Part_Number_1 (DcmDspDataInfo): DcmDspDataFixedLength=true
        DID_E303_Motor_Speed (DcmDspDid):
          DcmDspDidIdentifier = 58115
          DcmDspDidUsed = true
          DcmDspDidUsePort = USE_DATA_ELEMENT_SPECIFIC_INTERFACES
          DcmDspDidInfoRef = DidInfo_DID_E303_Motor_Speed
          DID_E303_Motor_Speed_ (DcmDspDidSignal): DcmDspDidDataPos=0, DcmDspDidDataRef=DID_E303_Motor_Speed_DID_E303_Motor_Speed_
        3 x DcmDspDataInfo, all with DcmDspDataFixedLength=true:
          DataInfo_DID_F12F_ECU_Software_Extended_Part_Numbers_ASCII_part_002
          DataInfo_DID_F12F_ECU_Software_Extended_Part_Numbers_ASCII_part_001
          DataInfo_DID_F12F_ECU_Software_Extended_Part_Numbers_ASCII_part_009
        DID_D005_High_Quiescent_Current_Fault_Identification_Data_DID_D005_3st_Usage_Mode_when_DID_is_triggered (DcmDspData):
          DcmDspDataSize = 8
          DcmDspDataType = UINT8
          DcmDspDataUsePort = USE_DATA_ASYNCH_CLIENT_SERVER
          DcmDspDataInfoRef = DataInfo_DID_D005_High_Quiescent_Current_Fault_Identification_Data_DID_D005_3st_Usage_Mode_when_DID_is_triggered
        DataInfo_DID_F12F_ECU_Software_Extended_Part_Numbers_ASCII_part_008 (DcmDspDataInfo): DcmDspDataFixedLength=true
        DidInfo_DID_D005_High_Quiescent_Current_Fault_Identification_Data (DcmDspDidInfo)
          DcmDspDidAccess
            DcmDspDidRead: DcmDspDidReadSessionRef=defaultSession, DcmDspDidReadSessionRef=extendedDiagnosticSession
        3 x DcmDspDataInfo, all with DcmDspDataFixedLength=true:
          DataInfo_DID_F12F_ECU_Software_Extended_Part_Numbers_ASCII_part_007
          DataInfo_DID_E103_Car_Configuration_Parameter_Faults_DID_E103_6_3rd_parameter_number_of_the_car_configuration_data_that_1458f62a
          DataInfo_DID_F12F_ECU_Software_Extended_Part_Numbers_ASCII_part_006
        DID_E324_Motor_Derating_reason_of_IEM_MGM (DcmDspDid):
          DcmDspDidIdentifier = 58148
          DcmDspDidUsed = true
          DcmDspDidUsePort = USE_DATA_ELEMENT_SPECIFIC_INTERFACES
          DcmDspDidInfoRef = DidInfo_DID_E324_Motor_Derating_reason_of_IEM_MGM
          DID_E324_Motor_Derating_reason_of_IEMMGM (DcmDspDidSignal): DcmDspDidDataPos=0, DcmDspDidDataRef=DID_E324_Motor_Derating_reason_of_IEM_MGM_DID_E324_Motor_Derating_reason_of_IEMMGM
        3 x DcmDspDataInfo, all with DcmDspDataFixedLength=true:
          DataInfo_DID_F12F_ECU_Software_Extended_Part_Numbers_ASCII_part_005
          DataInfo_DID_F12F_ECU_Software_Extended_Part_Numbers_ASCII_part_004
          DataInfo_DID_F12F_ECU_Software_Extended_Part_Numbers_ASCII_part_003
        3 x DcmDspData, all with DcmDspDataUsePort=USE_DATA_ASYNCH_CLIENT_SERVER:
          DID_D03A_swAuth_Public_Key_CheckSum_DID_D03A_swAuth_Public_Key_CheckSum: DcmDspDataSize=256, DcmDspDataType=UINT8_N, DcmDspDataInfoRef=DataInfo_DID_D03A_swAuth_Public_Key_CheckSum_DID_D03A_swAuth_Public_Key_CheckSum
          DID_D211_Network_Management_History_Propulsion_CAN_DID_D211_16_8th_Latest_State_Global_Real_Time: DcmDspDataSize=32, DcmDspDataType=UINT32, DcmDspDataInfoRef=DataInfo_DID_D211_Network_Management_History_Propulsion_CAN_DID_D211_16_8th_Latest_State_Global_Real_Time
          DID_ED20_Complete_set_of_ECU_part_serial_numbers_Geely_Reserved: DcmDspDataSize=80, DcmDspDataType=UINT8_N, DcmDspDataInfoRef=DataInfo_DID_ED20_Complete_set_of_ECU_part_serial_numbers_Geely_Reserved
        DidInfo_DID_F126_Autosar_BSW_Cluster_Versions (DcmDspDidInfo)
          DcmDspDidAccess
            DcmDspDidRead: DcmDspDidReadSessionRef=defaultSession, DcmDspDidReadSessionRef=extendedDiagnosticSession
        RoutineInfo_Starter_Generator_Position_Sensors_Calibration (DcmDspRoutineInfo)
          DcmDspRoutineRequestResOut
            Out_Bitfield (DcmDspRoutineRequestResOutSignal): DcmDspRoutineSignalLength=8, DcmDspRoutineSignalType=UINT8, DcmDspRoutineSignalPos=0
            Out_RID_4001_RequestResult_Pr_3_Calibration_result (DcmDspRoutineRequestResOutSignal): DcmDspRoutineSignalLength=16, DcmDspRoutineSignalType=UINT16, DcmDspRoutineSignalEndianness=BIG_ENDIAN, DcmDspRoutineSignalPos=8
          DcmDspRoutineAuthorization: DcmDspRoutineSessionRef=extendedDiagnosticSession, DcmDspRoutineSecurityLevelRef=CommonUnlock_Level_3
          DcmDspRoutineStopOut
            Out_Bitfield (DcmDspRoutineStopOutSignal): DcmDspRoutineSignalLength=8, DcmDspRoutineSignalType=UINT8, DcmDspRoutineSignalPos=0
          DcmDspStartRoutineOut
            Out_Bitfield (DcmDspStartRoutineOutSignal): DcmDspRoutineSignalLength=8, DcmDspRoutineSignalType=UINT8, DcmDspRoutineSignalPos=0
        DataInfo_DID_D211_Network_Management_History_Propulsion_CAN_DID_D211_20_10th_Latest_State_Global_Real_Time (DcmDspDataInfo): DcmDspDataFixedLength=true
        DidInfo_DID_E300_HVDC_Voltage (DcmDspDidInfo)
          DcmDspDidAccess
            DcmDspDidRead: DcmDspDidReadSessionRef=defaultSession, DcmDspDidReadSessionRef=extendedDiagnosticSession
        3 x DcmDspData, all with DcmDspDataSize=8, DcmDspDataType=UINT8, DcmDspDataUsePort=USE_DATA_ASYNCH_CLIENT_SERVER:
          DID_D005_High_Quiescent_Current_Fault_Identification_Data_D005_4st_Functionality_Activity_Level_PNC27: DcmDspDataInfoRef=DataInfo_DID_D005_High_Quiescent_Current_Fault_Identification_Data_D005_4st_Functionality_Activity_Level_PNC27
          DID_D005_High_Quiescent_Current_Fault_Identification_Data_D005_4st_Functionality_Activity_Level_PNC29: DcmDspDataInfoRef=DataInfo_DID_D005_High_Quiescent_Current_Fault_Identification_Data_D005_4st_Functionality_Activity_Level_PNC29
          DID_D005_High_Quiescent_Current_Fault_Identification_Data_Functionality_Activity_Level_Detect_Motor_Speed_Abnormal_2st: DcmDspDataInfoRef=DataInfo_DID_D005_High_Quiescent_Current_Fault_Identification_Data_Functionality_Activity_Level_Detect_Motor_Speed_Abnormal_2st
        DataInfo_DID_ED20_Complete_set_of_ECU_part_serial_numbers_Geely_ASCII_part_003 (DcmDspDataInfo): DcmDspDataFixedLength=true
        DataInfo_DID_ED20_Complete_set_of_ECU_part_serial_numbers_Geely_ASCII_part_002 (DcmDspDataInfo): DcmDspDataFixedLength=true
        DID_D005_High_Quiescent_Current_Fault_Identification_Data_D005_4st_Functionality_Activity_Level_PNC24 (DcmDspData):
          DcmDspDataSize = 8
          DcmDspDataType = UINT8
          DcmDspDataUsePort = USE_DATA_ASYNCH_CLIENT_SERVER
          DcmDspDataInfoRef = DataInfo_DID_D005_High_Quiescent_Current_Fault_Identification_Data_D005_4st_Functionality_Activity_Level_PNC24
        DataInfo_DID_ED20_Complete_set_of_ECU_part_serial_numbers_Geely_ASCII_part_001 (DcmDspDataInfo): DcmDspDataFixedLength=true
        DID_D005_High_Quiescent_Current_Fault_Identification_Data_D005_4st_Functionality_Activity_Level_PNC25 (DcmDspData):
          DcmDspDataSize = 8
          DcmDspDataType = UINT8
          DcmDspDataUsePort = USE_DATA_ASYNCH_CLIENT_SERVER
          DcmDspDataInfoRef = DataInfo_DID_D005_High_Quiescent_Current_Fault_Identification_Data_D005_4st_Functionality_Activity_Level_PNC25
        DataInfo_DID_D005_High_Quiescent_Current_Fault_Identification_Data_Functionality_Activity_Level_Detect_DC_Bus_voltage_Ab895ea3c2 (DcmDspDataInfo): DcmDspDataFixedLength=true
        DataInfo_DID_F1AE_ECU_Software_Part_Numbers_Geely_BCD_part (DcmDspDataInfo): DcmDspDataFixedLength=true
        5 x DcmDspData, all with DcmDspDataUsePort=USE_DATA_ASYNCH_CLIENT_SERVER:
          DID_D211_Network_Management_History_Propulsion_CAN_DID_D211_12_6th_Latest_State_Global_Real_Time: DcmDspDataSize=32, DcmDspDataType=UINT32, DcmDspDataInfoRef=DataInfo_DID_D211_Network_Management_History_Propulsion_CAN_DID_D211_12_6th_Latest_State_Global_Real_Time
          DID_D005_High_Quiescent_Current_Fault_Identification_Data_D005_4st_Functionality_Activity_Level_PNC26: DcmDspDataSize=8, DcmDspDataType=UINT8, DcmDspDataInfoRef=DataInfo_DID_D005_High_Quiescent_Current_Fault_Identification_Data_D005_4st_Functionality_Activity_Level_PNC26
          DID_D005_High_Quiescent_Current_Fault_Identification_Data_D005_4st_Functionality_Activity_Level_PNC30: DcmDspDataSize=8, DcmDspDataType=UINT8, DcmDspDataInfoRef=DataInfo_DID_D005_High_Quiescent_Current_Fault_Identification_Data_D005_4st_Functionality_Activity_Level_PNC30
          DID_EDA0_Complete_ECU_Part_Serial_Number_s_ASCII_part: DcmDspDataSize=24, DcmDspDataType=UINT8_N, DcmDspDataInfoRef=DataInfo_DID_EDA0_Complete_ECU_Part_Serial_Number_s_ASCII_part
          DID_F126_Autosar_BSW_Cluster_Versions_DID_F126_21_COM_CLUSTER_SW_PATCH_VERSION: DcmDspDataSize=8, DcmDspDataType=UINT8, DcmDspDataInfoRef=DataInfo_DID_F126_Autosar_BSW_Cluster_Versions_DID_F126_21_COM_CLUSTER_SW_PATCH_VERSION
        DataInfo_DID_E363_Modulation_index_DID_E363_Modulation_index (DcmDspDataInfo): DcmDspDataFixedLength=true
        5 x DcmDspData, all with DcmDspDataUsePort=USE_DATA_ASYNCH_CLIENT_SERVER:
          DID_D005_High_Quiescent_Current_Fault_Identification_Data_D005_3st_Functionality_Activity_Level_PNC35: DcmDspDataSize=8, DcmDspDataType=UINT8, DcmDspDataInfoRef=DataInfo_DID_D005_High_Quiescent_Current_Fault_Identification_Data_D005_3st_Functionality_Activity_Level_PNC35
          DID_E338_q_axis_current_feedback_DID_E338_q_axis_current_feedback: DcmDspDataSize=16, DcmDspDataType=UINT16, DcmDspDataInfoRef=DataInfo_DID_E338_q_axis_current_feedback_DID_E338_q_axis_current_feedback
          DID_F12E_ECU_Software_Part_Numbers_BCD_part: DcmDspDataSize=32, DcmDspDataType=UINT32, DcmDspDataInfoRef=DataInfo_DID_F12E_ECU_Software_Part_Numbers_BCD_part
          DID_D005_High_Quiescent_Current_Fault_Identification_Data_Reserved_PNC_2st: DcmDspDataSize=56, DcmDspDataType=UINT8_N, DcmDspDataInfoRef=DataInfo_DID_D005_High_Quiescent_Current_Fault_Identification_Data_Reserved_PNC_2st
          DID_D005_High_Quiescent_Current_Fault_Identification_Data_D005_3st_Functionality_Activity_Level_PNC39: DcmDspDataSize=8, DcmDspDataType=UINT8, DcmDspDataInfoRef=DataInfo_DID_D005_High_Quiescent_Current_Fault_Identification_Data_D005_3st_Functionality_Activity_Level_PNC39
        DataInfo_DID_D005_High_Quiescent_Current_Fault_Identification_Data_Bitfield_5th (DcmDspDataInfo): DcmDspDataFixedLength=true
        DID_DD01_Total_Distance (DcmDspDid):
          DcmDspDidIdentifier = 56577
          DcmDspDidUsed = true
          DcmDspDidUsePort = USE_DATA_ELEMENT_SPECIFIC_INTERFACES
          DcmDspDidInfoRef = DidInfo_DID_DD01_Total_Distance
          DID_DD01_Total_Distance (DcmDspDidSignal): DcmDspDidDataPos=0, DcmDspDidDataRef=DID_DD01_Total_Distance_DID_DD01_Total_Distance
        DataInfo_DID_D005_High_Quiescent_Current_Fault_Identification_Data_Functionality_Activity_Level_Detect_Motor_Speed_Abnormal_5st (DcmDspDataInfo): DcmDspDataFixedLength=true
        DID_D005_High_Quiescent_Current_Fault_Identification_Data_D005_3st_Functionality_Activity_Level_PNC30 (DcmDspData):
          DcmDspDataSize = 8
          DcmDspDataType = UINT8
          DcmDspDataUsePort = USE_DATA_ASYNCH_CLIENT_SERVER
          DcmDspDataInfoRef = DataInfo_DID_D005_High_Quiescent_Current_Fault_Identification_Data_D005_3st_Functionality_Activity_Level_PNC30
        DataInfo_DID_F12A_ECU_Core_Assembly_Part_Number_BCD_part (DcmDspDataInfo): DcmDspDataFixedLength=true
        DID_F126_Autosar_BSW_Cluster_Versions_DID_F126_16_MODEMGMT_CLUSTER_AR_RELEASE_MINOR_VERSION (DcmDspData):
          DcmDspDataSize = 8
          DcmDspDataType = UINT8
          DcmDspDataUsePort = USE_DATA_ASYNCH_CLIENT_SERVER
          DcmDspDataInfoRef = DataInfo_DID_F126_Autosar_BSW_Cluster_Versions_DID_F126_16_MODEMGMT_CLUSTER_AR_RELEASE_MINOR_VERSION
        DID_D005_High_Quiescent_Current_Fault_Identification_Data_Bitfield_2th (DcmDspData):
          DcmDspDataSize = 8
          DcmDspDataType = UINT8_N
          DcmDspDataUsePort = USE_DATA_ASYNCH_CLIENT_SERVER
          DcmDspDataInfoRef = DataInfo_DID_D005_High_Quiescent_Current_Fault_Identification_Data_Bitfield_2th
        DataInfo_DID_D211_Network_Management_History_Propulsion_CAN_DID_D211_11_6th_Latest_State_NM_History (DcmDspDataInfo): DcmDspDataFixedLength=true
        4 x DcmDspData, all with DcmDspDataUsePort=USE_DATA_ASYNCH_CLIENT_SERVER:
          DID_D005_High_Quiescent_Current_Fault_Identification_Data_D005_4st_Functionality_Activity_Level_PNC39: DcmDspDataSize=8, DcmDspDataType=UINT8, DcmDspDataInfoRef=DataInfo_DID_D005_High_Quiescent_Current_Fault_Identification_Data_D005_4st_Functionality_Activity_Level_PNC39
          DID_D005_High_Quiescent_Current_Fault_Identification_Data_D005_4st_Functionality_Activity_Level_PNC35: DcmDspDataSize=8, DcmDspDataType=UINT8, DcmDspDataInfoRef=DataInfo_DID_D005_High_Quiescent_Current_Fault_Identification_Data_D005_4st_Functionality_Activity_Level_PNC35
          DID_EF0A_Active_Discharge_Time_DID_EF0A_Active_Discharge_Time: DcmDspDataSize=8, DcmDspDataType=UINT8, DcmDspDataInfoRef=DataInfo_DID_EF0A_Active_Discharge_Time_DID_EF0A_Active_Discharge_Time
          DID_EF1C_EOL_config_word_B_DID_EF1C_EOL_config_word_B: DcmDspDataSize=320, DcmDspDataType=UINT8_N, DcmDspDataInfoRef=DataInfo_DID_EF1C_EOL_config_word_B_DID_EF1C_EOL_config_word_B
        DID_E320_System_Mode_Mismatch (DcmDspDid):
          DcmDspDidIdentifier = 58144
          DcmDspDidUsed = true
          DcmDspDidUsePort = USE_DATA_ELEMENT_SPECIFIC_INTERFACES
          DcmDspDidInfoRef = DidInfo_DID_E320_System_Mode_Mismatch
          DID_E320_System_Mode_Mismatch (DcmDspDidSignal): DcmDspDidDataPos=0, DcmDspDidDataRef=DID_E320_System_Mode_Mismatch_DID_E320_System_Mode_Mismatch
        DataInfo_DID_D003_Vehicle_Speed_DID_D003_Vehicle_Speed (DcmDspDataInfo): DcmDspDataFixedLength=true
        DID_F126_Autosar_BSW_Cluster_Versions_DID_F126_8_DIAG_CLUSTER_VCC_DEM_VERSION (DcmDspData):
          DcmDspDataSize = 8
          DcmDspDataType = UINT8
          DcmDspDataUsePort = USE_DATA_ASYNCH_CLIENT_SERVER
          DcmDspDataInfoRef = DataInfo_DID_F126_Autosar_BSW_Cluster_Versions_DID_F126_8_DIAG_CLUSTER_VCC_DEM_VERSION
        DID_E103_Car_Configuration_Parameter_Faults_DID_E103_3_1st_parameter_invalid_value (DcmDspData):
          DcmDspDataSize = 8
          DcmDspDataType = UINT8
          DcmDspDataUsePort = USE_DATA_ASYNCH_CLIENT_SERVER
          DcmDspDataInfoRef = DataInfo_DID_E103_Car_Configuration_Parameter_Faults_DID_E103_3_1st_parameter_invalid_value
        DID_F12F_ECU_Software_Extended_Part_Numbers (DcmDspDid):
          DcmDspDidIdentifier = 61743
          DcmDspDidUsed = true
          DcmDspDidUsePort = USE_DATA_ELEMENT_SPECIFIC_INTERFACES
          DcmDspDidInfoRef = DidInfo_DID_F12F_ECU_Software_Extended_Part_Numbers
          21 x DcmDspDidSignal:
            ASCII_part_009: DcmDspDidDataPos=544, DcmDspDidDataRef=DID_F12F_ECU_Software_Extended_Part_Numbers_ASCII_part_009
            BCD_part_005: DcmDspDidDataPos=288, DcmDspDidDataRef=DID_F12F_ECU_Software_Extended_Part_Numbers_BCD_part_005
            BCD_part_006: DcmDspDidDataPos=344, DcmDspDidDataRef=DID_F12F_ECU_Software_Extended_Part_Numbers_BCD_part_006
            BCD_part_003: DcmDspDidDataPos=176, DcmDspDidDataRef=DID_F12F_ECU_Software_Extended_Part_Numbers_BCD_part_003
            BCD_part_004: DcmDspDidDataPos=232, DcmDspDidDataRef=DID_F12F_ECU_Software_Extended_Part_Numbers_BCD_part_004
            ASCII_part_005: DcmDspDidDataPos=320, DcmDspDidDataRef=DID_F12F_ECU_Software_Extended_Part_Numbers_ASCII_part_005
            BCD_part_001: DcmDspDidDataPos=64, DcmDspDidDataRef=DID_F12F_ECU_Software_Extended_Part_Numbers_BCD_part_001
            ASCII_part_006: DcmDspDidDataPos=376, DcmDspDidDataRef=DID_F12F_ECU_Software_Extended_Part_Numbers_ASCII_part_006
            BCD_part_002: DcmDspDidDataPos=120, DcmDspDidDataRef=DID_F12F_ECU_Software_Extended_Part_Numbers_BCD_part_002
            ASCII_part_007: DcmDspDidDataPos=432, DcmDspDidDataRef=DID_F12F_ECU_Software_Extended_Part_Numbers_ASCII_part_007
            ASCII_part_008: DcmDspDidDataPos=488, DcmDspDidDataRef=DID_F12F_ECU_Software_Extended_Part_Numbers_ASCII_part_008
            BCD_part: DcmDspDidDataPos=8, DcmDspDidDataRef=DID_F12F_ECU_Software_Extended_Part_Numbers_BCD_part
            DID_F12F_1_Total_number_of_ECU_Software_Part_Numbers: DcmDspDidDataPos=0, DcmDspDidDataRef=DID_F12F_ECU_Software_Extended_Part_Numbers_DID_F12F_1_Total_number_of_ECU_Software_Part_Numbers
            ASCII_part_001: DcmDspDidDataPos=96, DcmDspDidDataRef=DID_F12F_ECU_Software_Extended_Part_Numbers_ASCII_part_001
            ASCII_part_002: DcmDspDidDataPos=152, DcmDspDidDataRef=DID_F12F_ECU_Software_Extended_Part_Numbers_ASCII_part_002
            ASCII_part_003: DcmDspDidDataPos=208, DcmDspDidDataRef=DID_F12F_ECU_Software_Extended_Part_Numbers_ASCII_part_003
            ASCII_part_004: DcmDspDidDataPos=264, DcmDspDidDataRef=DID_F12F_ECU_Software_Extended_Part_Numbers_ASCII_part_004
            ASCII_part: DcmDspDidDataPos=40, DcmDspDidDataRef=DID_F12F_ECU_Software_Extended_Part_Numbers_ASCII_part
            BCD_part_009: DcmDspDidDataPos=512, DcmDspDidDataRef=DID_F12F_ECU_Software_Extended_Part_Numbers_BCD_part_009
            BCD_part_007: DcmDspDidDataPos=400, DcmDspDidDataRef=DID_F12F_ECU_Software_Extended_Part_Numbers_BCD_part_007
            BCD_part_008: DcmDspDidDataPos=456, DcmDspDidDataRef=DID_F12F_ECU_Software_Extended_Part_Numbers_BCD_part_008
        DID_EEC4_Charging_Power_Sustain_Relay_CPSR_Voltage (DcmDspDid):
          DcmDspDidIdentifier = 61124
          DcmDspDidUsed = true
          DcmDspDidUsePort = USE_DATA_ELEMENT_SPECIFIC_INTERFACES
          DcmDspDidInfoRef = DidInfo_DID_EEC4_Charging_Power_Sustain_Relay_CPSR_Voltage
          DID_EEC4_Charging_Power_Sustain_RelayCPSR_Voltage (DcmDspDidSignal): DcmDspDidDataPos=0, DcmDspDidDataRef=DID_EEC4_Charging_Power_Sustain_Relay_CPSR_Voltage_DID_EEC4_Charging_Power_Sustain_RelayCPSR_Voltage
        DataInfo_DID_F126_Autosar_BSW_Cluster_Versions_DID_F126_33_FLEXRAY_CLUSTER_SW_MAJOR_VERSION (DcmDspDataInfo): DcmDspDataFixedLength=true
        DataInfo_DID_E103_Car_Configuration_Parameter_Faults_DID_E103_15_7th_parameter_invalid_value (DcmDspDataInfo): DcmDspDataFixedLength=true
        DID_D12F_Security_Constant_Level_11_12_DID_D12F_Security_Constant_Level_1112 (DcmDspData):
          DcmDspDataSize = 40
          DcmDspDataType = UINT8_N
          DcmDspDataUsePort = USE_DATA_ASYNCH_CLIENT_SERVER
          DcmDspDataInfoRef = DataInfo_DID_D12F_Security_Constant_Level_11_12_DID_D12F_Security_Constant_Level_1112
        DID_F12B_ECU_Delivery_Assembly_Part_Number (DcmDspDid):
          DcmDspDidIdentifier = 61739
          DcmDspDidUsed = true
          DcmDspDidUsePort = USE_DATA_ELEMENT_SPECIFIC_INTERFACES
          DcmDspDidInfoRef = DidInfo_DID_F12B_ECU_Delivery_Assembly_Part_Number
          ASCII_part (DcmDspDidSignal): DcmDspDidDataPos=32, DcmDspDidDataRef=DID_F12B_ECU_Delivery_Assembly_Part_Number_ASCII_part
          BCD_part (DcmDspDidSignal): DcmDspDidDataPos=0, DcmDspDidDataRef=DID_F12B_ECU_Delivery_Assembly_Part_Number_BCD_part
        DataInfo_DID_E305_Inverter_IGBT_Junction_Temp_DID_E305_Inverter_IGBT_Junction_Temp (DcmDspDataInfo): DcmDspDataFixedLength=true
        DID_F12A_ECU_Core_Assembly_Part_Number (DcmDspDid):
          DcmDspDidIdentifier = 61738
          DcmDspDidUsed = true
          DcmDspDidUsePort = USE_DATA_ELEMENT_SPECIFIC_INTERFACES
          DcmDspDidInfoRef = DidInfo_DID_F12A_ECU_Core_Assembly_Part_Number
          ASCII_part (DcmDspDidSignal): DcmDspDidDataPos=32, DcmDspDidDataRef=DID_F12A_ECU_Core_Assembly_Part_Number_ASCII_part
          BCD_part (DcmDspDidSignal): DcmDspDidDataPos=0, DcmDspDidDataRef=DID_F12A_ECU_Core_Assembly_Part_Number_BCD_part
        DID_F1A5_Primary_Bootloader_Software_Part_Number_Geely_BCD_part (DcmDspData):
          DcmDspDataSize = 40
          DcmDspDataType = UINT8_N
          DcmDspDataUsePort = USE_DATA_ASYNCH_CLIENT_SERVER
          DcmDspDataInfoRef = DataInfo_DID_F1A5_Primary_Bootloader_Software_Part_Number_Geely_BCD_part
        DID_F126_Autosar_BSW_Cluster_Versions_DID_F126_45_LIN_CLUSTER_AR_RELEASE_REVISION_VERSION (DcmDspData):
          DcmDspDataSize = 8
          DcmDspDataType = UINT8
          DcmDspDataUsePort = USE_DATA_ASYNCH_CLIENT_SERVER
          DcmDspDataInfoRef = DataInfo_DID_F126_Autosar_BSW_Cluster_Versions_DID_F126_45_LIN_CLUSTER_AR_RELEASE_REVISION_VERSION
        DataInfo_DID_D005_High_Quiescent_Current_Fault_Identification_Data_Reserved_Data_Field_4st (DcmDspDataInfo): DcmDspDataFixedLength=true
        DataInfo_DID_D005_High_Quiescent_Current_Fault_Identification_Data_DID_D005_2st_System_Global_Time_the_time_when_the_DID40fc1757 (DcmDspDataInfo): DcmDspDataFixedLength=true
        Application_Diagnostic_Database_Part_Number_Partnumber_Variant (DcmDspData):
          DcmDspDataSize = 24
          DcmDspDataType = UINT8_N
          DcmDspDataUsePort = USE_DATA_ASYNCH_CLIENT_SERVER
          DcmDspDataInfoRef = DataInfo_Application_Diagnostic_Database_Part_Number_Partnumber_Variant
        DID_F126_Autosar_BSW_Cluster_Versions_DID_F126_33_FLEXRAY_CLUSTER_SW_MAJOR_VERSION (DcmDspData):
          DcmDspDataSize = 8
          DcmDspDataType = UINT8
          DcmDspDataUsePort = USE_DATA_ASYNCH_CLIENT_SERVER
          DcmDspDataInfoRef = DataInfo_DID_F126_Autosar_BSW_Cluster_Versions_DID_F126_33_FLEXRAY_CLUSTER_SW_MAJOR_VERSION
        DataInfo_Application_Diagnostic_Database_Part_Number_Partnumber_Main (DcmDspDataInfo): DcmDspDataFixedLength=true
        DID_E346_ECM_Torque_Allowed_Status (DcmDspDid):
          DcmDspDidIdentifier = 58182
          DcmDspDidUsed = true
          DcmDspDidUsePort = USE_DATA_ELEMENT_SPECIFIC_INTERFACES
          DcmDspDidInfoRef = DidInfo_DID_E346_ECM_Torque_Allowed_Status
          DID_E346_ECM_Torque_Allowed_Status (DcmDspDidSignal): DcmDspDidDataPos=0, DcmDspDidDataRef=DID_E346_ECM_Torque_Allowed_Status_DID_E346_ECM_Torque_Allowed_Status
        DidInfo_DID_EDA0_Complete_ECU_Part_Serial_Number_s (DcmDspDidInfo)
          DcmDspDidAccess
            DcmDspDidRead: DcmDspDidReadSessionRef=defaultSession, DcmDspDidReadSessionRef=extendedDiagnosticSession
        DidInfo_DID_E347_IGBT_Max_Temperature (DcmDspDidInfo)
          DcmDspDidAccess
            DcmDspDidRead: DcmDspDidReadSessionRef=defaultSession, DcmDspDidReadSessionRef=extendedDiagnosticSession
        Application_Diagnostic_Database_Part_Number_Partnumber_Main (DcmDspData):
          DcmDspDataSize = 32
          DcmDspDataType = UINT32
          DcmDspDataUsePort = USE_DATA_ASYNCH_CLIENT_SERVER
          DcmDspDataInfoRef = DataInfo_Application_Diagnostic_Database_Part_Number_Partnumber_Main
        DataInfo_DID_EF1D_EOL_config_word_C_DID_EF1D_EOL_config_word_C (DcmDspDataInfo): DcmDspDataFixedLength=true
        DataInfo_DID_F126_Autosar_BSW_Cluster_Versions_DID_F126_34_FLEXRAY_CLUSTER_SW_MINOR_VERSION (DcmDspDataInfo): DcmDspDataFixedLength=true
        DID_EED3_Safety_speed (DcmDspDid):
          DcmDspDidIdentifier = 61139
          DcmDspDidUsed = true
          DcmDspDidUsePort = USE_DATA_ELEMENT_SPECIFIC_INTERFACES
          DcmDspDidInfoRef = DidInfo_DID_EED3_Safety_speed
          DID_EED3_Safety_speed (DcmDspDidSignal): DcmDspDidDataPos=0, DcmDspDidDataRef=DID_EED3_Safety_speed_DID_EED3_Safety_speed
        DID_F126_Autosar_BSW_Cluster_Versions_DID_F126_18_COM_CLUSTER_VENDOR_ID (DcmDspData):
          DcmDspDataSize = 16
          DcmDspDataType = UINT16
          DcmDspDataUsePort = USE_DATA_ASYNCH_CLIENT_SERVER
          DcmDspDataInfoRef = DataInfo_DID_F126_Autosar_BSW_Cluster_Versions_DID_F126_18_COM_CLUSTER_VENDOR_ID
        DID_D211_Network_Management_History_Propulsion_CAN_DID_D211_9_5th_Latest_State_NM_History (DcmDspData):
          DcmDspDataSize = 8
          DcmDspDataType = UINT8
          DcmDspDataUsePort = USE_DATA_ASYNCH_CLIENT_SERVER
          DcmDspDataInfoRef = DataInfo_DID_D211_Network_Management_History_Propulsion_CAN_DID_D211_9_5th_Latest_State_NM_History
        4 x DcmDspDataInfo, all with DcmDspDataFixedLength=true:
          DataInfo_DID_ED20_Complete_set_of_ECU_part_serial_numbers_Geely_BCD_part
          DataInfo_DID_F126_Autosar_BSW_Cluster_Versions_DID_F126_16_MODEMGMT_CLUSTER_AR_RELEASE_MINOR_VERSION
          DataInfo_DID_F126_Autosar_BSW_Cluster_Versions_DID_F126_23_COM_CLUSTER_AR_RELEASE_MINOR_VERSION
          DataInfo_DID_D005_High_Quiescent_Current_Fault_Identification_Data_Functionality_Activity_Level_Detect_DC_Bus_voltage_Ab8e570b1e
        DID_E304_Actual_Torque_DID_E304_Actual_Torque (DcmDspData):
          DcmDspDataSize = 16
          DcmDspDataType = UINT16
          DcmDspDataUsePort = USE_DATA_ASYNCH_CLIENT_SERVER
          DcmDspDataInfoRef = DataInfo_DID_E304_Actual_Torque_DID_E304_Actual_Torque
        DataInfo_DID_F1A1_Primary_Bootloader_Diagnostic_Database_Part_Number_Geely_BCD_part (DcmDspDataInfo): DcmDspDataFixedLength=true
        DataInfo_DID_F121_Primary_Bootloader_Diagnostic_Database_Part_Number_BCD_part (DcmDspDataInfo): DcmDspDataFixedLength=true
        DID_DD0C_Electric_Power_Level (DcmDspDid):
          DcmDspDidIdentifier = 56588
          DcmDspDidUsed = true
          DcmDspDidUsePort = USE_DATA_ELEMENT_SPECIFIC_INTERFACES
          DcmDspDidInfoRef = DidInfo_DID_DD0C_Electric_Power_Level
          DID_DD0C_Electric_Power_Level (DcmDspDidSignal): DcmDspDidDataPos=0, DcmDspDidDataRef=DID_DD0C_Electric_Power_Level_DID_DD0C_Electric_Power_Level
        DataInfo_DID_F125_Primary_Bootloader_Software_Part_Number_BCD_part (DcmDspDataInfo): DcmDspDataFixedLength=true
        DID_D003_Vehicle_Speed_DID_D003_Vehicle_Speed (DcmDspData):
          DcmDspDataSize = 16
          DcmDspDataType = UINT16
          DcmDspDataUsePort = USE_DATA_ASYNCH_CLIENT_SERVER
          DcmDspDataInfoRef = DataInfo_DID_D003_Vehicle_Speed_DID_D003_Vehicle_Speed
        DidInfo_DID_EEB6_ECM_Power_Limitation_maximum (DcmDspDidInfo)
          DcmDspDidAccess
            DcmDspDidRead: DcmDspDidReadSessionRef=defaultSession, DcmDspDidReadSessionRef=extendedDiagnosticSession
        4 x DcmDspDataInfo, all with DcmDspDataFixedLength=true:
          DataInfo_DID_E103_Car_Configuration_Parameter_Faults_DID_E103_18_9th_parameter_number_of_the_car_configuration_data_that4ae7c090
          DataInfo_DID_EDA0_Complete_ECU_Part_Serial_Number_s_ASCII_part
          DataInfo_DID_F12A_ECU_Core_Assembly_Part_Number_ASCII_part
          DataInfo_DID_F126_Autosar_BSW_Cluster_Versions_DID_F126_26_CAN_CLUSTER_SW_MAJOR_VERSION
        DID_F1A0_Application_Diagnostic_Database_Part_Number_Geely (DcmDspDid):
          DcmDspDidIdentifier = 61856
          DcmDspDidUsed = true
          DcmDspDidUsePort = USE_DATA_ELEMENT_SPECIFIC_INTERFACES
          DcmDspDidInfoRef = DidInfo_DID_F1A0_Application_Diagnostic_Database_Part_Number_Geely
          ASCII_part (DcmDspDidSignal): DcmDspDidDataPos=40, DcmDspDidDataRef=DID_F1A0_Application_Diagnostic_Database_Part_Number_Geely_ASCII_part
          BCD_part (DcmDspDidSignal): DcmDspDidDataPos=0, DcmDspDidDataRef=DID_F1A0_Application_Diagnostic_Database_Part_Number_Geely_BCD_part
        DataInfo_DID_D005_High_Quiescent_Current_Fault_Identification_Data_Reserved_PNC_3st (DcmDspDataInfo): DcmDspDataFixedLength=true
        DID_D005_High_Quiescent_Current_Fault_Identification_Data_Reserved_PNC_4st (DcmDspData):
          DcmDspDataSize = 56
          DcmDspDataType = UINT8_N
          DcmDspDataUsePort = USE_DATA_ASYNCH_CLIENT_SERVER
          DcmDspDataInfoRef = DataInfo_DID_D005_High_Quiescent_Current_Fault_Identification_Data_Reserved_PNC_4st
        DID_D211_Network_Management_History_Propulsion_CAN_DID_D211_4_2nd_Latest_State_Global_Real_Time (DcmDspData):
          DcmDspDataSize = 32
          DcmDspDataType = UINT32
          DcmDspDataUsePort = USE_DATA_ASYNCH_CLIENT_SERVER
          DcmDspDataInfoRef = DataInfo_DID_D211_Network_Management_History_Propulsion_CAN_DID_D211_4_2nd_Latest_State_Global_Real_Time
        DataInfo_DID_ED20_Complete_set_of_ECU_part_serial_numbers_Geely_ASCII_part (DcmDspDataInfo): DcmDspDataFixedLength=true
        DataInfo_DID_E304_Actual_Torque_DID_E304_Actual_Torque (DcmDspDataInfo): DcmDspDataFixedLength=true
        DID_E103_Car_Configuration_Parameter_Faults_DID_E103_1_Number_of_invalid_car_configuration_parameter_values_recognised (DcmDspData):
          DcmDspDataSize = 8
          DcmDspDataType = UINT8
          DcmDspDataUsePort = USE_DATA_ASYNCH_CLIENT_SERVER
          DcmDspDataInfoRef = DataInfo_DID_E103_Car_Configuration_Parameter_Faults_DID_E103_1_Number_of_invalid_car_configuration_parameter_values_recognised
        DataInfo_DID_D211_Network_Management_History_Propulsion_CAN_DID_D211_7_4th_Latest_State_NM_History (DcmDspDataInfo): DcmDspDataFixedLength=true
        DID_F126_Autosar_BSW_Cluster_Versions_DID_F126_34_FLEXRAY_CLUSTER_SW_MINOR_VERSION (DcmDspData):
          DcmDspDataSize = 8
          DcmDspDataType = UINT8
          DcmDspDataUsePort = USE_DATA_ASYNCH_CLIENT_SERVER
          DcmDspDataInfoRef = DataInfo_DID_F126_Autosar_BSW_Cluster_Versions_DID_F126_34_FLEXRAY_CLUSTER_SW_MINOR_VERSION
        DidInfo_DID_E336_d_axis_current_feedback (DcmDspDidInfo)
          DcmDspDidAccess
            DcmDspDidRead: DcmDspDidReadSessionRef=defaultSession, DcmDspDidReadSessionRef=extendedDiagnosticSession
        DID_D211_Network_Management_History_Propulsion_CAN_DID_D211_15_8th_Latest_State_NM_History (DcmDspData):
          DcmDspDataSize = 8
          DcmDspDataType = UINT8
          DcmDspDataUsePort = USE_DATA_ASYNCH_CLIENT_SERVER
          DcmDspDataInfoRef = DataInfo_DID_D211_Network_Management_History_Propulsion_CAN_DID_D211_15_8th_Latest_State_NM_History
        DID_EEB2_Three_Phase_Motor_Current_RMS_Current_DID_EEB2_Three_Phase_Motor_Current_RMS_Current (DcmDspData):
          DcmDspDataSize = 16
          DcmDspDataType = UINT16
          DcmDspDataUsePort = USE_DATA_ASYNCH_CLIENT_SERVER
          DcmDspDataInfoRef = DataInfo_DID_EEB2_Three_Phase_Motor_Current_RMS_Current_DID_EEB2_Three_Phase_Motor_Current_RMS_Current
        DataInfo_DID_E348_Phase_U_PWM_duty_DID_E348_Phase_U_PWM_duty (DcmDspDataInfo): DcmDspDataFixedLength=true
        DID_EE9D_Transient_Phase_Current_B_DID_EE9D_Transient_Phase_Current_B (DcmDspData):
          DcmDspDataSize = 16
          DcmDspDataType = UINT16
          DcmDspDataUsePort = USE_DATA_ASYNCH_CLIENT_SERVER
          DcmDspDataInfoRef = DataInfo_DID_EE9D_Transient_Phase_Current_B_DID_EE9D_Transient_Phase_Current_B
        DidInfo_DID_EED1_Safty_monitor_Fault_Indication (DcmDspDidInfo)
          DcmDspDidAccess
            DcmDspDidRead
        DID_D005_High_Quiescent_Current_Fault_Identification_Data_Functionality_Activity_Level_Detect_CPSR_Keep_Active_2st (DcmDspData):
          DcmDspDataSize = 8
          DcmDspDataType = UINT8
          DcmDspDataUsePort = USE_DATA_ASYNCH_CLIENT_SERVER
          DcmDspDataInfoRef = DataInfo_DID_D005_High_Quiescent_Current_Fault_Identification_Data_Functionality_Activity_Level_Detect_CPSR_Keep_Active_2st
        DidInfo_DID_F1A0_Application_Diagnostic_Database_Part_Number_Geely (DcmDspDidInfo)
          DcmDspDidAccess
            DcmDspDidRead: DcmDspDidReadSessionRef=defaultSession, DcmDspDidReadSessionRef=extendedDiagnosticSession
        3 x DcmDspDataInfo, all with DcmDspDataFixedLength=true:
          DataInfo_DID_E307_System_Mode_DID_E307_System_Mode
          DataInfo_DID_F126_Autosar_BSW_Cluster_Versions_DID_F126_32_FLEXRAY_CLUSTER_VENDOR_ID
          DataInfo_DID_D005_High_Quiescent_Current_Fault_Identification_Data_Reserved_Data_Field_2st
        DID_F1A5_Primary_Bootloader_Software_Part_Number_Geely_ASCII_part (DcmDspData):
          DcmDspDataSize = 24
          DcmDspDataType = UINT8_N
          DcmDspDataUsePort = USE_DATA_ASYNCH_CLIENT_SERVER
          DcmDspDataInfoRef = DataInfo_DID_F1A5_Primary_Bootloader_Software_Part_Number_Geely_ASCII_part
        DID_F126_Autosar_BSW_Cluster_Versions_DID_F126_37_FLEXRAY_CLUSTER_AR_RELEASE_MINOR_VERSION (DcmDspData):
          DcmDspDataSize = 8
          DcmDspDataType = UINT8
          DcmDspDataUsePort = USE_DATA_ASYNCH_CLIENT_SERVER
          DcmDspDataInfoRef = DataInfo_DID_F126_Autosar_BSW_Cluster_Versions_DID_F126_37_FLEXRAY_CLUSTER_AR_RELEASE_MINOR_VERSION
        DataInfo_DID_D005_High_Quiescent_Current_Fault_Identification_Data_DID_D005_4st_System_Global_Time_the_time_when_the_DID1302fa0f (DcmDspDataInfo): DcmDspDataFixedLength=true
        DID_E309_ECM_Mode_Request (DcmDspDid):
          DcmDspDidIdentifier = 58121
          DcmDspDidUsed = true
          DcmDspDidUsePort = USE_DATA_ELEMENT_SPECIFIC_INTERFACES
          DcmDspDidInfoRef = DidInfo_DID_E309_ECM_Mode_Request
          DID_E309_ECM_Mode_Request (DcmDspDidSignal): DcmDspDidDataPos=0, DcmDspDidDataRef=DID_E309_ECM_Mode_Request_DID_E309_ECM_Mode_Request
        DataInfo_DID_EEBD_IEM_MGM_rotor_offset_angle_DID_EEBD_IEMMGM_rotor_offset_angle (DcmDspDataInfo): DcmDspDataFixedLength=true
        DidInfo_DID_EF1D_EOL_config_word_C (DcmDspDidInfo)
          DcmDspDidAccess
            DcmDspDidWrite: DcmDspDidWriteSessionRef=extendedDiagnosticSession, DcmDspDidWriteSecurityLevelRef=CommonUnlock_Level_3
            DcmDspDidRead
        DID_F126_Autosar_BSW_Cluster_Versions_DID_F126_43_LIN_CLUSTER_AR_RELEASE_MAJOR_VERSION (DcmDspData):
          DcmDspDataSize = 8
          DcmDspDataType = UINT8
          DcmDspDataUsePort = USE_DATA_ASYNCH_CLIENT_SERVER
          DcmDspDataInfoRef = DataInfo_DID_F126_Autosar_BSW_Cluster_Versions_DID_F126_43_LIN_CLUSTER_AR_RELEASE_MAJOR_VERSION
        DID_E103_Car_Configuration_Parameter_Faults (DcmDspDid):
          DcmDspDidIdentifier = 57603
          DcmDspDidUsed = true
          DcmDspDidUsePort = USE_DATA_ELEMENT_SPECIFIC_INTERFACES
          DcmDspDidInfoRef = DidInfo_DID_E103_Car_Configuration_Parameter_Faults
          21 x DcmDspDidSignal:
            DID_E103_3_1st_parameter_invalid_value: DcmDspDidDataPos=24, DcmDspDidDataRef=DID_E103_Car_Configuration_Parameter_Faults_DID_E103_3_1st_parameter_invalid_value
            DID_E103_1_Number_of_invalid_car_configuration_parameter_values_recognised: DcmDspDidDataPos=0, DcmDspDidDataRef=DID_E103_Car_Configuration_Parameter_Faults_DID_E103_1_Number_of_invalid_car_configuration_parameter_values_recognised
            DID_E103_21_10th_parameter_invalid_value: DcmDspDidDataPos=240, DcmDspDidDataRef=DID_E103_Car_Configuration_Parameter_Faults_DID_E103_21_10th_parameter_invalid_value
            DID_E103_20_10th_parameter_number_of_the_car_configuration_data_that_is_invalid: DcmDspDidDataPos=224, DcmDspDidDataRef=DID_E103_Car_Configuration_Parameter_Faults_DID_E103_20_10th_parameter_number_of_the_car_configuration_data_that_is_invalid
            DID_E103_16_8th_parameter_number_of_the_car_configuration_data_that_is_invalid: DcmDspDidDataPos=176, DcmDspDidDataRef=DID_E103_Car_Configuration_Parameter_Faults_DID_E103_16_8th_parameter_number_of_the_car_configuration_data_that_is_invalid
            DID_E103_12_6th_parameter_number_of_the_car_configuration_data_that_is_invalid: DcmDspDidDataPos=128, DcmDspDidDataRef=DID_E103_Car_Configuration_Parameter_Faults_DID_E103_12_6th_parameter_number_of_the_car_configuration_data_that_is_invalid
            DID_E103_11_5th_parameter_invalid_value: DcmDspDidDataPos=120, DcmDspDidDataRef=DID_E103_Car_Configuration_Parameter_Faults_DID_E103_11_5th_parameter_invalid_value
            DID_E103_15_7th_parameter_invalid_value: DcmDspDidDataPos=168, DcmDspDidDataRef=DID_E103_Car_Configuration_Parameter_Faults_DID_E103_15_7th_parameter_invalid_value
            DID_E103_6_3rd_parameter_number_of_the_car_configuration_data_that_is_invalid: DcmDspDidDataPos=56, DcmDspDidDataRef=DID_E103_Car_Configuration_Parameter_Faults_DID_E103_6_3rd_parameter_number_of_the_car_configuration_data_that_is_invalid
            DID_E103_10_5th_parameter_number_of_the_car_configuration_data_that_is_invalid: DcmDspDidDataPos=104, DcmDspDidDataRef=DID_E103_Car_Configuration_Parameter_Faults_DID_E103_10_5th_parameter_number_of_the_car_configuration_data_that_is_invalid
            DID_E103_8_4th_parameter_number_of_the_car_configuration_data_that_is_invalid: DcmDspDidDataPos=80, DcmDspDidDataRef=DID_E103_Car_Configuration_Parameter_Faults_DID_E103_8_4th_parameter_number_of_the_car_configuration_data_that_is_invalid
            DID_E103_5_2nd_parameter_invalid_value: DcmDspDidDataPos=48, DcmDspDidDataRef=DID_E103_Car_Configuration_Parameter_Faults_DID_E103_5_2nd_parameter_invalid_value
            DID_E103_18_9th_parameter_number_of_the_car_configuration_data_that_is_invalid: DcmDspDidDataPos=200, DcmDspDidDataRef=DID_E103_Car_Configuration_Parameter_Faults_DID_E103_18_9th_parameter_number_of_the_car_configuration_data_that_is_invalid
            DID_E103_4_2nd_parameter_number_of_the_car_configuration_data_that_is_invalid: DcmDspDidDataPos=32, DcmDspDidDataRef=DID_E103_Car_Configuration_Parameter_Faults_DID_E103_4_2nd_parameter_number_of_the_car_configuration_data_that_is_invalid
            DID_E103_14_7th_parameter_number_of_the_car_configuration_data_that_is_invalid: DcmDspDidDataPos=152, DcmDspDidDataRef=DID_E103_Car_Configuration_Parameter_Faults_DID_E103_14_7th_parameter_number_of_the_car_configuration_data_that_is_invalid
            DID_E103_19_9th_parameter_invalid_value: DcmDspDidDataPos=216, DcmDspDidDataRef=DID_E103_Car_Configuration_Parameter_Faults_DID_E103_19_9th_parameter_invalid_value
            DID_E103_9_4th_parameter_invalid_value: DcmDspDidDataPos=96, DcmDspDidDataRef=DID_E103_Car_Configuration_Parameter_Faults_DID_E103_9_4th_parameter_invalid_value
            DID_E103_17_8th_parameter_invalid_value: DcmDspDidDataPos=192, DcmDspDidDataRef=DID_E103_Car_Configuration_Parameter_Faults_DID_E103_17_8th_parameter_invalid_value
            DID_E103_13_6th_parameter_invalid_value: DcmDspDidDataPos=144, DcmDspDidDataRef=DID_E103_Car_Configuration_Parameter_Faults_DID_E103_13_6th_parameter_invalid_value
            DID_E103_2_1st_parameter_number_of_the_car_configuration_data_that_is_invalid: DcmDspDidDataPos=8, DcmDspDidDataRef=DID_E103_Car_Configuration_Parameter_Faults_DID_E103_2_1st_parameter_number_of_the_car_configuration_data_that_is_invalid
            DID_E103_7_3rd_parameter_invalid_value: DcmDspDidDataPos=72, DcmDspDidDataRef=DID_E103_Car_Configuration_Parameter_Faults_DID_E103_7_3rd_parameter_invalid_value
        DID_E311_Crash_Status (DcmDspDid):
          DcmDspDidIdentifier = 58129
          DcmDspDidUsed = true
          DcmDspDidUsePort = USE_DATA_ELEMENT_SPECIFIC_INTERFACES
          DcmDspDidInfoRef = DidInfo_DID_E311_Crash_Status
          DID_E311_Crash_Status (DcmDspDidSignal): DcmDspDidDataPos=0, DcmDspDidDataRef=DID_E311_Crash_Status_DID_E311_Crash_Status
        DID_E358_Resolve_angle_DID_E358_Resolve_angle (DcmDspData):
          DcmDspDataSize = 16
          DcmDspDataType = UINT16
          DcmDspDataUsePort = USE_DATA_ASYNCH_CLIENT_SERVER
          DcmDspDataInfoRef = DataInfo_DID_E358_Resolve_angle_DID_E358_Resolve_angle
        DataInfo_DID_E339_d_axis_voltage_DID_E339_d_axis_voltage (DcmDspDataInfo): DcmDspDataFixedLength=true
        DID_E306_Motor_Temperature_DID_E306_Motor_Temperature (DcmDspData):
          DcmDspDataSize = 8
          DcmDspDataType = UINT8
          DcmDspDataUsePort = USE_DATA_ASYNCH_CLIENT_SERVER
          DcmDspDataInfoRef = DataInfo_DID_E306_Motor_Temperature_DID_E306_Motor_Temperature
        4 x DcmDspDataInfo, all with DcmDspDataFixedLength=true:
          DataInfo_DID_D09A_High_Quiescent_Current_Function_Activation_Deactivation_DID_D09A_High_Quiescent_Current_Function_Activ93b79a05
          DataInfo_DID_F126_Autosar_BSW_Cluster_Versions_DID_F126_8_DIAG_CLUSTER_VCC_DEM_VERSION
          DataInfo_DID_F1AF_ECU_Software_Extended_Part_Numbers_Geely_BCD_part
          DataInfo_DID_E308_ECM_Torque_Request_DID_E308_ECM_Torque_Request
        DID_EEC5_ImobEng2_node_status (DcmDspDid):
          DcmDspDidIdentifier = 61125
          DcmDspDidUsed = true
          DcmDspDidUsePort = USE_DATA_ELEMENT_SPECIFIC_INTERFACES
          DcmDspDidInfoRef = DidInfo_DID_EEC5_ImobEng2_node_status
          DID_EEC5_ImobEng2_node_status (DcmDspDidSignal): DcmDspDidDataPos=0, DcmDspDidDataRef=DID_EEC5_ImobEng2_node_status_DID_EEC5_ImobEng2_node_status
        DID_F12F_ECU_Software_Extended_Part_Numbers_DID_F12F_1_Total_number_of_ECU_Software_Part_Numbers (DcmDspData):
          DcmDspDataSize = 8
          DcmDspDataType = UINT8
          DcmDspDataUsePort = USE_DATA_ASYNCH_CLIENT_SERVER
          DcmDspDataInfoRef = DataInfo_DID_F12F_ECU_Software_Extended_Part_Numbers_DID_F12F_1_Total_number_of_ECU_Software_Part_Numbers
        DidInfo_DID_40E0_Secret_Key_Immobilizer_Target_3 (DcmDspDidInfo)
          DcmDspDidAccess
            DcmDspDidWrite: DcmDspDidWriteSessionRef=extendedDiagnosticSession, DcmDspDidWriteSecurityLevelRef=ImmoUnlocked_Level_4
            DcmDspDidRead: DcmDspDidReadSessionRef=extendedDiagnosticSession, DcmDspDidReadSecurityLevelRef=ImmoUnlocked_Level_4
        P_Lock (DcmDspRoutine):
          DcmDspRequestResultsRoutineSupported = true
          DcmDspStopRoutineSupported = true
          DcmDspRoutineIdentifier = 12389
          DcmDspRoutineFixedLength = false
          DcmDspRoutineUsePort = true
          DcmDspRoutineUsed = true
          DcmDspRoutineInfoRef = RoutineInfo_P_Lock
        DID_E324_Motor_Derating_reason_of_IEM_MGM_DID_E324_Motor_Derating_reason_of_IEMMGM (DcmDspData):
          DcmDspDataSize = 8
          DcmDspDataType = UINT8
          DcmDspDataUsePort = USE_DATA_ASYNCH_CLIENT_SERVER
          DcmDspDataInfoRef = DataInfo_DID_E324_Motor_Derating_reason_of_IEM_MGM_DID_E324_Motor_Derating_reason_of_IEMMGM
        DID_EF0A_Active_Discharge_Time (DcmDspDid):
          DcmDspDidIdentifier = 61194
          DcmDspDidUsed = true
          DcmDspDidUsePort = USE_DATA_ELEMENT_SPECIFIC_INTERFACES
          DcmDspDidInfoRef = DidInfo_DID_EF0A_Active_Discharge_Time
          DID_EF0A_Active_Discharge_Time (DcmDspDidSignal): DcmDspDidDataPos=0, DcmDspDidDataRef=DID_EF0A_Active_Discharge_Time_DID_EF0A_Active_Discharge_Time
        DidInfo_DID_DD02_Vehicle_Battery_Voltage (DcmDspDidInfo)
          DcmDspDidAccess
            DcmDspDidRead: DcmDspDidReadSessionRef=defaultSession, DcmDspDidReadSessionRef=extendedDiagnosticSession
        5 x DcmDspData, all with DcmDspDataUsePort=USE_DATA_ASYNCH_CLIENT_SERVER:
          DID_ED20_Complete_set_of_ECU_part_serial_numbers_Geely_BCD_part_003: DcmDspDataSize=40, DcmDspDataType=UINT8_N, DcmDspDataInfoRef=DataInfo_DID_ED20_Complete_set_of_ECU_part_serial_numbers_Geely_BCD_part_003
          DID_D211_Network_Management_History_Propulsion_CAN_DID_D211_14_7th_Latest_State_Global_Real_Time: DcmDspDataSize=32, DcmDspDataType=UINT32, DcmDspDataInfoRef=DataInfo_DID_D211_Network_Management_History_Propulsion_CAN_DID_D211_14_7th_Latest_State_Global_Real_Time
          DID_ED20_Complete_set_of_ECU_part_serial_numbers_Geely_BCD_part_002: DcmDspDataSize=40, DcmDspDataType=UINT8_N, DcmDspDataInfoRef=DataInfo_DID_ED20_Complete_set_of_ECU_part_serial_numbers_Geely_BCD_part_002
          DID_ED20_Complete_set_of_ECU_part_serial_numbers_Geely_BCD_part_001: DcmDspDataSize=40, DcmDspDataType=UINT8_N, DcmDspDataInfoRef=DataInfo_DID_ED20_Complete_set_of_ECU_part_serial_numbers_Geely_BCD_part_001
          DID_EDA0_Complete_ECU_Part_Serial_Number_s_BCD_part: DcmDspDataSize=32, DcmDspDataType=UINT32, DcmDspDataInfoRef=DataInfo_DID_EDA0_Complete_ECU_Part_Serial_Number_s_BCD_part
        DataInfo_DID_E336_d_axis_current_feedback_DID_E336_d_axis_current_feedback (DcmDspDataInfo): DcmDspDataFixedLength=true
        DID_F126_Autosar_BSW_Cluster_Versions_DID_F126_27_CAN_CLUSTER_SW_MINOR_VERSION (DcmDspData):
          DcmDspDataSize = 8
          DcmDspDataType = UINT8
          DcmDspDataUsePort = USE_DATA_ASYNCH_CLIENT_SERVER
          DcmDspDataInfoRef = DataInfo_DID_F126_Autosar_BSW_Cluster_Versions_DID_F126_27_CAN_CLUSTER_SW_MINOR_VERSION
        DID_E301_HVDC_Current_DID_E301_HVDC_Current_ (DcmDspData):
          DcmDspDataSize = 16
          DcmDspDataType = UINT16
          DcmDspDataUsePort = USE_DATA_ASYNCH_CLIENT_SERVER
          DcmDspDataInfoRef = DataInfo_DID_E301_HVDC_Current_DID_E301_HVDC_Current_
        DataInfo_DID_F126_Autosar_BSW_Cluster_Versions_DID_F126_38_FLEXRAY_CLUSTER_AR_RELEASE_REVISION_VERSION (DcmDspDataInfo): DcmDspDataFixedLength=true
        DataInfo_DID_D005_High_Quiescent_Current_Fault_Identification_Data_Reserved_PNC_5st (DcmDspDataInfo): DcmDspDataFixedLength=true
        DidInfo_DID_EE9C_Transient_Phase_Current_A (DcmDspDidInfo)
          DcmDspDidAccess
            DcmDspDidRead: DcmDspDidReadSessionRef=defaultSession, DcmDspDidReadSessionRef=extendedDiagnosticSession
        DID_D005_High_Quiescent_Current_Fault_Identification_Data_DID_D005_5st_Usage_Mode_when_DID_is_triggered (DcmDspData):
          DcmDspDataSize = 8
          DcmDspDataType = UINT8
          DcmDspDataUsePort = USE_DATA_ASYNCH_CLIENT_SERVER
          DcmDspDataInfoRef = DataInfo_DID_D005_High_Quiescent_Current_Fault_Identification_Data_DID_D005_5st_Usage_Mode_when_DID_is_triggered
        DataInfo_DID_D005_High_Quiescent_Current_Fault_Identification_Data_Bitfield_1th (DcmDspDataInfo): DcmDspDataFixedLength=true
        DID_DD00_Global_Real_Time_DID_DD00_Global_Real_Time (DcmDspData):
          DcmDspDataSize = 32
          DcmDspDataType = UINT32
          DcmDspDataUsePort = USE_DATA_ASYNCH_CLIENT_SERVER
          DcmDspDataInfoRef = DataInfo_DID_DD00_Global_Real_Time_DID_DD00_Global_Real_Time
      DcmPageBufferCfg: DcmPagedBufferEnabled=true

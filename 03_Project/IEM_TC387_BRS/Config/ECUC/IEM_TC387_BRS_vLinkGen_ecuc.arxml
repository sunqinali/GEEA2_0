AUTOSAR XML (schema 00048)
package /ActiveEcuC
  module config vLinkGen: implementation-config-variant=VARIANT-PRE-COMPILE, module-description=vLinkGen_Impl
    vLinkGenMemLayout
      8 x vLinkGenMemoryRegion, all with vLinkGenMemoryRegionAddrOffset=0:
        MemRegion_DSPR_Core0: vLinkGenMemoryRegionSize=245760, vLinkGenMemoryRegionAddress=1879048192, vLinkGenMemoryRegionHwRegion=DSPR0
          RegionBlock_0_DSPR_Core0 (vLinkGenMemoryRegionBlock):
            vLinkGenMemoryRegionBlockPosition = 0
            vLinkGenMemoryRegionBlockSize = 245760
            vLinkGenMemoryRegionBlockAddress = 1879048192
            vLinkGenMemoryRegionBlockBoundary = LOWER
            vLinkGenMemoryRegionBlockInitStage = NONE
        MemRegion_DSPR_Core1: vLinkGenMemoryRegionSize=245760, vLinkGenMemoryRegionAddress=1610612736, vLinkGenMemoryRegionHwRegion=DSPR1
          RegionBlock_0_DSPR_Core1 (vLinkGenMemoryRegionBlock):
            vLinkGenMemoryRegionBlockPosition = 0
            vLinkGenMemoryRegionBlockSize = 245760
            vLinkGenMemoryRegionBlockAddress = 1610612736
            vLinkGenMemoryRegionBlockBoundary = LOWER
            vLinkGenMemoryRegionBlockInitStage = NONE
        MemRegion_DSPR_Core2: vLinkGenMemoryRegionSize=98304, vLinkGenMemoryRegionAddress=1342177280, vLinkGenMemoryRegionHwRegion=DSPR2
          RegionBlock_0_DSPR_Core2 (vLinkGenMemoryRegionBlock):
            vLinkGenMemoryRegionBlockPosition = 0
            vLinkGenMemoryRegionBlockSize = 98304
            vLinkGenMemoryRegionBlockAddress = 1342177280
            vLinkGenMemoryRegionBlockBoundary = LOWER
            vLinkGenMemoryRegionBlockInitStage = NONE
        MemRegion_DSPR_Core3: vLinkGenMemoryRegionSize=98304, vLinkGenMemoryRegionAddress=1073741824, vLinkGenMemoryRegionHwRegion=DSPR3
          RegionBlock_0_DSPR_Core3 (vLinkGenMemoryRegionBlock):
            vLinkGenMemoryRegionBlockPosition = 0
            vLinkGenMemoryRegionBlockSize = 98304
            vLinkGenMemoryRegionBlockAddress = 1073741824
            vLinkGenMemoryRegionBlockBoundary = LOWER
            vLinkGenMemoryRegionBlockInitStage = NONE
        MemRegion_DSPR_Core4: vLinkGenMemoryRegionSize=98304, vLinkGenMemoryRegionAddress=805306368, vLinkGenMemoryRegionHwRegion=DSPR4
          RegionBlock_0_DSPR_Core4 (vLinkGenMemoryRegionBlock):
            vLinkGenMemoryRegionBlockPosition = 0
            vLinkGenMemoryRegionBlockSize = 98304
            vLinkGenMemoryRegionBlockAddress = 805306368
            vLinkGenMemoryRegionBlockBoundary = LOWER
            vLinkGenMemoryRegionBlockInitStage = NONE
        MemRegion_DSPR_Core5: vLinkGenMemoryRegionSize=98304, vLinkGenMemoryRegionAddress=268435456, vLinkGenMemoryRegionHwRegion=DSPR5
          RegionBlock_0_DSPR_Core5 (vLinkGenMemoryRegionBlock):
            vLinkGenMemoryRegionBlockPosition = 0
            vLinkGenMemoryRegionBlockSize = 98304
            vLinkGenMemoryRegionBlockAddress = 268435456
            vLinkGenMemoryRegionBlockBoundary = LOWER
            vLinkGenMemoryRegionBlockInitStage = NONE
        MemRegion_PFlash0_Cached: vLinkGenMemoryRegionSize=3145728, vLinkGenMemoryRegionAddress=2147483648, vLinkGenMemoryRegionHwRegion=PFlash0_Cached
          RegionBlock_Startup_Cached (vLinkGenMemoryRegionBlock):
            vLinkGenMemoryRegionBlockSize = 1280
            vLinkGenMemoryRegionBlockPosition = 0
            vLinkGenMemoryRegionBlockAddress = 2147483648
            vLinkGenMemoryRegionBlockBoundary = LOWER
            vLinkGenMemoryRegionBlockInitStage = NONE
          RegionBlock_PFlash0_Cached (vLinkGenMemoryRegionBlock):
            vLinkGenMemoryRegionBlockPosition = 1
            vLinkGenMemoryRegionBlockSize = 3144448
            vLinkGenMemoryRegionBlockAddress = 2147484928
            vLinkGenMemoryRegionBlockBoundary = LOWER
            vLinkGenMemoryRegionBlockInitStage = NONE
        MemRegion_BMHD0: vLinkGenMemoryRegionSize=512, vLinkGenMemoryRegionAddress=2940207104, vLinkGenMemoryRegionHwRegion=BMHD0
          RegionBlock_BMHD0 (vLinkGenMemoryRegionBlock):
            vLinkGenMemoryRegionBlockPosition = 0
            vLinkGenMemoryRegionBlockSize = 512
            vLinkGenMemoryRegionBlockAddress = 2940207104
            vLinkGenMemoryRegionBlockBoundary = LOWER
            vLinkGenMemoryRegionBlockInitStage = NONE
      34 x vLinkGenLogicalConstGroup:
        OS_CODE: vLinkGenConstGroupPosition=900, vLinkGenConstGroupRegion=RegionBlock_PFlash0_Cached, vLinkGenConstGroupModule=Os
          OS_CODE (vLinkGenConstSectionGroup):
            vLinkGenConstSectionGroupPosition = 0
            vLinkGenConstSectionGroupInit = NONE
            vLinkGenConstSectionGroupInitStage = ONE
            vLinkGenConstSectionGroupGapSize = 16
            vLinkGenConstSectionGroupFlag = vLinkGenConstGroupFlags/ORDERED
            vLinkGenConstSectionGroupFlag = vLinkGenConstGroupFlags/CONTIGUOUS
            vLinkGenConstSectionGroupFlag = vLinkGenConstGroupFlags/FILL
            vLinkGenConstSectionGroupFlag = vLinkGenConstGroupFlags/READ
            vLinkGenConstSectionGroupFlag = vLinkGenConstGroupFlags/EXECUTE
            vLinkGenConstSectionGroupRef = vLinkGenLinkerSections/OS_CODE
            vLinkGenConstSectionGroupRef = OS_OS_COREINITHOOK_CODE
        OS_CONST: vLinkGenConstGroupPosition=910, vLinkGenConstGroupRegion=RegionBlock_PFlash0_Cached, vLinkGenConstGroupModule=Os
          OS_CONST (vLinkGenConstSectionGroup):
            vLinkGenConstSectionGroupPosition = 0
            vLinkGenConstSectionGroupInit = NONE
            vLinkGenConstSectionGroupInitStage = ONE
            vLinkGenConstSectionGroupGapSize = 16
            vLinkGenConstSectionGroupFlag = vLinkGenConstGroupFlags/ORDERED
            vLinkGenConstSectionGroupFlag = vLinkGenConstGroupFlags/CONTIGUOUS
            vLinkGenConstSectionGroupFlag = vLinkGenConstGroupFlags/FILL
            vLinkGenConstSectionGroupFlag = vLinkGenConstGroupFlags/READ
            vLinkGenConstSectionGroupFlag = vLinkGenConstGroupFlags/EXECUTE
            vLinkGenConstSectionGroupRef = vLinkGenLinkerSections/OS_CONST
            vLinkGenConstSectionGroupRef = OS_CONST_FAST
            vLinkGenConstSectionGroupRef = OS_CORE0_CONST
            vLinkGenConstSectionGroupRef = OS_CORE0_CONST_FAST
            vLinkGenConstSectionGroupRef = OS_CORE1_CONST
            vLinkGenConstSectionGroupRef = OS_CORE1_CONST_FAST
            vLinkGenConstSectionGroupRef = OS_CORE2_CONST
            vLinkGenConstSectionGroupRef = OS_CORE2_CONST_FAST
            vLinkGenConstSectionGroupRef = OS_CORE3_CONST
            vLinkGenConstSectionGroupRef = OS_CORE3_CONST_FAST
            vLinkGenConstSectionGroupRef = OS_SystemApplication_OsCore0_CONST
            vLinkGenConstSectionGroupRef = OS_SystemApplication_OsCore0_CONST_FAST
            vLinkGenConstSectionGroupRef = OS_SystemApplication_OsCore1_CONST
            vLinkGenConstSectionGroupRef = OS_SystemApplication_OsCore1_CONST_FAST
            vLinkGenConstSectionGroupRef = OS_SystemApplication_OsCore2_CONST
            vLinkGenConstSectionGroupRef = OS_SystemApplication_OsCore2_CONST_FAST
            vLinkGenConstSectionGroupRef = OS_SystemApplication_OsCore3_CONST
            vLinkGenConstSectionGroupRef = OS_SystemApplication_OsCore3_CONST_FAST
        OS_INTVEC_CODE: vLinkGenConstGroupPosition=5, vLinkGenConstGroupRegion=RegionBlock_PFlash0_Cached, vLinkGenConstGroupModule=Os
          OS_INTVEC_CODE (vLinkGenConstSectionGroup):
            vLinkGenConstSectionGroupPosition = 0
            vLinkGenConstSectionGroupInit = NONE
            vLinkGenConstSectionGroupInitStage = ONE
            vLinkGenConstSectionGroupGapSize = 16
            vLinkGenConstSectionGroupAlignment = 8192
            vLinkGenConstSectionGroupEndAlignment = 8
            vLinkGenConstSectionGroupFlag = vLinkGenConstGroupFlags/ORDERED
            vLinkGenConstSectionGroupFlag = vLinkGenConstGroupFlags/CONTIGUOUS
            vLinkGenConstSectionGroupFlag = vLinkGenConstGroupFlags/FILL
            vLinkGenConstSectionGroupFlag = vLinkGenConstGroupFlags/READ
            vLinkGenConstSectionGroupFlag = vLinkGenConstGroupFlags/EXECUTE
            vLinkGenConstSectionGroupRef = vLinkGenLinkerSections/OS_INTVEC_CODE
        OS_INTVEC_CORE0_CODE: vLinkGenConstGroupPosition=5, vLinkGenConstGroupRegion=RegionBlock_PFlash0_Cached, vLinkGenConstGroupModule=Os
          OS_INTVEC_CORE0_CODE (vLinkGenConstSectionGroup):
            vLinkGenConstSectionGroupPosition = 0
            vLinkGenConstSectionGroupInit = NONE
            vLinkGenConstSectionGroupInitStage = ONE
            vLinkGenConstSectionGroupGapSize = 16
            vLinkGenConstSectionGroupAlignment = 8192
            vLinkGenConstSectionGroupEndAlignment = 8
            vLinkGenConstSectionGroupFlag = vLinkGenConstGroupFlags/ORDERED
            vLinkGenConstSectionGroupFlag = vLinkGenConstGroupFlags/CONTIGUOUS
            vLinkGenConstSectionGroupFlag = vLinkGenConstGroupFlags/FILL
            vLinkGenConstSectionGroupFlag = vLinkGenConstGroupFlags/READ
            vLinkGenConstSectionGroupFlag = vLinkGenConstGroupFlags/EXECUTE
            vLinkGenConstSectionGroupRef = vLinkGenLinkerSections/OS_INTVEC_CORE0_CODE
        OS_EXCVEC_CORE0_CODE: vLinkGenConstGroupPosition=5, vLinkGenConstGroupRegion=RegionBlock_PFlash0_Cached, vLinkGenConstGroupModule=Os
          OS_EXCVEC_CORE0_CODE (vLinkGenConstSectionGroup):
            vLinkGenConstSectionGroupPosition = 0
            vLinkGenConstSectionGroupInit = NONE
            vLinkGenConstSectionGroupInitStage = ONE
            vLinkGenConstSectionGroupGapSize = 16
            vLinkGenConstSectionGroupAlignment = 256
            vLinkGenConstSectionGroupEndAlignment = 8
            vLinkGenConstSectionGroupFlag = vLinkGenConstGroupFlags/ORDERED
            vLinkGenConstSectionGroupFlag = vLinkGenConstGroupFlags/CONTIGUOUS
            vLinkGenConstSectionGroupFlag = vLinkGenConstGroupFlags/FILL
            vLinkGenConstSectionGroupFlag = vLinkGenConstGroupFlags/READ
            vLinkGenConstSectionGroupFlag = vLinkGenConstGroupFlags/EXECUTE
            vLinkGenConstSectionGroupRef = vLinkGenLinkerSections/OS_EXCVEC_CORE0_CODE
        OS_INTVEC_CORE1_CODE: vLinkGenConstGroupPosition=5, vLinkGenConstGroupRegion=RegionBlock_PFlash0_Cached, vLinkGenConstGroupModule=Os
          OS_INTVEC_CORE1_CODE (vLinkGenConstSectionGroup):
            vLinkGenConstSectionGroupPosition = 0
            vLinkGenConstSectionGroupInit = NONE
            vLinkGenConstSectionGroupInitStage = ONE
            vLinkGenConstSectionGroupGapSize = 16
            vLinkGenConstSectionGroupAlignment = 8192
            vLinkGenConstSectionGroupEndAlignment = 8
            vLinkGenConstSectionGroupFlag = vLinkGenConstGroupFlags/ORDERED
            vLinkGenConstSectionGroupFlag = vLinkGenConstGroupFlags/CONTIGUOUS
            vLinkGenConstSectionGroupFlag = vLinkGenConstGroupFlags/FILL
            vLinkGenConstSectionGroupFlag = vLinkGenConstGroupFlags/READ
            vLinkGenConstSectionGroupFlag = vLinkGenConstGroupFlags/EXECUTE
            vLinkGenConstSectionGroupRef = vLinkGenLinkerSections/OS_INTVEC_CORE1_CODE
        OS_EXCVEC_CORE1_CODE: vLinkGenConstGroupPosition=5, vLinkGenConstGroupRegion=RegionBlock_PFlash0_Cached, vLinkGenConstGroupModule=Os
          OS_EXCVEC_CORE1_CODE (vLinkGenConstSectionGroup):
            vLinkGenConstSectionGroupPosition = 0
            vLinkGenConstSectionGroupInit = NONE
            vLinkGenConstSectionGroupInitStage = ONE
            vLinkGenConstSectionGroupGapSize = 16
            vLinkGenConstSectionGroupAlignment = 256
            vLinkGenConstSectionGroupEndAlignment = 8
            vLinkGenConstSectionGroupFlag = vLinkGenConstGroupFlags/ORDERED
            vLinkGenConstSectionGroupFlag = vLinkGenConstGroupFlags/CONTIGUOUS
            vLinkGenConstSectionGroupFlag = vLinkGenConstGroupFlags/FILL
            vLinkGenConstSectionGroupFlag = vLinkGenConstGroupFlags/READ
            vLinkGenConstSectionGroupFlag = vLinkGenConstGroupFlags/EXECUTE
            vLinkGenConstSectionGroupRef = vLinkGenLinkerSections/OS_EXCVEC_CORE1_CODE
        OS_INTVEC_CORE2_CODE: vLinkGenConstGroupPosition=5, vLinkGenConstGroupRegion=RegionBlock_PFlash0_Cached, vLinkGenConstGroupModule=Os
          OS_INTVEC_CORE2_CODE (vLinkGenConstSectionGroup):
            vLinkGenConstSectionGroupPosition = 0
            vLinkGenConstSectionGroupInit = NONE
            vLinkGenConstSectionGroupInitStage = ONE
            vLinkGenConstSectionGroupGapSize = 16
            vLinkGenConstSectionGroupAlignment = 8192
            vLinkGenConstSectionGroupEndAlignment = 8
            vLinkGenConstSectionGroupFlag = vLinkGenConstGroupFlags/ORDERED
            vLinkGenConstSectionGroupFlag = vLinkGenConstGroupFlags/CONTIGUOUS
            vLinkGenConstSectionGroupFlag = vLinkGenConstGroupFlags/FILL
            vLinkGenConstSectionGroupFlag = vLinkGenConstGroupFlags/READ
            vLinkGenConstSectionGroupFlag = vLinkGenConstGroupFlags/EXECUTE
            vLinkGenConstSectionGroupRef = vLinkGenLinkerSections/OS_INTVEC_CORE2_CODE
        OS_EXCVEC_CORE2_CODE: vLinkGenConstGroupPosition=5, vLinkGenConstGroupRegion=RegionBlock_PFlash0_Cached, vLinkGenConstGroupModule=Os
          OS_EXCVEC_CORE2_CODE (vLinkGenConstSectionGroup):
            vLinkGenConstSectionGroupPosition = 0
            vLinkGenConstSectionGroupInit = NONE
            vLinkGenConstSectionGroupInitStage = ONE
            vLinkGenConstSectionGroupGapSize = 16
            vLinkGenConstSectionGroupAlignment = 256
            vLinkGenConstSectionGroupEndAlignment = 8
            vLinkGenConstSectionGroupFlag = vLinkGenConstGroupFlags/ORDERED
            vLinkGenConstSectionGroupFlag = vLinkGenConstGroupFlags/CONTIGUOUS
            vLinkGenConstSectionGroupFlag = vLinkGenConstGroupFlags/FILL
            vLinkGenConstSectionGroupFlag = vLinkGenConstGroupFlags/READ
            vLinkGenConstSectionGroupFlag = vLinkGenConstGroupFlags/EXECUTE
            vLinkGenConstSectionGroupRef = vLinkGenLinkerSections/OS_EXCVEC_CORE2_CODE
        OS_INTVEC_CORE3_CODE: vLinkGenConstGroupPosition=5, vLinkGenConstGroupRegion=RegionBlock_PFlash0_Cached, vLinkGenConstGroupModule=Os
          OS_INTVEC_CORE3_CODE (vLinkGenConstSectionGroup):
            vLinkGenConstSectionGroupPosition = 0
            vLinkGenConstSectionGroupInit = NONE
            vLinkGenConstSectionGroupInitStage = ONE
            vLinkGenConstSectionGroupGapSize = 16
            vLinkGenConstSectionGroupAlignment = 8192
            vLinkGenConstSectionGroupEndAlignment = 8
            vLinkGenConstSectionGroupFlag = vLinkGenConstGroupFlags/ORDERED
            vLinkGenConstSectionGroupFlag = vLinkGenConstGroupFlags/CONTIGUOUS
            vLinkGenConstSectionGroupFlag = vLinkGenConstGroupFlags/FILL
            vLinkGenConstSectionGroupFlag = vLinkGenConstGroupFlags/READ
            vLinkGenConstSectionGroupFlag = vLinkGenConstGroupFlags/EXECUTE
            vLinkGenConstSectionGroupRef = vLinkGenLinkerSections/OS_INTVEC_CORE3_CODE
        OS_EXCVEC_CORE3_CODE: vLinkGenConstGroupPosition=5, vLinkGenConstGroupRegion=RegionBlock_PFlash0_Cached, vLinkGenConstGroupModule=Os
          OS_EXCVEC_CORE3_CODE (vLinkGenConstSectionGroup):
            vLinkGenConstSectionGroupPosition = 0
            vLinkGenConstSectionGroupInit = NONE
            vLinkGenConstSectionGroupInitStage = ONE
            vLinkGenConstSectionGroupGapSize = 16
            vLinkGenConstSectionGroupAlignment = 256
            vLinkGenConstSectionGroupEndAlignment = 8
            vLinkGenConstSectionGroupFlag = vLinkGenConstGroupFlags/ORDERED
            vLinkGenConstSectionGroupFlag = vLinkGenConstGroupFlags/CONTIGUOUS
            vLinkGenConstSectionGroupFlag = vLinkGenConstGroupFlags/FILL
            vLinkGenConstSectionGroupFlag = vLinkGenConstGroupFlags/READ
            vLinkGenConstSectionGroupFlag = vLinkGenConstGroupFlags/EXECUTE
            vLinkGenConstSectionGroupRef = vLinkGenLinkerSections/OS_EXCVEC_CORE3_CODE
        OS_INTVEC_CORE4_CODE: vLinkGenConstGroupPosition=5, vLinkGenConstGroupRegion=RegionBlock_PFlash0_Cached
        OS_EXCVEC_CORE4_CODE: vLinkGenConstGroupPosition=5, vLinkGenConstGroupRegion=RegionBlock_PFlash0_Cached
        OS_INTVEC_CORE5_CODE: vLinkGenConstGroupPosition=5, vLinkGenConstGroupRegion=RegionBlock_PFlash0_Cached
        OS_EXCVEC_CORE5_CODE: vLinkGenConstGroupPosition=5, vLinkGenConstGroupRegion=RegionBlock_PFlash0_Cached
        OS_INTVEC_CONST: vLinkGenConstGroupPosition=5, vLinkGenConstGroupRegion=RegionBlock_PFlash0_Cached, vLinkGenConstGroupModule=Os
          OS_INTVEC_CONST (vLinkGenConstSectionGroup):
            vLinkGenConstSectionGroupPosition = 0
            vLinkGenConstSectionGroupInit = NONE
            vLinkGenConstSectionGroupInitStage = ONE
            vLinkGenConstSectionGroupGapSize = 16
            vLinkGenConstSectionGroupAlignment = 8192
            vLinkGenConstSectionGroupEndAlignment = 8
            vLinkGenConstSectionGroupFlag = vLinkGenConstGroupFlags/ORDERED
            vLinkGenConstSectionGroupFlag = vLinkGenConstGroupFlags/CONTIGUOUS
            vLinkGenConstSectionGroupFlag = vLinkGenConstGroupFlags/FILL
            vLinkGenConstSectionGroupFlag = vLinkGenConstGroupFlags/READ
            vLinkGenConstSectionGroupFlag = vLinkGenConstGroupFlags/EXECUTE
            vLinkGenConstSectionGroupRef = vLinkGenLinkerSections/OS_INTVEC_CONST
        OS_INTVEC_CORE0_CONST: vLinkGenConstGroupPosition=5, vLinkGenConstGroupRegion=RegionBlock_PFlash0_Cached, vLinkGenConstGroupModule=Os
          OS_INTVEC_CORE0_CONST (vLinkGenConstSectionGroup):
            vLinkGenConstSectionGroupPosition = 0
            vLinkGenConstSectionGroupInit = NONE
            vLinkGenConstSectionGroupInitStage = ONE
            vLinkGenConstSectionGroupGapSize = 16
            vLinkGenConstSectionGroupAlignment = 8192
            vLinkGenConstSectionGroupEndAlignment = 8
            vLinkGenConstSectionGroupFlag = vLinkGenConstGroupFlags/ORDERED
            vLinkGenConstSectionGroupFlag = vLinkGenConstGroupFlags/CONTIGUOUS
            vLinkGenConstSectionGroupFlag = vLinkGenConstGroupFlags/FILL
            vLinkGenConstSectionGroupFlag = vLinkGenConstGroupFlags/READ
            vLinkGenConstSectionGroupFlag = vLinkGenConstGroupFlags/EXECUTE
            vLinkGenConstSectionGroupRef = vLinkGenLinkerSections/OS_INTVEC_CORE0_CONST
        OS_EXCVEC_CORE0_CONST: vLinkGenConstGroupPosition=5, vLinkGenConstGroupRegion=RegionBlock_PFlash0_Cached, vLinkGenConstGroupModule=Os
          OS_EXCVEC_CORE0_CONST (vLinkGenConstSectionGroup):
            vLinkGenConstSectionGroupPosition = 0
            vLinkGenConstSectionGroupInit = NONE
            vLinkGenConstSectionGroupInitStage = ONE
            vLinkGenConstSectionGroupGapSize = 16
            vLinkGenConstSectionGroupAlignment = 256
            vLinkGenConstSectionGroupEndAlignment = 8
            vLinkGenConstSectionGroupFlag = vLinkGenConstGroupFlags/ORDERED
            vLinkGenConstSectionGroupFlag = vLinkGenConstGroupFlags/CONTIGUOUS
            vLinkGenConstSectionGroupFlag = vLinkGenConstGroupFlags/FILL
            vLinkGenConstSectionGroupFlag = vLinkGenConstGroupFlags/READ
            vLinkGenConstSectionGroupFlag = vLinkGenConstGroupFlags/EXECUTE
            vLinkGenConstSectionGroupRef = vLinkGenLinkerSections/OS_EXCVEC_CORE0_CONST
        OS_INTVEC_CORE1_CONST: vLinkGenConstGroupPosition=5, vLinkGenConstGroupRegion=RegionBlock_PFlash0_Cached, vLinkGenConstGroupModule=Os
          OS_INTVEC_CORE1_CONST (vLinkGenConstSectionGroup):
            vLinkGenConstSectionGroupPosition = 0
            vLinkGenConstSectionGroupInit = NONE
            vLinkGenConstSectionGroupInitStage = ONE
            vLinkGenConstSectionGroupGapSize = 16
            vLinkGenConstSectionGroupAlignment = 8192
            vLinkGenConstSectionGroupEndAlignment = 8
            vLinkGenConstSectionGroupFlag = vLinkGenConstGroupFlags/ORDERED
            vLinkGenConstSectionGroupFlag = vLinkGenConstGroupFlags/CONTIGUOUS
            vLinkGenConstSectionGroupFlag = vLinkGenConstGroupFlags/FILL
            vLinkGenConstSectionGroupFlag = vLinkGenConstGroupFlags/READ
            vLinkGenConstSectionGroupFlag = vLinkGenConstGroupFlags/EXECUTE
            vLinkGenConstSectionGroupRef = vLinkGenLinkerSections/OS_INTVEC_CORE1_CONST
        OS_EXCVEC_CORE1_CONST: vLinkGenConstGroupPosition=5, vLinkGenConstGroupRegion=RegionBlock_PFlash0_Cached, vLinkGenConstGroupModule=Os
          OS_EXCVEC_CORE1_CONST (vLinkGenConstSectionGroup):
            vLinkGenConstSectionGroupPosition = 0
            vLinkGenConstSectionGroupInit = NONE
            vLinkGenConstSectionGroupInitStage = ONE
            vLinkGenConstSectionGroupGapSize = 16
            vLinkGenConstSectionGroupAlignment = 256
            vLinkGenConstSectionGroupEndAlignment = 8
            vLinkGenConstSectionGroupFlag = vLinkGenConstGroupFlags/ORDERED
            vLinkGenConstSectionGroupFlag = vLinkGenConstGroupFlags/CONTIGUOUS
            vLinkGenConstSectionGroupFlag = vLinkGenConstGroupFlags/FILL
            vLinkGenConstSectionGroupFlag = vLinkGenConstGroupFlags/READ
            vLinkGenConstSectionGroupFlag = vLinkGenConstGroupFlags/EXECUTE
            vLinkGenConstSectionGroupRef = vLinkGenLinkerSections/OS_EXCVEC_CORE1_CONST
        OS_INTVEC_CORE2_CONST: vLinkGenConstGroupPosition=5, vLinkGenConstGroupRegion=RegionBlock_PFlash0_Cached, vLinkGenConstGroupModule=Os
          OS_INTVEC_CORE2_CONST (vLinkGenConstSectionGroup):
            vLinkGenConstSectionGroupPosition = 0
            vLinkGenConstSectionGroupInit = NONE
            vLinkGenConstSectionGroupInitStage = ONE
            vLinkGenConstSectionGroupGapSize = 16
            vLinkGenConstSectionGroupAlignment = 8192
            vLinkGenConstSectionGroupEndAlignment = 8
            vLinkGenConstSectionGroupFlag = vLinkGenConstGroupFlags/ORDERED
            vLinkGenConstSectionGroupFlag = vLinkGenConstGroupFlags/CONTIGUOUS
            vLinkGenConstSectionGroupFlag = vLinkGenConstGroupFlags/FILL
            vLinkGenConstSectionGroupFlag = vLinkGenConstGroupFlags/READ
            vLinkGenConstSectionGroupFlag = vLinkGenConstGroupFlags/EXECUTE
            vLinkGenConstSectionGroupRef = vLinkGenLinkerSections/OS_INTVEC_CORE2_CONST
        OS_EXCVEC_CORE2_CONST: vLinkGenConstGroupPosition=5, vLinkGenConstGroupRegion=RegionBlock_PFlash0_Cached, vLinkGenConstGroupModule=Os
          OS_EXCVEC_CORE2_CONST (vLinkGenConstSectionGroup):
            vLinkGenConstSectionGroupPosition = 0
            vLinkGenConstSectionGroupInit = NONE
            vLinkGenConstSectionGroupInitStage = ONE
            vLinkGenConstSectionGroupGapSize = 16
            vLinkGenConstSectionGroupAlignment = 256
            vLinkGenConstSectionGroupEndAlignment = 8
            vLinkGenConstSectionGroupFlag = vLinkGenConstGroupFlags/ORDERED
            vLinkGenConstSectionGroupFlag = vLinkGenConstGroupFlags/CONTIGUOUS
            vLinkGenConstSectionGroupFlag = vLinkGenConstGroupFlags/FILL
            vLinkGenConstSectionGroupFlag = vLinkGenConstGroupFlags/READ
            vLinkGenConstSectionGroupFlag = vLinkGenConstGroupFlags/EXECUTE
            vLinkGenConstSectionGroupRef = vLinkGenLinkerSections/OS_EXCVEC_CORE2_CONST
        OS_INTVEC_CORE3_CONST: vLinkGenConstGroupPosition=5, vLinkGenConstGroupRegion=RegionBlock_PFlash0_Cached, vLinkGenConstGroupModule=Os
          OS_INTVEC_CORE3_CONST (vLinkGenConstSectionGroup):
            vLinkGenConstSectionGroupPosition = 0
            vLinkGenConstSectionGroupInit = NONE
            vLinkGenConstSectionGroupInitStage = ONE
            vLinkGenConstSectionGroupGapSize = 16
            vLinkGenConstSectionGroupAlignment = 8192
            vLinkGenConstSectionGroupEndAlignment = 8
            vLinkGenConstSectionGroupFlag = vLinkGenConstGroupFlags/ORDERED
            vLinkGenConstSectionGroupFlag = vLinkGenConstGroupFlags/CONTIGUOUS
            vLinkGenConstSectionGroupFlag = vLinkGenConstGroupFlags/FILL
            vLinkGenConstSectionGroupFlag = vLinkGenConstGroupFlags/READ
            vLinkGenConstSectionGroupFlag = vLinkGenConstGroupFlags/EXECUTE
            vLinkGenConstSectionGroupRef = vLinkGenLinkerSections/OS_INTVEC_CORE3_CONST
        OS_EXCVEC_CORE3_CONST: vLinkGenConstGroupPosition=5, vLinkGenConstGroupRegion=RegionBlock_PFlash0_Cached, vLinkGenConstGroupModule=Os
          OS_EXCVEC_CORE3_CONST (vLinkGenConstSectionGroup):
            vLinkGenConstSectionGroupPosition = 0
            vLinkGenConstSectionGroupInit = NONE
            vLinkGenConstSectionGroupInitStage = ONE
            vLinkGenConstSectionGroupGapSize = 16
            vLinkGenConstSectionGroupAlignment = 256
            vLinkGenConstSectionGroupEndAlignment = 8
            vLinkGenConstSectionGroupFlag = vLinkGenConstGroupFlags/ORDERED
            vLinkGenConstSectionGroupFlag = vLinkGenConstGroupFlags/CONTIGUOUS
            vLinkGenConstSectionGroupFlag = vLinkGenConstGroupFlags/FILL
            vLinkGenConstSectionGroupFlag = vLinkGenConstGroupFlags/READ
            vLinkGenConstSectionGroupFlag = vLinkGenConstGroupFlags/EXECUTE
            vLinkGenConstSectionGroupRef = vLinkGenLinkerSections/OS_EXCVEC_CORE3_CONST
        OS_INTVEC_CORE4_CONST: vLinkGenConstGroupPosition=5, vLinkGenConstGroupRegion=RegionBlock_PFlash0_Cached
        OS_EXCVEC_CORE4_CONST: vLinkGenConstGroupPosition=5, vLinkGenConstGroupRegion=RegionBlock_PFlash0_Cached
        OS_INTVEC_CORE5_CONST: vLinkGenConstGroupPosition=5, vLinkGenConstGroupRegion=RegionBlock_PFlash0_Cached
        OS_EXCVEC_CORE5_CONST: vLinkGenConstGroupPosition=5, vLinkGenConstGroupRegion=RegionBlock_PFlash0_Cached
        OS_USER_CODE: vLinkGenConstGroupPosition=5, vLinkGenConstGroupRegion=RegionBlock_PFlash0_Cached, vLinkGenConstGroupModule=Os
          OS_USER_CODE (vLinkGenConstSectionGroup):
            vLinkGenConstSectionGroupPosition = 0
            vLinkGenConstSectionGroupInit = NONE
            vLinkGenConstSectionGroupInitStage = ONE
            vLinkGenConstSectionGroupGapSize = 16
            vLinkGenConstSectionGroupFlag = vLinkGenConstGroupFlags/ORDERED
            vLinkGenConstSectionGroupFlag = vLinkGenConstGroupFlags/CONTIGUOUS
            vLinkGenConstSectionGroupFlag = vLinkGenConstGroupFlags/FILL
            vLinkGenConstSectionGroupFlag = vLinkGenConstGroupFlags/READ
            vLinkGenConstSectionGroupFlag = vLinkGenConstGroupFlags/EXECUTE
            vLinkGenConstSectionGroupRef = OS_ERRORHOOK_CODE
            vLinkGenConstSectionGroupRef = OS_Task_Com_5ms_CODE
            vLinkGenConstSectionGroupRef = OS_Task_Appl_10ms_CODE
            vLinkGenConstSectionGroupRef = OS_Task_Bsw_10ms_CODE
            vLinkGenConstSectionGroupRef = OS_Default_Init_Task_CODE
            vLinkGenConstSectionGroupRef = OS_Task_EcuM_Core3_CODE
            vLinkGenConstSectionGroupRef = OS_Default_Init_Task_Trusted_CODE
            vLinkGenConstSectionGroupRef = OS_Task_EcuM_Core1_CODE
            vLinkGenConstSectionGroupRef = OS_Task_Appl_100ms_CODE
            vLinkGenConstSectionGroupRef = OS_Default_Init_Task_Core{1..3}_Trusted_CODE
            vLinkGenConstSectionGroupRef = OS_Default_Init_Task_Core2_CODE
            vLinkGenConstSectionGroupRef = OS_Default_Init_Task_Core3_CODE
            vLinkGenConstSectionGroupRef = OS_Default_Init_Task_Core1_CODE
            vLinkGenConstSectionGroupRef = OS_CanIsr_3_CODE
        OS_USER_CONST: vLinkGenConstGroupPosition=5, vLinkGenConstGroupRegion=RegionBlock_PFlash0_Cached, vLinkGenConstGroupModule=Os
          OS_USER_CONST (vLinkGenConstSectionGroup):
            vLinkGenConstSectionGroupPosition = 0
            vLinkGenConstSectionGroupInit = NONE
            vLinkGenConstSectionGroupInitStage = ONE
            vLinkGenConstSectionGroupGapSize = 16
            vLinkGenConstSectionGroupFlag = vLinkGenConstGroupFlags/ORDERED
            vLinkGenConstSectionGroupFlag = vLinkGenConstGroupFlags/CONTIGUOUS
            vLinkGenConstSectionGroupFlag = vLinkGenConstGroupFlags/FILL
            vLinkGenConstSectionGroupFlag = vLinkGenConstGroupFlags/READ
            vLinkGenConstSectionGroupFlag = vLinkGenConstGroupFlags/EXECUTE
            vLinkGenConstSectionGroupRef = OS_OsApplication_CONST
            vLinkGenConstSectionGroupRef = OS_OsApplication_CONST_FAST
            vLinkGenConstSectionGroupRef = OS_OsApplication_Core1_CONST
            vLinkGenConstSectionGroupRef = OS_OsApplication_Core1_CONST_FAST
            vLinkGenConstSectionGroupRef = OS_OsApplication_Core2_CONST
            vLinkGenConstSectionGroupRef = OS_OsApplication_Core2_CONST_FAST
            vLinkGenConstSectionGroupRef = OS_OsApplication_Core3_CONST
            vLinkGenConstSectionGroupRef = OS_OsApplication_Core3_CONST_FAST
        OS_GLOBALSHARED_CONST: vLinkGenConstGroupPosition=5, vLinkGenConstGroupRegion=RegionBlock_PFlash0_Cached, vLinkGenConstGroupModule=Os
          OS_GLOBALSHARED_CONST (vLinkGenConstSectionGroup):
            vLinkGenConstSectionGroupPosition = 0
            vLinkGenConstSectionGroupInit = NONE
            vLinkGenConstSectionGroupInitStage = ONE
            vLinkGenConstSectionGroupGapSize = 16
            vLinkGenConstSectionGroupFlag = vLinkGenConstGroupFlags/ORDERED
            vLinkGenConstSectionGroupFlag = vLinkGenConstGroupFlags/CONTIGUOUS
            vLinkGenConstSectionGroupFlag = vLinkGenConstGroupFlags/FILL
            vLinkGenConstSectionGroupFlag = vLinkGenConstGroupFlags/READ
            vLinkGenConstSectionGroupFlag = vLinkGenConstGroupFlags/EXECUTE
            vLinkGenConstSectionGroupRef = vLinkGenLinkerSections/OS_GLOBALSHARED_CONST
            vLinkGenConstSectionGroupRef = OS_GLOBALSHARED_CONST_FAST
        Const_Default: vLinkGenConstGroupPosition=1000, vLinkGenConstGroupRegion=RegionBlock_PFlash0_Cached
          3 x vLinkGenConstSectionGroup, all with vLinkGenConstSectionGroupPosition=0, vLinkGenConstSectionGroupInit=NONE, vLinkGenConstSectionGroupInitStage=ONE, vLinkGenConstSectionGroupFlag=vLinkGenConstGroupFlags/ORDERED, vLinkGenConstSectionGroupFlag=vLinkGenConstGroupFlags/CONTIGUOUS, vLinkGenConstSectionGroupFlag=vLinkGenConstGroupFlags/FILL, vLinkGenConstSectionGroupFlag=vLinkGenConstGroupFlags/READ, vLinkGenConstSectionGroupFlag=vLinkGenConstGroupFlags/EXECUTE:
            text: vLinkGenConstSectionGroupRef=vLinkGenLinkerSections/text
            rodata: vLinkGenConstSectionGroupRef=vLinkGenLinkerSections/rodata
            zrodata: vLinkGenConstSectionGroupRef=vLinkGenLinkerSections/zrodata
        BMHD0: vLinkGenConstGroupPosition=5, vLinkGenConstGroupRegion=RegionBlock_BMHD0
          BMHD0 (vLinkGenConstSectionGroup):
            vLinkGenConstSectionGroupAlignment = 4
            vLinkGenConstSectionGroupPosition = 0
            vLinkGenConstSectionGroupInit = NONE
            vLinkGenConstSectionGroupInitStage = ONE
            vLinkGenConstSectionGroupFlag = vLinkGenConstGroupFlags/ORDERED
            vLinkGenConstSectionGroupFlag = vLinkGenConstGroupFlags/CONTIGUOUS
            vLinkGenConstSectionGroupFlag = vLinkGenConstGroupFlags/FILL
            vLinkGenConstSectionGroupFlag = vLinkGenConstGroupFlags/READ
            vLinkGenConstSectionGroupFlag = vLinkGenConstGroupFlags/EXECUTE
            vLinkGenConstSectionGroupRef = vLinkGenLinkerSections/BMHD0
        Startup_Code: vLinkGenConstGroupPosition=0, vLinkGenConstGroupRegion=RegionBlock_Startup_Cached
          Startup_Code (vLinkGenConstSectionGroup):
            vLinkGenConstSectionGroupAlignment = 4
            vLinkGenConstSectionGroupPosition = 0
            vLinkGenConstSectionGroupInit = NONE
            vLinkGenConstSectionGroupInitStage = ONE
            vLinkGenConstSectionGroupFlag = vLinkGenConstGroupFlags/ORDERED
            vLinkGenConstSectionGroupFlag = vLinkGenConstGroupFlags/CONTIGUOUS
            vLinkGenConstSectionGroupFlag = vLinkGenConstGroupFlags/FILL
            vLinkGenConstSectionGroupFlag = vLinkGenConstGroupFlags/READ
            vLinkGenConstSectionGroupFlag = vLinkGenConstGroupFlags/EXECUTE
            vLinkGenConstSectionGroupRef = brsStartup
      27 x vLinkGenLogicalVarGroup:
        OS_STACKS_CORE0_VAR: vLinkGenVarGroupPosition=5, vLinkGenVarGroupRegion=RegionBlock_0_DSPR_Core0, vLinkGenVarGroupModule=Os
          OS_STACKS_CORE0_VAR_NOINIT (vLinkGenVarSectionGroup):
            vLinkGenVarSectionGroupPosition = 0
            vLinkGenVarSectionGroupInit = NONE
            vLinkGenVarSectionGroupInitStage = ONE
            vLinkGenVarSectionGroupGapSize = 16
            vLinkGenVarSectionGroupAlignment = 16
            vLinkGenVarSectionGroupFlag = vLinkGenVarGroupFlags/ORDERED
            vLinkGenVarSectionGroupFlag = vLinkGenVarGroupFlags/CONTIGUOUS
            vLinkGenVarSectionGroupFlag = vLinkGenVarGroupFlags/FILL
            vLinkGenVarSectionGroupFlag = vLinkGenVarGroupFlags/READ
            vLinkGenVarSectionGroupFlag = vLinkGenVarGroupFlags/WRITE
            vLinkGenVarSectionGroupRef = OS_STACK_OSCORE0_ERROR_VAR_NOINIT
            vLinkGenVarSectionGroupRef = OS_STACK_OSCORE0_INIT_VAR_NOINIT
            vLinkGenVarSectionGroupRef = OS_STACK_OSCORE0_KERNEL_VAR_NOINIT
            vLinkGenVarSectionGroupRef = OS_STACK_OSCORE0_TASK_PRIO20_VAR_NOINIT
            vLinkGenVarSectionGroupRef = OS_STACK_OSCORE0_TASK_PRIO40_VAR_NOINIT
            vLinkGenVarSectionGroupRef = OS_STACK_OSCORE0_ISR_CORE_VAR_NOINIT
            vLinkGenVarSectionGroupRef = OS_STACK_OSCORE0_TASK_PRIO4294967295_VAR_NOINIT
            vLinkGenVarSectionGroupRef = OS_STACK_OSCORE0_TASK_PRIO49_VAR_NOINIT
            vLinkGenVarSectionGroupRef = OS_STACK_OSCORE0_TASK_PRIO50_VAR_NOINIT
        OS_STACKS_CORE1_VAR: vLinkGenVarGroupPosition=5, vLinkGenVarGroupRegion=RegionBlock_0_DSPR_Core1, vLinkGenVarGroupModule=Os
          OS_STACKS_CORE1_VAR_NOINIT (vLinkGenVarSectionGroup):
            vLinkGenVarSectionGroupPosition = 0
            vLinkGenVarSectionGroupInit = NONE
            vLinkGenVarSectionGroupInitStage = ONE
            vLinkGenVarSectionGroupGapSize = 16
            vLinkGenVarSectionGroupAlignment = 16
            vLinkGenVarSectionGroupFlag = vLinkGenVarGroupFlags/ORDERED
            vLinkGenVarSectionGroupFlag = vLinkGenVarGroupFlags/CONTIGUOUS
            vLinkGenVarSectionGroupFlag = vLinkGenVarGroupFlags/FILL
            vLinkGenVarSectionGroupFlag = vLinkGenVarGroupFlags/READ
            vLinkGenVarSectionGroupFlag = vLinkGenVarGroupFlags/WRITE
            vLinkGenVarSectionGroupRef = OS_STACK_OSCORE1_ERROR_VAR_NOINIT
            vLinkGenVarSectionGroupRef = OS_STACK_OSCORE1_INIT_VAR_NOINIT
            vLinkGenVarSectionGroupRef = OS_STACK_OSCORE1_KERNEL_VAR_NOINIT
            vLinkGenVarSectionGroupRef = OS_STACK_OSCORE1_TASK_PRIO4294967295_VAR_NOINIT
            vLinkGenVarSectionGroupRef = OS_STACK_OSCORE1_TASK_PRIO5_VAR_NOINIT
            vLinkGenVarSectionGroupRef = OS_STACK_OSCORE1_TASK_PRIO49_VAR_NOINIT
            vLinkGenVarSectionGroupRef = OS_STACK_OSCORE1_TASK_PRIO50_VAR_NOINIT
        OS_STACKS_CORE2_VAR: vLinkGenVarGroupPosition=5, vLinkGenVarGroupRegion=RegionBlock_0_DSPR_Core2, vLinkGenVarGroupModule=Os
          OS_STACKS_CORE2_VAR_NOINIT (vLinkGenVarSectionGroup):
            vLinkGenVarSectionGroupPosition = 0
            vLinkGenVarSectionGroupInit = NONE
            vLinkGenVarSectionGroupInitStage = ONE
            vLinkGenVarSectionGroupGapSize = 16
            vLinkGenVarSectionGroupAlignment = 16
            vLinkGenVarSectionGroupFlag = vLinkGenVarGroupFlags/ORDERED
            vLinkGenVarSectionGroupFlag = vLinkGenVarGroupFlags/CONTIGUOUS
            vLinkGenVarSectionGroupFlag = vLinkGenVarGroupFlags/FILL
            vLinkGenVarSectionGroupFlag = vLinkGenVarGroupFlags/READ
            vLinkGenVarSectionGroupFlag = vLinkGenVarGroupFlags/WRITE
            vLinkGenVarSectionGroupRef = OS_STACK_OSCORE2_ERROR_VAR_NOINIT
            vLinkGenVarSectionGroupRef = OS_STACK_OSCORE2_INIT_VAR_NOINIT
            vLinkGenVarSectionGroupRef = OS_STACK_OSCORE2_KERNEL_VAR_NOINIT
            vLinkGenVarSectionGroupRef = OS_STACK_OSCORE2_TASK_PRIO10_VAR_NOINIT
            vLinkGenVarSectionGroupRef = OS_STACK_OSCORE2_TASK_PRIO15_VAR_NOINIT
            vLinkGenVarSectionGroupRef = OS_STACK_OSCORE2_ISR_CORE_VAR_NOINIT
            vLinkGenVarSectionGroupRef = OS_STACK_OSCORE2_TASK_PRIO4294967295_VAR_NOINIT
            vLinkGenVarSectionGroupRef = OS_STACK_OSCORE2_TASK_PRIO49_VAR_NOINIT
            vLinkGenVarSectionGroupRef = OS_STACK_OSCORE2_TASK_PRIO50_VAR_NOINIT
        OS_STACKS_CORE3_VAR: vLinkGenVarGroupPosition=5, vLinkGenVarGroupRegion=RegionBlock_0_DSPR_Core3, vLinkGenVarGroupModule=Os
          OS_STACKS_CORE3_VAR_NOINIT (vLinkGenVarSectionGroup):
            vLinkGenVarSectionGroupPosition = 0
            vLinkGenVarSectionGroupInit = NONE
            vLinkGenVarSectionGroupInitStage = ONE
            vLinkGenVarSectionGroupGapSize = 16
            vLinkGenVarSectionGroupAlignment = 16
            vLinkGenVarSectionGroupFlag = vLinkGenVarGroupFlags/ORDERED
            vLinkGenVarSectionGroupFlag = vLinkGenVarGroupFlags/CONTIGUOUS
            vLinkGenVarSectionGroupFlag = vLinkGenVarGroupFlags/FILL
            vLinkGenVarSectionGroupFlag = vLinkGenVarGroupFlags/READ
            vLinkGenVarSectionGroupFlag = vLinkGenVarGroupFlags/WRITE
            vLinkGenVarSectionGroupRef = OS_STACK_OSCORE3_ERROR_VAR_NOINIT
            vLinkGenVarSectionGroupRef = OS_STACK_OSCORE3_INIT_VAR_NOINIT
            vLinkGenVarSectionGroupRef = OS_STACK_OSCORE3_KERNEL_VAR_NOINIT
            vLinkGenVarSectionGroupRef = OS_STACK_OSCORE3_TASK_PRIO4294967295_VAR_NOINIT
            vLinkGenVarSectionGroupRef = OS_STACK_OSCORE3_TASK_PRIO5_VAR_NOINIT
            vLinkGenVarSectionGroupRef = OS_STACK_OSCORE3_TASK_PRIO49_VAR_NOINIT
            vLinkGenVarSectionGroupRef = OS_STACK_OSCORE3_TASK_PRIO50_VAR_NOINIT
        OS_STACKS_CORE4_VAR: vLinkGenVarGroupPosition=5, vLinkGenVarGroupRegion=RegionBlock_0_DSPR_Core4
        OS_STACKS_CORE5_VAR: vLinkGenVarGroupPosition=5, vLinkGenVarGroupRegion=RegionBlock_0_DSPR_Core5
        OS_DATA_CORE0_VAR: vLinkGenVarGroupInitCore=0, vLinkGenVarGroupPosition=5, vLinkGenVarGroupRegion=RegionBlock_0_DSPR_Core0, vLinkGenVarGroupRomRegion=RegionBlock_PFlash0_Cached, vLinkGenVarGroupModule=Os
          8 x vLinkGenVarSectionGroup, all with vLinkGenVarSectionGroupPosition=0, vLinkGenVarSectionGroupInitStage=ONE, vLinkGenVarSectionGroupGapSize=16, vLinkGenVarSectionGroupAlignment=16, vLinkGenVarSectionGroupFlag=vLinkGenVarGroupFlags/ORDERED, vLinkGenVarSectionGroupFlag=vLinkGenVarGroupFlags/CONTIGUOUS, vLinkGenVarSectionGroupFlag=vLinkGenVarGroupFlags/FILL, vLinkGenVarSectionGroupFlag=vLinkGenVarGroupFlags/READ, vLinkGenVarSectionGroupFlag=vLinkGenVarGroupFlags/WRITE:
            OS_DATA_CORE0_VAR_NOINIT: vLinkGenVarSectionGroupInit=NONE, vLinkGenVarSectionGroupRef=OS_CORE0_VAR_NOINIT, vLinkGenVarSectionGroupRef=OS_CORE0_VAR_NOCACHE_NOINIT, vLinkGenVarSectionGroupRef=OS_SystemApplication_OsCore0_VAR_NOINIT, vLinkGenVarSectionGroupRef=OS_SystemApplication_OsCore0_VAR_NOCACHE_NOINIT
            OS_DATA_CORE0_VAR_FAST_NOINIT: vLinkGenVarSectionGroupInit=NONE, vLinkGenVarSectionGroupRef=OS_CORE0_VAR_FAST_NOINIT, vLinkGenVarSectionGroupRef=OS_CORE0_VAR_FAST_NOCACHE_NOINIT, vLinkGenVarSectionGroupRef=OS_SystemApplication_OsCore0_VAR_FAST_NOINIT, vLinkGenVarSectionGroupRef=OS_SystemApplication_OsCore0_VAR_FAST_NOCACHE_NOINIT
            OS_DATA_CORE0_VAR_INIT: vLinkGenVarSectionGroupInit=INIT, vLinkGenVarSectionGroupEndAlignment=4, vLinkGenVarSectionGroupRef=OS_CORE0_VAR, vLinkGenVarSectionGroupRef=OS_CORE0_VAR_NOCACHE, vLinkGenVarSectionGroupRef=OS_SystemApplication_OsCore0_VAR, vLinkGenVarSectionGroupRef=OS_SystemApplication_OsCore0_VAR_NOCACHE
            OS_DATA_CORE0_VAR_FAST_INIT: vLinkGenVarSectionGroupInit=INIT, vLinkGenVarSectionGroupEndAlignment=4, vLinkGenVarSectionGroupRef=OS_CORE0_VAR_FAST, vLinkGenVarSectionGroupRef=OS_CORE0_VAR_FAST_NOCACHE, vLinkGenVarSectionGroupRef=OS_SystemApplication_OsCore0_VAR_FAST, vLinkGenVarSectionGroupRef=OS_SystemApplication_OsCore0_VAR_FAST_NOCACHE
            OS_DATA_CORE0_VAR_ZERO_INIT: vLinkGenVarSectionGroupInit=ZERO_INIT, vLinkGenVarSectionGroupEndAlignment=4, vLinkGenVarSectionGroupRef=OS_SystemApplication_OsCore0_VAR_ZERO_INIT, vLinkGenVarSectionGroupRef=OS_SystemApplication_OsCore0_VAR_NOCACHE_ZERO_INIT
            OS_DATA_CORE0_VAR_FAST_ZERO_INIT: vLinkGenVarSectionGroupInit=ZERO_INIT, vLinkGenVarSectionGroupEndAlignment=4, vLinkGenVarSectionGroupRef=OS_SystemApplication_OsCore0_VAR_FAST_ZERO_INIT, vLinkGenVarSectionGroupRef=OS_SystemApplication_OsCore0_VAR_FAST_NOCACHE_ZERO_INIT
            OS_DATA_CORE0_VAR_ZERO_INIT_bss: vLinkGenVarSectionGroupInit=ZERO_INIT, vLinkGenVarSectionGroupEndAlignment=4, vLinkGenVarSectionGroupRef=OS_SystemApplication_OsCore0_VAR_ZERO_INIT_bss, vLinkGenVarSectionGroupRef=OS_SystemApplication_OsCore0_VAR_NOCACHE_ZERO_INIT_bss
            OS_DATA_CORE0_VAR_FAST_ZERO_INIT_bss: vLinkGenVarSectionGroupInit=ZERO_INIT, vLinkGenVarSectionGroupEndAlignment=4, vLinkGenVarSectionGroupRef=OS_SystemApplication_OsCore0_VAR_FAST_ZERO_INIT_bss, vLinkGenVarSectionGroupRef=OS_SystemApplication_OsCore0_VAR_FAST_NOCACHE_ZERO_INIT_bss
        OS_DATA_CORE1_VAR: vLinkGenVarGroupInitCore=1, vLinkGenVarGroupPosition=5, vLinkGenVarGroupRegion=RegionBlock_0_DSPR_Core1, vLinkGenVarGroupRomRegion=RegionBlock_PFlash0_Cached, vLinkGenVarGroupModule=Os
          8 x vLinkGenVarSectionGroup, all with vLinkGenVarSectionGroupPosition=0, vLinkGenVarSectionGroupInitStage=ONE, vLinkGenVarSectionGroupGapSize=16, vLinkGenVarSectionGroupAlignment=16, vLinkGenVarSectionGroupFlag=vLinkGenVarGroupFlags/ORDERED, vLinkGenVarSectionGroupFlag=vLinkGenVarGroupFlags/CONTIGUOUS, vLinkGenVarSectionGroupFlag=vLinkGenVarGroupFlags/FILL, vLinkGenVarSectionGroupFlag=vLinkGenVarGroupFlags/READ, vLinkGenVarSectionGroupFlag=vLinkGenVarGroupFlags/WRITE:
            OS_DATA_CORE1_VAR_NOINIT: vLinkGenVarSectionGroupInit=NONE, vLinkGenVarSectionGroupRef=OS_CORE1_VAR_NOINIT, vLinkGenVarSectionGroupRef=OS_CORE1_VAR_NOCACHE_NOINIT, vLinkGenVarSectionGroupRef=OS_SystemApplication_OsCore1_VAR_NOINIT, vLinkGenVarSectionGroupRef=OS_SystemApplication_OsCore1_VAR_NOCACHE_NOINIT
            OS_DATA_CORE1_VAR_FAST_NOINIT: vLinkGenVarSectionGroupInit=NONE, vLinkGenVarSectionGroupRef=OS_CORE1_VAR_FAST_NOINIT, vLinkGenVarSectionGroupRef=OS_CORE1_VAR_FAST_NOCACHE_NOINIT, vLinkGenVarSectionGroupRef=OS_SystemApplication_OsCore1_VAR_FAST_NOINIT, vLinkGenVarSectionGroupRef=OS_SystemApplication_OsCore1_VAR_FAST_NOCACHE_NOINIT
            OS_DATA_CORE1_VAR_INIT: vLinkGenVarSectionGroupInit=INIT, vLinkGenVarSectionGroupEndAlignment=4, vLinkGenVarSectionGroupRef=OS_CORE1_VAR, vLinkGenVarSectionGroupRef=OS_CORE1_VAR_NOCACHE, vLinkGenVarSectionGroupRef=OS_SystemApplication_OsCore1_VAR, vLinkGenVarSectionGroupRef=OS_SystemApplication_OsCore1_VAR_NOCACHE
            OS_DATA_CORE1_VAR_FAST_INIT: vLinkGenVarSectionGroupInit=INIT, vLinkGenVarSectionGroupEndAlignment=4, vLinkGenVarSectionGroupRef=OS_CORE1_VAR_FAST, vLinkGenVarSectionGroupRef=OS_CORE1_VAR_FAST_NOCACHE, vLinkGenVarSectionGroupRef=OS_SystemApplication_OsCore1_VAR_FAST, vLinkGenVarSectionGroupRef=OS_SystemApplication_OsCore1_VAR_FAST_NOCACHE
            OS_DATA_CORE1_VAR_ZERO_INIT: vLinkGenVarSectionGroupInit=ZERO_INIT, vLinkGenVarSectionGroupEndAlignment=4, vLinkGenVarSectionGroupRef=OS_SystemApplication_OsCore1_VAR_ZERO_INIT, vLinkGenVarSectionGroupRef=OS_SystemApplication_OsCore1_VAR_NOCACHE_ZERO_INIT
            OS_DATA_CORE1_VAR_FAST_ZERO_INIT: vLinkGenVarSectionGroupInit=ZERO_INIT, vLinkGenVarSectionGroupEndAlignment=4, vLinkGenVarSectionGroupRef=OS_SystemApplication_OsCore1_VAR_FAST_ZERO_INIT, vLinkGenVarSectionGroupRef=OS_SystemApplication_OsCore1_VAR_FAST_NOCACHE_ZERO_INIT
            OS_DATA_CORE1_VAR_ZERO_INIT_bss: vLinkGenVarSectionGroupInit=ZERO_INIT, vLinkGenVarSectionGroupEndAlignment=4, vLinkGenVarSectionGroupRef=OS_SystemApplication_OsCore1_VAR_ZERO_INIT_bss, vLinkGenVarSectionGroupRef=OS_SystemApplication_OsCore1_VAR_NOCACHE_ZERO_INIT_bss
            OS_DATA_CORE1_VAR_FAST_ZERO_INIT_bss: vLinkGenVarSectionGroupInit=ZERO_INIT, vLinkGenVarSectionGroupEndAlignment=4, vLinkGenVarSectionGroupRef=OS_SystemApplication_OsCore1_VAR_FAST_ZERO_INIT_bss, vLinkGenVarSectionGroupRef=OS_SystemApplication_OsCore1_VAR_FAST_NOCACHE_ZERO_INIT_bss
        OS_DATA_CORE2_VAR: vLinkGenVarGroupInitCore=2, vLinkGenVarGroupPosition=5, vLinkGenVarGroupRegion=RegionBlock_0_DSPR_Core2, vLinkGenVarGroupRomRegion=RegionBlock_PFlash0_Cached, vLinkGenVarGroupModule=Os
          8 x vLinkGenVarSectionGroup, all with vLinkGenVarSectionGroupPosition=0, vLinkGenVarSectionGroupInitStage=ONE, vLinkGenVarSectionGroupGapSize=16, vLinkGenVarSectionGroupAlignment=16, vLinkGenVarSectionGroupFlag=vLinkGenVarGroupFlags/ORDERED, vLinkGenVarSectionGroupFlag=vLinkGenVarGroupFlags/CONTIGUOUS, vLinkGenVarSectionGroupFlag=vLinkGenVarGroupFlags/FILL, vLinkGenVarSectionGroupFlag=vLinkGenVarGroupFlags/READ, vLinkGenVarSectionGroupFlag=vLinkGenVarGroupFlags/WRITE:
            OS_DATA_CORE2_VAR_NOINIT: vLinkGenVarSectionGroupInit=NONE, vLinkGenVarSectionGroupRef=OS_CORE2_VAR_NOINIT, vLinkGenVarSectionGroupRef=OS_CORE2_VAR_NOCACHE_NOINIT, vLinkGenVarSectionGroupRef=OS_SystemApplication_OsCore2_VAR_NOINIT, vLinkGenVarSectionGroupRef=OS_SystemApplication_OsCore2_VAR_NOCACHE_NOINIT
            OS_DATA_CORE2_VAR_FAST_NOINIT: vLinkGenVarSectionGroupInit=NONE, vLinkGenVarSectionGroupRef=OS_CORE2_VAR_FAST_NOINIT, vLinkGenVarSectionGroupRef=OS_CORE2_VAR_FAST_NOCACHE_NOINIT, vLinkGenVarSectionGroupRef=OS_SystemApplication_OsCore2_VAR_FAST_NOINIT, vLinkGenVarSectionGroupRef=OS_SystemApplication_OsCore2_VAR_FAST_NOCACHE_NOINIT
            OS_DATA_CORE2_VAR_INIT: vLinkGenVarSectionGroupInit=INIT, vLinkGenVarSectionGroupEndAlignment=4, vLinkGenVarSectionGroupRef=OS_CORE2_VAR, vLinkGenVarSectionGroupRef=OS_CORE2_VAR_NOCACHE, vLinkGenVarSectionGroupRef=OS_SystemApplication_OsCore2_VAR, vLinkGenVarSectionGroupRef=OS_SystemApplication_OsCore2_VAR_NOCACHE
            OS_DATA_CORE2_VAR_FAST_INIT: vLinkGenVarSectionGroupInit=INIT, vLinkGenVarSectionGroupEndAlignment=4, vLinkGenVarSectionGroupRef=OS_CORE2_VAR_FAST, vLinkGenVarSectionGroupRef=OS_CORE2_VAR_FAST_NOCACHE, vLinkGenVarSectionGroupRef=OS_SystemApplication_OsCore2_VAR_FAST, vLinkGenVarSectionGroupRef=OS_SystemApplication_OsCore2_VAR_FAST_NOCACHE
            OS_DATA_CORE2_VAR_ZERO_INIT: vLinkGenVarSectionGroupInit=ZERO_INIT, vLinkGenVarSectionGroupEndAlignment=4, vLinkGenVarSectionGroupRef=OS_SystemApplication_OsCore2_VAR_ZERO_INIT, vLinkGenVarSectionGroupRef=OS_SystemApplication_OsCore2_VAR_NOCACHE_ZERO_INIT
            OS_DATA_CORE2_VAR_FAST_ZERO_INIT: vLinkGenVarSectionGroupInit=ZERO_INIT, vLinkGenVarSectionGroupEndAlignment=4, vLinkGenVarSectionGroupRef=OS_SystemApplication_OsCore2_VAR_FAST_ZERO_INIT, vLinkGenVarSectionGroupRef=OS_SystemApplication_OsCore2_VAR_FAST_NOCACHE_ZERO_INIT
            OS_DATA_CORE2_VAR_ZERO_INIT_bss: vLinkGenVarSectionGroupInit=ZERO_INIT, vLinkGenVarSectionGroupEndAlignment=4, vLinkGenVarSectionGroupRef=OS_SystemApplication_OsCore2_VAR_ZERO_INIT_bss, vLinkGenVarSectionGroupRef=OS_SystemApplication_OsCore2_VAR_NOCACHE_ZERO_INIT_bss
            OS_DATA_CORE2_VAR_FAST_ZERO_INIT_bss: vLinkGenVarSectionGroupInit=ZERO_INIT, vLinkGenVarSectionGroupEndAlignment=4, vLinkGenVarSectionGroupRef=OS_SystemApplication_OsCore2_VAR_FAST_ZERO_INIT_bss, vLinkGenVarSectionGroupRef=OS_SystemApplication_OsCore2_VAR_FAST_NOCACHE_ZERO_INIT_bss
        OS_DATA_CORE3_VAR: vLinkGenVarGroupInitCore=3, vLinkGenVarGroupPosition=5, vLinkGenVarGroupRegion=RegionBlock_0_DSPR_Core3, vLinkGenVarGroupRomRegion=RegionBlock_PFlash0_Cached, vLinkGenVarGroupModule=Os
          8 x vLinkGenVarSectionGroup, all with vLinkGenVarSectionGroupPosition=0, vLinkGenVarSectionGroupInitStage=ONE, vLinkGenVarSectionGroupGapSize=16, vLinkGenVarSectionGroupAlignment=16, vLinkGenVarSectionGroupFlag=vLinkGenVarGroupFlags/ORDERED, vLinkGenVarSectionGroupFlag=vLinkGenVarGroupFlags/CONTIGUOUS, vLinkGenVarSectionGroupFlag=vLinkGenVarGroupFlags/FILL, vLinkGenVarSectionGroupFlag=vLinkGenVarGroupFlags/READ, vLinkGenVarSectionGroupFlag=vLinkGenVarGroupFlags/WRITE:
            OS_DATA_CORE3_VAR_NOINIT: vLinkGenVarSectionGroupInit=NONE, vLinkGenVarSectionGroupRef=OS_CORE3_VAR_NOINIT, vLinkGenVarSectionGroupRef=OS_CORE3_VAR_NOCACHE_NOINIT, vLinkGenVarSectionGroupRef=OS_SystemApplication_OsCore3_VAR_NOINIT, vLinkGenVarSectionGroupRef=OS_SystemApplication_OsCore3_VAR_NOCACHE_NOINIT
            OS_DATA_CORE3_VAR_FAST_NOINIT: vLinkGenVarSectionGroupInit=NONE, vLinkGenVarSectionGroupRef=OS_CORE3_VAR_FAST_NOINIT, vLinkGenVarSectionGroupRef=OS_CORE3_VAR_FAST_NOCACHE_NOINIT, vLinkGenVarSectionGroupRef=OS_SystemApplication_OsCore3_VAR_FAST_NOINIT, vLinkGenVarSectionGroupRef=OS_SystemApplication_OsCore3_VAR_FAST_NOCACHE_NOINIT
            OS_DATA_CORE3_VAR_INIT: vLinkGenVarSectionGroupInit=INIT, vLinkGenVarSectionGroupEndAlignment=4, vLinkGenVarSectionGroupRef=OS_CORE3_VAR, vLinkGenVarSectionGroupRef=OS_CORE3_VAR_NOCACHE, vLinkGenVarSectionGroupRef=OS_SystemApplication_OsCore3_VAR, vLinkGenVarSectionGroupRef=OS_SystemApplication_OsCore3_VAR_NOCACHE
            OS_DATA_CORE3_VAR_FAST_INIT: vLinkGenVarSectionGroupInit=INIT, vLinkGenVarSectionGroupEndAlignment=4, vLinkGenVarSectionGroupRef=OS_CORE3_VAR_FAST, vLinkGenVarSectionGroupRef=OS_CORE3_VAR_FAST_NOCACHE, vLinkGenVarSectionGroupRef=OS_SystemApplication_OsCore3_VAR_FAST, vLinkGenVarSectionGroupRef=OS_SystemApplication_OsCore3_VAR_FAST_NOCACHE
            OS_DATA_CORE3_VAR_ZERO_INIT: vLinkGenVarSectionGroupInit=ZERO_INIT, vLinkGenVarSectionGroupEndAlignment=4, vLinkGenVarSectionGroupRef=OS_SystemApplication_OsCore3_VAR_ZERO_INIT, vLinkGenVarSectionGroupRef=OS_SystemApplication_OsCore3_VAR_NOCACHE_ZERO_INIT
            OS_DATA_CORE3_VAR_FAST_ZERO_INIT: vLinkGenVarSectionGroupInit=ZERO_INIT, vLinkGenVarSectionGroupEndAlignment=4, vLinkGenVarSectionGroupRef=OS_SystemApplication_OsCore3_VAR_FAST_ZERO_INIT, vLinkGenVarSectionGroupRef=OS_SystemApplication_OsCore3_VAR_FAST_NOCACHE_ZERO_INIT
            OS_DATA_CORE3_VAR_ZERO_INIT_bss: vLinkGenVarSectionGroupInit=ZERO_INIT, vLinkGenVarSectionGroupEndAlignment=4, vLinkGenVarSectionGroupRef=OS_SystemApplication_OsCore3_VAR_ZERO_INIT_bss, vLinkGenVarSectionGroupRef=OS_SystemApplication_OsCore3_VAR_NOCACHE_ZERO_INIT_bss
            OS_DATA_CORE3_VAR_FAST_ZERO_INIT_bss: vLinkGenVarSectionGroupInit=ZERO_INIT, vLinkGenVarSectionGroupEndAlignment=4, vLinkGenVarSectionGroupRef=OS_SystemApplication_OsCore3_VAR_FAST_ZERO_INIT_bss, vLinkGenVarSectionGroupRef=OS_SystemApplication_OsCore3_VAR_FAST_NOCACHE_ZERO_INIT_bss
        OS_DATA_CORE4_VAR: vLinkGenVarGroupInitCore=4, vLinkGenVarGroupPosition=5, vLinkGenVarGroupRegion=RegionBlock_0_DSPR_Core4, vLinkGenVarGroupRomRegion=RegionBlock_PFlash0_Cached
        OS_DATA_CORE5_VAR: vLinkGenVarGroupInitCore=6, vLinkGenVarGroupPosition=5, vLinkGenVarGroupRegion=RegionBlock_0_DSPR_Core5, vLinkGenVarGroupRomRegion=RegionBlock_PFlash0_Cached
        OS_DATA_SHARED_VAR: vLinkGenVarGroupInitCore=0, vLinkGenVarGroupPosition=5, vLinkGenVarGroupRegion=RegionBlock_0_DSPR_Core0, vLinkGenVarGroupRomRegion=RegionBlock_PFlash0_Cached, vLinkGenVarGroupModule=Os
          4 x vLinkGenVarSectionGroup, all with vLinkGenVarSectionGroupPosition=0, vLinkGenVarSectionGroupInitStage=ONE, vLinkGenVarSectionGroupGapSize=16, vLinkGenVarSectionGroupAlignment=16, vLinkGenVarSectionGroupFlag=vLinkGenVarGroupFlags/ORDERED, vLinkGenVarSectionGroupFlag=vLinkGenVarGroupFlags/CONTIGUOUS, vLinkGenVarSectionGroupFlag=vLinkGenVarGroupFlags/FILL, vLinkGenVarSectionGroupFlag=vLinkGenVarGroupFlags/READ, vLinkGenVarSectionGroupFlag=vLinkGenVarGroupFlags/WRITE:
            OS_DATA_SHARED_VAR_NOINIT: vLinkGenVarSectionGroupInit=NONE, vLinkGenVarSectionGroupRef=OS_VAR_NOCACHE_NOINIT, vLinkGenVarSectionGroupRef=OS_CORESTATUS_CORE0_VAR_NOCACHE_NOINIT, vLinkGenVarSectionGroupRef=OS_PUBLIC_CORE0_VAR_NOINIT, vLinkGenVarSectionGroupRef=OS_BARRIER_CORE0_VAR_NOCACHE_NOINIT, vLinkGenVarSectionGroupRef=OS_CORESTATUS_CORE1_VAR_NOCACHE_NOINIT, vLinkGenVarSectionGroupRef=OS_PUBLIC_CORE1_VAR_NOINIT, vLinkGenVarSectionGroupRef=OS_BARRIER_CORE1_VAR_NOCACHE_NOINIT, vLinkGenVarSectionGroupRef=OS_CORESTATUS_CORE2_VAR_NOCACHE_NOINIT, vLinkGenVarSectionGroupRef=OS_PUBLIC_CORE2_VAR_NOINIT, vLinkGenVarSectionGroupRef=OS_BARRIER_CORE2_VAR_NOCACHE_NOINIT, vLinkGenVarSectionGroupRef=OS_CORESTATUS_CORE3_VAR_NOCACHE_NOINIT, vLinkGenVarSectionGroupRef=OS_PUBLIC_CORE3_VAR_NOINIT, vLinkGenVarSectionGroupRef=OS_BARRIER_CORE3_VAR_NOCACHE_NOINIT
            OS_DATA_SHARED_VAR_FAST_NOINIT: vLinkGenVarSectionGroupInit=NONE, vLinkGenVarSectionGroupRef=OS_VAR_FAST_NOCACHE_NOINIT, vLinkGenVarSectionGroupRef=OS_CORESTATUS_CORE0_VAR_FAST_NOCACHE_NOINIT, vLinkGenVarSectionGroupRef=OS_PUBLIC_CORE0_VAR_FAST_NOINIT, vLinkGenVarSectionGroupRef=OS_BARRIER_CORE0_VAR_FAST_NOCACHE_NOINIT, vLinkGenVarSectionGroupRef=OS_CORESTATUS_CORE1_VAR_FAST_NOCACHE_NOINIT, vLinkGenVarSectionGroupRef=OS_PUBLIC_CORE1_VAR_FAST_NOINIT, vLinkGenVarSectionGroupRef=OS_BARRIER_CORE1_VAR_FAST_NOCACHE_NOINIT, vLinkGenVarSectionGroupRef=OS_CORESTATUS_CORE2_VAR_FAST_NOCACHE_NOINIT, vLinkGenVarSectionGroupRef=OS_PUBLIC_CORE2_VAR_FAST_NOINIT, vLinkGenVarSectionGroupRef=OS_BARRIER_CORE2_VAR_FAST_NOCACHE_NOINIT, vLinkGenVarSectionGroupRef=OS_CORESTATUS_CORE3_VAR_FAST_NOCACHE_NOINIT, vLinkGenVarSectionGroupRef=OS_PUBLIC_CORE3_VAR_FAST_NOINIT, vLinkGenVarSectionGroupRef=OS_BARRIER_CORE3_VAR_FAST_NOCACHE_NOINIT
            OS_DATA_SHARED_VAR_INIT: vLinkGenVarSectionGroupInit=INIT, vLinkGenVarSectionGroupEndAlignment=4, vLinkGenVarSectionGroupRef=OS_VAR_NOCACHE
            OS_DATA_SHARED_VAR_FAST_INIT: vLinkGenVarSectionGroupInit=INIT, vLinkGenVarSectionGroupEndAlignment=4, vLinkGenVarSectionGroupRef=OS_VAR_FAST_NOCACHE
        OS_GLOBALSHARED_VAR: vLinkGenVarGroupInitCore=0, vLinkGenVarGroupPosition=5, vLinkGenVarGroupRegion=RegionBlock_0_DSPR_Core0, vLinkGenVarGroupRomRegion=RegionBlock_PFlash0_Cached, vLinkGenVarGroupModule=Os
          8 x vLinkGenVarSectionGroup, all with vLinkGenVarSectionGroupPosition=0, vLinkGenVarSectionGroupInitStage=ONE, vLinkGenVarSectionGroupGapSize=16, vLinkGenVarSectionGroupAlignment=16, vLinkGenVarSectionGroupFlag=vLinkGenVarGroupFlags/ORDERED, vLinkGenVarSectionGroupFlag=vLinkGenVarGroupFlags/CONTIGUOUS, vLinkGenVarSectionGroupFlag=vLinkGenVarGroupFlags/FILL, vLinkGenVarSectionGroupFlag=vLinkGenVarGroupFlags/READ, vLinkGenVarSectionGroupFlag=vLinkGenVarGroupFlags/WRITE:
            OS_GLOBALSHARED_VAR_NOINIT: vLinkGenVarSectionGroupInit=NONE, vLinkGenVarSectionGroupRef=vLinkGenLinkerSections/OS_GLOBALSHARED_VAR_NOINIT, vLinkGenVarSectionGroupRef=OS_GLOBALSHARED_VAR_NOCACHE_NOINIT
            OS_GLOBALSHARED_VAR_FAST_NOINIT: vLinkGenVarSectionGroupInit=NONE, vLinkGenVarSectionGroupRef=vLinkGenLinkerSections/OS_GLOBALSHARED_VAR_FAST_NOINIT, vLinkGenVarSectionGroupRef=OS_GLOBALSHARED_VAR_FAST_NOCACHE_NOINIT
            OS_GLOBALSHARED_VAR_INIT: vLinkGenVarSectionGroupInit=INIT, vLinkGenVarSectionGroupEndAlignment=4, vLinkGenVarSectionGroupRef=vLinkGenLinkerSections/OS_GLOBALSHARED_VAR, vLinkGenVarSectionGroupRef=OS_GLOBALSHARED_VAR_NOCACHE
            OS_GLOBALSHARED_VAR_FAST_INIT: vLinkGenVarSectionGroupInit=INIT, vLinkGenVarSectionGroupEndAlignment=4, vLinkGenVarSectionGroupRef=OS_GLOBALSHARED_VAR_FAST, vLinkGenVarSectionGroupRef=OS_GLOBALSHARED_VAR_FAST_NOCACHE
            OS_GLOBALSHARED_VAR_ZERO_INIT: vLinkGenVarSectionGroupInit=ZERO_INIT, vLinkGenVarSectionGroupEndAlignment=4, vLinkGenVarSectionGroupRef=vLinkGenLinkerSections/OS_GLOBALSHARED_VAR_ZERO_INIT, vLinkGenVarSectionGroupRef=OS_GLOBALSHARED_VAR_NOCACHE_ZERO_INIT
            OS_GLOBALSHARED_VAR_FAST_ZERO_INIT: vLinkGenVarSectionGroupInit=ZERO_INIT, vLinkGenVarSectionGroupEndAlignment=4, vLinkGenVarSectionGroupRef=vLinkGenLinkerSections/OS_GLOBALSHARED_VAR_FAST_ZERO_INIT, vLinkGenVarSectionGroupRef=OS_GLOBALSHARED_VAR_FAST_NOCACHE_ZERO_INIT
            OS_GLOBALSHARED_VAR_ZERO_INIT_bss: vLinkGenVarSectionGroupInit=ZERO_INIT, vLinkGenVarSectionGroupEndAlignment=4, vLinkGenVarSectionGroupRef=vLinkGenLinkerSections/OS_GLOBALSHARED_VAR_ZERO_INIT_bss, vLinkGenVarSectionGroupRef=OS_GLOBALSHARED_VAR_NOCACHE_ZERO_INIT_bss
            OS_GLOBALSHARED_VAR_FAST_ZERO_INIT_bss: vLinkGenVarSectionGroupInit=ZERO_INIT, vLinkGenVarSectionGroupEndAlignment=4, vLinkGenVarSectionGroupRef=vLinkGenLinkerSections/OS_GLOBALSHARED_VAR_FAST_ZERO_INIT_bss, vLinkGenVarSectionGroupRef=OS_GLOBALSHARED_VAR_FAST_NOCACHE_ZERO_INIT_bss
        Data_Default: vLinkGenVarGroupInitCore=0, vLinkGenVarGroupPosition=1000, vLinkGenVarGroupRegion=RegionBlock_0_DSPR_Core0, vLinkGenVarGroupRomRegion=RegionBlock_PFlash0_Cached
          4 x vLinkGenVarSectionGroup, all with vLinkGenVarSectionGroupPosition=0, vLinkGenVarSectionGroupInitStage=ONE, vLinkGenVarSectionGroupAlignment=16, vLinkGenVarSectionGroupEndAlignment=4, vLinkGenVarSectionGroupFlag=vLinkGenVarGroupFlags/ORDERED, vLinkGenVarSectionGroupFlag=vLinkGenVarGroupFlags/CONTIGUOUS, vLinkGenVarSectionGroupFlag=vLinkGenVarGroupFlags/FILL, vLinkGenVarSectionGroupFlag=vLinkGenVarGroupFlags/READ, vLinkGenVarSectionGroupFlag=vLinkGenVarGroupFlags/WRITE:
            data: vLinkGenVarSectionGroupInit=INIT, vLinkGenVarSectionGroupRef=vLinkGenLinkerSections/data
            zdata: vLinkGenVarSectionGroupInit=INIT, vLinkGenVarSectionGroupRef=vLinkGenLinkerSections/zdata
            bss: vLinkGenVarSectionGroupInit=ZERO_INIT, vLinkGenVarSectionGroupRef=vLinkGenLinkerSections/bss
            zbss: vLinkGenVarSectionGroupInit=ZERO_INIT, vLinkGenVarSectionGroupRef=vLinkGenLinkerSections/zbss
        STACK_C0: vLinkGenVarGroupInitCore=0, vLinkGenVarGroupPosition=5, vLinkGenVarGroupRegion=RegionBlock_0_DSPR_Core0
          STACK_C0 (vLinkGenVarSectionGroup):
            vLinkGenVarSectionGroupAlignment = 4
            vLinkGenVarSectionGroupEndAlignment = 4
            vLinkGenVarSectionGroupSize = 1024
            vLinkGenVarSectionGroupInit = ZERO_INIT
            vLinkGenVarSectionGroupInitStage = EARLY
            vLinkGenVarSectionGroupPosition = 0
            vLinkGenVarSectionGroupFlag = vLinkGenVarGroupFlags/ORDERED
            vLinkGenVarSectionGroupFlag = vLinkGenVarGroupFlags/CONTIGUOUS
            vLinkGenVarSectionGroupFlag = vLinkGenVarGroupFlags/FILL
            vLinkGenVarSectionGroupFlag = vLinkGenVarGroupFlags/READ
            vLinkGenVarSectionGroupFlag = vLinkGenVarGroupFlags/WRITE
        STACK_C1: vLinkGenVarGroupInitCore=1, vLinkGenVarGroupPosition=5, vLinkGenVarGroupRegion=RegionBlock_0_DSPR_Core1
          STACK_C1 (vLinkGenVarSectionGroup):
            vLinkGenVarSectionGroupAlignment = 4
            vLinkGenVarSectionGroupEndAlignment = 4
            vLinkGenVarSectionGroupSize = 1024
            vLinkGenVarSectionGroupInit = ZERO_INIT
            vLinkGenVarSectionGroupInitStage = EARLY
            vLinkGenVarSectionGroupPosition = 0
            vLinkGenVarSectionGroupFlag = vLinkGenVarGroupFlags/ORDERED
            vLinkGenVarSectionGroupFlag = vLinkGenVarGroupFlags/CONTIGUOUS
            vLinkGenVarSectionGroupFlag = vLinkGenVarGroupFlags/FILL
            vLinkGenVarSectionGroupFlag = vLinkGenVarGroupFlags/READ
            vLinkGenVarSectionGroupFlag = vLinkGenVarGroupFlags/WRITE
        STACK_C2: vLinkGenVarGroupInitCore=2, vLinkGenVarGroupPosition=5, vLinkGenVarGroupRegion=RegionBlock_0_DSPR_Core2
          STACK_C2 (vLinkGenVarSectionGroup):
            vLinkGenVarSectionGroupAlignment = 4
            vLinkGenVarSectionGroupEndAlignment = 4
            vLinkGenVarSectionGroupSize = 1024
            vLinkGenVarSectionGroupInit = ZERO_INIT
            vLinkGenVarSectionGroupInitStage = EARLY
            vLinkGenVarSectionGroupPosition = 0
            vLinkGenVarSectionGroupFlag = vLinkGenVarGroupFlags/ORDERED
            vLinkGenVarSectionGroupFlag = vLinkGenVarGroupFlags/CONTIGUOUS
            vLinkGenVarSectionGroupFlag = vLinkGenVarGroupFlags/FILL
            vLinkGenVarSectionGroupFlag = vLinkGenVarGroupFlags/READ
            vLinkGenVarSectionGroupFlag = vLinkGenVarGroupFlags/WRITE
        STACK_C3: vLinkGenVarGroupInitCore=3, vLinkGenVarGroupPosition=5, vLinkGenVarGroupRegion=RegionBlock_0_DSPR_Core3
          STACK_C3 (vLinkGenVarSectionGroup):
            vLinkGenVarSectionGroupAlignment = 4
            vLinkGenVarSectionGroupEndAlignment = 4
            vLinkGenVarSectionGroupSize = 1024
            vLinkGenVarSectionGroupInit = ZERO_INIT
            vLinkGenVarSectionGroupInitStage = EARLY
            vLinkGenVarSectionGroupPosition = 0
            vLinkGenVarSectionGroupFlag = vLinkGenVarGroupFlags/ORDERED
            vLinkGenVarSectionGroupFlag = vLinkGenVarGroupFlags/CONTIGUOUS
            vLinkGenVarSectionGroupFlag = vLinkGenVarGroupFlags/FILL
            vLinkGenVarSectionGroupFlag = vLinkGenVarGroupFlags/READ
            vLinkGenVarSectionGroupFlag = vLinkGenVarGroupFlags/WRITE
        STACK_C4: vLinkGenVarGroupInitCore=4, vLinkGenVarGroupPosition=5, vLinkGenVarGroupRegion=RegionBlock_0_DSPR_Core4
          STACK_C4 (vLinkGenVarSectionGroup):
            vLinkGenVarSectionGroupAlignment = 4
            vLinkGenVarSectionGroupEndAlignment = 4
            vLinkGenVarSectionGroupSize = 1024
            vLinkGenVarSectionGroupInit = ZERO_INIT
            vLinkGenVarSectionGroupInitStage = EARLY
            vLinkGenVarSectionGroupPosition = 0
            vLinkGenVarSectionGroupFlag = vLinkGenVarGroupFlags/ORDERED
            vLinkGenVarSectionGroupFlag = vLinkGenVarGroupFlags/CONTIGUOUS
            vLinkGenVarSectionGroupFlag = vLinkGenVarGroupFlags/FILL
            vLinkGenVarSectionGroupFlag = vLinkGenVarGroupFlags/READ
            vLinkGenVarSectionGroupFlag = vLinkGenVarGroupFlags/WRITE
        STACK_C5: vLinkGenVarGroupInitCore=6, vLinkGenVarGroupPosition=5, vLinkGenVarGroupRegion=RegionBlock_0_DSPR_Core5
          STACK_C5 (vLinkGenVarSectionGroup):
            vLinkGenVarSectionGroupAlignment = 4
            vLinkGenVarSectionGroupEndAlignment = 4
            vLinkGenVarSectionGroupSize = 1024
            vLinkGenVarSectionGroupInit = ZERO_INIT
            vLinkGenVarSectionGroupInitStage = EARLY
            vLinkGenVarSectionGroupPosition = 0
            vLinkGenVarSectionGroupFlag = vLinkGenVarGroupFlags/ORDERED
            vLinkGenVarSectionGroupFlag = vLinkGenVarGroupFlags/CONTIGUOUS
            vLinkGenVarSectionGroupFlag = vLinkGenVarGroupFlags/FILL
            vLinkGenVarSectionGroupFlag = vLinkGenVarGroupFlags/READ
            vLinkGenVarSectionGroupFlag = vLinkGenVarGroupFlags/WRITE
        CSA_CORE0: vLinkGenVarGroupPosition=5, vLinkGenVarGroupRegion=RegionBlock_0_DSPR_Core0
          CSA_CORE0 (vLinkGenVarSectionGroup):
            vLinkGenVarSectionGroupAlignment = 64
            vLinkGenVarSectionGroupSize = 32768
            vLinkGenVarSectionGroupPosition = 0
            vLinkGenVarSectionGroupInit = NONE
            vLinkGenVarSectionGroupInitStage = ONE
            vLinkGenVarSectionGroupFlag = vLinkGenVarGroupFlags/ORDERED
            vLinkGenVarSectionGroupFlag = vLinkGenVarGroupFlags/CONTIGUOUS
            vLinkGenVarSectionGroupFlag = vLinkGenVarGroupFlags/FILL
            vLinkGenVarSectionGroupFlag = vLinkGenVarGroupFlags/READ
            vLinkGenVarSectionGroupFlag = vLinkGenVarGroupFlags/WRITE
        CSA_CORE1: vLinkGenVarGroupPosition=5, vLinkGenVarGroupRegion=RegionBlock_0_DSPR_Core1
          CSA_CORE1 (vLinkGenVarSectionGroup):
            vLinkGenVarSectionGroupAlignment = 64
            vLinkGenVarSectionGroupSize = 8192
            vLinkGenVarSectionGroupPosition = 0
            vLinkGenVarSectionGroupInit = NONE
            vLinkGenVarSectionGroupInitStage = ONE
            vLinkGenVarSectionGroupFlag = vLinkGenVarGroupFlags/ORDERED
            vLinkGenVarSectionGroupFlag = vLinkGenVarGroupFlags/CONTIGUOUS
            vLinkGenVarSectionGroupFlag = vLinkGenVarGroupFlags/FILL
            vLinkGenVarSectionGroupFlag = vLinkGenVarGroupFlags/READ
            vLinkGenVarSectionGroupFlag = vLinkGenVarGroupFlags/WRITE
        CSA_CORE2: vLinkGenVarGroupPosition=5, vLinkGenVarGroupRegion=RegionBlock_0_DSPR_Core2
          CSA_CORE2 (vLinkGenVarSectionGroup):
            vLinkGenVarSectionGroupAlignment = 64
            vLinkGenVarSectionGroupSize = 8192
            vLinkGenVarSectionGroupPosition = 0
            vLinkGenVarSectionGroupInit = NONE
            vLinkGenVarSectionGroupInitStage = ONE
            vLinkGenVarSectionGroupFlag = vLinkGenVarGroupFlags/ORDERED
            vLinkGenVarSectionGroupFlag = vLinkGenVarGroupFlags/CONTIGUOUS
            vLinkGenVarSectionGroupFlag = vLinkGenVarGroupFlags/FILL
            vLinkGenVarSectionGroupFlag = vLinkGenVarGroupFlags/READ
            vLinkGenVarSectionGroupFlag = vLinkGenVarGroupFlags/WRITE
        CSA_CORE3: vLinkGenVarGroupPosition=5, vLinkGenVarGroupRegion=RegionBlock_0_DSPR_Core3
          CSA_CORE3 (vLinkGenVarSectionGroup):
            vLinkGenVarSectionGroupAlignment = 64
            vLinkGenVarSectionGroupSize = 8192
            vLinkGenVarSectionGroupPosition = 0
            vLinkGenVarSectionGroupInit = NONE
            vLinkGenVarSectionGroupInitStage = ONE
            vLinkGenVarSectionGroupFlag = vLinkGenVarGroupFlags/ORDERED
            vLinkGenVarSectionGroupFlag = vLinkGenVarGroupFlags/CONTIGUOUS
            vLinkGenVarSectionGroupFlag = vLinkGenVarGroupFlags/FILL
            vLinkGenVarSectionGroupFlag = vLinkGenVarGroupFlags/READ
            vLinkGenVarSectionGroupFlag = vLinkGenVarGroupFlags/WRITE
        CSA_CORE4: vLinkGenVarGroupPosition=5, vLinkGenVarGroupRegion=RegionBlock_0_DSPR_Core4
          CSA_CORE4 (vLinkGenVarSectionGroup):
            vLinkGenVarSectionGroupAlignment = 64
            vLinkGenVarSectionGroupSize = 8192
            vLinkGenVarSectionGroupPosition = 0
            vLinkGenVarSectionGroupInit = NONE
            vLinkGenVarSectionGroupInitStage = ONE
            vLinkGenVarSectionGroupFlag = vLinkGenVarGroupFlags/ORDERED
            vLinkGenVarSectionGroupFlag = vLinkGenVarGroupFlags/CONTIGUOUS
            vLinkGenVarSectionGroupFlag = vLinkGenVarGroupFlags/FILL
            vLinkGenVarSectionGroupFlag = vLinkGenVarGroupFlags/READ
            vLinkGenVarSectionGroupFlag = vLinkGenVarGroupFlags/WRITE
        CSA_CORE5: vLinkGenVarGroupPosition=5, vLinkGenVarGroupRegion=RegionBlock_0_DSPR_Core5
          CSA_CORE5 (vLinkGenVarSectionGroup):
            vLinkGenVarSectionGroupAlignment = 64
            vLinkGenVarSectionGroupSize = 8192
            vLinkGenVarSectionGroupPosition = 0
            vLinkGenVarSectionGroupInit = NONE
            vLinkGenVarSectionGroupInitStage = ONE
            vLinkGenVarSectionGroupFlag = vLinkGenVarGroupFlags/ORDERED
            vLinkGenVarSectionGroupFlag = vLinkGenVarGroupFlags/CONTIGUOUS
            vLinkGenVarSectionGroupFlag = vLinkGenVarGroupFlags/FILL
            vLinkGenVarSectionGroupFlag = vLinkGenVarGroupFlags/READ
            vLinkGenVarSectionGroupFlag = vLinkGenVarGroupFlags/WRITE
      3 x vLinkGenLogicalSymbolGroup, all with vLinkGenSymbolGroupPosition=5:
        Startup_Labels
          10 x vLinkGenLinkerSymbol, all with vLinkGenLinkerSymbolValue=brsStartupEntry, vLinkGenLinkerSymbolPosition=0:
            Startup_Labels1: vLinkGenLinkerSymbolName=_RESET
            Startup_Labels2: vLinkGenLinkerSymbolName=_start
            Startup_Labels3: vLinkGenLinkerSymbolName=StartupEntry
            Startup_Labels4: vLinkGenLinkerSymbolName=_brsStartupEntry
            Startup_Labels5: vLinkGenLinkerSymbolName=_start_tc0
            Startup_Labels6: vLinkGenLinkerSymbolName=_start_tc1
            Startup_Labels7: vLinkGenLinkerSymbolName=_start_tc2
            Startup_Labels8: vLinkGenLinkerSymbolName=_start_tc3
            Startup_Labels9: vLinkGenLinkerSymbolName=_start_tc4
            Startup_Labels10: vLinkGenLinkerSymbolName=_start_tc5
        CSA_LABELS
          12 x vLinkGenLinkerSymbol, all with vLinkGenLinkerSymbolPosition=0:
            CSA_LABELS1: vLinkGenLinkerSymbolName=__CSA_BEGIN_CPU0_, vLinkGenLinkerSymbolValue=_CSA_CORE0_START
            CSA_LABELS2: vLinkGenLinkerSymbolName=__CSA_END_CPU0_, vLinkGenLinkerSymbolValue=_CSA_CORE0_LIMIT
            CSA_LABELS3: vLinkGenLinkerSymbolName=__CSA_BEGIN_CPU1_, vLinkGenLinkerSymbolValue=_CSA_CORE1_START
            CSA_LABELS4: vLinkGenLinkerSymbolName=__CSA_END_CPU1_, vLinkGenLinkerSymbolValue=_CSA_CORE1_LIMIT
            CSA_LABELS5: vLinkGenLinkerSymbolName=__CSA_BEGIN_CPU2_, vLinkGenLinkerSymbolValue=_CSA_CORE2_START
            CSA_LABELS6: vLinkGenLinkerSymbolName=__CSA_END_CPU2_, vLinkGenLinkerSymbolValue=_CSA_CORE2_LIMIT
            CSA_LABELS7: vLinkGenLinkerSymbolName=__CSA_BEGIN_CPU3_, vLinkGenLinkerSymbolValue=_CSA_CORE3_START
            CSA_LABELS8: vLinkGenLinkerSymbolName=__CSA_END_CPU3_, vLinkGenLinkerSymbolValue=_CSA_CORE3_LIMIT
            CSA_LABELS9: vLinkGenLinkerSymbolName=__CSA_BEGIN_CPU4_, vLinkGenLinkerSymbolValue=_CSA_CORE4_START
            CSA_LABELS10: vLinkGenLinkerSymbolName=__CSA_END_CPU4_, vLinkGenLinkerSymbolValue=_CSA_CORE4_LIMIT
            CSA_LABELS11: vLinkGenLinkerSymbolName=__CSA_BEGIN_CPU5_, vLinkGenLinkerSymbolValue=_CSA_CORE5_START
            CSA_LABELS12: vLinkGenLinkerSymbolName=__CSA_END_CPU5_, vLinkGenLinkerSymbolValue=_CSA_CORE5_LIMIT
        Startup_Stack
          6 x vLinkGenLinkerSymbol, all with vLinkGenLinkerSymbolPosition=0:
            Startup_Stack_c{0..5}: vLinkGenLinkerSymbolName=__STARTUPSTACK_CORE{0..5}, vLinkGenLinkerSymbolValue=_STACK_C{0..5}_LIMIT
      vLinkGenLinkerSections
        brsStartup (vLinkGenLinkerCodeSection): vLinkGenLinkerCodeSectionName=brsStartup, vLinkGenLinkerCodeSectionAlignment=8, vLinkGenLinkerCodeSectionFast=false
        BMHD0 (vLinkGenLinkerConstSection): vLinkGenLinkerConstSectionName=BMHD0, vLinkGenLinkerConstSectionAlignment=32, vLinkGenLinkerConstSectionFast=false
        7 x vLinkGenLinkerSpecSection, all with vLinkGenLinkerSpecSectionPad=0, vLinkGenLinkerSpecSectionAlignment=0:
          text: vLinkGenLinkerSpecSectionValue=[.]text*
          rodata: vLinkGenLinkerSpecSectionValue=[.]rodata*
          zrodata: vLinkGenLinkerSpecSectionValue=[.]zrodata*
          data: vLinkGenLinkerSpecSectionValue=[.]data*
          zdata: vLinkGenLinkerSpecSectionValue=[.]zdata*
          bss: vLinkGenLinkerSpecSectionValue=[.]bss*
          zbss: vLinkGenLinkerSpecSectionValue=[.]zbss*
        20 x vLinkGenLinkerCodeSection, all with vLinkGenLinkerCodeSectionFast=false, vLinkGenLinkerCodeSectionModule=Os:
          OS_CODE: vLinkGenLinkerCodeSectionName=OS_CODE, vLinkGenLinkerCodeSectionAlignment=0
          OS_OS_COREINITHOOK_CODE: vLinkGenLinkerCodeSectionName=OS_OS_COREINITHOOK_CODE, vLinkGenLinkerCodeSectionAlignment=0
          OS_INTVEC_CODE: vLinkGenLinkerCodeSectionName=OS_INTVEC_CODE, vLinkGenLinkerCodeSectionAlignment=8192
          OS_EXCVEC_CORE0_CODE: vLinkGenLinkerCodeSectionName=OS_EXCVEC_CORE0_CODE, vLinkGenLinkerCodeSectionAlignment=256
          OS_INTVEC_CORE0_CODE: vLinkGenLinkerCodeSectionName=OS_INTVEC_CORE0_CODE, vLinkGenLinkerCodeSectionAlignment=8192
          OS_EXCVEC_CORE1_CODE: vLinkGenLinkerCodeSectionName=OS_EXCVEC_CORE1_CODE, vLinkGenLinkerCodeSectionAlignment=256
          OS_INTVEC_CORE1_CODE: vLinkGenLinkerCodeSectionName=OS_INTVEC_CORE1_CODE, vLinkGenLinkerCodeSectionAlignment=8192
          OS_EXCVEC_CORE2_CODE: vLinkGenLinkerCodeSectionName=OS_EXCVEC_CORE2_CODE, vLinkGenLinkerCodeSectionAlignment=256
          OS_INTVEC_CORE2_CODE: vLinkGenLinkerCodeSectionName=OS_INTVEC_CORE2_CODE, vLinkGenLinkerCodeSectionAlignment=8192
          OS_EXCVEC_CORE3_CODE: vLinkGenLinkerCodeSectionName=OS_EXCVEC_CORE3_CODE, vLinkGenLinkerCodeSectionAlignment=256
          OS_INTVEC_CORE3_CODE: vLinkGenLinkerCodeSectionName=OS_INTVEC_CORE3_CODE, vLinkGenLinkerCodeSectionAlignment=8192
          OS_ERRORHOOK_CODE: vLinkGenLinkerCodeSectionName=OS_ERRORHOOK_CODE, vLinkGenLinkerCodeSectionAlignment=0
          OS_Task_Com_5ms_CODE: vLinkGenLinkerCodeSectionName=OS_Task_Com_5ms_CODE, vLinkGenLinkerCodeSectionAlignment=0
          OS_Task_Appl_10ms_CODE: vLinkGenLinkerCodeSectionName=OS_Task_Appl_10ms_CODE, vLinkGenLinkerCodeSectionAlignment=0
          OS_Task_Bsw_10ms_CODE: vLinkGenLinkerCodeSectionName=OS_Task_Bsw_10ms_CODE, vLinkGenLinkerCodeSectionAlignment=0
          OS_Default_Init_Task_CODE: vLinkGenLinkerCodeSectionName=OS_Default_Init_Task_CODE, vLinkGenLinkerCodeSectionAlignment=0
          OS_Task_EcuM_Core3_CODE: vLinkGenLinkerCodeSectionName=OS_Task_EcuM_Core3_CODE, vLinkGenLinkerCodeSectionAlignment=0
          OS_Default_Init_Task_Trusted_CODE: vLinkGenLinkerCodeSectionName=OS_Default_Init_Task_Trusted_CODE, vLinkGenLinkerCodeSectionAlignment=0
          OS_Task_EcuM_Core1_CODE: vLinkGenLinkerCodeSectionName=OS_Task_EcuM_Core1_CODE, vLinkGenLinkerCodeSectionAlignment=0
          OS_Task_Appl_100ms_CODE: vLinkGenLinkerCodeSectionName=OS_Task_Appl_100ms_CODE, vLinkGenLinkerCodeSectionAlignment=0
        37 x vLinkGenLinkerConstSection, all with vLinkGenLinkerConstSectionModule=Os:
          OS_CONST: vLinkGenLinkerConstSectionName=OS_CONST, vLinkGenLinkerConstSectionFast=false, vLinkGenLinkerConstSectionAlignment=0
          OS_INTVEC_CONST: vLinkGenLinkerConstSectionName=OS_INTVEC_CONST, vLinkGenLinkerConstSectionFast=false, vLinkGenLinkerConstSectionAlignment=0
          OS_GLOBALSHARED_CONST: vLinkGenLinkerConstSectionName=OS_GLOBALSHARED_CONST, vLinkGenLinkerConstSectionFast=false, vLinkGenLinkerConstSectionAlignment=0
          OS_CONST_FAST: vLinkGenLinkerConstSectionName=OS_CONST_FAST, vLinkGenLinkerConstSectionFast=true, vLinkGenLinkerConstSectionAlignment=0
          OS_GLOBALSHARED_CONST_FAST: vLinkGenLinkerConstSectionName=OS_GLOBALSHARED_CONST_FAST, vLinkGenLinkerConstSectionFast=true, vLinkGenLinkerConstSectionAlignment=0
          OS_CORE0_CONST: vLinkGenLinkerConstSectionName=OS_CORE0_CONST, vLinkGenLinkerConstSectionFast=false, vLinkGenLinkerConstSectionAlignment=0
          OS_CORE0_CONST_FAST: vLinkGenLinkerConstSectionName=OS_CORE0_CONST_FAST, vLinkGenLinkerConstSectionFast=true, vLinkGenLinkerConstSectionAlignment=0
          OS_EXCVEC_CORE0_CONST: vLinkGenLinkerConstSectionName=OS_EXCVEC_CORE0_CONST, vLinkGenLinkerConstSectionFast=false, vLinkGenLinkerConstSectionAlignment=256
          OS_INTVEC_CORE0_CONST: vLinkGenLinkerConstSectionName=OS_INTVEC_CORE0_CONST, vLinkGenLinkerConstSectionFast=false, vLinkGenLinkerConstSectionAlignment=8192
          OS_CORE1_CONST: vLinkGenLinkerConstSectionName=OS_CORE1_CONST, vLinkGenLinkerConstSectionFast=false, vLinkGenLinkerConstSectionAlignment=0
          OS_CORE1_CONST_FAST: vLinkGenLinkerConstSectionName=OS_CORE1_CONST_FAST, vLinkGenLinkerConstSectionFast=true, vLinkGenLinkerConstSectionAlignment=0
          OS_EXCVEC_CORE1_CONST: vLinkGenLinkerConstSectionName=OS_EXCVEC_CORE1_CONST, vLinkGenLinkerConstSectionFast=false, vLinkGenLinkerConstSectionAlignment=256
          OS_INTVEC_CORE1_CONST: vLinkGenLinkerConstSectionName=OS_INTVEC_CORE1_CONST, vLinkGenLinkerConstSectionFast=false, vLinkGenLinkerConstSectionAlignment=8192
          OS_CORE2_CONST: vLinkGenLinkerConstSectionName=OS_CORE2_CONST, vLinkGenLinkerConstSectionFast=false, vLinkGenLinkerConstSectionAlignment=0
          OS_CORE2_CONST_FAST: vLinkGenLinkerConstSectionName=OS_CORE2_CONST_FAST, vLinkGenLinkerConstSectionFast=true, vLinkGenLinkerConstSectionAlignment=0
          OS_EXCVEC_CORE2_CONST: vLinkGenLinkerConstSectionName=OS_EXCVEC_CORE2_CONST, vLinkGenLinkerConstSectionFast=false, vLinkGenLinkerConstSectionAlignment=256
          OS_INTVEC_CORE2_CONST: vLinkGenLinkerConstSectionName=OS_INTVEC_CORE2_CONST, vLinkGenLinkerConstSectionFast=false, vLinkGenLinkerConstSectionAlignment=8192
          OS_CORE3_CONST: vLinkGenLinkerConstSectionName=OS_CORE3_CONST, vLinkGenLinkerConstSectionFast=false, vLinkGenLinkerConstSectionAlignment=0
          OS_CORE3_CONST_FAST: vLinkGenLinkerConstSectionName=OS_CORE3_CONST_FAST, vLinkGenLinkerConstSectionFast=true, vLinkGenLinkerConstSectionAlignment=0
          OS_EXCVEC_CORE3_CONST: vLinkGenLinkerConstSectionName=OS_EXCVEC_CORE3_CONST, vLinkGenLinkerConstSectionFast=false, vLinkGenLinkerConstSectionAlignment=256
          OS_INTVEC_CORE3_CONST: vLinkGenLinkerConstSectionName=OS_INTVEC_CORE3_CONST, vLinkGenLinkerConstSectionFast=false, vLinkGenLinkerConstSectionAlignment=8192
          OS_OsApplication_CONST: vLinkGenLinkerConstSectionName=OS_OsApplication_CONST, vLinkGenLinkerConstSectionFast=false, vLinkGenLinkerConstSectionAlignment=0
          OS_OsApplication_CONST_FAST: vLinkGenLinkerConstSectionName=OS_OsApplication_CONST_FAST, vLinkGenLinkerConstSectionFast=true, vLinkGenLinkerConstSectionAlignment=0
          OS_OsApplication_Core1_CONST: vLinkGenLinkerConstSectionName=OS_OsApplication_Core1_CONST, vLinkGenLinkerConstSectionFast=false, vLinkGenLinkerConstSectionAlignment=0
          OS_OsApplication_Core1_CONST_FAST: vLinkGenLinkerConstSectionName=OS_OsApplication_Core1_CONST_FAST, vLinkGenLinkerConstSectionFast=true, vLinkGenLinkerConstSectionAlignment=0
          OS_OsApplication_Core2_CONST: vLinkGenLinkerConstSectionName=OS_OsApplication_Core2_CONST, vLinkGenLinkerConstSectionFast=false, vLinkGenLinkerConstSectionAlignment=0
          OS_OsApplication_Core2_CONST_FAST: vLinkGenLinkerConstSectionName=OS_OsApplication_Core2_CONST_FAST, vLinkGenLinkerConstSectionFast=true, vLinkGenLinkerConstSectionAlignment=0
          OS_OsApplication_Core3_CONST: vLinkGenLinkerConstSectionName=OS_OsApplication_Core3_CONST, vLinkGenLinkerConstSectionFast=false, vLinkGenLinkerConstSectionAlignment=0
          OS_OsApplication_Core3_CONST_FAST: vLinkGenLinkerConstSectionName=OS_OsApplication_Core3_CONST_FAST, vLinkGenLinkerConstSectionFast=true, vLinkGenLinkerConstSectionAlignment=0
          OS_SystemApplication_OsCore0_CONST: vLinkGenLinkerConstSectionName=OS_SystemApplication_OsCore0_CONST, vLinkGenLinkerConstSectionFast=false, vLinkGenLinkerConstSectionAlignment=0
          OS_SystemApplication_OsCore0_CONST_FAST: vLinkGenLinkerConstSectionName=OS_SystemApplication_OsCore0_CONST_FAST, vLinkGenLinkerConstSectionFast=true, vLinkGenLinkerConstSectionAlignment=0
          OS_SystemApplication_OsCore1_CONST: vLinkGenLinkerConstSectionName=OS_SystemApplication_OsCore1_CONST, vLinkGenLinkerConstSectionFast=false, vLinkGenLinkerConstSectionAlignment=0
          OS_SystemApplication_OsCore1_CONST_FAST: vLinkGenLinkerConstSectionName=OS_SystemApplication_OsCore1_CONST_FAST, vLinkGenLinkerConstSectionFast=true, vLinkGenLinkerConstSectionAlignment=0
          OS_SystemApplication_OsCore2_CONST: vLinkGenLinkerConstSectionName=OS_SystemApplication_OsCore2_CONST, vLinkGenLinkerConstSectionFast=false, vLinkGenLinkerConstSectionAlignment=0
          OS_SystemApplication_OsCore2_CONST_FAST: vLinkGenLinkerConstSectionName=OS_SystemApplication_OsCore2_CONST_FAST, vLinkGenLinkerConstSectionFast=true, vLinkGenLinkerConstSectionAlignment=0
          OS_SystemApplication_OsCore3_CONST: vLinkGenLinkerConstSectionName=OS_SystemApplication_OsCore3_CONST, vLinkGenLinkerConstSectionFast=false, vLinkGenLinkerConstSectionAlignment=0
          OS_SystemApplication_OsCore3_CONST_FAST: vLinkGenLinkerConstSectionName=OS_SystemApplication_OsCore3_CONST_FAST, vLinkGenLinkerConstSectionFast=true, vLinkGenLinkerConstSectionAlignment=0
        24 x vLinkGenLinkerStackSection, all with vLinkGenLinkerStackSectionAlignment=8, vLinkGenLinkerStackSectionModule=Os:
          OS_STACK_OSCORE0_ERROR_VAR_NOINIT: vLinkGenLinkerStackSectionName=OS_STACK_OSCORE0_ERROR_VAR_NOINIT
          OS_STACK_OSCORE0_INIT_VAR_NOINIT: vLinkGenLinkerStackSectionName=OS_STACK_OSCORE0_INIT_VAR_NOINIT
          OS_STACK_OSCORE0_KERNEL_VAR_NOINIT: vLinkGenLinkerStackSectionName=OS_STACK_OSCORE0_KERNEL_VAR_NOINIT
          OS_STACK_OSCORE1_ERROR_VAR_NOINIT: vLinkGenLinkerStackSectionName=OS_STACK_OSCORE1_ERROR_VAR_NOINIT
          OS_STACK_OSCORE1_INIT_VAR_NOINIT: vLinkGenLinkerStackSectionName=OS_STACK_OSCORE1_INIT_VAR_NOINIT
          OS_STACK_OSCORE1_KERNEL_VAR_NOINIT: vLinkGenLinkerStackSectionName=OS_STACK_OSCORE1_KERNEL_VAR_NOINIT
          OS_STACK_OSCORE2_ERROR_VAR_NOINIT: vLinkGenLinkerStackSectionName=OS_STACK_OSCORE2_ERROR_VAR_NOINIT
          OS_STACK_OSCORE2_INIT_VAR_NOINIT: vLinkGenLinkerStackSectionName=OS_STACK_OSCORE2_INIT_VAR_NOINIT
          OS_STACK_OSCORE2_KERNEL_VAR_NOINIT: vLinkGenLinkerStackSectionName=OS_STACK_OSCORE2_KERNEL_VAR_NOINIT
          OS_STACK_OSCORE3_ERROR_VAR_NOINIT: vLinkGenLinkerStackSectionName=OS_STACK_OSCORE3_ERROR_VAR_NOINIT
          OS_STACK_OSCORE3_INIT_VAR_NOINIT: vLinkGenLinkerStackSectionName=OS_STACK_OSCORE3_INIT_VAR_NOINIT
          OS_STACK_OSCORE3_KERNEL_VAR_NOINIT: vLinkGenLinkerStackSectionName=OS_STACK_OSCORE3_KERNEL_VAR_NOINIT
          OS_STACK_OSCORE0_TASK_PRIO20_VAR_NOINIT: vLinkGenLinkerStackSectionName=OS_STACK_OSCORE0_TASK_PRIO20_VAR_NOINIT
          OS_STACK_OSCORE0_TASK_PRIO40_VAR_NOINIT: vLinkGenLinkerStackSectionName=OS_STACK_OSCORE0_TASK_PRIO40_VAR_NOINIT
          OS_STACK_OSCORE2_TASK_PRIO10_VAR_NOINIT: vLinkGenLinkerStackSectionName=OS_STACK_OSCORE2_TASK_PRIO10_VAR_NOINIT
          OS_STACK_OSCORE2_TASK_PRIO15_VAR_NOINIT: vLinkGenLinkerStackSectionName=OS_STACK_OSCORE2_TASK_PRIO15_VAR_NOINIT
          OS_STACK_OSCORE0_ISR_CORE_VAR_NOINIT: vLinkGenLinkerStackSectionName=OS_STACK_OSCORE0_ISR_CORE_VAR_NOINIT
          OS_STACK_OSCORE2_ISR_CORE_VAR_NOINIT: vLinkGenLinkerStackSectionName=OS_STACK_OSCORE2_ISR_CORE_VAR_NOINIT
          OS_STACK_OSCORE{0..3}_TASK_PRIO4294967295_VAR_NOINIT: vLinkGenLinkerStackSectionName=OS_STACK_OSCORE{0..3}_TASK_PRIO4294967295_VAR_NOINIT
          OS_STACK_OSCORE1_TASK_PRIO5_VAR_NOINIT: vLinkGenLinkerStackSectionName=OS_STACK_OSCORE1_TASK_PRIO5_VAR_NOINIT
          OS_STACK_OSCORE3_TASK_PRIO5_VAR_NOINIT: vLinkGenLinkerStackSectionName=OS_STACK_OSCORE3_TASK_PRIO5_VAR_NOINIT
        204 x vLinkGenLinkerVarSection, all with vLinkGenLinkerVarSectionAlignment=0, vLinkGenLinkerVarSectionModule=Os:
          OS_VAR_NOCACHE: vLinkGenLinkerVarSectionName=OS_VAR_NOCACHE, vLinkGenLinkerVarSectionFast=false
          OS_VAR_NOCACHE_NOINIT: vLinkGenLinkerVarSectionName=OS_VAR_NOCACHE_NOINIT, vLinkGenLinkerVarSectionFast=false
          OS_VAR_FAST_NOCACHE: vLinkGenLinkerVarSectionName=OS_VAR_FAST_NOCACHE, vLinkGenLinkerVarSectionFast=true
          OS_VAR_FAST_NOCACHE_NOINIT: vLinkGenLinkerVarSectionName=OS_VAR_FAST_NOCACHE_NOINIT, vLinkGenLinkerVarSectionFast=true
          OS_GLOBALSHARED_VAR_NOINIT: vLinkGenLinkerVarSectionName=OS_GLOBALSHARED_VAR_NOINIT, vLinkGenLinkerVarSectionFast=false
          OS_GLOBALSHARED_VAR: vLinkGenLinkerVarSectionName=OS_GLOBALSHARED_VAR, vLinkGenLinkerVarSectionFast=false
          OS_GLOBALSHARED_VAR_ZERO_INIT: vLinkGenLinkerVarSectionName=OS_GLOBALSHARED_VAR_ZERO_INIT, vLinkGenLinkerVarSectionFast=false
          OS_GLOBALSHARED_VAR_NOCACHE_NOINIT: vLinkGenLinkerVarSectionName=OS_GLOBALSHARED_VAR_NOCACHE_NOINIT, vLinkGenLinkerVarSectionFast=false
          OS_GLOBALSHARED_VAR_NOCACHE: vLinkGenLinkerVarSectionName=OS_GLOBALSHARED_VAR_NOCACHE, vLinkGenLinkerVarSectionFast=false
          OS_GLOBALSHARED_VAR_NOCACHE_ZERO_INIT: vLinkGenLinkerVarSectionName=OS_GLOBALSHARED_VAR_NOCACHE_ZERO_INIT, vLinkGenLinkerVarSectionFast=false
          OS_GLOBALSHARED_VAR_FAST_NOINIT: vLinkGenLinkerVarSectionName=OS_GLOBALSHARED_VAR_FAST_NOINIT, vLinkGenLinkerVarSectionFast=true
          OS_GLOBALSHARED_VAR_FAST: vLinkGenLinkerVarSectionName=OS_GLOBALSHARED_VAR_FAST, vLinkGenLinkerVarSectionFast=true
          OS_GLOBALSHARED_VAR_FAST_ZERO_INIT: vLinkGenLinkerVarSectionName=OS_GLOBALSHARED_VAR_FAST_ZERO_INIT, vLinkGenLinkerVarSectionFast=true
          OS_GLOBALSHARED_VAR_FAST_NOCACHE_NOINIT: vLinkGenLinkerVarSectionName=OS_GLOBALSHARED_VAR_FAST_NOCACHE_NOINIT, vLinkGenLinkerVarSectionFast=true
          OS_GLOBALSHARED_VAR_FAST_NOCACHE: vLinkGenLinkerVarSectionName=OS_GLOBALSHARED_VAR_FAST_NOCACHE, vLinkGenLinkerVarSectionFast=true
          OS_GLOBALSHARED_VAR_FAST_NOCACHE_ZERO_INIT: vLinkGenLinkerVarSectionName=OS_GLOBALSHARED_VAR_FAST_NOCACHE_ZERO_INIT, vLinkGenLinkerVarSectionFast=true
          OS_GLOBALSHARED_VAR_ZERO_INIT_bss: vLinkGenLinkerVarSectionName=OS_GLOBALSHARED_VAR_ZERO_INIT_bss, vLinkGenLinkerVarSectionFast=false
          OS_GLOBALSHARED_VAR_NOCACHE_ZERO_INIT_bss: vLinkGenLinkerVarSectionName=OS_GLOBALSHARED_VAR_NOCACHE_ZERO_INIT_bss, vLinkGenLinkerVarSectionFast=false
          OS_GLOBALSHARED_VAR_FAST_ZERO_INIT_bss: vLinkGenLinkerVarSectionName=OS_GLOBALSHARED_VAR_FAST_ZERO_INIT_bss, vLinkGenLinkerVarSectionFast=true
          OS_GLOBALSHARED_VAR_FAST_NOCACHE_ZERO_INIT_bss: vLinkGenLinkerVarSectionName=OS_GLOBALSHARED_VAR_FAST_NOCACHE_ZERO_INIT_bss, vLinkGenLinkerVarSectionFast=true
          OS_CORESTATUS_CORE0_VAR_NOCACHE_NOINIT: vLinkGenLinkerVarSectionName=OS_CORESTATUS_CORE0_VAR_NOCACHE_NOINIT, vLinkGenLinkerVarSectionFast=false
          OS_CORESTATUS_CORE0_VAR_FAST_NOCACHE_NOINIT: vLinkGenLinkerVarSectionName=OS_CORESTATUS_CORE0_VAR_FAST_NOCACHE_NOINIT, vLinkGenLinkerVarSectionFast=true
          OS_CORE0_VAR: vLinkGenLinkerVarSectionName=OS_CORE0_VAR, vLinkGenLinkerVarSectionFast=false
          OS_CORE0_VAR_NOCACHE: vLinkGenLinkerVarSectionName=OS_CORE0_VAR_NOCACHE, vLinkGenLinkerVarSectionFast=false
          OS_CORE0_VAR_NOINIT: vLinkGenLinkerVarSectionName=OS_CORE0_VAR_NOINIT, vLinkGenLinkerVarSectionFast=false
          OS_CORE0_VAR_NOCACHE_NOINIT: vLinkGenLinkerVarSectionName=OS_CORE0_VAR_NOCACHE_NOINIT, vLinkGenLinkerVarSectionFast=false
          OS_PUBLIC_CORE0_VAR_NOINIT: vLinkGenLinkerVarSectionName=OS_PUBLIC_CORE0_VAR_NOINIT, vLinkGenLinkerVarSectionFast=false
          OS_BARRIER_CORE0_VAR_NOCACHE_NOINIT: vLinkGenLinkerVarSectionName=OS_BARRIER_CORE0_VAR_NOCACHE_NOINIT, vLinkGenLinkerVarSectionFast=false
          OS_CORE0_VAR_FAST: vLinkGenLinkerVarSectionName=OS_CORE0_VAR_FAST, vLinkGenLinkerVarSectionFast=true
          OS_CORE0_VAR_FAST_NOCACHE: vLinkGenLinkerVarSectionName=OS_CORE0_VAR_FAST_NOCACHE, vLinkGenLinkerVarSectionFast=true
          OS_CORE0_VAR_FAST_NOINIT: vLinkGenLinkerVarSectionName=OS_CORE0_VAR_FAST_NOINIT, vLinkGenLinkerVarSectionFast=true
          OS_CORE0_VAR_FAST_NOCACHE_NOINIT: vLinkGenLinkerVarSectionName=OS_CORE0_VAR_FAST_NOCACHE_NOINIT, vLinkGenLinkerVarSectionFast=true
          OS_PUBLIC_CORE0_VAR_FAST_NOINIT: vLinkGenLinkerVarSectionName=OS_PUBLIC_CORE0_VAR_FAST_NOINIT, vLinkGenLinkerVarSectionFast=true
          OS_BARRIER_CORE0_VAR_FAST_NOCACHE_NOINIT: vLinkGenLinkerVarSectionName=OS_BARRIER_CORE0_VAR_FAST_NOCACHE_NOINIT, vLinkGenLinkerVarSectionFast=true
          OS_CORESTATUS_CORE1_VAR_NOCACHE_NOINIT: vLinkGenLinkerVarSectionName=OS_CORESTATUS_CORE1_VAR_NOCACHE_NOINIT, vLinkGenLinkerVarSectionFast=false
          OS_CORESTATUS_CORE1_VAR_FAST_NOCACHE_NOINIT: vLinkGenLinkerVarSectionName=OS_CORESTATUS_CORE1_VAR_FAST_NOCACHE_NOINIT, vLinkGenLinkerVarSectionFast=true
          OS_CORE1_VAR: vLinkGenLinkerVarSectionName=OS_CORE1_VAR, vLinkGenLinkerVarSectionFast=false
          OS_CORE1_VAR_NOCACHE: vLinkGenLinkerVarSectionName=OS_CORE1_VAR_NOCACHE, vLinkGenLinkerVarSectionFast=false
          OS_CORE1_VAR_NOINIT: vLinkGenLinkerVarSectionName=OS_CORE1_VAR_NOINIT, vLinkGenLinkerVarSectionFast=false
          OS_CORE1_VAR_NOCACHE_NOINIT: vLinkGenLinkerVarSectionName=OS_CORE1_VAR_NOCACHE_NOINIT, vLinkGenLinkerVarSectionFast=false
          OS_PUBLIC_CORE1_VAR_NOINIT: vLinkGenLinkerVarSectionName=OS_PUBLIC_CORE1_VAR_NOINIT, vLinkGenLinkerVarSectionFast=false
          OS_BARRIER_CORE1_VAR_NOCACHE_NOINIT: vLinkGenLinkerVarSectionName=OS_BARRIER_CORE1_VAR_NOCACHE_NOINIT, vLinkGenLinkerVarSectionFast=false
          OS_CORE1_VAR_FAST: vLinkGenLinkerVarSectionName=OS_CORE1_VAR_FAST, vLinkGenLinkerVarSectionFast=true
          OS_CORE1_VAR_FAST_NOCACHE: vLinkGenLinkerVarSectionName=OS_CORE1_VAR_FAST_NOCACHE, vLinkGenLinkerVarSectionFast=true
          OS_CORE1_VAR_FAST_NOINIT: vLinkGenLinkerVarSectionName=OS_CORE1_VAR_FAST_NOINIT, vLinkGenLinkerVarSectionFast=true
          OS_CORE1_VAR_FAST_NOCACHE_NOINIT: vLinkGenLinkerVarSectionName=OS_CORE1_VAR_FAST_NOCACHE_NOINIT, vLinkGenLinkerVarSectionFast=true
          OS_PUBLIC_CORE1_VAR_FAST_NOINIT: vLinkGenLinkerVarSectionName=OS_PUBLIC_CORE1_VAR_FAST_NOINIT, vLinkGenLinkerVarSectionFast=true
          OS_BARRIER_CORE1_VAR_FAST_NOCACHE_NOINIT: vLinkGenLinkerVarSectionName=OS_BARRIER_CORE1_VAR_FAST_NOCACHE_NOINIT, vLinkGenLinkerVarSectionFast=true
          OS_CORESTATUS_CORE2_VAR_NOCACHE_NOINIT: vLinkGenLinkerVarSectionName=OS_CORESTATUS_CORE2_VAR_NOCACHE_NOINIT, vLinkGenLinkerVarSectionFast=false
          OS_CORESTATUS_CORE2_VAR_FAST_NOCACHE_NOINIT: vLinkGenLinkerVarSectionName=OS_CORESTATUS_CORE2_VAR_FAST_NOCACHE_NOINIT, vLinkGenLinkerVarSectionFast=true
          OS_CORE2_VAR: vLinkGenLinkerVarSectionName=OS_CORE2_VAR, vLinkGenLinkerVarSectionFast=false
          OS_CORE2_VAR_NOCACHE: vLinkGenLinkerVarSectionName=OS_CORE2_VAR_NOCACHE, vLinkGenLinkerVarSectionFast=false
          OS_CORE2_VAR_NOINIT: vLinkGenLinkerVarSectionName=OS_CORE2_VAR_NOINIT, vLinkGenLinkerVarSectionFast=false
          OS_CORE2_VAR_NOCACHE_NOINIT: vLinkGenLinkerVarSectionName=OS_CORE2_VAR_NOCACHE_NOINIT, vLinkGenLinkerVarSectionFast=false
          OS_PUBLIC_CORE2_VAR_NOINIT: vLinkGenLinkerVarSectionName=OS_PUBLIC_CORE2_VAR_NOINIT, vLinkGenLinkerVarSectionFast=false
          OS_BARRIER_CORE2_VAR_NOCACHE_NOINIT: vLinkGenLinkerVarSectionName=OS_BARRIER_CORE2_VAR_NOCACHE_NOINIT, vLinkGenLinkerVarSectionFast=false
          OS_CORE2_VAR_FAST: vLinkGenLinkerVarSectionName=OS_CORE2_VAR_FAST, vLinkGenLinkerVarSectionFast=true
          OS_CORE2_VAR_FAST_NOCACHE: vLinkGenLinkerVarSectionName=OS_CORE2_VAR_FAST_NOCACHE, vLinkGenLinkerVarSectionFast=true
          OS_CORE2_VAR_FAST_NOINIT: vLinkGenLinkerVarSectionName=OS_CORE2_VAR_FAST_NOINIT, vLinkGenLinkerVarSectionFast=true
          OS_CORE2_VAR_FAST_NOCACHE_NOINIT: vLinkGenLinkerVarSectionName=OS_CORE2_VAR_FAST_NOCACHE_NOINIT, vLinkGenLinkerVarSectionFast=true
          OS_PUBLIC_CORE2_VAR_FAST_NOINIT: vLinkGenLinkerVarSectionName=OS_PUBLIC_CORE2_VAR_FAST_NOINIT, vLinkGenLinkerVarSectionFast=true
          OS_BARRIER_CORE2_VAR_FAST_NOCACHE_NOINIT: vLinkGenLinkerVarSectionName=OS_BARRIER_CORE2_VAR_FAST_NOCACHE_NOINIT, vLinkGenLinkerVarSectionFast=true
          OS_CORESTATUS_CORE3_VAR_NOCACHE_NOINIT: vLinkGenLinkerVarSectionName=OS_CORESTATUS_CORE3_VAR_NOCACHE_NOINIT, vLinkGenLinkerVarSectionFast=false
          OS_CORESTATUS_CORE3_VAR_FAST_NOCACHE_NOINIT: vLinkGenLinkerVarSectionName=OS_CORESTATUS_CORE3_VAR_FAST_NOCACHE_NOINIT, vLinkGenLinkerVarSectionFast=true
          OS_CORE3_VAR: vLinkGenLinkerVarSectionName=OS_CORE3_VAR, vLinkGenLinkerVarSectionFast=false
          OS_CORE3_VAR_NOCACHE: vLinkGenLinkerVarSectionName=OS_CORE3_VAR_NOCACHE, vLinkGenLinkerVarSectionFast=false
          OS_CORE3_VAR_NOINIT: vLinkGenLinkerVarSectionName=OS_CORE3_VAR_NOINIT, vLinkGenLinkerVarSectionFast=false
          OS_CORE3_VAR_NOCACHE_NOINIT: vLinkGenLinkerVarSectionName=OS_CORE3_VAR_NOCACHE_NOINIT, vLinkGenLinkerVarSectionFast=false
          OS_PUBLIC_CORE3_VAR_NOINIT: vLinkGenLinkerVarSectionName=OS_PUBLIC_CORE3_VAR_NOINIT, vLinkGenLinkerVarSectionFast=false
          OS_BARRIER_CORE3_VAR_NOCACHE_NOINIT: vLinkGenLinkerVarSectionName=OS_BARRIER_CORE3_VAR_NOCACHE_NOINIT, vLinkGenLinkerVarSectionFast=false
          OS_CORE3_VAR_FAST: vLinkGenLinkerVarSectionName=OS_CORE3_VAR_FAST, vLinkGenLinkerVarSectionFast=true
          OS_CORE3_VAR_FAST_NOCACHE: vLinkGenLinkerVarSectionName=OS_CORE3_VAR_FAST_NOCACHE, vLinkGenLinkerVarSectionFast=true
          OS_CORE3_VAR_FAST_NOINIT: vLinkGenLinkerVarSectionName=OS_CORE3_VAR_FAST_NOINIT, vLinkGenLinkerVarSectionFast=true
          OS_CORE3_VAR_FAST_NOCACHE_NOINIT: vLinkGenLinkerVarSectionName=OS_CORE3_VAR_FAST_NOCACHE_NOINIT, vLinkGenLinkerVarSectionFast=true
          OS_PUBLIC_CORE3_VAR_FAST_NOINIT: vLinkGenLinkerVarSectionName=OS_PUBLIC_CORE3_VAR_FAST_NOINIT, vLinkGenLinkerVarSectionFast=true
          OS_BARRIER_CORE3_VAR_FAST_NOCACHE_NOINIT: vLinkGenLinkerVarSectionName=OS_BARRIER_CORE3_VAR_FAST_NOCACHE_NOINIT, vLinkGenLinkerVarSectionFast=true
          OS_OsApplication_VAR_NOINIT: vLinkGenLinkerVarSectionName=OS_OsApplication_VAR_NOINIT, vLinkGenLinkerVarSectionFast=false
          OS_OsApplication_VAR: vLinkGenLinkerVarSectionName=OS_OsApplication_VAR, vLinkGenLinkerVarSectionFast=false
          OS_OsApplication_VAR_ZERO_INIT: vLinkGenLinkerVarSectionName=OS_OsApplication_VAR_ZERO_INIT, vLinkGenLinkerVarSectionFast=false
          OS_OsApplication_VAR_NOCACHE_NOINIT: vLinkGenLinkerVarSectionName=OS_OsApplication_VAR_NOCACHE_NOINIT, vLinkGenLinkerVarSectionFast=false
          OS_OsApplication_VAR_NOCACHE: vLinkGenLinkerVarSectionName=OS_OsApplication_VAR_NOCACHE, vLinkGenLinkerVarSectionFast=false
          OS_OsApplication_VAR_NOCACHE_ZERO_INIT: vLinkGenLinkerVarSectionName=OS_OsApplication_VAR_NOCACHE_ZERO_INIT, vLinkGenLinkerVarSectionFast=false
          OS_OsApplication_VAR_FAST_NOINIT: vLinkGenLinkerVarSectionName=OS_OsApplication_VAR_FAST_NOINIT, vLinkGenLinkerVarSectionFast=true
          OS_OsApplication_VAR_FAST: vLinkGenLinkerVarSectionName=OS_OsApplication_VAR_FAST, vLinkGenLinkerVarSectionFast=true
          OS_OsApplication_VAR_FAST_ZERO_INIT: vLinkGenLinkerVarSectionName=OS_OsApplication_VAR_FAST_ZERO_INIT, vLinkGenLinkerVarSectionFast=true
          OS_OsApplication_VAR_FAST_NOCACHE_NOINIT: vLinkGenLinkerVarSectionName=OS_OsApplication_VAR_FAST_NOCACHE_NOINIT, vLinkGenLinkerVarSectionFast=true
          OS_OsApplication_VAR_FAST_NOCACHE: vLinkGenLinkerVarSectionName=OS_OsApplication_VAR_FAST_NOCACHE, vLinkGenLinkerVarSectionFast=true
          OS_OsApplication_VAR_FAST_NOCACHE_ZERO_INIT: vLinkGenLinkerVarSectionName=OS_OsApplication_VAR_FAST_NOCACHE_ZERO_INIT, vLinkGenLinkerVarSectionFast=true
          OS_OsApplication_VAR_ZERO_INIT_bss: vLinkGenLinkerVarSectionName=OS_OsApplication_VAR_ZERO_INIT_bss, vLinkGenLinkerVarSectionFast=false
          OS_OsApplication_VAR_NOCACHE_ZERO_INIT_bss: vLinkGenLinkerVarSectionName=OS_OsApplication_VAR_NOCACHE_ZERO_INIT_bss, vLinkGenLinkerVarSectionFast=false
          OS_OsApplication_VAR_FAST_ZERO_INIT_bss: vLinkGenLinkerVarSectionName=OS_OsApplication_VAR_FAST_ZERO_INIT_bss, vLinkGenLinkerVarSectionFast=true
          OS_OsApplication_VAR_FAST_NOCACHE_ZERO_INIT_bss: vLinkGenLinkerVarSectionName=OS_OsApplication_VAR_FAST_NOCACHE_ZERO_INIT_bss, vLinkGenLinkerVarSectionFast=true
          OS_OsApplication_Core1_VAR_NOINIT: vLinkGenLinkerVarSectionName=OS_OsApplication_Core1_VAR_NOINIT, vLinkGenLinkerVarSectionFast=false
          OS_OsApplication_Core1_VAR: vLinkGenLinkerVarSectionName=OS_OsApplication_Core1_VAR, vLinkGenLinkerVarSectionFast=false
          OS_OsApplication_Core1_VAR_ZERO_INIT: vLinkGenLinkerVarSectionName=OS_OsApplication_Core1_VAR_ZERO_INIT, vLinkGenLinkerVarSectionFast=false
          OS_OsApplication_Core1_VAR_NOCACHE_NOINIT: vLinkGenLinkerVarSectionName=OS_OsApplication_Core1_VAR_NOCACHE_NOINIT, vLinkGenLinkerVarSectionFast=false
          OS_OsApplication_Core1_VAR_NOCACHE: vLinkGenLinkerVarSectionName=OS_OsApplication_Core1_VAR_NOCACHE, vLinkGenLinkerVarSectionFast=false
          OS_OsApplication_Core1_VAR_NOCACHE_ZERO_INIT: vLinkGenLinkerVarSectionName=OS_OsApplication_Core1_VAR_NOCACHE_ZERO_INIT, vLinkGenLinkerVarSectionFast=false
          OS_OsApplication_Core1_VAR_FAST_NOINIT: vLinkGenLinkerVarSectionName=OS_OsApplication_Core1_VAR_FAST_NOINIT, vLinkGenLinkerVarSectionFast=true
          OS_OsApplication_Core1_VAR_FAST: vLinkGenLinkerVarSectionName=OS_OsApplication_Core1_VAR_FAST, vLinkGenLinkerVarSectionFast=true
          OS_OsApplication_Core1_VAR_FAST_ZERO_INIT: vLinkGenLinkerVarSectionName=OS_OsApplication_Core1_VAR_FAST_ZERO_INIT, vLinkGenLinkerVarSectionFast=true
          OS_OsApplication_Core1_VAR_FAST_NOCACHE_NOINIT: vLinkGenLinkerVarSectionName=OS_OsApplication_Core1_VAR_FAST_NOCACHE_NOINIT, vLinkGenLinkerVarSectionFast=true
          OS_OsApplication_Core1_VAR_FAST_NOCACHE: vLinkGenLinkerVarSectionName=OS_OsApplication_Core1_VAR_FAST_NOCACHE, vLinkGenLinkerVarSectionFast=true
          OS_OsApplication_Core1_VAR_FAST_NOCACHE_ZERO_INIT: vLinkGenLinkerVarSectionName=OS_OsApplication_Core1_VAR_FAST_NOCACHE_ZERO_INIT, vLinkGenLinkerVarSectionFast=true
          OS_OsApplication_Core1_VAR_ZERO_INIT_bss: vLinkGenLinkerVarSectionName=OS_OsApplication_Core1_VAR_ZERO_INIT_bss, vLinkGenLinkerVarSectionFast=false
          OS_OsApplication_Core1_VAR_NOCACHE_ZERO_INIT_bss: vLinkGenLinkerVarSectionName=OS_OsApplication_Core1_VAR_NOCACHE_ZERO_INIT_bss, vLinkGenLinkerVarSectionFast=false
          OS_OsApplication_Core1_VAR_FAST_ZERO_INIT_bss: vLinkGenLinkerVarSectionName=OS_OsApplication_Core1_VAR_FAST_ZERO_INIT_bss, vLinkGenLinkerVarSectionFast=true
          OS_OsApplication_Core1_VAR_FAST_NOCACHE_ZERO_INIT_bss: vLinkGenLinkerVarSectionName=OS_OsApplication_Core1_VAR_FAST_NOCACHE_ZERO_INIT_bss, vLinkGenLinkerVarSectionFast=true
          OS_OsApplication_Core2_VAR_NOINIT: vLinkGenLinkerVarSectionName=OS_OsApplication_Core2_VAR_NOINIT, vLinkGenLinkerVarSectionFast=false
          OS_OsApplication_Core2_VAR: vLinkGenLinkerVarSectionName=OS_OsApplication_Core2_VAR, vLinkGenLinkerVarSectionFast=false
          OS_OsApplication_Core2_VAR_ZERO_INIT: vLinkGenLinkerVarSectionName=OS_OsApplication_Core2_VAR_ZERO_INIT, vLinkGenLinkerVarSectionFast=false
          OS_OsApplication_Core2_VAR_NOCACHE_NOINIT: vLinkGenLinkerVarSectionName=OS_OsApplication_Core2_VAR_NOCACHE_NOINIT, vLinkGenLinkerVarSectionFast=false
          OS_OsApplication_Core2_VAR_NOCACHE: vLinkGenLinkerVarSectionName=OS_OsApplication_Core2_VAR_NOCACHE, vLinkGenLinkerVarSectionFast=false
          OS_OsApplication_Core2_VAR_NOCACHE_ZERO_INIT: vLinkGenLinkerVarSectionName=OS_OsApplication_Core2_VAR_NOCACHE_ZERO_INIT, vLinkGenLinkerVarSectionFast=false
          OS_OsApplication_Core2_VAR_FAST_NOINIT: vLinkGenLinkerVarSectionName=OS_OsApplication_Core2_VAR_FAST_NOINIT, vLinkGenLinkerVarSectionFast=true
          OS_OsApplication_Core2_VAR_FAST: vLinkGenLinkerVarSectionName=OS_OsApplication_Core2_VAR_FAST, vLinkGenLinkerVarSectionFast=true
          OS_OsApplication_Core2_VAR_FAST_ZERO_INIT: vLinkGenLinkerVarSectionName=OS_OsApplication_Core2_VAR_FAST_ZERO_INIT, vLinkGenLinkerVarSectionFast=true
          OS_OsApplication_Core2_VAR_FAST_NOCACHE_NOINIT: vLinkGenLinkerVarSectionName=OS_OsApplication_Core2_VAR_FAST_NOCACHE_NOINIT, vLinkGenLinkerVarSectionFast=true
          OS_OsApplication_Core2_VAR_FAST_NOCACHE: vLinkGenLinkerVarSectionName=OS_OsApplication_Core2_VAR_FAST_NOCACHE, vLinkGenLinkerVarSectionFast=true
          OS_OsApplication_Core2_VAR_FAST_NOCACHE_ZERO_INIT: vLinkGenLinkerVarSectionName=OS_OsApplication_Core2_VAR_FAST_NOCACHE_ZERO_INIT, vLinkGenLinkerVarSectionFast=true
          OS_OsApplication_Core2_VAR_ZERO_INIT_bss: vLinkGenLinkerVarSectionName=OS_OsApplication_Core2_VAR_ZERO_INIT_bss, vLinkGenLinkerVarSectionFast=false
          OS_OsApplication_Core2_VAR_NOCACHE_ZERO_INIT_bss: vLinkGenLinkerVarSectionName=OS_OsApplication_Core2_VAR_NOCACHE_ZERO_INIT_bss, vLinkGenLinkerVarSectionFast=false
          OS_OsApplication_Core2_VAR_FAST_ZERO_INIT_bss: vLinkGenLinkerVarSectionName=OS_OsApplication_Core2_VAR_FAST_ZERO_INIT_bss, vLinkGenLinkerVarSectionFast=true
          OS_OsApplication_Core2_VAR_FAST_NOCACHE_ZERO_INIT_bss: vLinkGenLinkerVarSectionName=OS_OsApplication_Core2_VAR_FAST_NOCACHE_ZERO_INIT_bss, vLinkGenLinkerVarSectionFast=true
          OS_OsApplication_Core3_VAR_NOINIT: vLinkGenLinkerVarSectionName=OS_OsApplication_Core3_VAR_NOINIT, vLinkGenLinkerVarSectionFast=false
          OS_OsApplication_Core3_VAR: vLinkGenLinkerVarSectionName=OS_OsApplication_Core3_VAR, vLinkGenLinkerVarSectionFast=false
          OS_OsApplication_Core3_VAR_ZERO_INIT: vLinkGenLinkerVarSectionName=OS_OsApplication_Core3_VAR_ZERO_INIT, vLinkGenLinkerVarSectionFast=false
          OS_OsApplication_Core3_VAR_NOCACHE_NOINIT: vLinkGenLinkerVarSectionName=OS_OsApplication_Core3_VAR_NOCACHE_NOINIT, vLinkGenLinkerVarSectionFast=false
          OS_OsApplication_Core3_VAR_NOCACHE: vLinkGenLinkerVarSectionName=OS_OsApplication_Core3_VAR_NOCACHE, vLinkGenLinkerVarSectionFast=false
          OS_OsApplication_Core3_VAR_NOCACHE_ZERO_INIT: vLinkGenLinkerVarSectionName=OS_OsApplication_Core3_VAR_NOCACHE_ZERO_INIT, vLinkGenLinkerVarSectionFast=false
          OS_OsApplication_Core3_VAR_FAST_NOINIT: vLinkGenLinkerVarSectionName=OS_OsApplication_Core3_VAR_FAST_NOINIT, vLinkGenLinkerVarSectionFast=true
          OS_OsApplication_Core3_VAR_FAST: vLinkGenLinkerVarSectionName=OS_OsApplication_Core3_VAR_FAST, vLinkGenLinkerVarSectionFast=true
          OS_OsApplication_Core3_VAR_FAST_ZERO_INIT: vLinkGenLinkerVarSectionName=OS_OsApplication_Core3_VAR_FAST_ZERO_INIT, vLinkGenLinkerVarSectionFast=true
          OS_OsApplication_Core3_VAR_FAST_NOCACHE_NOINIT: vLinkGenLinkerVarSectionName=OS_OsApplication_Core3_VAR_FAST_NOCACHE_NOINIT, vLinkGenLinkerVarSectionFast=true
          OS_OsApplication_Core3_VAR_FAST_NOCACHE: vLinkGenLinkerVarSectionName=OS_OsApplication_Core3_VAR_FAST_NOCACHE, vLinkGenLinkerVarSectionFast=true
          OS_OsApplication_Core3_VAR_FAST_NOCACHE_ZERO_INIT: vLinkGenLinkerVarSectionName=OS_OsApplication_Core3_VAR_FAST_NOCACHE_ZERO_INIT, vLinkGenLinkerVarSectionFast=true
          OS_OsApplication_Core3_VAR_ZERO_INIT_bss: vLinkGenLinkerVarSectionName=OS_OsApplication_Core3_VAR_ZERO_INIT_bss, vLinkGenLinkerVarSectionFast=false
          OS_OsApplication_Core3_VAR_NOCACHE_ZERO_INIT_bss: vLinkGenLinkerVarSectionName=OS_OsApplication_Core3_VAR_NOCACHE_ZERO_INIT_bss, vLinkGenLinkerVarSectionFast=false
          OS_OsApplication_Core3_VAR_FAST_ZERO_INIT_bss: vLinkGenLinkerVarSectionName=OS_OsApplication_Core3_VAR_FAST_ZERO_INIT_bss, vLinkGenLinkerVarSectionFast=true
          OS_OsApplication_Core3_VAR_FAST_NOCACHE_ZERO_INIT_bss: vLinkGenLinkerVarSectionName=OS_OsApplication_Core3_VAR_FAST_NOCACHE_ZERO_INIT_bss, vLinkGenLinkerVarSectionFast=true
          OS_SystemApplication_OsCore0_VAR_NOINIT: vLinkGenLinkerVarSectionName=OS_SystemApplication_OsCore0_VAR_NOINIT, vLinkGenLinkerVarSectionFast=false
          OS_SystemApplication_OsCore0_VAR: vLinkGenLinkerVarSectionName=OS_SystemApplication_OsCore0_VAR, vLinkGenLinkerVarSectionFast=false
          OS_SystemApplication_OsCore0_VAR_ZERO_INIT: vLinkGenLinkerVarSectionName=OS_SystemApplication_OsCore0_VAR_ZERO_INIT, vLinkGenLinkerVarSectionFast=false
          OS_SystemApplication_OsCore0_VAR_NOCACHE_NOINIT: vLinkGenLinkerVarSectionName=OS_SystemApplication_OsCore0_VAR_NOCACHE_NOINIT, vLinkGenLinkerVarSectionFast=false
          OS_SystemApplication_OsCore0_VAR_NOCACHE: vLinkGenLinkerVarSectionName=OS_SystemApplication_OsCore0_VAR_NOCACHE, vLinkGenLinkerVarSectionFast=false
          OS_SystemApplication_OsCore0_VAR_NOCACHE_ZERO_INIT: vLinkGenLinkerVarSectionName=OS_SystemApplication_OsCore0_VAR_NOCACHE_ZERO_INIT, vLinkGenLinkerVarSectionFast=false
          OS_SystemApplication_OsCore0_VAR_FAST_NOINIT: vLinkGenLinkerVarSectionName=OS_SystemApplication_OsCore0_VAR_FAST_NOINIT, vLinkGenLinkerVarSectionFast=true
          OS_SystemApplication_OsCore0_VAR_FAST: vLinkGenLinkerVarSectionName=OS_SystemApplication_OsCore0_VAR_FAST, vLinkGenLinkerVarSectionFast=true
          OS_SystemApplication_OsCore0_VAR_FAST_ZERO_INIT: vLinkGenLinkerVarSectionName=OS_SystemApplication_OsCore0_VAR_FAST_ZERO_INIT, vLinkGenLinkerVarSectionFast=true
          OS_SystemApplication_OsCore0_VAR_FAST_NOCACHE_NOINIT: vLinkGenLinkerVarSectionName=OS_SystemApplication_OsCore0_VAR_FAST_NOCACHE_NOINIT, vLinkGenLinkerVarSectionFast=true
          OS_SystemApplication_OsCore0_VAR_FAST_NOCACHE: vLinkGenLinkerVarSectionName=OS_SystemApplication_OsCore0_VAR_FAST_NOCACHE, vLinkGenLinkerVarSectionFast=true
          OS_SystemApplication_OsCore0_VAR_FAST_NOCACHE_ZERO_INIT: vLinkGenLinkerVarSectionName=OS_SystemApplication_OsCore0_VAR_FAST_NOCACHE_ZERO_INIT, vLinkGenLinkerVarSectionFast=true
          OS_SystemApplication_OsCore0_VAR_ZERO_INIT_bss: vLinkGenLinkerVarSectionName=OS_SystemApplication_OsCore0_VAR_ZERO_INIT_bss, vLinkGenLinkerVarSectionFast=false
          OS_SystemApplication_OsCore0_VAR_NOCACHE_ZERO_INIT_bss: vLinkGenLinkerVarSectionName=OS_SystemApplication_OsCore0_VAR_NOCACHE_ZERO_INIT_bss, vLinkGenLinkerVarSectionFast=false
          OS_SystemApplication_OsCore0_VAR_FAST_ZERO_INIT_bss: vLinkGenLinkerVarSectionName=OS_SystemApplication_OsCore0_VAR_FAST_ZERO_INIT_bss, vLinkGenLinkerVarSectionFast=true
          OS_SystemApplication_OsCore0_VAR_FAST_NOCACHE_ZERO_INIT_bss: vLinkGenLinkerVarSectionName=OS_SystemApplication_OsCore0_VAR_FAST_NOCACHE_ZERO_INIT_bss, vLinkGenLinkerVarSectionFast=true
          OS_SystemApplication_OsCore1_VAR_NOINIT: vLinkGenLinkerVarSectionName=OS_SystemApplication_OsCore1_VAR_NOINIT, vLinkGenLinkerVarSectionFast=false
          OS_SystemApplication_OsCore1_VAR: vLinkGenLinkerVarSectionName=OS_SystemApplication_OsCore1_VAR, vLinkGenLinkerVarSectionFast=false
          OS_SystemApplication_OsCore1_VAR_ZERO_INIT: vLinkGenLinkerVarSectionName=OS_SystemApplication_OsCore1_VAR_ZERO_INIT, vLinkGenLinkerVarSectionFast=false
          OS_SystemApplication_OsCore1_VAR_NOCACHE_NOINIT: vLinkGenLinkerVarSectionName=OS_SystemApplication_OsCore1_VAR_NOCACHE_NOINIT, vLinkGenLinkerVarSectionFast=false
          OS_SystemApplication_OsCore1_VAR_NOCACHE: vLinkGenLinkerVarSectionName=OS_SystemApplication_OsCore1_VAR_NOCACHE, vLinkGenLinkerVarSectionFast=false
          OS_SystemApplication_OsCore1_VAR_NOCACHE_ZERO_INIT: vLinkGenLinkerVarSectionName=OS_SystemApplication_OsCore1_VAR_NOCACHE_ZERO_INIT, vLinkGenLinkerVarSectionFast=false
          OS_SystemApplication_OsCore1_VAR_FAST_NOINIT: vLinkGenLinkerVarSectionName=OS_SystemApplication_OsCore1_VAR_FAST_NOINIT, vLinkGenLinkerVarSectionFast=true
          OS_SystemApplication_OsCore1_VAR_FAST: vLinkGenLinkerVarSectionName=OS_SystemApplication_OsCore1_VAR_FAST, vLinkGenLinkerVarSectionFast=true
          OS_SystemApplication_OsCore1_VAR_FAST_ZERO_INIT: vLinkGenLinkerVarSectionName=OS_SystemApplication_OsCore1_VAR_FAST_ZERO_INIT, vLinkGenLinkerVarSectionFast=true
          OS_SystemApplication_OsCore1_VAR_FAST_NOCACHE_NOINIT: vLinkGenLinkerVarSectionName=OS_SystemApplication_OsCore1_VAR_FAST_NOCACHE_NOINIT, vLinkGenLinkerVarSectionFast=true
          OS_SystemApplication_OsCore1_VAR_FAST_NOCACHE: vLinkGenLinkerVarSectionName=OS_SystemApplication_OsCore1_VAR_FAST_NOCACHE, vLinkGenLinkerVarSectionFast=true
          OS_SystemApplication_OsCore1_VAR_FAST_NOCACHE_ZERO_INIT: vLinkGenLinkerVarSectionName=OS_SystemApplication_OsCore1_VAR_FAST_NOCACHE_ZERO_INIT, vLinkGenLinkerVarSectionFast=true
          OS_SystemApplication_OsCore1_VAR_ZERO_INIT_bss: vLinkGenLinkerVarSectionName=OS_SystemApplication_OsCore1_VAR_ZERO_INIT_bss, vLinkGenLinkerVarSectionFast=false
          OS_SystemApplication_OsCore1_VAR_NOCACHE_ZERO_INIT_bss: vLinkGenLinkerVarSectionName=OS_SystemApplication_OsCore1_VAR_NOCACHE_ZERO_INIT_bss, vLinkGenLinkerVarSectionFast=false
          OS_SystemApplication_OsCore1_VAR_FAST_ZERO_INIT_bss: vLinkGenLinkerVarSectionName=OS_SystemApplication_OsCore1_VAR_FAST_ZERO_INIT_bss, vLinkGenLinkerVarSectionFast=true
          OS_SystemApplication_OsCore1_VAR_FAST_NOCACHE_ZERO_INIT_bss: vLinkGenLinkerVarSectionName=OS_SystemApplication_OsCore1_VAR_FAST_NOCACHE_ZERO_INIT_bss, vLinkGenLinkerVarSectionFast=true
          OS_SystemApplication_OsCore2_VAR_NOINIT: vLinkGenLinkerVarSectionName=OS_SystemApplication_OsCore2_VAR_NOINIT, vLinkGenLinkerVarSectionFast=false
          OS_SystemApplication_OsCore2_VAR: vLinkGenLinkerVarSectionName=OS_SystemApplication_OsCore2_VAR, vLinkGenLinkerVarSectionFast=false
          OS_SystemApplication_OsCore2_VAR_ZERO_INIT: vLinkGenLinkerVarSectionName=OS_SystemApplication_OsCore2_VAR_ZERO_INIT, vLinkGenLinkerVarSectionFast=false
          OS_SystemApplication_OsCore2_VAR_NOCACHE_NOINIT: vLinkGenLinkerVarSectionName=OS_SystemApplication_OsCore2_VAR_NOCACHE_NOINIT, vLinkGenLinkerVarSectionFast=false
          OS_SystemApplication_OsCore2_VAR_NOCACHE: vLinkGenLinkerVarSectionName=OS_SystemApplication_OsCore2_VAR_NOCACHE, vLinkGenLinkerVarSectionFast=false
          OS_SystemApplication_OsCore2_VAR_NOCACHE_ZERO_INIT: vLinkGenLinkerVarSectionName=OS_SystemApplication_OsCore2_VAR_NOCACHE_ZERO_INIT, vLinkGenLinkerVarSectionFast=false
          OS_SystemApplication_OsCore2_VAR_FAST_NOINIT: vLinkGenLinkerVarSectionName=OS_SystemApplication_OsCore2_VAR_FAST_NOINIT, vLinkGenLinkerVarSectionFast=true
          OS_SystemApplication_OsCore2_VAR_FAST: vLinkGenLinkerVarSectionName=OS_SystemApplication_OsCore2_VAR_FAST, vLinkGenLinkerVarSectionFast=true
          OS_SystemApplication_OsCore2_VAR_FAST_ZERO_INIT: vLinkGenLinkerVarSectionName=OS_SystemApplication_OsCore2_VAR_FAST_ZERO_INIT, vLinkGenLinkerVarSectionFast=true
          OS_SystemApplication_OsCore2_VAR_FAST_NOCACHE_NOINIT: vLinkGenLinkerVarSectionName=OS_SystemApplication_OsCore2_VAR_FAST_NOCACHE_NOINIT, vLinkGenLinkerVarSectionFast=true
          OS_SystemApplication_OsCore2_VAR_FAST_NOCACHE: vLinkGenLinkerVarSectionName=OS_SystemApplication_OsCore2_VAR_FAST_NOCACHE, vLinkGenLinkerVarSectionFast=true
          OS_SystemApplication_OsCore2_VAR_FAST_NOCACHE_ZERO_INIT: vLinkGenLinkerVarSectionName=OS_SystemApplication_OsCore2_VAR_FAST_NOCACHE_ZERO_INIT, vLinkGenLinkerVarSectionFast=true
          OS_SystemApplication_OsCore2_VAR_ZERO_INIT_bss: vLinkGenLinkerVarSectionName=OS_SystemApplication_OsCore2_VAR_ZERO_INIT_bss, vLinkGenLinkerVarSectionFast=false
          OS_SystemApplication_OsCore2_VAR_NOCACHE_ZERO_INIT_bss: vLinkGenLinkerVarSectionName=OS_SystemApplication_OsCore2_VAR_NOCACHE_ZERO_INIT_bss, vLinkGenLinkerVarSectionFast=false
          OS_SystemApplication_OsCore2_VAR_FAST_ZERO_INIT_bss: vLinkGenLinkerVarSectionName=OS_SystemApplication_OsCore2_VAR_FAST_ZERO_INIT_bss, vLinkGenLinkerVarSectionFast=true
          OS_SystemApplication_OsCore2_VAR_FAST_NOCACHE_ZERO_INIT_bss: vLinkGenLinkerVarSectionName=OS_SystemApplication_OsCore2_VAR_FAST_NOCACHE_ZERO_INIT_bss, vLinkGenLinkerVarSectionFast=true
          OS_SystemApplication_OsCore3_VAR_NOINIT: vLinkGenLinkerVarSectionName=OS_SystemApplication_OsCore3_VAR_NOINIT, vLinkGenLinkerVarSectionFast=false
          OS_SystemApplication_OsCore3_VAR: vLinkGenLinkerVarSectionName=OS_SystemApplication_OsCore3_VAR, vLinkGenLinkerVarSectionFast=false
          OS_SystemApplication_OsCore3_VAR_ZERO_INIT: vLinkGenLinkerVarSectionName=OS_SystemApplication_OsCore3_VAR_ZERO_INIT, vLinkGenLinkerVarSectionFast=false
          OS_SystemApplication_OsCore3_VAR_NOCACHE_NOINIT: vLinkGenLinkerVarSectionName=OS_SystemApplication_OsCore3_VAR_NOCACHE_NOINIT, vLinkGenLinkerVarSectionFast=false
          OS_SystemApplication_OsCore3_VAR_NOCACHE: vLinkGenLinkerVarSectionName=OS_SystemApplication_OsCore3_VAR_NOCACHE, vLinkGenLinkerVarSectionFast=false
          OS_SystemApplication_OsCore3_VAR_NOCACHE_ZERO_INIT: vLinkGenLinkerVarSectionName=OS_SystemApplication_OsCore3_VAR_NOCACHE_ZERO_INIT, vLinkGenLinkerVarSectionFast=false
          OS_SystemApplication_OsCore3_VAR_FAST_NOINIT: vLinkGenLinkerVarSectionName=OS_SystemApplication_OsCore3_VAR_FAST_NOINIT, vLinkGenLinkerVarSectionFast=true
          OS_SystemApplication_OsCore3_VAR_FAST: vLinkGenLinkerVarSectionName=OS_SystemApplication_OsCore3_VAR_FAST, vLinkGenLinkerVarSectionFast=true
          OS_SystemApplication_OsCore3_VAR_FAST_ZERO_INIT: vLinkGenLinkerVarSectionName=OS_SystemApplication_OsCore3_VAR_FAST_ZERO_INIT, vLinkGenLinkerVarSectionFast=true
          OS_SystemApplication_OsCore3_VAR_FAST_NOCACHE_NOINIT: vLinkGenLinkerVarSectionName=OS_SystemApplication_OsCore3_VAR_FAST_NOCACHE_NOINIT, vLinkGenLinkerVarSectionFast=true
          OS_SystemApplication_OsCore3_VAR_FAST_NOCACHE: vLinkGenLinkerVarSectionName=OS_SystemApplication_OsCore3_VAR_FAST_NOCACHE, vLinkGenLinkerVarSectionFast=true
          OS_SystemApplication_OsCore3_VAR_FAST_NOCACHE_ZERO_INIT: vLinkGenLinkerVarSectionName=OS_SystemApplication_OsCore3_VAR_FAST_NOCACHE_ZERO_INIT, vLinkGenLinkerVarSectionFast=true
          OS_SystemApplication_OsCore3_VAR_ZERO_INIT_bss: vLinkGenLinkerVarSectionName=OS_SystemApplication_OsCore3_VAR_ZERO_INIT_bss, vLinkGenLinkerVarSectionFast=false
          OS_SystemApplication_OsCore3_VAR_NOCACHE_ZERO_INIT_bss: vLinkGenLinkerVarSectionName=OS_SystemApplication_OsCore3_VAR_NOCACHE_ZERO_INIT_bss, vLinkGenLinkerVarSectionFast=false
          OS_SystemApplication_OsCore3_VAR_FAST_ZERO_INIT_bss: vLinkGenLinkerVarSectionName=OS_SystemApplication_OsCore3_VAR_FAST_ZERO_INIT_bss, vLinkGenLinkerVarSectionFast=true
          OS_SystemApplication_OsCore3_VAR_FAST_NOCACHE_ZERO_INIT_bss: vLinkGenLinkerVarSectionName=OS_SystemApplication_OsCore3_VAR_FAST_NOCACHE_ZERO_INIT_bss, vLinkGenLinkerVarSectionFast=true
        6 x vLinkGenLinkerCodeSection, all with vLinkGenLinkerCodeSectionFast=false, vLinkGenLinkerCodeSectionAlignment=0, vLinkGenLinkerCodeSectionModule=Os:
          OS_Default_Init_Task_Core{1..3}_Trusted_CODE: vLinkGenLinkerCodeSectionName=OS_Default_Init_Task_Core{1..3}_Trusted_CODE
          OS_Default_Init_Task_Core2_CODE: vLinkGenLinkerCodeSectionName=OS_Default_Init_Task_Core2_CODE
          OS_Default_Init_Task_Core3_CODE: vLinkGenLinkerCodeSectionName=OS_Default_Init_Task_Core3_CODE
          OS_Default_Init_Task_Core1_CODE: vLinkGenLinkerCodeSectionName=OS_Default_Init_Task_Core1_CODE
        8 x vLinkGenLinkerStackSection, all with vLinkGenLinkerStackSectionAlignment=8, vLinkGenLinkerStackSectionModule=Os:
          OS_STACK_OSCORE0_TASK_PRIO49_VAR_NOINIT: vLinkGenLinkerStackSectionName=OS_STACK_OSCORE0_TASK_PRIO49_VAR_NOINIT
          OS_STACK_OSCORE0_TASK_PRIO50_VAR_NOINIT: vLinkGenLinkerStackSectionName=OS_STACK_OSCORE0_TASK_PRIO50_VAR_NOINIT
          OS_STACK_OSCORE1_TASK_PRIO49_VAR_NOINIT: vLinkGenLinkerStackSectionName=OS_STACK_OSCORE1_TASK_PRIO49_VAR_NOINIT
          OS_STACK_OSCORE1_TASK_PRIO50_VAR_NOINIT: vLinkGenLinkerStackSectionName=OS_STACK_OSCORE1_TASK_PRIO50_VAR_NOINIT
          OS_STACK_OSCORE2_TASK_PRIO49_VAR_NOINIT: vLinkGenLinkerStackSectionName=OS_STACK_OSCORE2_TASK_PRIO49_VAR_NOINIT
          OS_STACK_OSCORE2_TASK_PRIO50_VAR_NOINIT: vLinkGenLinkerStackSectionName=OS_STACK_OSCORE2_TASK_PRIO50_VAR_NOINIT
          OS_STACK_OSCORE3_TASK_PRIO49_VAR_NOINIT: vLinkGenLinkerStackSectionName=OS_STACK_OSCORE3_TASK_PRIO49_VAR_NOINIT
          OS_STACK_OSCORE3_TASK_PRIO50_VAR_NOINIT: vLinkGenLinkerStackSectionName=OS_STACK_OSCORE3_TASK_PRIO50_VAR_NOINIT
        OS_CanIsr_3_CODE (vLinkGenLinkerCodeSection):
          vLinkGenLinkerCodeSectionName = OS_CanIsr_3_CODE
          vLinkGenLinkerCodeSectionFast = false
          vLinkGenLinkerCodeSectionAlignment = 0
          vLinkGenLinkerCodeSectionModule = Os
      4 x vLinkGenLogicalVarGroup, all with vLinkGenVarGroupPosition=5, vLinkGenVarGroupRomRegion=RegionBlock_PFlash0_Cached, vLinkGenVarGroupModule=Os:
        OS_OsApplication_Core2_VAR: vLinkGenVarGroupInitCore=2, vLinkGenVarGroupRegion=RegionBlock_0_DSPR_Core2
          8 x vLinkGenVarSectionGroup, all with vLinkGenVarSectionGroupPosition=0, vLinkGenVarSectionGroupInitStage=ONE, vLinkGenVarSectionGroupGapSize=16, vLinkGenVarSectionGroupAlignment=16, vLinkGenVarSectionGroupFlag=vLinkGenVarGroupFlags/ORDERED, vLinkGenVarSectionGroupFlag=vLinkGenVarGroupFlags/CONTIGUOUS, vLinkGenVarSectionGroupFlag=vLinkGenVarGroupFlags/FILL, vLinkGenVarSectionGroupFlag=vLinkGenVarGroupFlags/READ, vLinkGenVarSectionGroupFlag=vLinkGenVarGroupFlags/WRITE:
            OS_OsApplication_Core2_VAR_NOINIT: vLinkGenVarSectionGroupInit=NONE, vLinkGenVarSectionGroupRef=vLinkGenLinkerSections/OS_OsApplication_Core2_VAR_NOINIT, vLinkGenVarSectionGroupRef=OS_OsApplication_Core2_VAR_NOCACHE_NOINIT
            OS_OsApplication_Core2_VAR_FAST_NOINIT: vLinkGenVarSectionGroupInit=NONE, vLinkGenVarSectionGroupRef=vLinkGenLinkerSections/OS_OsApplication_Core2_VAR_FAST_NOINIT, vLinkGenVarSectionGroupRef=OS_OsApplication_Core2_VAR_FAST_NOCACHE_NOINIT
            OS_OsApplication_Core2_VAR_INIT: vLinkGenVarSectionGroupInit=INIT, vLinkGenVarSectionGroupEndAlignment=4, vLinkGenVarSectionGroupRef=vLinkGenLinkerSections/OS_OsApplication_Core2_VAR, vLinkGenVarSectionGroupRef=OS_OsApplication_Core2_VAR_NOCACHE
            OS_OsApplication_Core2_VAR_FAST_INIT: vLinkGenVarSectionGroupInit=INIT, vLinkGenVarSectionGroupEndAlignment=4, vLinkGenVarSectionGroupRef=OS_OsApplication_Core2_VAR_FAST, vLinkGenVarSectionGroupRef=OS_OsApplication_Core2_VAR_FAST_NOCACHE
            OS_OsApplication_Core2_VAR_ZERO_INIT: vLinkGenVarSectionGroupInit=ZERO_INIT, vLinkGenVarSectionGroupEndAlignment=4, vLinkGenVarSectionGroupRef=vLinkGenLinkerSections/OS_OsApplication_Core2_VAR_ZERO_INIT, vLinkGenVarSectionGroupRef=OS_OsApplication_Core2_VAR_NOCACHE_ZERO_INIT
            OS_OsApplication_Core2_VAR_FAST_ZERO_INIT: vLinkGenVarSectionGroupInit=ZERO_INIT, vLinkGenVarSectionGroupEndAlignment=4, vLinkGenVarSectionGroupRef=vLinkGenLinkerSections/OS_OsApplication_Core2_VAR_FAST_ZERO_INIT, vLinkGenVarSectionGroupRef=OS_OsApplication_Core2_VAR_FAST_NOCACHE_ZERO_INIT
            OS_OsApplication_Core2_VAR_ZERO_INIT_bss: vLinkGenVarSectionGroupInit=ZERO_INIT, vLinkGenVarSectionGroupEndAlignment=4, vLinkGenVarSectionGroupRef=vLinkGenLinkerSections/OS_OsApplication_Core2_VAR_ZERO_INIT_bss, vLinkGenVarSectionGroupRef=OS_OsApplication_Core2_VAR_NOCACHE_ZERO_INIT_bss
            OS_OsApplication_Core2_VAR_FAST_ZERO_INIT_bss: vLinkGenVarSectionGroupInit=ZERO_INIT, vLinkGenVarSectionGroupEndAlignment=4, vLinkGenVarSectionGroupRef=vLinkGenLinkerSections/OS_OsApplication_Core2_VAR_FAST_ZERO_INIT_bss, vLinkGenVarSectionGroupRef=OS_OsApplication_Core2_VAR_FAST_NOCACHE_ZERO_INIT_bss
        OS_OsApplication_Core3_VAR: vLinkGenVarGroupInitCore=3, vLinkGenVarGroupRegion=RegionBlock_0_DSPR_Core3
          8 x vLinkGenVarSectionGroup, all with vLinkGenVarSectionGroupPosition=0, vLinkGenVarSectionGroupInitStage=ONE, vLinkGenVarSectionGroupGapSize=16, vLinkGenVarSectionGroupAlignment=16, vLinkGenVarSectionGroupFlag=vLinkGenVarGroupFlags/ORDERED, vLinkGenVarSectionGroupFlag=vLinkGenVarGroupFlags/CONTIGUOUS, vLinkGenVarSectionGroupFlag=vLinkGenVarGroupFlags/FILL, vLinkGenVarSectionGroupFlag=vLinkGenVarGroupFlags/READ, vLinkGenVarSectionGroupFlag=vLinkGenVarGroupFlags/WRITE:
            OS_OsApplication_Core3_VAR_NOINIT: vLinkGenVarSectionGroupInit=NONE, vLinkGenVarSectionGroupRef=vLinkGenLinkerSections/OS_OsApplication_Core3_VAR_NOINIT, vLinkGenVarSectionGroupRef=OS_OsApplication_Core3_VAR_NOCACHE_NOINIT
            OS_OsApplication_Core3_VAR_FAST_NOINIT: vLinkGenVarSectionGroupInit=NONE, vLinkGenVarSectionGroupRef=vLinkGenLinkerSections/OS_OsApplication_Core3_VAR_FAST_NOINIT, vLinkGenVarSectionGroupRef=OS_OsApplication_Core3_VAR_FAST_NOCACHE_NOINIT
            OS_OsApplication_Core3_VAR_INIT: vLinkGenVarSectionGroupInit=INIT, vLinkGenVarSectionGroupEndAlignment=4, vLinkGenVarSectionGroupRef=vLinkGenLinkerSections/OS_OsApplication_Core3_VAR, vLinkGenVarSectionGroupRef=OS_OsApplication_Core3_VAR_NOCACHE
            OS_OsApplication_Core3_VAR_FAST_INIT: vLinkGenVarSectionGroupInit=INIT, vLinkGenVarSectionGroupEndAlignment=4, vLinkGenVarSectionGroupRef=OS_OsApplication_Core3_VAR_FAST, vLinkGenVarSectionGroupRef=OS_OsApplication_Core3_VAR_FAST_NOCACHE
            OS_OsApplication_Core3_VAR_ZERO_INIT: vLinkGenVarSectionGroupInit=ZERO_INIT, vLinkGenVarSectionGroupEndAlignment=4, vLinkGenVarSectionGroupRef=vLinkGenLinkerSections/OS_OsApplication_Core3_VAR_ZERO_INIT, vLinkGenVarSectionGroupRef=OS_OsApplication_Core3_VAR_NOCACHE_ZERO_INIT
            OS_OsApplication_Core3_VAR_FAST_ZERO_INIT: vLinkGenVarSectionGroupInit=ZERO_INIT, vLinkGenVarSectionGroupEndAlignment=4, vLinkGenVarSectionGroupRef=vLinkGenLinkerSections/OS_OsApplication_Core3_VAR_FAST_ZERO_INIT, vLinkGenVarSectionGroupRef=OS_OsApplication_Core3_VAR_FAST_NOCACHE_ZERO_INIT
            OS_OsApplication_Core3_VAR_ZERO_INIT_bss: vLinkGenVarSectionGroupInit=ZERO_INIT, vLinkGenVarSectionGroupEndAlignment=4, vLinkGenVarSectionGroupRef=vLinkGenLinkerSections/OS_OsApplication_Core3_VAR_ZERO_INIT_bss, vLinkGenVarSectionGroupRef=OS_OsApplication_Core3_VAR_NOCACHE_ZERO_INIT_bss
            OS_OsApplication_Core3_VAR_FAST_ZERO_INIT_bss: vLinkGenVarSectionGroupInit=ZERO_INIT, vLinkGenVarSectionGroupEndAlignment=4, vLinkGenVarSectionGroupRef=vLinkGenLinkerSections/OS_OsApplication_Core3_VAR_FAST_ZERO_INIT_bss, vLinkGenVarSectionGroupRef=OS_OsApplication_Core3_VAR_FAST_NOCACHE_ZERO_INIT_bss
        OS_OsApplication_VAR: vLinkGenVarGroupInitCore=0, vLinkGenVarGroupRegion=RegionBlock_0_DSPR_Core0
          8 x vLinkGenVarSectionGroup, all with vLinkGenVarSectionGroupPosition=0, vLinkGenVarSectionGroupInitStage=ONE, vLinkGenVarSectionGroupGapSize=16, vLinkGenVarSectionGroupAlignment=16, vLinkGenVarSectionGroupFlag=vLinkGenVarGroupFlags/ORDERED, vLinkGenVarSectionGroupFlag=vLinkGenVarGroupFlags/CONTIGUOUS, vLinkGenVarSectionGroupFlag=vLinkGenVarGroupFlags/FILL, vLinkGenVarSectionGroupFlag=vLinkGenVarGroupFlags/READ, vLinkGenVarSectionGroupFlag=vLinkGenVarGroupFlags/WRITE:
            OS_OsApplication_VAR_NOINIT: vLinkGenVarSectionGroupInit=NONE, vLinkGenVarSectionGroupRef=vLinkGenLinkerSections/OS_OsApplication_VAR_NOINIT, vLinkGenVarSectionGroupRef=OS_OsApplication_VAR_NOCACHE_NOINIT
            OS_OsApplication_VAR_FAST_NOINIT: vLinkGenVarSectionGroupInit=NONE, vLinkGenVarSectionGroupRef=vLinkGenLinkerSections/OS_OsApplication_VAR_FAST_NOINIT, vLinkGenVarSectionGroupRef=OS_OsApplication_VAR_FAST_NOCACHE_NOINIT
            OS_OsApplication_VAR_INIT: vLinkGenVarSectionGroupInit=INIT, vLinkGenVarSectionGroupEndAlignment=4, vLinkGenVarSectionGroupRef=vLinkGenLinkerSections/OS_OsApplication_VAR, vLinkGenVarSectionGroupRef=OS_OsApplication_VAR_NOCACHE
            OS_OsApplication_VAR_FAST_INIT: vLinkGenVarSectionGroupInit=INIT, vLinkGenVarSectionGroupEndAlignment=4, vLinkGenVarSectionGroupRef=OS_OsApplication_VAR_FAST, vLinkGenVarSectionGroupRef=OS_OsApplication_VAR_FAST_NOCACHE
            OS_OsApplication_VAR_ZERO_INIT: vLinkGenVarSectionGroupInit=ZERO_INIT, vLinkGenVarSectionGroupEndAlignment=4, vLinkGenVarSectionGroupRef=vLinkGenLinkerSections/OS_OsApplication_VAR_ZERO_INIT, vLinkGenVarSectionGroupRef=OS_OsApplication_VAR_NOCACHE_ZERO_INIT
            OS_OsApplication_VAR_FAST_ZERO_INIT: vLinkGenVarSectionGroupInit=ZERO_INIT, vLinkGenVarSectionGroupEndAlignment=4, vLinkGenVarSectionGroupRef=vLinkGenLinkerSections/OS_OsApplication_VAR_FAST_ZERO_INIT, vLinkGenVarSectionGroupRef=OS_OsApplication_VAR_FAST_NOCACHE_ZERO_INIT
            OS_OsApplication_VAR_ZERO_INIT_bss: vLinkGenVarSectionGroupInit=ZERO_INIT, vLinkGenVarSectionGroupEndAlignment=4, vLinkGenVarSectionGroupRef=vLinkGenLinkerSections/OS_OsApplication_VAR_ZERO_INIT_bss, vLinkGenVarSectionGroupRef=OS_OsApplication_VAR_NOCACHE_ZERO_INIT_bss
            OS_OsApplication_VAR_FAST_ZERO_INIT_bss: vLinkGenVarSectionGroupInit=ZERO_INIT, vLinkGenVarSectionGroupEndAlignment=4, vLinkGenVarSectionGroupRef=vLinkGenLinkerSections/OS_OsApplication_VAR_FAST_ZERO_INIT_bss, vLinkGenVarSectionGroupRef=OS_OsApplication_VAR_FAST_NOCACHE_ZERO_INIT_bss
        OS_OsApplication_Core1_VAR: vLinkGenVarGroupInitCore=1, vLinkGenVarGroupRegion=RegionBlock_0_DSPR_Core1
          8 x vLinkGenVarSectionGroup, all with vLinkGenVarSectionGroupPosition=0, vLinkGenVarSectionGroupInitStage=ONE, vLinkGenVarSectionGroupGapSize=16, vLinkGenVarSectionGroupAlignment=16, vLinkGenVarSectionGroupFlag=vLinkGenVarGroupFlags/ORDERED, vLinkGenVarSectionGroupFlag=vLinkGenVarGroupFlags/CONTIGUOUS, vLinkGenVarSectionGroupFlag=vLinkGenVarGroupFlags/FILL, vLinkGenVarSectionGroupFlag=vLinkGenVarGroupFlags/READ, vLinkGenVarSectionGroupFlag=vLinkGenVarGroupFlags/WRITE:
            OS_OsApplication_Core1_VAR_NOINIT: vLinkGenVarSectionGroupInit=NONE, vLinkGenVarSectionGroupRef=vLinkGenLinkerSections/OS_OsApplication_Core1_VAR_NOINIT, vLinkGenVarSectionGroupRef=OS_OsApplication_Core1_VAR_NOCACHE_NOINIT
            OS_OsApplication_Core1_VAR_FAST_NOINIT: vLinkGenVarSectionGroupInit=NONE, vLinkGenVarSectionGroupRef=vLinkGenLinkerSections/OS_OsApplication_Core1_VAR_FAST_NOINIT, vLinkGenVarSectionGroupRef=OS_OsApplication_Core1_VAR_FAST_NOCACHE_NOINIT
            OS_OsApplication_Core1_VAR_INIT: vLinkGenVarSectionGroupInit=INIT, vLinkGenVarSectionGroupEndAlignment=4, vLinkGenVarSectionGroupRef=vLinkGenLinkerSections/OS_OsApplication_Core1_VAR, vLinkGenVarSectionGroupRef=OS_OsApplication_Core1_VAR_NOCACHE
            OS_OsApplication_Core1_VAR_FAST_INIT: vLinkGenVarSectionGroupInit=INIT, vLinkGenVarSectionGroupEndAlignment=4, vLinkGenVarSectionGroupRef=OS_OsApplication_Core1_VAR_FAST, vLinkGenVarSectionGroupRef=OS_OsApplication_Core1_VAR_FAST_NOCACHE
            OS_OsApplication_Core1_VAR_ZERO_INIT: vLinkGenVarSectionGroupInit=ZERO_INIT, vLinkGenVarSectionGroupEndAlignment=4, vLinkGenVarSectionGroupRef=vLinkGenLinkerSections/OS_OsApplication_Core1_VAR_ZERO_INIT, vLinkGenVarSectionGroupRef=OS_OsApplication_Core1_VAR_NOCACHE_ZERO_INIT
            OS_OsApplication_Core1_VAR_FAST_ZERO_INIT: vLinkGenVarSectionGroupInit=ZERO_INIT, vLinkGenVarSectionGroupEndAlignment=4, vLinkGenVarSectionGroupRef=vLinkGenLinkerSections/OS_OsApplication_Core1_VAR_FAST_ZERO_INIT, vLinkGenVarSectionGroupRef=OS_OsApplication_Core1_VAR_FAST_NOCACHE_ZERO_INIT
            OS_OsApplication_Core1_VAR_ZERO_INIT_bss: vLinkGenVarSectionGroupInit=ZERO_INIT, vLinkGenVarSectionGroupEndAlignment=4, vLinkGenVarSectionGroupRef=vLinkGenLinkerSections/OS_OsApplication_Core1_VAR_ZERO_INIT_bss, vLinkGenVarSectionGroupRef=OS_OsApplication_Core1_VAR_NOCACHE_ZERO_INIT_bss
            OS_OsApplication_Core1_VAR_FAST_ZERO_INIT_bss: vLinkGenVarSectionGroupInit=ZERO_INIT, vLinkGenVarSectionGroupEndAlignment=4, vLinkGenVarSectionGroupRef=vLinkGenLinkerSections/OS_OsApplication_Core1_VAR_FAST_ZERO_INIT_bss, vLinkGenVarSectionGroupRef=OS_OsApplication_Core1_VAR_FAST_NOCACHE_ZERO_INIT_bss
    vLinkGenGeneral: vLinkGenEntrySymbol=brsStartupEntry, vLinkGenFileGeneration=STANDARD
    vLinkGenPublishedInformation: vLinkGenDefaultVarGroupAlignment=16, vLinkGenGeneration=2, vLinkGenDuplicatedLabels=false
      vLinkGenRegionBlockFlags
        RESERVED (vLinkGenRegionBlockFlag)
      vLinkGenConstGroupFlags
        7 x vLinkGenConstGroupFlag:
          ORDERED
          CONTIGUOUS
          FILL
          NOCOPY
          EXECUTE
          READ
          WRITE
      vLinkGenConstSectionFlags
        KEEP (vLinkGenConstSectionFlag)
      vLinkGenVarGroupFlags
        7 x vLinkGenVarGroupFlag:
          ORDERED
          CONTIGUOUS
          FILL
          NOCOPY
          EXECUTE
          READ
          WRITE
      vLinkGenVarSectionFlags
        KEEP (vLinkGenVarSectionFlag)

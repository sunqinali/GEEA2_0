AUTOSAR XML (schema 4-2-2)
package /ActiveEcuC
  module config CanTp: implementation-config-variant=VARIANT-PRE-COMPILE, module-description=CanTp_Impl
    CanTpGeneral:
      CanTpChangeParameterApi = false
      CanTpDevErrorDetect = true
      CanTpPaddingByte = 204
      CanTpReadParameterApi = false
      CanTpVersionInfoApi = false
      CanTpPaddingActive = true
      CanTpHavePaddingByte = false
      CanTpNumRxChannels = 0
      CanTpNumTxChannels = 0
      CanTpEnableSplitMainFunction = false
      CanTpSupportStandardAddressing = true
      CanTpSupportExtendedAddressing = true
      CanTpSupportMixed11Addressing = true
      CanTpOnlyNotifyInformedAppl = true
      CanTpRc = false
      CanTpTc = false
      CanTpSafeBswChecks = false
      CanTpEnableConstantBS = true
      CanTpEnableTransmitQueue = false
      CanTpUseOnlyFirstFc = true
      CanTpSupportMixed29Addressing = true
      CanTpSupportNormalFixedAddressing = true
    CanTpConfig: CanTpMainFunctionPeriod=0.005
      7 x CanTpChannel, all with CanTpChannelMode=CANTP_MODE_HALF_DUPLEX:
        IemEtcUUDTPropCha1_2495fbf5
          CanTpTxNSdu_46d88454 (CanTpTxNSdu):
            CanTpNas = 1
            CanTpNbs = 1
            CanTpNcs = 0.9
            CanTpTc = false
            CanTpTxAddressingFormat = CANTP_STANDARD
            CanTpTxDl = 8
            CanTpTxPaddingActivation = CANTP_ON
            CanTpTxTaType = CANTP_PHYSICAL
            CanTpTxNSduId = 1
            CanTpTxNSduRef = IemToEtcUudtDcmIpdu1_4ae85965_Tx
            CanTpTxNPdu_8431c063 (CanTpTxNPdu): CanTpTxNPduConfirmationPduId=2, CanTpTxNPduRef=UudtIemNPdu1_4b1dfe9b_Tx
            CanTpRxFcNPdu: CanTpRxFcNPduId=0, CanTpRxFcNPduRef=UudtFcNPdu1
          CanTpRxNSdu:
            CanTpNbr = 0.9
            CanTpRxAddressingFormat = CANTP_STANDARD
            CanTpRxNSduId = 0
            CanTpRxPaddingActivation = CANTP_ON
            CanTpRxTaType = CANTP_PHYSICAL
            CanTpBs = 0
            CanTpNar = 1
            CanTpNcr = 1
            CanTpRxDl = 8
            CanTpRxWftMax = 255
            CanTpSTmin = 0.005
            CanTpRxNSduRef = UudtDcmRx1
            CanTpRxNPdu: CanTpRxNPduId=0, CanTpRxNPduRef=UudtFcNPdu1
            CanTpTxFcNPdu: CanTpTxFcNPduConfirmationPduId=2, CanTpTxFcNPduRef=UudtIemNPdu1_4b1dfe9b_Tx
        VddmToAllFuncPropDiagCha_11278746
          CanTpRxNSdu_c024ac3e (CanTpRxNSdu):
            CanTpBs = 0
            CanTpNar = 1
            CanTpNbr = 0.9
            CanTpNcr = 1
            CanTpRxAddressingFormat = CANTP_STANDARD
            CanTpRxDl = 8
            CanTpRxPaddingActivation = CANTP_ON
            CanTpRxTaType = CANTP_FUNCTIONAL
            CanTpRxWftMax = 255
            CanTpSTmin = 0.005
            CanTpRxNSduId = 5
            CanTpRxNSduRef = VgmToAllFuncDiagDcmIpdu_030e2fcd_Rx
            CanTpRxNPdu_9726b6f8 (CanTpRxNPdu): CanTpRxNPduId=5, CanTpRxNPduRef=VddmToAllFuncPropDiagReqNpdu_86e6f41a_Rx
        VgmToAllJ1979OBDDiagCha11_2cd66346
          CanTpRxNSdu_0d429961 (CanTpRxNSdu):
            CanTpBs = 0
            CanTpNar = 1
            CanTpNbr = 0.9
            CanTpNcr = 1
            CanTpRxAddressingFormat = CANTP_STANDARD
            CanTpRxDl = 8
            CanTpRxPaddingActivation = CANTP_ON
            CanTpRxTaType = CANTP_FUNCTIONAL
            CanTpRxWftMax = 255
            CanTpSTmin = 0.005
            CanTpRxNSduId = 1
            CanTpRxNSduRef = EtcToAllJ1979OBDDiagDcmIpdu11_b7ab7660_Rx
            CanTpRxNPdu_8f524760 (CanTpRxNPdu): CanTpRxNPduId=6, CanTpRxNPduRef=VgmToAllFuncJ1979OBDPropCanReqNpdu11_a7af92b3_Rx
        VddmIemPropDiagCha_48ac995b
          CanTpRxNSdu_183e09ee (CanTpRxNSdu):
            CanTpBs = 0
            CanTpNar = 1
            CanTpNbr = 0.9
            CanTpNcr = 1
            CanTpRxAddressingFormat = CANTP_STANDARD
            CanTpRxDl = 8
            CanTpRxPaddingActivation = CANTP_ON
            CanTpRxTaType = CANTP_PHYSICAL
            CanTpRxWftMax = 255
            CanTpSTmin = 0.005
            CanTpRxNSduId = 4
            CanTpRxNSduRef = VgmToIemDiagDcmIpdu_81f41e2d_Rx
            CanTpRxNPdu_17ec4684 (CanTpRxNPdu): CanTpRxNPduId=3, CanTpRxNPduRef=VddmToIemPropDiagReqNpdu_b1f6d800_Rx
            CanTpTxFcNPdu_17ec4684 (CanTpTxFcNPdu): CanTpTxFcNPduConfirmationPduId=0, CanTpTxFcNPduRef=IemToVddmPropDiagResNpdu_cef1039b_Tx
          CanTpTxNSdu_183e09ee (CanTpTxNSdu):
            CanTpNas = 1
            CanTpNbs = 1
            CanTpNcs = 0.9
            CanTpTc = false
            CanTpTxAddressingFormat = CANTP_STANDARD
            CanTpTxDl = 8
            CanTpTxPaddingActivation = CANTP_ON
            CanTpTxTaType = CANTP_PHYSICAL
            CanTpTxNSduId = 2
            CanTpTxNSduRef = IemToVgmDiagDcmIpdu_411ec11e_Tx
            CanTpRxFcNPdu_35169276 (CanTpRxFcNPdu): CanTpRxFcNPduId=3, CanTpRxFcNPduRef=VddmToIemPropDiagReqNpdu_b1f6d800_Rx
            CanTpTxNPdu_35169276 (CanTpTxNPdu): CanTpTxNPduConfirmationPduId=0, CanTpTxNPduRef=IemToVddmPropDiagResNpdu_cef1039b_Tx
        IemEtcUUDTPropCha2_0b8ad8e1
          CanTpTxNSdu_4e62aa3e (CanTpTxNSdu):
            CanTpNas = 1
            CanTpNbs = 1
            CanTpNcs = 0.9
            CanTpTc = false
            CanTpTxAddressingFormat = CANTP_STANDARD
            CanTpTxDl = 8
            CanTpTxPaddingActivation = CANTP_ON
            CanTpTxTaType = CANTP_PHYSICAL
            CanTpTxNSduId = 0
            CanTpTxNSduRef = IemToEtcUudtDcmIpdu2_07005902_Tx
            CanTpTxNPdu_6f36b3fb (CanTpTxNPdu): CanTpTxNPduConfirmationPduId=3, CanTpTxNPduRef=UudtIemNPdu2_06f5fefc_Tx
            CanTpRxFcNPdu_001 (CanTpRxFcNPdu): CanTpRxFcNPduId=1, CanTpRxFcNPduRef=UudtFcNPdu2
          CanTpRxNSdu_001 (CanTpRxNSdu):
            CanTpNbr = 0.9
            CanTpRxAddressingFormat = CANTP_STANDARD
            CanTpRxNSduId = 2
            CanTpRxPaddingActivation = CANTP_ON
            CanTpRxTaType = CANTP_PHYSICAL
            CanTpBs = 0
            CanTpNar = 1
            CanTpNcr = 1
            CanTpRxDl = 8
            CanTpRxWftMax = 255
            CanTpSTmin = 0.005
            CanTpRxNSduRef = UudtDcmRx2
            CanTpRxNPdu_1 (CanTpRxNPdu): CanTpRxNPduId=1, CanTpRxNPduRef=UudtFcNPdu2
            CanTpTxFcNPdu_001 (CanTpTxFcNPdu): CanTpTxFcNPduConfirmationPduId=3, CanTpTxFcNPduRef=UudtIemNPdu2_06f5fefc_Tx
        VgmIemJ1979OBDDiagCha11_7badfeec
          CanTpRxNSdu_f73faffe (CanTpRxNSdu):
            CanTpBs = 0
            CanTpNar = 1
            CanTpNbr = 0.9
            CanTpNcr = 1
            CanTpRxAddressingFormat = CANTP_STANDARD
            CanTpRxDl = 8
            CanTpRxPaddingActivation = CANTP_ON
            CanTpRxTaType = CANTP_PHYSICAL
            CanTpRxWftMax = 255
            CanTpSTmin = 0.005
            CanTpRxNSduId = 6
            CanTpRxNSduRef = EtcToIemJ1979OBDDiagDcmIpdu11_ac95f359_Rx
            CanTpTxFcNPdu_106c7114 (CanTpTxFcNPdu): CanTpTxFcNPduConfirmationPduId=1, CanTpTxFcNPduRef=IemToVgmJ1979OBDPropCanResNpdu11_72c85f7f_Tx
            CanTpRxNPdu_106c7114 (CanTpRxNPdu): CanTpRxNPduId=4, CanTpRxNPduRef=VgmToIemJ1979OBDPropCanReqNpdu11_0f26f145_Rx
          CanTpTxNSdu_f73faffe (CanTpTxNSdu):
            CanTpNas = 1
            CanTpNbs = 1
            CanTpNcs = 0.9
            CanTpTc = false
            CanTpTxAddressingFormat = CANTP_STANDARD
            CanTpTxDl = 8
            CanTpTxPaddingActivation = CANTP_ON
            CanTpTxTaType = CANTP_PHYSICAL
            CanTpTxNSduId = 4
            CanTpTxNSduRef = IemToEtcJ1979OBDDiagDcmIpdu11_525ada58_Tx
            CanTpRxFcNPdu_3296a5e6 (CanTpRxFcNPdu): CanTpRxFcNPduId=4, CanTpRxFcNPduRef=VgmToIemJ1979OBDPropCanReqNpdu11_0f26f145_Rx
            CanTpTxNPdu_3296a5e6 (CanTpTxNPdu): CanTpTxNPduConfirmationPduId=1, CanTpTxNPduRef=IemToVgmJ1979OBDPropCanResNpdu11_72c85f7f_Tx
        IemEtcUUDTPropCha3_a7af3bd2
          CanTpTxNSdu_67838de1 (CanTpTxNSdu):
            CanTpNas = 1
            CanTpNbs = 1
            CanTpNcs = 0.9
            CanTpTc = false
            CanTpTxAddressingFormat = CANTP_STANDARD
            CanTpTxDl = 8
            CanTpTxPaddingActivation = CANTP_ON
            CanTpTxTaType = CANTP_PHYSICAL
            CanTpTxNSduId = 3
            CanTpTxNSduRef = IemToEtcUudtDcmIpdu3_8a88a4e0_Tx
            CanTpTxNPdu_173b30c5 (CanTpTxNPdu): CanTpTxNPduConfirmationPduId=4, CanTpTxNPduRef=UudtIemNPdu3_8b7d031e_Tx
            CanTpRxFcNPdu_002 (CanTpRxFcNPdu): CanTpRxFcNPduId=2, CanTpRxFcNPduRef=UudtFcNPdu3
          CanTpRxNSdu_002 (CanTpRxNSdu):
            CanTpNbr = 0.9
            CanTpRxAddressingFormat = CANTP_STANDARD
            CanTpRxNSduId = 3
            CanTpRxPaddingActivation = CANTP_ON
            CanTpRxTaType = CANTP_PHYSICAL
            CanTpBs = 0
            CanTpNar = 1
            CanTpNcr = 1
            CanTpRxDl = 8
            CanTpRxWftMax = 255
            CanTpSTmin = 0.005
            CanTpRxNSduRef = UudtDcmRx3
            CanTpRxNPdu_2 (CanTpRxNPdu): CanTpRxNPduId=2, CanTpRxNPduRef=UudtFcNPdu3
            CanTpTxFcNPdu_002 (CanTpTxFcNPdu): CanTpTxFcNPduConfirmationPduId=4, CanTpTxFcNPduRef=UudtIemNPdu3_8b7d031e_Tx

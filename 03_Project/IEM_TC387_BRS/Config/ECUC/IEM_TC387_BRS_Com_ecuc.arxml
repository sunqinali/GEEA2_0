AUTOSAR XML (schema 4-2-2)
package /ActiveEcuC
  module config Com: implementation-config-variant=VARIANT-PRE-COMPILE, module-description=Com_Impl
    ComGeneration:
      ComOutOfBoundsWriteProtectionStrategy = NONE
      ComOutOfBoundsWriteSanitizer = false
      ComOutOfBoundsReadSanitizer = false
      ComReduceConstantData2Define = false
      ComBoolDataInArrayOfStructStrategy = BOOLEAN
      ComDeduplicateIndirectedData = true
      ComDataDeduplicationStrategy = WITH_CAST
      ComReduceBoolDataByNegationThreshold = 2
      ComReduceBoolDataByNumericalComparisonThreshold = 2
      ComReduceBoolDataByNumericalRelationThreshold = 2
      ComReduceBoolDataByNumericalOperandStrategy = WITH_ANY_VALUE
      ComReduceNumericalDataByOffsetThreshold = 2
      ComReduceNumericalDataByArraySubtractionThreshold = 2
      ComReduceDataByStreaming = false
      ComShortSymbols = false
      ComInterfacesForDeactivatedData = false
      ComReferringKeysInComments = false
    ComOptimization:
      ComTxCyclicProcessingISRLockThreshold = 1
      ComTxDeadlineMonitoringISRLockThreshold = 1
      ComTxProcessingISRLockThreshold = 1
      ComRxDeadlineMonitoringISRLockThreshold = 1
      ComRxDeferredProcessingISRLockThreshold = 1
      ComGatewayProcessingISRLockThreshold = 1
      ComGatewayDescriptionProcessingISRLockThreshold = 1
      ComIPduGroupISRLockThreshold = 1
    ComConfig: ComConfigurationId=0, ComRxDeferredNotificationCacheSize=1, ComRxImmediateNotificationCacheSize=0
      BecmPropSignalIpdu15_64eecccf_Rx (ComIPdu):
        ComIPduDirection = RECEIVE
        ComIPduType = NORMAL
        ComIPduHandleId = 3
        ComIPduSignalProcessing = DEFERRED
        ComIPduCancellationSupport = false
        ComIPduGroupRef = RxSPG_PropulsionCAN_PNC24_f9c65551
        ComIPduGroupRef = RxSPG_PropulsionCAN_PNC25_8ec165c7
        ComIPduGroupRef = RxSPG_PropulsionCAN_PNC26_17c8347d
        ComIPduGroupRef = RxSPG_PropulsionCAN_PNC29_877729ec
        ComIPduGroupRef = RxSPG_PropulsionCAN_PNC30_e7b0a009
        ComIPduGroupRef = RxSPG_PropulsionCAN_PNC35_97da5486
        ComIPduGroupRef = RxSPG_PropulsionCAN_PNC39_9e6c18ad
        ComIPduSignalRef = isDCChrgnHndlSts_7439a8f3_Rx
        ComPduIdRef = BecmPropSignalIpdu15_64eecccf_Rx
      igImobEngChk2_35eae3c1_Tx (ComSignalGroup):
        ComTransferProperty = PENDING
        ComUpdateBitPosition = 1
        ComSignalGroupAccess = ACCESS_NEEDED_BY_SWC_OR_COM
        ComHandleId = 5
        ComSystemTemplateSignalGroupRef = igImobEngChk2_mtx
        8 x ComGroupSignal, all with ComSignalEndianness=BIG_ENDIAN, ComSignalInitValue=0, ComSignalType=UINT8, ComSignalAccess=ACCESS_NEEDED_BY_SWC_OR_COM, ComTransferProperty=PENDING:
          isImobEngChk2ImobEngDataChk5_8bcc7104_Tx: ComBitPosition=55, ComBitSize=8, ComHandleId=52, ComSystemTemplateSystemSignalRef=isImobEngChk2ImobEngDataChk5_mtx
          isImobEngChk2ImobEngDataChk0_fba6858b_Tx: ComBitPosition=15, ComBitSize=8, ComHandleId=47, ComSystemTemplateSystemSignalRef=isImobEngChk2ImobEngDataChk0_mtx
          isImobEngChk2ImobEngDataChk3_62afd431_Tx: ComBitPosition=39, ComBitSize=8, ComHandleId=50, ComSystemTemplateSystemSignalRef=isImobEngChk2ImobEngDataChk3_mtx
          isImobEngChk2ImobEngDataChk2_15a8e4a7_Tx: ComBitPosition=31, ComBitSize=8, ComHandleId=49, ComSystemTemplateSystemSignalRef=isImobEngChk2ImobEngDataChk2_mtx
          isImobEngChk2ImobEngDataChk6_12c520be_Tx: ComBitPosition=63, ComBitSize=8, ComHandleId=53, ComSystemTemplateSystemSignalRef=isImobEngChk2ImobEngDataChk6_mtx
          isImobEngChk2ImobEngDataChk4_fccb4192_Tx: ComBitPosition=47, ComBitSize=8, ComHandleId=51, ComSystemTemplateSystemSignalRef=isImobEngChk2ImobEngDataChk4_mtx
          isImobEngChk2ImobEngChkSts_8e88c5e4_Tx: ComBitPosition=0, ComBitSize=1, ComHandleId=46, ComSystemTemplateSystemSignalRef=isImobEngChk2ImobEngChkSts_mtx
            ComFilter: ComFilterAlgorithm=ALWAYS
          isImobEngChk2ImobEngDataChk1_8ca1b51d_Tx: ComBitPosition=23, ComBitSize=8, ComHandleId=48, ComSystemTemplateSystemSignalRef=isImobEngChk2ImobEngDataChk1_mtx
      BecmPropSignalIpdu01_7a983997_Rx (ComIPdu):
        ComIPduDirection = RECEIVE
        ComIPduType = NORMAL
        ComIPduHandleId = 0
        ComIPduSignalProcessing = DEFERRED
        ComIPduCancellationSupport = false
        ComIPduGroupRef = RxSPG_PropulsionCAN_PNC24_f9c65551
        ComIPduGroupRef = RxSPG_PropulsionCAN_PNC25_8ec165c7
        ComIPduGroupRef = RxSPG_PropulsionCAN_PNC26_17c8347d
        ComIPduGroupRef = RxSPG_PropulsionCAN_PNC29_877729ec
        ComIPduGroupRef = RxSPG_PropulsionCAN_PNC30_e7b0a009
        ComIPduGroupRef = RxSPG_PropulsionCAN_PNC35_97da5486
        ComIPduGroupRef = RxSPG_PropulsionCAN_PNC39_9e6c18ad
        ComIPduSignalGroupRef = igHvSysRlySts_760c5326_Rx
        ComIPduSignalRef = isHvBattUDc_bcd9ade4_Rx
        ComIPduSignalRef = isHvBattUDynMaxLim_6d11df88_Rx
        ComPduIdRef = BecmPropSignalIpdu01_7a983997_Rx
      isWhlMotSysMotT_54e003b6_Tx (ComSignal):
        ComBitPosition = 23
        ComBitSize = 8
        ComSignalEndianness = BIG_ENDIAN
        ComSignalInitValue = 50
        ComSignalType = UINT8
        ComTransferProperty = PENDING
        ComUpdateBitPosition = 8
        ComSignalAccess = ACCESS_NEEDED_BY_SWC_OR_COM
        ComHandleId = 80
        ComSystemTemplateSystemSignalRef = isWhlMotSysMotT_mtx
      RxSPG_PropulsionCAN_PNC35_97da5486 (ComIPduGroup): ComIPduGroupHandleId=7, ComIPduGroupGroupRef=RxMPG_PropulsionCAN_aad5aa75
      TxSPG_PropulsionCAN_PNC25_e51a0961 (ComIPduGroup): ComIPduGroupHandleId=14, ComIPduGroupGroupRef=TxMPG_PropulsionCAN_3709a166
      igIemGeneric_ab95030b_Tx (ComSignalGroup): ComTransferProperty=PENDING, ComSignalGroupAccess=ACCESS_NEEDED_BY_SWC_OR_COM, ComHandleId=4, ComSystemTemplateSignalGroupRef=igIemGeneric_mtx
        16 x ComGroupSignal, all with ComSignalEndianness=BIG_ENDIAN, ComSignalType=UINT8, ComSignalAccess=ACCESS_NEEDED_BY_SWC_OR_COM, ComTransferProperty=PENDING:
          isIemGenericEMSeqNr_5f6f0e31_Tx: ComBitPosition=35, ComBitSize=4, ComSignalInitValue=0, ComHandleId=36, ComSystemTemplateSystemSignalRef=isIemGenericEMSeqNr_mtx
          isIemGenericUDcAlrmSt_14e497d8_Tx: ComBitPosition=57, ComBitSize=2, ComSignalInitValue=0, ComHandleId=45, ComSystemTemplateSystemSignalRef=isIemGenericUDcAlrmSt_mtx
          isIemGenericADAlrmSt_2216fde0_Tx: ComBitPosition=55, ComBitSize=2, ComSignalInitValue=0, ComHandleId=30, ComSystemTemplateSystemSignalRef=isIemGenericADAlrmSt_mtx
          isIemGenericDTCLow_2f81f21c_Tx: ComBitPosition=15, ComBitSize=8, ComSignalInitValue=0, ComHandleId=32, ComSystemTemplateSystemSignalRef=isIemGenericDTCLow_mtx
          isIemGenericModStatusRms_527fb71c_Tx: ComBitPosition=47, ComBitSize=4, ComSignalInitValue=3, ComHandleId=40, ComSystemTemplateSystemSignalRef=isIemGenericModStatusRms_mtx
          isIemGenericSpdAlrmSt_a3de8d5b_Tx: ComBitPosition=59, ComBitSize=2, ComSignalInitValue=0, ComHandleId=43, ComSystemTemplateSystemSignalRef=isIemGenericSpdAlrmSt_mtx
          isIemGenericEMQnty_067a3f4d_Tx: ComBitPosition=39, ComBitSize=4, ComSignalInitValue=0, ComHandleId=35, ComSystemTemplateSystemSignalRef=isIemGenericEMQnty_mtx
          isIemGenericTypeInfo_10f77ae7_Tx: ComBitPosition=43, ComBitSize=4, ComSignalInitValue=0, ComHandleId=44, ComSystemTemplateSystemSignalRef=isIemGenericTypeInfo_mtx
          isIemGenericIacAlrmSt_ef864a8f_Tx: ComBitPosition=51, ComBitSize=2, ComSignalInitValue=0, ComHandleId=38, ComSystemTemplateSystemSignalRef=isIemGenericIacAlrmSt_mtx
          isIemGenericRslAlrmSt_09c5d09c_Tx: ComBitPosition=61, ComBitSize=2, ComSignalInitValue=0, ComHandleId=42, ComSystemTemplateSystemSignalRef=isIemGenericRslAlrmSt_mtx
          isIemGenericFltAlrmSt_094332cf_Tx: ComBitPosition=53, ComBitSize=2, ComSignalInitValue=0, ComHandleId=37, ComSystemTemplateSystemSignalRef=isIemGenericFltAlrmSt_mtx
          isIemGenericDTCSts_96a019d2_Tx: ComBitPosition=31, ComBitSize=8, ComSignalInitValue=0, ComHandleId=34, ComSystemTemplateSystemSignalRef=isIemGenericDTCSts_mtx
          isIemGenericDTCHig_6365ed22_Tx: ComBitPosition=7, ComBitSize=8, ComSignalInitValue=0, ComHandleId=31, ComSystemTemplateSystemSignalRef=isIemGenericDTCHig_mtx
            ComFilter: ComFilterAlgorithm=ALWAYS
          isIemGenericInvrtTAlrmSt_ad103698_Tx: ComBitPosition=49, ComBitSize=2, ComSignalInitValue=0, ComHandleId=39, ComSystemTemplateSystemSignalRef=isIemGenericInvrtTAlrmSt_mtx
          isIemGenericMotTAlrmSt_e29bb0dd_Tx: ComBitPosition=63, ComBitSize=2, ComSignalInitValue=0, ComHandleId=41, ComSystemTemplateSystemSignalRef=isIemGenericMotTAlrmSt_mtx
          isIemGenericDTCMid_fca77e73_Tx: ComBitPosition=23, ComBitSize=8, ComSignalInitValue=0, ComHandleId=33, ComSystemTemplateSystemSignalRef=isIemGenericDTCMid_mtx
      IemPropSignalIPdu01_21049770_Tx (ComIPdu):
        ComIPduDirection = SEND
        ComIPduType = NORMAL
        ComIPduHandleId = 2
        ComIPduSignalProcessing = DEFERRED
        ComIPduCancellationSupport = false
        ComIPduGroupRef = TxSPG_PropulsionCAN_617cc08d
        ComIPduSignalGroupRef = igIEMTestFr1_f9c0b06a_Tx
        ComPduIdRef = IemPropSignalIPdu01_21049770_Tx
        ComTxIPdu: ComTxIPduUnusedAreasDefault=0, ComMinimumDelayTime=0
          ComTxModeTrue
            ComTxMode: ComTxModeMode=PERIODIC, ComTxModeTimeOffset=0, ComTxModeTimePeriod=0.8
          ComTxModeFalse
            ComTxMode: ComTxModeMode=NONE
      isWhlMotSysSpdAct_e26fc666_Tx (ComSignal):
        ComBitPosition = 6
        ComBitSize = 15
        ComSignalEndianness = BIG_ENDIAN
        ComSignalInitValue = 0
        ComSignalType = SINT16
        ComTransferProperty = PENDING
        ComUpdateBitPosition = 7
        ComSignalAccess = ACCESS_NEEDED_BY_SWC_OR_COM
        ComHandleId = 81
        ComSystemTemplateSystemSignalRef = isWhlMotSysSpdAct_mtx
        ComFilter: ComFilterAlgorithm=ALWAYS
      RxSPG_PropulsionCAN_PNC26_17c8347d (ComIPduGroup): ComIPduGroupHandleId=3, ComIPduGroupGroupRef=RxMPG_PropulsionCAN_aad5aa75
      ECMPropSignalIPDU06_ba4fcd25_Rx (ComIPdu):
        ComIPduDirection = RECEIVE
        ComIPduType = NORMAL
        ComIPduHandleId = 8
        ComIPduSignalProcessing = DEFERRED
        ComIPduCancellationSupport = false
        ComIPduGroupRef = RxSPG_PropulsionCAN_PNC24_f9c65551
        ComIPduGroupRef = RxSPG_PropulsionCAN_PNC25_8ec165c7
        ComIPduGroupRef = RxSPG_PropulsionCAN_PNC26_17c8347d
        ComIPduGroupRef = RxSPG_PropulsionCAN_PNC29_877729ec
        ComIPduSignalRef = isPLockParkReq_5b6f1b96_Rx
        ComIPduSignalRef = isWhlMotSysActvDampgModReq_1c578291_Rx
        ComIPduSignalRef = isWhlMotSysPwrLimMin_79b86f03_Rx
        ComPduIdRef = ECMPropSignalIPDU06_ba4fcd25_Rx
      RxSPG_PropulsionCAN_PNC39_9e6c18ad (ComIPduGroup): ComIPduGroupHandleId=8, ComIPduGroupGroupRef=RxMPG_PropulsionCAN_aad5aa75
      VDDMPropSignalIPDU11_f7bbf892_Rx (ComIPdu):
        ComIPduDirection = RECEIVE
        ComIPduType = NORMAL
        ComIPduHandleId = 19
        ComIPduSignalProcessing = DEFERRED
        ComIPduCancellationSupport = false
        ComIPduGroupRef = RxSPG_PropulsionCAN_PNC26_17c8347d
        ComIPduGroupRef = RxSPG_PropulsionCAN_PNC29_877729ec
        ComIPduGroupRef = RxSPG_PropulsionCAN_PNC30_e7b0a009
        ComIPduSignalRef = isSpdRotlForWhlsAtAxleRe_cda9e459_Rx
        ComPduIdRef = VDDMPropSignalIPDU11_f7bbf892_Rx
      isSpdRotlForWhlsAtAxleRe_cda9e459_Rx (ComSignal):
        ComBitPosition = 38
        ComBitSize = 15
        ComSignalEndianness = BIG_ENDIAN
        ComSignalInitValue = 0
        ComSignalType = UINT16
        ComUpdateBitPosition = 39
        ComSignalAccess = ACCESS_NEEDED_BY_SWC_OR_COM
        ComHandleId = 85
        ComSystemTemplateSystemSignalRef = isSpdRotlForWhlsAtAxleRe_mrx
      igVehModMngtGlbSafe1_d1f2be1a_Rx (ComSignalGroup):
        ComUpdateBitPosition = 32
        ComSignalGroupAccess = ACCESS_NEEDED_BY_SWC_OR_COM
        ComHandleId = 10
        ComSystemTemplateSignalGroupRef = igVehModMngtGlbSafe1_mrx
        10 x ComGroupSignal, all with ComSignalEndianness=BIG_ENDIAN, ComSignalType=UINT8, ComSignalAccess=ACCESS_NEEDED_BY_SWC_OR_COM:
          isVehModMngtGlbSafe1EgyLvlElecMai_47690dfe_Rx: ComBitPosition=27, ComBitSize=4, ComSignalInitValue=0, ComHandleId=53, ComSystemTemplateSystemSignalRef=isVehModMngtGlbSafe1EgyLvlElecMai_mrx
          isVehModMngtGlbSafe1Cntr_ede3beb1_Rx: ComBitPosition=15, ComBitSize=4, ComSignalInitValue=0, ComHandleId=52, ComSystemTemplateSystemSignalRef=isVehModMngtGlbSafe1Cntr_mrx
          isVehModMngtGlbSafe1UsgModSts_8ea1ac37_Rx: ComBitPosition=11, ComBitSize=4, ComSignalInitValue=1, ComHandleId=58, ComSystemTemplateSystemSignalRef=isVehModMngtGlbSafe1UsgModSts_mrx
          isVehModMngtGlbSafe1CarModSubtypWdCarModSubtyp_e21ae44e_Rx: ComBitPosition=36, ComBitSize=3, ComSignalInitValue=0, ComHandleId=50, ComSystemTemplateSystemSignalRef=isVehModMngtGlbSafe1CarModSubtypWdCarModSubtyp_mrx
          isVehModMngtGlbSafe1PwrLvlElecMai_c178728f_Rx: ComBitPosition=19, ComBitSize=4, ComSignalInitValue=0, ComHandleId=56, ComSystemTemplateSystemSignalRef=isVehModMngtGlbSafe1PwrLvlElecMai_mrx
          isVehModMngtGlbSafe1Chks_5333fc0b_Rx: ComBitPosition=7, ComBitSize=8, ComSignalInitValue=0, ComHandleId=51, ComSystemTemplateSystemSignalRef=isVehModMngtGlbSafe1Chks_mrx
          isVehModMngtGlbSafe1PwrLvlElecSubtyp_d042c1b3_Rx: ComBitPosition=23, ComBitSize=4, ComSignalInitValue=0, ComHandleId=57, ComSystemTemplateSystemSignalRef=isVehModMngtGlbSafe1PwrLvlElecSubtyp_mrx
          isVehModMngtGlbSafe1CarModSts1_a7324f03_Rx: ComBitPosition=39, ComBitSize=3, ComSignalInitValue=0, ComHandleId=49, ComSystemTemplateSystemSignalRef=isVehModMngtGlbSafe1CarModSts1_mrx
          isVehModMngtGlbSafe1EgyLvlElecSubtyp_47668699_Rx: ComBitPosition=31, ComBitSize=4, ComSignalInitValue=0, ComHandleId=54, ComSystemTemplateSystemSignalRef=isVehModMngtGlbSafe1EgyLvlElecSubtyp_mrx
          isVehModMngtGlbSafe1FltEgyCnsWdSts_c45a6bde_Rx: ComBitPosition=33, ComBitSize=1, ComSignalInitValue=0, ComHandleId=55, ComSystemTemplateSystemSignalRef=isVehModMngtGlbSafe1FltEgyCnsWdSts_mrx
      EcmPropSignalIPDU08_2e126ae8_Rx (ComIPdu):
        ComIPduDirection = RECEIVE
        ComIPduType = NORMAL
        ComIPduHandleId = 9
        ComIPduSignalProcessing = DEFERRED
        ComIPduCancellationSupport = false
        ComIPduGroupRef = RxSPG_PropulsionCAN_PNC24_f9c65551
        ComIPduGroupRef = RxSPG_PropulsionCAN_PNC25_8ec165c7
        ComIPduGroupRef = RxSPG_PropulsionCAN_PNC26_17c8347d
        ComIPduGroupRef = RxSPG_PropulsionCAN_PNC29_877729ec
        ComIPduGroupRef = RxSPG_PropulsionCAN_PNC35_97da5486
        ComIPduSignalRef = isPrpsnFbLimnIndcn_5674da6b_Rx
        ComPduIdRef = EcmPropSignalIPDU08_2e126ae8_Rx
      igVehCfgPrm_eee11443_Rx (ComSignalGroup): ComSignalGroupAccess=ACCESS_NEEDED_BY_SWC_OR_COM, ComHandleId=9, ComSystemTemplateSignalGroupRef=igVehCfgPrm_mrx
        8 x ComGroupSignal, all with ComBitSize=8, ComSignalEndianness=BIG_ENDIAN, ComSignalInitValue=0, ComSignalType=UINT8, ComSignalAccess=ACCESS_NEEDED_BY_SWC_OR_COM:
          isVehCfgPrmCCPBytePosn8_29f0b15f_Rx: ComBitPosition=63, ComHandleId=48, ComSystemTemplateSystemSignalRef=isVehCfgPrmCCPBytePosn8_mrx
          isVehCfgPrmCCPBytePosn5_5741cde2_Rx: ComBitPosition=39, ComHandleId=45, ComSystemTemplateSystemSignalRef=isVehCfgPrmCCPBytePosn5_mrx
          isVehCfgPrmCCPBytePosn4_2046fd74_Rx: ComBitPosition=31, ComHandleId=44, ComSystemTemplateSystemSignalRef=isVehCfgPrmCCPBytePosn4_mrx
          isVehCfgPrmCCPBytePosn3_be2268d7_Rx: ComBitPosition=23, ComHandleId=43, ComSystemTemplateSystemSignalRef=isVehCfgPrmCCPBytePosn3_mrx
          isVehCfgPrmBlkIDBytePosn1_16ee2fa8_Rx: ComBitPosition=7, ComHandleId=41, ComSystemTemplateSystemSignalRef=isVehCfgPrmBlkIDBytePosn1_mrx
          isVehCfgPrmCCPBytePosn2_c9255841_Rx: ComBitPosition=15, ComHandleId=42, ComSystemTemplateSystemSignalRef=isVehCfgPrmCCPBytePosn2_mrx
          isVehCfgPrmCCPBytePosn6_ce489c58_Rx: ComBitPosition=47, ComHandleId=46, ComSystemTemplateSystemSignalRef=isVehCfgPrmCCPBytePosn6_mrx
          isVehCfgPrmCCPBytePosn7_b94facce_Rx: ComBitPosition=55, ComHandleId=47, ComSystemTemplateSystemSignalRef=isVehCfgPrmCCPBytePosn7_mrx
      RxSPG_PropulsionCAN_PNC30_e7b0a009 (ComIPduGroup): ComIPduGroupHandleId=6, ComIPduGroupGroupRef=RxMPG_PropulsionCAN_aad5aa75
      isWhlMotSysHeatPwrAct_e1709dcf_Tx (ComSignal):
        ComBitPosition = 31
        ComBitSize = 8
        ComSignalEndianness = BIG_ENDIAN
        ComSignalInitValue = 0
        ComSignalType = UINT8
        ComTransferProperty = PENDING
        ComUpdateBitPosition = 19
        ComSignalAccess = ACCESS_NEEDED_BY_SWC_OR_COM
        ComHandleId = 74
        ComSystemTemplateSystemSignalRef = isWhlMotSysHeatPwrAct_mtx
      igWhlMotSysTqEst_02b3fb8d_Tx (ComSignalGroup):
        ComTransferProperty = PENDING
        ComUpdateBitPosition = 27
        ComSignalGroupAccess = ACCESS_NEEDED_BY_SWC_OR_COM
        ComHandleId = 8
        ComSystemTemplateSignalGroupRef = igWhlMotSysTqEst_mtx
        4 x ComGroupSignal, all with ComSignalEndianness=BIG_ENDIAN, ComSignalAccess=ACCESS_NEEDED_BY_SWC_OR_COM, ComTransferProperty=PENDING:
          isWhlMotSysTqEstChks_cdf81842_Tx: ComBitPosition=7, ComBitSize=8, ComSignalInitValue=0, ComSignalType=UINT8, ComHandleId=60, ComSystemTemplateSystemSignalRef=isWhlMotSysTqEstChks_mtx
            ComFilter: ComFilterAlgorithm=ALWAYS
          isWhlMotSysTqEstIsgTqAct_70852206_Tx: ComBitPosition=15, ComBitSize=14, ComSignalInitValue=8188, ComSignalType=UINT16, ComHandleId=62, ComSystemTemplateSystemSignalRef=isWhlMotSysTqEstIsgTqAct_mtx
          isWhlMotSysTqEstCntr_73285af8_Tx: ComBitPosition=31, ComBitSize=4, ComSignalInitValue=0, ComSignalType=UINT8, ComHandleId=61, ComSystemTemplateSystemSignalRef=isWhlMotSysTqEstCntr_mtx
          isWhlMotSysTqEstQualityFactor_cb4e64ff_Tx: ComBitPosition=17, ComBitSize=2, ComSignalInitValue=1, ComSignalType=UINT8, ComHandleId=63, ComSystemTemplateSystemSignalRef=isWhlMotSysTqEstQualityFactor_mtx
      isDCChrgnHndlSts_7439a8f3_Rx (ComSignal):
        ComBitPosition = 23
        ComBitSize = 3
        ComSignalEndianness = BIG_ENDIAN
        ComSignalInitValue = 0
        ComSignalType = UINT8
        ComUpdateBitPosition = 35
        ComSignalAccess = ACCESS_NEEDED_BY_SWC_OR_COM
        ComHandleId = 73
        ComSystemTemplateSystemSignalRef = isDCChrgnHndlSts_mrx
      igStcStsToDmc_cb036148_Rx (ComSignalGroup): ComUpdateBitPosition=4, ComSignalGroupAccess=ACCESS_NEEDED_BY_SWC_OR_COM, ComHandleId=6, ComSystemTemplateSignalGroupRef=igStcStsToDmc_mrx
        6 x ComGroupSignal, all with ComSignalEndianness=BIG_ENDIAN, ComSignalInitValue=0, ComSignalAccess=ACCESS_NEEDED_BY_SWC_OR_COM:
          isStcStsToDmcRear_121676a5_Rx: ComBitPosition=63, ComBitSize=8, ComSignalType=UINT8, ComHandleId=30, ComSystemTemplateSystemSignalRef=isStcStsToDmcRear_mrx
          isStcStsToDmcChks_7f830d10_Rx: ComBitPosition=15, ComBitSize=8, ComSignalType=UINT8, ComHandleId=25, ComSystemTemplateSystemSignalRef=isStcStsToDmcChks_mrx
          isStcStsToDmcFrnt_baffba62_Rx: ComBitPosition=55, ComBitSize=8, ComSignalType=UINT8, ComHandleId=29, ComSystemTemplateSystemSignalRef=isStcStsToDmcFrnt_mrx
          isStcStsToDmcCntr_c1534faa_Rx: ComBitPosition=3, ComBitSize=4, ComSignalType=UINT8, ComHandleId=26, ComSystemTemplateSystemSignalRef=isStcStsToDmcCntr_mrx
          isStcStsToDmcEngRotTarSpdDMCFrnt_46c9d05b_Rx: ComBitPosition=23, ComBitSize=16, ComSignalType=UINT16, ComHandleId=27, ComSystemTemplateSystemSignalRef=isStcStsToDmcEngRotTarSpdDMCFrnt_mrx
          isStcStsToDmcEngRotTarSpdDMCRear_ee201c9c_Rx: ComBitPosition=39, ComBitSize=16, ComSignalType=UINT16, ComHandleId=28, ComSystemTemplateSystemSignalRef=isStcStsToDmcEngRotTarSpdDMCRear_mrx
      igWhlMotSysTqAllwd_20f5846f_Rx (ComSignalGroup): ComUpdateBitPosition=6, ComSignalGroupAccess=ACCESS_NEEDED_BY_SWC_OR_COM, ComHandleId=13, ComSystemTemplateSignalGroupRef=igWhlMotSysTqAllwd_mrx
        3 x ComGroupSignal, all with ComSignalEndianness=BIG_ENDIAN, ComSignalInitValue=0, ComSignalType=UINT8, ComSignalAccess=ACCESS_NEEDED_BY_SWC_OR_COM:
          isWhlMotSysTqAllwdWhlMotSysTqAllwd_0ecd7abd_Rx: ComBitPosition=5, ComBitSize=2, ComHandleId=68, ComSystemTemplateSystemSignalRef=isWhlMotSysTqAllwdWhlMotSysTqAllwd_mrx
          isWhlMotSysTqAllwdCntr_e287795e_Rx: ComBitPosition=3, ComBitSize=4, ComHandleId=67, ComSystemTemplateSystemSignalRef=isWhlMotSysTqAllwdCntr_mrx
          isWhlMotSysTqAllwdChks_5c573be4_Rx: ComBitPosition=15, ComBitSize=8, ComHandleId=66, ComSystemTemplateSystemSignalRef=isWhlMotSysTqAllwdChks_mrx
      isOnBdChrgrHndlSts1_677311c9_Rx (ComSignal):
        ComBitPosition = 19
        ComBitSize = 4
        ComSignalEndianness = BIG_ENDIAN
        ComSignalInitValue = 8
        ComSignalType = UINT8
        ComUpdateBitPosition = 20
        ComSignalAccess = ACCESS_NEEDED_BY_SWC_OR_COM
        ComHandleId = 80
        ComSystemTemplateSystemSignalRef = isOnBdChrgrHndlSts1_mrx
      EcmPropSignalIPDU28_1c24086a_Rx (ComIPdu):
        ComIPduDirection = RECEIVE
        ComIPduType = NORMAL
        ComIPduHandleId = 11
        ComIPduSignalProcessing = DEFERRED
        ComIPduCancellationSupport = false
        ComIPduGroupRef = RxSPG_PropulsionCAN_PNC26_17c8347d
        ComIPduGroupRef = RxSPG_PropulsionCAN_PNC29_877729ec
        ComIPduSignalRef = isRearHeatModEnad_a110df41_Rx
        ComIPduSignalRef = isRearHeatPwrAllwd_c919804a_Rx
        ComPduIdRef = EcmPropSignalIPDU28_1c24086a_Rx
      VddmBcmPropdTCSignalIPDU01_886bd56f_Rx (ComIPdu):
        ComIPduDirection = RECEIVE
        ComIPduType = NORMAL
        ComIPduHandleId = 25
        ComIPduSignalProcessing = DEFERRED
        ComIPduCancellationSupport = false
        ComIPduGroupRef = RxSPG_PropulsionCAN_fca0cb9e
        ComIPduSignalGroupRef = igEscVariantToDmc_3c205019_Rx
        ComPduIdRef = VddmBcmPropdTCSignalIPDU01_886bd56f_Rx
      PropulsionCAN_db9c2837_Rx (ComSignal):
        ComSignalLength = 6
        ComSignalType = UINT8_N
        ComBitPosition = 0
        ComSignalEndianness = opaque
        ComSignalInitValue = 0 0 0 0 0 0
        ComSignalAccess = ACCESS_UNCLEAR
        ComHandleId = 0
        ComNotification = ComM_ComCbk_PropulsionCAN_db9c2837_Rx
      TxSPG_PropulsionCAN_PNC29_ecac454a (ComIPduGroup): ComIPduGroupHandleId=17, ComIPduGroupGroupRef=TxMPG_PropulsionCAN_3709a166
      isHvBattUDynMaxLim_6d11df88_Rx (ComSignal):
        ComBitPosition = 34
        ComBitSize = 11
        ComSignalEndianness = BIG_ENDIAN
        ComSignalInitValue = 0
        ComSignalType = UINT16
        ComUpdateBitPosition = 35
        ComSignalAccess = ACCESS_NEEDED_BY_SWC_OR_COM
        ComHandleId = 78
        ComSystemTemplateSystemSignalRef = isHvBattUDynMaxLim_mrx
      IemEduPropSignalIPdu01_3346005e_Tx (ComIPdu):
        ComIPduDirection = SEND
        ComIPduType = NORMAL
        ComIPduHandleId = 0
        ComIPduSignalProcessing = DEFERRED
        ComIPduCancellationSupport = false
        ComIPduGroupRef = TxSPG_PropulsionCAN_PNC16_573e0b18
        ComIPduGroupRef = TxSPG_PropulsionCAN_PNC24_921d39f7
        ComIPduGroupRef = TxSPG_PropulsionCAN_PNC25_e51a0961
        ComIPduGroupRef = TxSPG_PropulsionCAN_PNC26_7c1358db
        ComIPduGroupRef = TxSPG_PropulsionCAN_PNC27_0b14684d
        ComIPduGroupRef = TxSPG_PropulsionCAN_PNC29_ecac454a
        ComIPduGroupRef = TxSPG_PropulsionCAN_PNC30_8c6bccaf
        ComIPduGroupRef = TxSPG_PropulsionCAN_PNC33_15629d15
        ComIPduGroupRef = TxSPG_PropulsionCAN_PNC35_fc013820
        ComIPduGroupRef = TxSPG_PropulsionCAN_PNC39_f5b7740b
        ComIPduSignalGroupRef = igWhlMotSysTqAvl_6ba13f42_Tx
        ComIPduSignalGroupRef = igWhlMotSysTqEst_02b3fb8d_Tx
        ComIPduSignalRef = isWhlMotSysModSts_bd46c3f5_Tx
        ComPduIdRef = IemEduPropSignalIPdu01_3346005e_Tx
        ComTxIPdu: ComTxIPduUnusedAreasDefault=0, ComMinimumDelayTime=0, ComTxIPduClearUpdateBit=Transmit
          ComTxModeTrue
            ComTxMode: ComTxModeMode=PERIODIC, ComTxModeTimeOffset=0, ComTxModeTimePeriod=0.01
          ComTxModeFalse
            ComTxMode: ComTxModeMode=NONE
      RxSPG_PropulsionCAN_PNC24_f9c65551 (ComIPduGroup): ComIPduGroupHandleId=1, ComIPduGroupGroupRef=RxMPG_PropulsionCAN_aad5aa75
      isWhlMotSysHeatPwrMax_d3ea4a02_Tx (ComSignal):
        ComBitPosition = 7
        ComBitSize = 8
        ComSignalEndianness = BIG_ENDIAN
        ComSignalInitValue = 0
        ComSignalType = UINT8
        ComTransferProperty = PENDING
        ComUpdateBitPosition = 12
        ComSignalAccess = ACCESS_NEEDED_BY_SWC_OR_COM
        ComHandleId = 75
        ComSystemTemplateSystemSignalRef = isWhlMotSysHeatPwrMax_mtx
        ComFilter: ComFilterAlgorithm=ALWAYS
      IemPropSignalIPdu08_58d82fd4_Tx (ComIPdu):
        ComIPduDirection = SEND
        ComIPduType = NORMAL
        ComIPduHandleId = 8
        ComIPduSignalProcessing = DEFERRED
        ComIPduCancellationSupport = false
        ComIPduGroupRef = TxSPG_PropulsionCAN_PNC16_573e0b18
        ComIPduGroupRef = TxSPG_PropulsionCAN_PNC24_921d39f7
        ComIPduGroupRef = TxSPG_PropulsionCAN_PNC25_e51a0961
        ComIPduGroupRef = TxSPG_PropulsionCAN_PNC26_7c1358db
        ComIPduGroupRef = TxSPG_PropulsionCAN_PNC27_0b14684d
        ComIPduGroupRef = TxSPG_PropulsionCAN_PNC29_ecac454a
        ComIPduGroupRef = TxSPG_PropulsionCAN_PNC33_15629d15
        ComIPduGroupRef = TxSPG_PropulsionCAN_PNC35_fc013820
        ComIPduGroupRef = TxSPG_PropulsionCAN_PNC39_f5b7740b
        ComIPduSignalRef = isPLockParkStsRe_8fb3cac5_Tx
        ComIPduSignalRef = isWhlMotSysHeatPwrAct_e1709dcf_Tx
        ComIPduSignalRef = isWhlMotSysIdc_56101b54_Tx
        ComPduIdRef = IemPropSignalIPdu08_58d82fd4_Tx
        ComTxIPdu: ComTxIPduUnusedAreasDefault=0, ComMinimumDelayTime=0, ComTxIPduClearUpdateBit=Transmit
          ComTxModeTrue
            ComTxMode: ComTxModeMode=PERIODIC, ComTxModeTimeOffset=0, ComTxModeTimePeriod=0.02
          ComTxModeFalse
            ComTxMode: ComTxModeMode=NONE
      RxSPG_PropulsionCAN_PNC29_877729ec (ComIPduGroup): ComIPduGroupHandleId=5, ComIPduGroupGroupRef=RxMPG_PropulsionCAN_aad5aa75
      isDrvgCyc_edb7d721_Rx (ComSignal):
        ComBitPosition = 5
        ComBitSize = 1
        ComSignalEndianness = BIG_ENDIAN
        ComSignalInitValue = 0
        ComSignalType = UINT8
        ComUpdateBitPosition = 4
        ComSignalAccess = ACCESS_NEEDED_BY_SWC_OR_COM
        ComHandleId = 74
        ComSystemTemplateSystemSignalRef = isDrvgCyc_mrx
      ECMPropSignalIPDU04_5441ac09_Rx (ComIPdu):
        ComIPduDirection = RECEIVE
        ComIPduType = NORMAL
        ComIPduHandleId = 6
        ComIPduSignalProcessing = DEFERRED
        ComIPduCancellationSupport = false
        ComIPduGroupRef = RxSPG_PropulsionCAN_PNC24_f9c65551
        ComIPduGroupRef = RxSPG_PropulsionCAN_PNC25_8ec165c7
        ComIPduGroupRef = RxSPG_PropulsionCAN_PNC26_17c8347d
        ComIPduGroupRef = RxSPG_PropulsionCAN_PNC29_877729ec
        ComIPduSignalRef = isWhlMotSysPwrLimMax_45b5505a_Rx
        ComPduIdRef = ECMPropSignalIPDU04_5441ac09_Rx
      3 x ComSignal, all with ComSignalEndianness=BIG_ENDIAN, ComSignalInitValue=0, ComTransferProperty=PENDING, ComSignalAccess=ACCESS_NEEDED_BY_SWC_OR_COM:
        isWhlMotSysModSts_bd46c3f5_Tx: ComBitPosition=35, ComBitSize=4, ComSignalType=UINT8, ComUpdateBitPosition=36, ComHandleId=79, ComSystemTemplateSystemSignalRef=isWhlMotSysModSts_mtx
        isPLockFltLvlRe_167e1ed2_Tx: ComBitPosition=7, ComBitSize=2, ComSignalType=UINT8, ComUpdateBitPosition=55, ComHandleId=66, ComSystemTemplateSystemSignalRef=isPLockFltLvlRe_mtx
        isWhlMotSysLimnIndcn_9f88a06a_Tx: ComBitPosition=55, ComBitSize=16, ComSignalType=UINT16, ComUpdateBitPosition=39, ComHandleId=78, ComSystemTemplateSystemSignalRef=isWhlMotSysLimnIndcn_mtx
      BecmPropSignalIpdu03_949658bb_Rx (ComIPdu):
        ComIPduDirection = RECEIVE
        ComIPduType = NORMAL
        ComIPduHandleId = 2
        ComIPduSignalProcessing = DEFERRED
        ComIPduCancellationSupport = false
        ComIPduGroupRef = RxSPG_PropulsionCAN_PNC24_f9c65551
        ComIPduGroupRef = RxSPG_PropulsionCAN_PNC25_8ec165c7
        ComIPduGroupRef = RxSPG_PropulsionCAN_PNC26_17c8347d
        ComIPduGroupRef = RxSPG_PropulsionCAN_PNC29_877729ec
        ComIPduGroupRef = RxSPG_PropulsionCAN_PNC30_e7b0a009
        ComIPduGroupRef = RxSPG_PropulsionCAN_PNC35_97da5486
        ComIPduGroupRef = RxSPG_PropulsionCAN_PNC39_9e6c18ad
        ComIPduSignalRef = isHvBattSoc_ce242c3f_Rx
        ComPduIdRef = BecmPropSignalIpdu03_949658bb_Rx
      VDDMPropSignalIPDU18_8e674036_Rx (ComIPdu):
        ComIPduDirection = RECEIVE
        ComIPduType = NORMAL
        ComIPduHandleId = 22
        ComIPduSignalProcessing = DEFERRED
        ComIPduCancellationSupport = false
        ComIPduGroupRef = RxSPG_PropulsionCAN_fca0cb9e
        ComIPduSignalGroupRef = igVehModMngtGlbSafe1_d1f2be1a_Rx
        ComPduIdRef = VDDMPropSignalIPDU18_8e674036_Rx
      isHvBattSoc_ce242c3f_Rx (ComSignal):
        ComBitPosition = 47
        ComBitSize = 11
        ComSignalEndianness = BIG_ENDIAN
        ComSignalInitValue = 0
        ComSignalType = UINT16
        ComUpdateBitPosition = 52
        ComSignalAccess = ACCESS_NEEDED_BY_SWC_OR_COM
        ComHandleId = 76
        ComSystemTemplateSystemSignalRef = isHvBattSoc_mrx
      isWhlMotSysUdc_432c4140_Tx (ComSignal):
        ComBitPosition = 34
        ComBitSize = 11
        ComSignalEndianness = BIG_ENDIAN
        ComSignalInitValue = 0
        ComSignalType = UINT16
        ComTransferProperty = PENDING
        ComUpdateBitPosition = 38
        ComSignalAccess = ACCESS_NEEDED_BY_SWC_OR_COM
        ComHandleId = 82
        ComSystemTemplateSystemSignalRef = isWhlMotSysUdc_mtx
      IemPropSignalIPdu04_516e63ff_Tx (ComIPdu):
        ComIPduDirection = SEND
        ComIPduType = NORMAL
        ComIPduHandleId = 5
        ComIPduSignalProcessing = DEFERRED
        ComIPduCancellationSupport = false
        ComIPduGroupRef = TxSPG_PropulsionCAN_PNC24_921d39f7
        ComIPduGroupRef = TxSPG_PropulsionCAN_PNC26_7c1358db
        ComIPduGroupRef = TxSPG_PropulsionCAN_PNC29_ecac454a
        ComIPduSignalGroupRef = igImobEngChk2_35eae3c1_Tx
        ComPduIdRef = IemPropSignalIPdu04_516e63ff_Tx
        ComTxIPdu: ComTxIPduUnusedAreasDefault=0, ComMinimumDelayTime=0, ComTxIPduClearUpdateBit=Transmit
          ComTxModeTrue
            ComTxMode: ComTxModeMode=PERIODIC, ComTxModeTimeOffset=0, ComTxModeTimePeriod=0.08
          ComTxModeFalse
            ComTxMode: ComTxModeMode=NONE
      igPtTqAtAxleMaxReq_e1a6f04e_Rx (ComSignalGroup): ComUpdateBitPosition=20, ComSignalGroupAccess=ACCESS_NEEDED_BY_SWC_OR_COM, ComHandleId=5, ComSystemTemplateSignalGroupRef=igPtTqAtAxleMaxReq_mrx
        4 x ComGroupSignal, all with ComSignalEndianness=BIG_ENDIAN, ComSignalAccess=ACCESS_NEEDED_BY_SWC_OR_COM:
          isPtTqAtAxleMaxReqCntr_d4048d38_Rx: ComBitPosition=19, ComBitSize=4, ComSignalInitValue=0, ComSignalType=UINT8, ComHandleId=22, ComSystemTemplateSystemSignalRef=isPtTqAtAxleMaxReqCntr_mrx
          isPtTqAtAxleMaxReqPtTqAtAxleReReq_449843f2_Rx: ComBitPosition=55, ComBitSize=16, ComSignalInitValue=20000, ComSignalType=SINT16, ComHandleId=24, ComSystemTemplateSystemSignalRef=isPtTqAtAxleMaxReqPtTqAtAxleReReq_mrx
          isPtTqAtAxleMaxReqChks_6ad4cf82_Rx: ComBitPosition=31, ComBitSize=8, ComSignalInitValue=0, ComSignalType=UINT8, ComHandleId=21, ComSystemTemplateSystemSignalRef=isPtTqAtAxleMaxReqChks_mrx
          isPtTqAtAxleMaxReqPtTqAtAxleFrntReq_8c330c00_Rx: ComBitPosition=39, ComBitSize=16, ComSignalInitValue=20000, ComSignalType=SINT16, ComHandleId=23, ComSystemTemplateSystemSignalRef=isPtTqAtAxleMaxReqPtTqAtAxleFrntReq_mrx
      ECMPropSignalIPDU02_bd22093c_Rx (ComIPdu):
        ComIPduDirection = RECEIVE
        ComIPduType = NORMAL
        ComIPduHandleId = 5
        ComIPduSignalProcessing = DEFERRED
        ComIPduCancellationSupport = false
        ComIPduGroupRef = RxSPG_PropulsionCAN_PNC24_f9c65551
        ComIPduGroupRef = RxSPG_PropulsionCAN_PNC25_8ec165c7
        ComIPduGroupRef = RxSPG_PropulsionCAN_PNC26_17c8347d
        ComIPduGroupRef = RxSPG_PropulsionCAN_PNC29_877729ec
        ComIPduSignalRef = isWhlMotSysModReq_0153ebfe_Rx
        ComPduIdRef = ECMPropSignalIPDU02_bd22093c_Rx
      igIEMTestFr3_17ced146_Tx (ComSignalGroup): ComTransferProperty=TRIGGERED, ComSignalGroupAccess=ACCESS_NEEDED_BY_SWC_OR_COM, ComHandleId=3, ComSystemTemplateSignalGroupRef=igIEMTestFr3_mtx
        8 x ComGroupSignal, all with ComBitSize=8, ComSignalEndianness=BIG_ENDIAN, ComSignalInitValue=0, ComSignalType=UINT8, ComSignalAccess=ACCESS_NEEDED_BY_SWC_OR_COM, ComTransferProperty=PENDING:
          isIEMTestFr3Byte5_d6877035_Tx: ComBitPosition=47, ComHandleId=27, ComSystemTemplateSystemSignalRef=isIEMTestFr3Byte5_mtx
          isIEMTestFr3Byte6_4f8e218f_Tx: ComBitPosition=55, ComHandleId=28, ComSystemTemplateSystemSignalRef=isIEMTestFr3Byte6_mtx
          isIEMTestFr3Byte2_48e3e596_Tx: ComBitPosition=23, ComHandleId=24, ComSystemTemplateSystemSignalRef=isIEMTestFr3Byte2_mtx
          isIEMTestFr3Byte1_d1eab42c_Tx: ComBitPosition=15, ComHandleId=23, ComSystemTemplateSystemSignalRef=isIEMTestFr3Byte1_mtx
          isIEMTestFr3Byte4_a18040a3_Tx: ComBitPosition=39, ComHandleId=26, ComSystemTemplateSystemSignalRef=isIEMTestFr3Byte4_mtx
          isIEMTestFr3Byte0_a6ed84ba_Tx: ComBitPosition=7, ComHandleId=22, ComSystemTemplateSystemSignalRef=isIEMTestFr3Byte0_mtx
            ComFilter: ComFilterAlgorithm=ALWAYS
          isIEMTestFr3Byte3_3fe4d500_Tx: ComBitPosition=31, ComHandleId=25, ComSystemTemplateSystemSignalRef=isIEMTestFr3Byte3_mtx
          isIEMTestFr3Byte7_38891119_Tx: ComBitPosition=63, ComHandleId=29, ComSystemTemplateSystemSignalRef=isIEMTestFr3Byte7_mtx
      VDDMPropSignalIPDU06_70c45c70_Rx (ComIPdu):
        ComIPduDirection = RECEIVE
        ComIPduType = NORMAL
        ComIPduHandleId = 17
        ComIPduSignalProcessing = DEFERRED
        ComIPduCancellationSupport = false
        ComIPduGroupRef = RxSPG_PropulsionCAN_fca0cb9e
        ComIPduSignalGroupRef = igVehCfgPrm_eee11443_Rx
        ComPduIdRef = VDDMPropSignalIPDU06_70c45c70_Rx
      isWhlMotCooltFlowMinReq_102e8fa4_Tx (ComSignal):
        ComBitPosition = 1
        ComBitSize = 10
        ComSignalEndianness = BIG_ENDIAN
        ComSignalInitValue = 0
        ComSignalType = UINT16
        ComTransferProperty = PENDING
        ComUpdateBitPosition = 54
        ComSignalAccess = ACCESS_NEEDED_BY_SWC_OR_COM
        ComHandleId = 69
        ComSystemTemplateSystemSignalRef = isWhlMotCooltFlowMinReq_mtx
        ComFilter: ComFilterAlgorithm=ALWAYS
      ComTimeBase: ComGwTimeBase=0.005, ComRxTimeBase=0.005, ComTxTimeBase=0.005
      IemPropSignalIPdu16_a67b3392_Tx (ComIPdu):
        ComIPduDirection = SEND
        ComIPduType = NORMAL
        ComIPduHandleId = 12
        ComIPduSignalProcessing = DEFERRED
        ComIPduCancellationSupport = false
        ComIPduGroupRef = TxSPG_PropulsionCAN_617cc08d
        ComIPduSignalGroupRef = igDmcStsRearToEsc_5d8e0053_Tx
        ComPduIdRef = IemPropSignalIPdu16_a67b3392_Tx
        ComTxIPdu: ComTxIPduUnusedAreasDefault=0, ComMinimumDelayTime=0, ComTxIPduClearUpdateBit=Transmit
          ComTxModeTrue
            ComTxMode: ComTxModeMode=PERIODIC, ComTxModeTimeOffset=0, ComTxModeTimePeriod=0.02
          ComTxModeFalse
            ComTxMode: ComTxModeMode=NONE
      isWhlMotSysHeatFdBck_516116c8_Tx (ComSignal):
        ComBitPosition = 15
        ComBitSize = 2
        ComSignalEndianness = BIG_ENDIAN
        ComSignalInitValue = 1
        ComSignalType = UINT8
        ComTransferProperty = PENDING
        ComUpdateBitPosition = 13
        ComSignalAccess = ACCESS_NEEDED_BY_SWC_OR_COM
        ComHandleId = 73
        ComSystemTemplateSystemSignalRef = isWhlMotSysHeatFdBck_mtx
      isHvBattUDc_bcd9ade4_Rx (ComSignal):
        ComBitPosition = 18
        ComBitSize = 11
        ComSignalEndianness = BIG_ENDIAN
        ComSignalInitValue = 0
        ComSignalType = UINT16
        ComUpdateBitPosition = 19
        ComSignalAccess = ACCESS_NEEDED_BY_SWC_OR_COM
        ComHandleId = 77
        ComSystemTemplateSystemSignalRef = isHvBattUDc_mrx
      VDDMPropSignalIPDU17_1ed85da7_Rx (ComIPdu):
        ComIPduDirection = RECEIVE
        ComIPduType = NORMAL
        ComIPduHandleId = 21
        ComIPduSignalProcessing = DEFERRED
        ComIPduCancellationSupport = false
        ComIPduGroupRef = RxSPG_PropulsionCAN_fca0cb9e
        ComIPduSignalRef = isCarTiGlb_7a3bdc75_Rx
        ComPduIdRef = VDDMPropSignalIPDU17_1ed85da7_Rx
      igIEMTestFr2_60c9e1d0_Tx (ComSignalGroup): ComTransferProperty=TRIGGERED, ComSignalGroupAccess=ACCESS_NEEDED_BY_SWC_OR_COM, ComHandleId=2, ComSystemTemplateSignalGroupRef=igIEMTestFr2_mtx
        8 x ComGroupSignal, all with ComBitSize=8, ComSignalEndianness=BIG_ENDIAN, ComSignalInitValue=0, ComSignalType=UINT8, ComSignalAccess=ACCESS_NEEDED_BY_SWC_OR_COM, ComTransferProperty=PENDING:
          isIEMTestFr2Byte4_6adc9306_Tx: ComBitPosition=39, ComHandleId=18, ComSystemTemplateSystemSignalRef=isIEMTestFr2Byte4_mtx
          isIEMTestFr2Byte5_1ddba390_Tx: ComBitPosition=47, ComHandleId=19, ComSystemTemplateSystemSignalRef=isIEMTestFr2Byte5_mtx
          isIEMTestFr2Byte0_6db1571f_Tx: ComBitPosition=7, ComHandleId=14, ComSystemTemplateSystemSignalRef=isIEMTestFr2Byte0_mtx
            ComFilter: ComFilterAlgorithm=ALWAYS
          isIEMTestFr2Byte3_f4b806a5_Tx: ComBitPosition=31, ComHandleId=17, ComSystemTemplateSystemSignalRef=isIEMTestFr2Byte3_mtx
          isIEMTestFr2Byte2_83bf3633_Tx: ComBitPosition=23, ComHandleId=16, ComSystemTemplateSystemSignalRef=isIEMTestFr2Byte2_mtx
          isIEMTestFr2Byte1_1ab66789_Tx: ComBitPosition=15, ComHandleId=15, ComSystemTemplateSystemSignalRef=isIEMTestFr2Byte1_mtx
          isIEMTestFr2Byte6_84d2f22a_Tx: ComBitPosition=55, ComHandleId=20, ComSystemTemplateSystemSignalRef=isIEMTestFr2Byte6_mtx
          isIEMTestFr2Byte7_f3d5c2bc_Tx: ComBitPosition=63, ComHandleId=21, ComSystemTemplateSystemSignalRef=isIEMTestFr2Byte7_mtx
      isWhlMotSysModReq_0153ebfe_Rx (ComSignal):
        ComBitPosition = 58
        ComBitSize = 3
        ComSignalEndianness = BIG_ENDIAN
        ComSignalInitValue = 0
        ComSignalType = UINT8
        ComUpdateBitPosition = 59
        ComSignalAccess = ACCESS_NEEDED_BY_SWC_OR_COM
        ComHandleId = 87
        ComSystemTemplateSystemSignalRef = isWhlMotSysModReq_mrx
      VDDMPropSignalIPDU05_e9cd0dca_Rx (ComIPdu):
        ComIPduDirection = RECEIVE
        ComIPduType = NORMAL
        ComIPduHandleId = 16
        ComIPduSignalProcessing = DEFERRED
        ComIPduCancellationSupport = false
        ComIPduGroupRef = RxSPG_PropulsionCAN_PNC26_17c8347d
        ComIPduGroupRef = RxSPG_PropulsionCAN_PNC29_877729ec
        ComIPduGroupRef = RxSPG_PropulsionCAN_PNC30_e7b0a009
        ComIPduSignalGroupRef = igVehMtnSt_68a0f345_Rx
        ComIPduSignalGroupRef = igVehSpdLgt_56c0cfd4_Rx
        ComPduIdRef = VDDMPropSignalIPDU05_e9cd0dca_Rx
      VDDMPropSignalIPDU16_69df6d31_Rx (ComIPdu):
        ComIPduDirection = RECEIVE
        ComIPduType = NORMAL
        ComIPduHandleId = 20
        ComIPduSignalProcessing = DEFERRED
        ComIPduCancellationSupport = false
        ComIPduGroupRef = RxSPG_PropulsionCAN_PNC24_f9c65551
        ComIPduGroupRef = RxSPG_PropulsionCAN_PNC26_17c8347d
        ComIPduGroupRef = RxSPG_PropulsionCAN_PNC29_877729ec
        ComIPduSignalGroupRef = igImobEngMgrReq2_1df0559d_Rx
        ComPduIdRef = VDDMPropSignalIPDU16_69df6d31_Rx
      TxSPG_PropulsionCAN_PNC24_921d39f7 (ComIPduGroup): ComIPduGroupHandleId=13, ComIPduGroupGroupRef=TxMPG_PropulsionCAN_3709a166
      IemPropSignalIPdu07_c8673245_Tx (ComIPdu):
        ComIPduDirection = SEND
        ComIPduType = NORMAL
        ComIPduHandleId = 7
        ComIPduSignalProcessing = DEFERRED
        ComIPduCancellationSupport = false
        ComIPduGroupRef = TxSPG_PropulsionCAN_PNC24_921d39f7
        ComIPduGroupRef = TxSPG_PropulsionCAN_PNC25_e51a0961
        ComIPduGroupRef = TxSPG_PropulsionCAN_PNC26_7c1358db
        ComIPduGroupRef = TxSPG_PropulsionCAN_PNC29_ecac454a
        ComIPduGroupRef = TxSPG_PropulsionCAN_PNC35_fc013820
        ComIPduGroupRef = TxSPG_PropulsionCAN_PNC39_f5b7740b
        ComIPduSignalRef = isPLockFltIndcRe_f756fd30_Tx
        ComIPduSignalRef = isPLockFltLvlRe_167e1ed2_Tx
        ComIPduSignalRef = isWhlMotCooltFlowMinReq_102e8fa4_Tx
        ComPduIdRef = IemPropSignalIPdu07_c8673245_Tx
        ComTxIPdu: ComTxIPduUnusedAreasDefault=0, ComMinimumDelayTime=0, ComTxIPduClearUpdateBit=Transmit
          ComTxModeTrue
            ComTxMode: ComTxModeMode=PERIODIC, ComTxModeTimeOffset=0, ComTxModeTimePeriod=0.15
          ComTxModeFalse
            ComTxMode: ComTxModeMode=NONE
      isWhlMotSysCooltT_da703242_Tx (ComSignal):
        ComBitPosition = 31
        ComBitSize = 8
        ComSignalEndianness = BIG_ENDIAN
        ComSignalInitValue = 40
        ComSignalType = UINT8
        ComTransferProperty = PENDING
        ComUpdateBitPosition = 16
        ComSignalAccess = ACCESS_NEEDED_BY_SWC_OR_COM
        ComHandleId = 71
        ComSystemTemplateSystemSignalRef = isWhlMotSysCooltT_mtx
      isWhlMotSysPwrLimMax_45b5505a_Rx (ComSignal):
        ComBitPosition = 41
        ComBitSize = 10
        ComSignalEndianness = BIG_ENDIAN
        ComSignalInitValue = 0
        ComSignalType = UINT16
        ComUpdateBitPosition = 45
        ComSignalAccess = ACCESS_NEEDED_BY_SWC_OR_COM
        ComHandleId = 88
        ComSystemTemplateSystemSignalRef = isWhlMotSysPwrLimMax_mrx
      TxSPG_PropulsionCAN_617cc08d (ComIPduGroup): ComIPduGroupHandleId=11, ComIPduGroupGroupRef=TxMPG_PropulsionCAN_3709a166
      EcmPropSignalIPdu25_faea9d09_Rx (ComIPdu):
        ComIPduDirection = RECEIVE
        ComIPduType = NORMAL
        ComIPduHandleId = 13
        ComIPduSignalProcessing = DEFERRED
        ComIPduCancellationSupport = false
        ComIPduGroupRef = RxSPG_PropulsionCAN_PNC24_f9c65551
        ComIPduGroupRef = RxSPG_PropulsionCAN_PNC25_8ec165c7
        ComIPduGroupRef = RxSPG_PropulsionCAN_PNC26_17c8347d
        ComIPduGroupRef = RxSPG_PropulsionCAN_PNC29_877729ec
        ComIPduGroupRef = RxSPG_PropulsionCAN_PNC39_9e6c18ad
        ComIPduSignalRef = isDrvgCyc_edb7d721_Rx
        ComPduIdRef = EcmPropSignalIPdu25_faea9d09_Rx
      IemPropSignalIPdu09_2fdf1f42_Tx (ComIPdu):
        ComIPduDirection = SEND
        ComIPduType = NORMAL
        ComIPduHandleId = 9
        ComIPduSignalProcessing = DEFERRED
        ComIPduCancellationSupport = false
        ComIPduGroupRef = TxSPG_PropulsionCAN_617cc08d
        ComIPduSignalGroupRef = igIEMTestFr3_17ced146_Tx
        ComPduIdRef = IemPropSignalIPdu09_2fdf1f42_Tx
        ComTxIPdu: ComTxIPduUnusedAreasDefault=0, ComMinimumDelayTime=0
          ComTxModeTrue
            ComTxMode: ComTxModeMode=PERIODIC, ComTxModeTimeOffset=0, ComTxModeTimePeriod=0.8
          ComTxModeFalse
            ComTxMode: ComTxModeMode=NONE
      TxSPG_PropulsionCAN_PNC39_f5b7740b (ComIPduGroup): ComIPduGroupHandleId=21, ComIPduGroupGroupRef=TxMPG_PropulsionCAN_3709a166
      IemPropSignalIPdu02_b80dc6ca_Tx (ComIPdu):
        ComIPduDirection = SEND
        ComIPduType = NORMAL
        ComIPduHandleId = 3
        ComIPduSignalProcessing = DEFERRED
        ComIPduCancellationSupport = false
        ComIPduGroupRef = TxSPG_PropulsionCAN_617cc08d
        ComIPduSignalGroupRef = igIEMTestFr2_60c9e1d0_Tx
        ComPduIdRef = IemPropSignalIPdu02_b80dc6ca_Tx
        ComTxIPdu: ComTxIPduUnusedAreasDefault=0, ComMinimumDelayTime=0
          ComTxModeTrue
            ComTxMode: ComTxModeMode=PERIODIC, ComTxModeTimeOffset=0, ComTxModeTimePeriod=0.8
          ComTxModeFalse
            ComTxMode: ComTxModeMode=NONE
      VDDMPropSignalIPDU08_977c7177_Rx (ComIPdu):
        ComIPduDirection = RECEIVE
        ComIPduType = NORMAL
        ComIPduHandleId = 18
        ComIPduSignalProcessing = DEFERRED
        ComIPduCancellationSupport = false
        ComIPduGroupRef = RxSPG_PropulsionCAN_PNC29_877729ec
        ComIPduGroupRef = RxSPG_PropulsionCAN_PNC39_9e6c18ad
        ComIPduSignalGroupRef = igPtTqAtAxleMaxReq_e1a6f04e_Rx
        ComPduIdRef = VDDMPropSignalIPDU08_977c7177_Rx
      igCrashStsSafe_0a09c5f2_Rx (ComSignalGroup): ComUpdateBitPosition=5, ComSignalGroupAccess=ACCESS_NEEDED_BY_SWC_OR_COM, ComHandleId=0, ComSystemTemplateSignalGroupRef=igCrashStsSafe_mrx
        3 x ComGroupSignal, all with ComSignalEndianness=BIG_ENDIAN, ComSignalType=UINT8, ComSignalAccess=ACCESS_NEEDED_BY_SWC_OR_COM:
          isCrashStsSafeChks_42d0b327_Rx: ComBitPosition=15, ComBitSize=8, ComSignalInitValue=255, ComHandleId=1, ComSystemTemplateSystemSignalRef=isCrashStsSafeChks_mrx
          isCrashStsSafeCntr_fc00f19d_Rx: ComBitPosition=3, ComBitSize=4, ComSignalInitValue=0, ComHandleId=2, ComSystemTemplateSystemSignalRef=isCrashStsSafeCntr_mrx
          isCrashStsSafeSts_847c5d07_Rx: ComBitPosition=4, ComBitSize=1, ComSignalInitValue=0, ComHandleId=3, ComSystemTemplateSystemSignalRef=isCrashStsSafeSts_mrx
      RxSPG_PropulsionCAN_PNC27_60cf04eb (ComIPduGroup): ComIPduGroupHandleId=4, ComIPduGroupGroupRef=RxMPG_PropulsionCAN_aad5aa75
      IemEduPropSignalIPdu02_aa4f51e4_Tx (ComIPdu):
        ComIPduDirection = SEND
        ComIPduType = NORMAL
        ComIPduHandleId = 1
        ComIPduSignalProcessing = DEFERRED
        ComIPduCancellationSupport = false
        ComIPduGroupRef = TxSPG_PropulsionCAN_617cc08d
        ComIPduSignalRef = isImobEngSts2_5f8745c8_Tx
        ComIPduSignalRef = isWhlMotSysCooltT_da703242_Tx
        ComIPduSignalRef = isWhlMotSysLimnIndcn_9f88a06a_Tx
        ComIPduSignalRef = isWhlMotSysSpdAct_e26fc666_Tx
        ComIPduSignalRef = isWhlMotSysUdc_432c4140_Tx
        ComPduIdRef = IemEduPropSignalIPdu02_aa4f51e4_Tx
        ComTxIPdu: ComTxIPduUnusedAreasDefault=0, ComMinimumDelayTime=0, ComTxIPduClearUpdateBit=Transmit
          ComTxModeTrue
            ComTxMode: ComTxModeMode=PERIODIC, ComTxModeTimeOffset=0, ComTxModeTimePeriod=0.02
          ComTxModeFalse
            ComTxMode: ComTxModeMode=NONE
      isImobEngSts2_5f8745c8_Tx (ComSignal):
        ComBitPosition = 36
        ComBitSize = 2
        ComSignalEndianness = BIG_ENDIAN
        ComSignalInitValue = 0
        ComSignalType = UINT8
        ComTransferProperty = PENDING
        ComUpdateBitPosition = 37
        ComSignalAccess = ACCESS_NEEDED_BY_SWC_OR_COM
        ComHandleId = 64
        ComSystemTemplateSystemSignalRef = isImobEngSts2_mtx
      isCooltTSigForDtElec_f43a3873_Rx (ComSignal):
        ComBitPosition = 39
        ComBitSize = 11
        ComSignalEndianness = BIG_ENDIAN
        ComSignalInitValue = 400
        ComSignalType = UINT16
        ComUpdateBitPosition = 5
        ComSignalAccess = ACCESS_NEEDED_BY_SWC_OR_COM
        ComHandleId = 72
        ComSystemTemplateSystemSignalRef = isCooltTSigForDtElec_mrx
      igWhlMotSysSpdActSafe_58c9c55b_Tx (ComSignalGroup):
        ComTransferProperty = PENDING
        ComUpdateBitPosition = 24
        ComSignalGroupAccess = ACCESS_NEEDED_BY_SWC_OR_COM
        ComHandleId = 6
        ComSystemTemplateSignalGroupRef = igWhlMotSysSpdActSafe_mtx
        4 x ComGroupSignal, all with ComSignalEndianness=BIG_ENDIAN, ComSignalAccess=ACCESS_NEEDED_BY_SWC_OR_COM, ComTransferProperty=PENDING:
          isWhlMotSysSpdActSafeChks_8eaaad7b_Tx: ComBitPosition=15, ComBitSize=8, ComSignalInitValue=0, ComSignalType=UINT8, ComHandleId=54, ComSystemTemplateSystemSignalRef=isWhlMotSysSpdActSafeChks_mtx
          isWhlMotSysSpdActSafeCntr_307aefc1_Tx: ComBitPosition=3, ComBitSize=4, ComSignalInitValue=0, ComSignalType=UINT8, ComHandleId=55, ComSystemTemplateSystemSignalRef=isWhlMotSysSpdActSafeCntr_mtx
            ComFilter: ComFilterAlgorithm=ALWAYS
          isWhlMotSysSpdActSafeIsgSpdWSgnTyp_9d8822c6_Tx: ComBitPosition=23, ComBitSize=15, ComSignalInitValue=0, ComSignalType=SINT16, ComHandleId=56, ComSystemTemplateSystemSignalRef=isWhlMotSysSpdActSafeIsgSpdWSgnTyp_mtx
          isWhlMotSysSpdActSafeQf_b9719ecc_Tx: ComBitPosition=5, ComBitSize=2, ComSignalInitValue=1, ComSignalType=UINT8, ComHandleId=57, ComSystemTemplateSystemSignalRef=isWhlMotSysSpdActSafeQf_mtx
      EcmPropSignalIPdu24_8dedad9f_Rx (ComIPdu):
        ComIPduDirection = RECEIVE
        ComIPduType = NORMAL
        ComIPduHandleId = 12
        ComIPduSignalProcessing = DEFERRED
        ComIPduCancellationSupport = false
        ComIPduGroupRef = RxSPG_PropulsionCAN_PNC24_f9c65551
        ComIPduGroupRef = RxSPG_PropulsionCAN_PNC25_8ec165c7
        ComIPduGroupRef = RxSPG_PropulsionCAN_PNC26_17c8347d
        ComIPduGroupRef = RxSPG_PropulsionCAN_PNC29_877729ec
        ComIPduSignalGroupRef = igEngSt1WdSts_adcf75d2_Rx
        ComIPduSignalRef = isGearLvrIndcn_bb4b951e_Rx
        ComIPduSignalRef = isWhlMotSysTqReq_f0fdb022_Rx
        ComPduIdRef = EcmPropSignalIPdu24_8dedad9f_Rx
      igWhlMotSysTqAvl_6ba13f42_Tx (ComSignalGroup):
        ComTransferProperty = PENDING
        ComUpdateBitPosition = 37
        ComSignalGroupAccess = ACCESS_NEEDED_BY_SWC_OR_COM
        ComHandleId = 7
        ComSystemTemplateSignalGroupRef = igWhlMotSysTqAvl_mtx
        isWhlMotSysTqAvlTqAvlMin_875cb2e3_Tx (ComGroupSignal):
          ComBitPosition = 51
          ComBitSize = 12
          ComSignalEndianness = BIG_ENDIAN
          ComSignalInitValue = 2047
          ComSignalType = UINT16
          ComSignalAccess = ACCESS_NEEDED_BY_SWC_OR_COM
          ComHandleId = 59
          ComTransferProperty = PENDING
          ComSystemTemplateSystemSignalRef = isWhlMotSysTqAvlTqAvlMin_mtx
        isWhlMotSysTqAvlTqAvlMax_bb518dba_Tx (ComGroupSignal):
          ComBitPosition = 47
          ComBitSize = 12
          ComSignalEndianness = BIG_ENDIAN
          ComSignalInitValue = 2047
          ComSignalType = UINT16
          ComSignalAccess = ACCESS_NEEDED_BY_SWC_OR_COM
          ComHandleId = 58
          ComTransferProperty = PENDING
          ComSystemTemplateSystemSignalRef = isWhlMotSysTqAvlTqAvlMax_mtx
      RxSPG_PropulsionCAN_fca0cb9e (ComIPduGroup): ComIPduGroupHandleId=9, ComIPduGroupGroupRef=RxMPG_PropulsionCAN_aad5aa75
      isGearLvrIndcn_bb4b951e_Rx (ComSignal):
        ComBitPosition = 27
        ComBitSize = 3
        ComSignalEndianness = BIG_ENDIAN
        ComSignalInitValue = 7
        ComSignalType = UINT8
        ComUpdateBitPosition = 24
        ComSignalAccess = ACCESS_NEEDED_BY_SWC_OR_COM
        ComHandleId = 75
        ComSystemTemplateSystemSignalRef = isGearLvrIndcn_mrx
      igImobEngMgrReq2_1df0559d_Rx (ComSignalGroup): ComUpdateBitPosition=2, ComSignalGroupAccess=ACCESS_NEEDED_BY_SWC_OR_COM, ComHandleId=4, ComSystemTemplateSignalGroupRef=igImobEngMgrReq2_mrx
        8 x ComGroupSignal, all with ComSignalEndianness=BIG_ENDIAN, ComSignalInitValue=0, ComSignalType=UINT8, ComSignalAccess=ACCESS_NEEDED_BY_SWC_OR_COM:
          isImobEngMgrReq2ImobEngDataMgrReq4_9b6bb3ea_Rx: ComBitPosition=47, ComBitSize=8, ComHandleId=17, ComSystemTemplateSystemSignalRef=isImobEngMgrReq2ImobEngDataMgrReq4_mrx
          isImobEngMgrReq2ImobEngMgrCmdTar1_817e486b_Rx: ComBitPosition=1, ComBitSize=2, ComHandleId=20, ComSystemTemplateSystemSignalRef=isImobEngMgrReq2ImobEngMgrCmdTar1_mrx
          isImobEngMgrReq2ImobEngDataMgrReq0_9c0677f3_Rx: ComBitPosition=15, ComBitSize=8, ComHandleId=13, ComSystemTemplateSystemSignalRef=isImobEngMgrReq2ImobEngDataMgrReq0_mrx
          isImobEngMgrReq2ImobEngDataMgrReq5_ec6c837c_Rx: ComBitPosition=55, ComBitSize=8, ComHandleId=18, ComSystemTemplateSystemSignalRef=isImobEngMgrReq2ImobEngDataMgrReq5_mrx
          isImobEngMgrReq2ImobEngDataMgrReq1_eb014765_Rx: ComBitPosition=23, ComBitSize=8, ComHandleId=14, ComSystemTemplateSystemSignalRef=isImobEngMgrReq2ImobEngDataMgrReq1_mrx
          isImobEngMgrReq2ImobEngDataMgrReq6_7565d2c6_Rx: ComBitPosition=63, ComBitSize=8, ComHandleId=19, ComSystemTemplateSystemSignalRef=isImobEngMgrReq2ImobEngDataMgrReq6_mrx
          isImobEngMgrReq2ImobEngDataMgrReq3_050f2649_Rx: ComBitPosition=39, ComBitSize=8, ComHandleId=16, ComSystemTemplateSystemSignalRef=isImobEngMgrReq2ImobEngDataMgrReq3_mrx
          isImobEngMgrReq2ImobEngDataMgrReq2_720816df_Rx: ComBitPosition=31, ComBitSize=8, ComHandleId=15, ComSystemTemplateSystemSignalRef=isImobEngMgrReq2ImobEngDataMgrReq2_mrx
      4 x ComSignal, all with ComSignalEndianness=BIG_ENDIAN, ComSignalInitValue=0, ComSignalAccess=ACCESS_NEEDED_BY_SWC_OR_COM:
        isCarTiGlb_7a3bdc75_Rx: ComBitPosition=7, ComBitSize=32, ComSignalType=UINT32, ComUpdateBitPosition=39, ComHandleId=70, ComSystemTemplateSystemSignalRef=isCarTiGlb_mrx
        isWhlMotSysErrIndcnReq_d5e6edc2_Tx: ComBitPosition=10, ComBitSize=1, ComSignalType=UINT8, ComTransferProperty=PENDING, ComUpdateBitPosition=9, ComHandleId=72, ComSystemTemplateSystemSignalRef=isWhlMotSysErrIndcnReq_mtx
        isWhlMotClrRdyReq_189c9369_Tx: ComBitPosition=24, ComBitSize=1, ComSignalType=UINT8, ComTransferProperty=PENDING, ComUpdateBitPosition=25, ComHandleId=68, ComSystemTemplateSystemSignalRef=isWhlMotClrRdyReq_mtx
        isWhlMotSysActvDampgModReq_1c578291_Rx: ComBitPosition=50, ComBitSize=2, ComSignalType=UINT8, ComUpdateBitPosition=48, ComHandleId=86, ComSystemTemplateSystemSignalRef=isWhlMotSysActvDampgModReq_mrx
      igVehSpdLgt_56c0cfd4_Rx (ComSignalGroup): ComUpdateBitPosition=39, ComSignalGroupAccess=ACCESS_NEEDED_BY_SWC_OR_COM, ComHandleId=12, ComSystemTemplateSignalGroupRef=igVehSpdLgt_mrx
        4 x ComGroupSignal, all with ComSignalEndianness=BIG_ENDIAN, ComSignalAccess=ACCESS_NEEDED_BY_SWC_OR_COM:
          isVehSpdLgtA_668ad5e3_Rx: ComBitPosition=38, ComBitSize=15, ComSignalInitValue=0, ComSignalType=UINT16, ComHandleId=62, ComSystemTemplateSystemSignalRef=isVehSpdLgtA_mrx
          isVehSpdLgtQf_057400a6_Rx: ComBitPosition=59, ComBitSize=2, ComSignalInitValue=1, ComSignalType=UINT8, ComHandleId=65, ComSystemTemplateSystemSignalRef=isVehSpdLgtQf_mrx
          isVehSpdLgtCntr_b8df6eaa_Rx: ComBitPosition=63, ComBitSize=4, ComSignalInitValue=0, ComSignalType=UINT8, ComHandleId=64, ComSystemTemplateSystemSignalRef=isVehSpdLgtCntr_mrx
          isVehSpdLgtChks_060f2c10_Rx: ComBitPosition=55, ComBitSize=8, ComSignalInitValue=0, ComSignalType=UINT8, ComHandleId=63, ComSystemTemplateSystemSignalRef=isVehSpdLgtChks_mrx
      VddmPropSignalIPdu26_8fec2bf2_Rx (ComIPdu):
        ComIPduDirection = RECEIVE
        ComIPduType = NORMAL
        ComIPduHandleId = 26
        ComIPduSignalProcessing = DEFERRED
        ComIPduCancellationSupport = false
        ComIPduGroupRef = RxSPG_PropulsionCAN_fca0cb9e
        ComIPduSignalGroupRef = igVehCfgPrmExt_b2e1e62e_Rx
        ComPduIdRef = VddmPropSignalIPdu26_8fec2bf2_Rx
      igVehMtnSt_68a0f345_Rx (ComSignalGroup): ComUpdateBitPosition=57, ComSignalGroupAccess=ACCESS_NEEDED_BY_SWC_OR_COM, ComHandleId=11, ComSystemTemplateSignalGroupRef=igVehMtnSt_mrx
        3 x ComGroupSignal, all with ComSignalEndianness=BIG_ENDIAN, ComSignalInitValue=0, ComSignalType=UINT8, ComSignalAccess=ACCESS_NEEDED_BY_SWC_OR_COM:
          isVehMtnStChks_46ae48d7_Rx: ComBitPosition=31, ComBitSize=8, ComHandleId=59, ComSystemTemplateSystemSignalRef=isVehMtnStChks_mrx
          isVehMtnStVehMtnSt_e696b713_Rx: ComBitPosition=18, ComBitSize=3, ComHandleId=61, ComSystemTemplateSystemSignalRef=isVehMtnStVehMtnSt_mrx
          isVehMtnStCntr_f87e0a6d_Rx: ComBitPosition=22, ComBitSize=4, ComHandleId=60, ComSystemTemplateSystemSignalRef=isVehMtnStCntr_mrx
      isPLockParkReq_5b6f1b96_Rx (ComSignal):
        ComBitPosition = 53
        ComBitSize = 2
        ComSignalEndianness = BIG_ENDIAN
        ComSignalInitValue = 0
        ComSignalType = UINT8
        ComUpdateBitPosition = 51
        ComSignalAccess = ACCESS_NEEDED_BY_SWC_OR_COM
        ComHandleId = 81
        ComSystemTemplateSystemSignalRef = isPLockParkReq_mrx
      VDDMPropdTCSignalIPdu38_808bfd3f_Rx (ComIPdu):
        ComIPduDirection = RECEIVE
        ComIPduType = NORMAL
        ComIPduHandleId = 24
        ComIPduSignalProcessing = DEFERRED
        ComIPduCancellationSupport = false
        ComIPduGroupRef = RxSPG_PropulsionCAN_fca0cb9e
        ComIPduSignalGroupRef = igStcStsToDmc_cb036148_Rx
        ComPduIdRef = VDDMPropdTCSignalIPdu38_808bfd3f_Rx
      ECMPropSignalIPDU05_23469c9f_Rx (ComIPdu):
        ComIPduDirection = RECEIVE
        ComIPduType = NORMAL
        ComIPduHandleId = 7
        ComIPduSignalProcessing = DEFERRED
        ComIPduCancellationSupport = false
        ComIPduGroupRef = RxSPG_PropulsionCAN_PNC24_f9c65551
        ComIPduGroupRef = RxSPG_PropulsionCAN_PNC25_8ec165c7
        ComIPduGroupRef = RxSPG_PropulsionCAN_PNC26_17c8347d
        ComIPduGroupRef = RxSPG_PropulsionCAN_PNC29_877729ec
        ComIPduSignalGroupRef = igWhlMotSysTqAllwd_20f5846f_Rx
        ComPduIdRef = ECMPropSignalIPDU05_23469c9f_Rx
      igDmcStsRearToEsc_5d8e0053_Tx (ComSignalGroup):
        ComTransferProperty = PENDING
        ComUpdateBitPosition = 56
        ComSignalGroupAccess = ACCESS_NEEDED_BY_SWC_OR_COM
        ComHandleId = 0
        ComSystemTemplateSignalGroupRef = igDmcStsRearToEsc_mtx
        5 x ComGroupSignal, all with ComSignalEndianness=BIG_ENDIAN, ComSignalInitValue=0, ComSignalAccess=ACCESS_NEEDED_BY_SWC_OR_COM, ComTransferProperty=PENDING:
          isDmcStsRearToEscDmcSts_2fffc6c5_Tx: ComBitPosition=11, ComBitSize=4, ComSignalType=UINT8, ComHandleId=5, ComSystemTemplateSystemSignalRef=isDmcStsRearToEscDmcSts_mtx
          isDmcStsRearToEscDmcActAppTarTq_eaa126f0_Tx: ComBitPosition=23, ComBitSize=16, ComSignalType=SINT16, ComHandleId=3, ComSystemTemplateSystemSignalRef=isDmcStsRearToEscDmcActAppTarTq_mtx
          isDmcStsRearToEscDmcSWInfo_6d930900_Tx: ComBitPosition=39, ComBitSize=16, ComSignalType=UINT16, ComHandleId=4, ComSystemTemplateSystemSignalRef=isDmcStsRearToEscDmcSWInfo_mtx
          isDmcStsRearToEscChks_0817ec86_Tx: ComBitPosition=7, ComBitSize=8, ComSignalType=UINT8, ComHandleId=1, ComSystemTemplateSystemSignalRef=isDmcStsRearToEscChks_mtx
            ComFilter: ComFilterAlgorithm=ALWAYS
          isDmcStsRearToEscCntr_b6c7ae3c_Tx: ComBitPosition=15, ComBitSize=4, ComSignalType=UINT8, ComHandleId=2, ComSystemTemplateSystemSignalRef=isDmcStsRearToEscCntr_mtx
      igVehCfgPrmExt_b2e1e62e_Rx (ComSignalGroup): ComSignalGroupAccess=ACCESS_NEEDED_BY_SWC_OR_COM, ComHandleId=8, ComSystemTemplateSignalGroupRef=igVehCfgPrmExt_mrx
        8 x ComGroupSignal, all with ComBitSize=8, ComSignalEndianness=BIG_ENDIAN, ComSignalInitValue=0, ComSignalType=UINT8, ComSignalAccess=ACCESS_NEEDED_BY_SWC_OR_COM:
          isVehCfgPrmExtBlkIDBytePosn1_6585aabf_Rx: ComBitPosition=7, ComHandleId=33, ComSystemTemplateSystemSignalRef=isVehCfgPrmExtBlkIDBytePosn1_mrx
          isVehCfgPrmExtCCPBytePosn3_90ead4a9_Rx: ComBitPosition=23, ComHandleId=35, ComSystemTemplateSystemSignalRef=isVehCfgPrmExtCCPBytePosn3_mrx
          isVehCfgPrmExtCCPBytePosn2_e7ede43f_Rx: ComBitPosition=15, ComHandleId=34, ComSystemTemplateSystemSignalRef=isVehCfgPrmExtCCPBytePosn2_mrx
          isVehCfgPrmExtCCPBytePosn5_7989719c_Rx: ComBitPosition=39, ComHandleId=37, ComSystemTemplateSystemSignalRef=isVehCfgPrmExtCCPBytePosn5_mrx
          isVehCfgPrmExtCCPBytePosn6_e0802026_Rx: ComBitPosition=47, ComHandleId=38, ComSystemTemplateSystemSignalRef=isVehCfgPrmExtCCPBytePosn6_mrx
          isVehCfgPrmExtCCPBytePosn4_0e8e410a_Rx: ComBitPosition=31, ComHandleId=36, ComSystemTemplateSystemSignalRef=isVehCfgPrmExtCCPBytePosn4_mrx
          isVehCfgPrmExtCCPBytePosn7_978710b0_Rx: ComBitPosition=55, ComHandleId=39, ComSystemTemplateSystemSignalRef=isVehCfgPrmExtCCPBytePosn7_mrx
          isVehCfgPrmExtCCPBytePosn8_07380d21_Rx: ComBitPosition=63, ComHandleId=40, ComSystemTemplateSystemSignalRef=isVehCfgPrmExtCCPBytePosn8_mrx
      IemPropSignalIPdu14_487552be_Tx (ComIPdu):
        ComIPduDirection = SEND
        ComIPduType = NORMAL
        ComIPduHandleId = 11
        ComIPduSignalProcessing = DEFERRED
        ComIPduCancellationSupport = false
        ComIPduGroupRef = TxSPG_PropulsionCAN_PNC24_921d39f7
        ComIPduGroupRef = TxSPG_PropulsionCAN_PNC25_e51a0961
        ComIPduGroupRef = TxSPG_PropulsionCAN_PNC26_7c1358db
        ComIPduGroupRef = TxSPG_PropulsionCAN_PNC29_ecac454a
        ComIPduSignalRef = isWhlMotSysHeatFdBck_516116c8_Tx
        ComIPduSignalRef = isWhlMotSysHeatPwrMax_d3ea4a02_Tx
        ComPduIdRef = IemPropSignalIPdu14_487552be_Tx
        ComTxIPdu: ComTxIPduUnusedAreasDefault=0, ComMinimumDelayTime=0, ComTxIPduClearUpdateBit=Transmit
          ComTxModeTrue
            ComTxMode: ComTxModeMode=PERIODIC, ComTxModeTimeOffset=0, ComTxModeTimePeriod=0.08
          ComTxModeFalse
            ComTxMode: ComTxModeMode=NONE
      VDDMPropSignalIPDU19_f96070a0_Rx (ComIPdu):
        ComIPduDirection = RECEIVE
        ComIPduType = NORMAL
        ComIPduHandleId = 23
        ComIPduSignalProcessing = DEFERRED
        ComIPduCancellationSupport = false
        ComIPduGroupRef = RxSPG_PropulsionCAN_fca0cb9e
        ComIPduSignalGroupRef = igVehBattU_0a2a47a4_Rx
        ComIPduSignalRef = isBkpOfDstTrvld_1c9ea633_Rx
        ComPduIdRef = VDDMPropSignalIPDU19_f96070a0_Rx
      RxMPG_PropulsionCAN_aad5aa75 (ComIPduGroup): ComIPduGroupHandleId=0
      SrsPropSignalIPdu02_4fa2d123_Rx (ComIPdu):
        ComIPduDirection = RECEIVE
        ComIPduType = NORMAL
        ComIPduHandleId = 15
        ComIPduSignalProcessing = DEFERRED
        ComIPduCancellationSupport = false
        ComIPduGroupRef = RxSPG_PropulsionCAN_PNC26_17c8347d
        ComIPduGroupRef = RxSPG_PropulsionCAN_PNC29_877729ec
        ComIPduGroupRef = RxSPG_PropulsionCAN_PNC30_e7b0a009
        ComIPduGroupRef = RxSPG_PropulsionCAN_PNC39_9e6c18ad
        ComIPduSignalGroupRef = igCrashStsSafe_0a09c5f2_Rx
        ComPduIdRef = SrsPropSignalIPdu02_4fa2d123_Rx
      3 x ComSignalGroup, all with ComSignalGroupAccess=ACCESS_NEEDED_BY_SWC_OR_COM:
        igHvSysRlySts_760c5326_Rx: ComUpdateBitPosition=22, ComHandleId=3, ComSystemTemplateSignalGroupRef=igHvSysRlySts_mrx
          3 x ComGroupSignal, all with ComSignalEndianness=BIG_ENDIAN, ComSignalType=UINT8, ComSignalAccess=ACCESS_NEEDED_BY_SWC_OR_COM:
            isHvSysRlyStsHvSysRlySts_5b219bea_Rx: ComBitPosition=5, ComBitSize=2, ComSignalInitValue=2, ComHandleId=12, ComSystemTemplateSystemSignalRef=isHvSysRlyStsHvSysRlySts_mrx
            isHvSysRlyStsChks_b1dd6f20_Rx: ComBitPosition=15, ComBitSize=8, ComSignalInitValue=0, ComHandleId=10, ComSystemTemplateSystemSignalRef=isHvSysRlyStsChks_mrx
            isHvSysRlyStsCntr_0f0d2d9a_Rx: ComBitPosition=3, ComBitSize=4, ComSignalInitValue=0, ComHandleId=11, ComSystemTemplateSystemSignalRef=isHvSysRlyStsCntr_mrx
        igIEMTestFr1_f9c0b06a_Tx: ComTransferProperty=TRIGGERED, ComHandleId=1, ComSystemTemplateSignalGroupRef=igIEMTestFr1_mtx
          8 x ComGroupSignal, all with ComBitSize=8, ComSignalEndianness=BIG_ENDIAN, ComSignalInitValue=0, ComSignalType=UINT8, ComSignalAccess=ACCESS_NEEDED_BY_SWC_OR_COM, ComTransferProperty=PENDING:
            isIEMTestFr1Byte3_722c740b_Tx: ComBitPosition=31, ComHandleId=9, ComSystemTemplateSystemSignalRef=isIEMTestFr1Byte3_mtx
            isIEMTestFr1Byte2_052b449d_Tx: ComBitPosition=23, ComHandleId=8, ComSystemTemplateSystemSignalRef=isIEMTestFr1Byte2_mtx
            isIEMTestFr1Byte7_7541b012_Tx: ComBitPosition=63, ComHandleId=13, ComSystemTemplateSystemSignalRef=isIEMTestFr1Byte7_mtx
            isIEMTestFr1Byte6_02468084_Tx: ComBitPosition=55, ComHandleId=12, ComSystemTemplateSystemSignalRef=isIEMTestFr1Byte6_mtx
            isIEMTestFr1Byte5_9b4fd13e_Tx: ComBitPosition=47, ComHandleId=11, ComSystemTemplateSystemSignalRef=isIEMTestFr1Byte5_mtx
            isIEMTestFr1Byte0_eb2525b1_Tx: ComBitPosition=7, ComHandleId=6, ComSystemTemplateSystemSignalRef=isIEMTestFr1Byte0_mtx
              ComFilter: ComFilterAlgorithm=ALWAYS
            isIEMTestFr1Byte4_ec48e1a8_Tx: ComBitPosition=39, ComHandleId=10, ComSystemTemplateSystemSignalRef=isIEMTestFr1Byte4_mtx
            isIEMTestFr1Byte1_9c221527_Tx: ComBitPosition=15, ComHandleId=7, ComSystemTemplateSystemSignalRef=isIEMTestFr1Byte1_mtx
        igVehBattU_0a2a47a4_Rx: ComUpdateBitPosition=2, ComHandleId=7, ComSystemTemplateSignalGroupRef=igVehBattU_mrx
          isVehBattUSysUQf_f605b03a_Rx (ComGroupSignal):
            ComBitPosition = 1
            ComBitSize = 2
            ComSignalEndianness = BIG_ENDIAN
            ComSignalInitValue = 1
            ComSignalType = UINT8
            ComSignalAccess = ACCESS_NEEDED_BY_SWC_OR_COM
            ComHandleId = 31
            ComSystemTemplateSystemSignalRef = isVehBattUSysUQf_mrx
          isVehBattUSysU_9501cb8f_Rx (ComGroupSignal):
            ComBitPosition = 15
            ComBitSize = 8
            ComSignalEndianness = BIG_ENDIAN
            ComSignalInitValue = 0
            ComSignalType = UINT8
            ComSignalAccess = ACCESS_NEEDED_BY_SWC_OR_COM
            ComHandleId = 32
            ComSystemTemplateSystemSignalRef = isVehBattUSysU_mrx
      isPrpsnFbLimnIndcn_5674da6b_Rx (ComSignal):
        ComBitPosition = 22
        ComBitSize = 4
        ComSignalEndianness = BIG_ENDIAN
        ComSignalInitValue = 0
        ComSignalType = UINT8
        ComUpdateBitPosition = 23
        ComSignalAccess = ACCESS_NEEDED_BY_SWC_OR_COM
        ComHandleId = 82
        ComSystemTemplateSystemSignalRef = isPrpsnFbLimnIndcn_mrx
      RxSPG_PropulsionCAN_PNC25_8ec165c7 (ComIPduGroup): ComIPduGroupHandleId=2, ComIPduGroupGroupRef=RxMPG_PropulsionCAN_aad5aa75
      PropulsionCAN_33157db4_Rx (ComIPdu):
        ComIPduDirection = RECEIVE
        ComIPduHandleId = 14
        ComIPduSignalProcessing = DEFERRED
        ComIPduType = NORMAL
        ComIPduCancellationSupport = false
        ComIPduSignalRef = PropulsionCAN_db9c2837_Rx
        ComPduIdRef = PropulsionCAN_c71a5358_Rx
      isPLockParkStsRe_8fb3cac5_Tx (ComSignal):
        ComBitPosition = 23
        ComBitSize = 4
        ComSignalEndianness = BIG_ENDIAN
        ComSignalInitValue = 7
        ComSignalType = UINT8
        ComTransferProperty = PENDING
        ComUpdateBitPosition = 7
        ComSignalAccess = ACCESS_NEEDED_BY_SWC_OR_COM
        ComHandleId = 67
        ComSystemTemplateSystemSignalRef = isPLockParkStsRe_mtx
      isPLockFltIndcRe_f756fd30_Tx (ComSignal):
        ComBitPosition = 4
        ComBitSize = 3
        ComSignalEndianness = BIG_ENDIAN
        ComSignalInitValue = 0
        ComSignalType = UINT8
        ComTransferProperty = PENDING
        ComUpdateBitPosition = 5
        ComSignalAccess = ACCESS_NEEDED_BY_SWC_OR_COM
        ComHandleId = 65
        ComSystemTemplateSystemSignalRef = isPLockFltIndcRe_mtx
      IemPropSignalIPdu12_a116f78b_Tx (ComIPdu):
        ComIPduDirection = SEND
        ComIPduType = NORMAL
        ComIPduHandleId = 10
        ComIPduSignalProcessing = DEFERRED
        ComIPduCancellationSupport = false
        ComIPduGroupRef = TxSPG_PropulsionCAN_PNC16_573e0b18
        ComIPduGroupRef = TxSPG_PropulsionCAN_PNC25_e51a0961
        ComIPduGroupRef = TxSPG_PropulsionCAN_PNC29_ecac454a
        ComIPduGroupRef = TxSPG_PropulsionCAN_PNC30_8c6bccaf
        ComIPduGroupRef = TxSPG_PropulsionCAN_PNC33_15629d15
        ComIPduGroupRef = TxSPG_PropulsionCAN_PNC39_f5b7740b
        ComIPduSignalGroupRef = igWhlMotSysSpdActSafe_58c9c55b_Tx
        ComPduIdRef = IemPropSignalIPdu12_a116f78b_Tx
        ComTxIPdu: ComTxIPduUnusedAreasDefault=0, ComMinimumDelayTime=0, ComTxIPduClearUpdateBit=Transmit
          ComTxModeTrue
            ComTxMode: ComTxModeMode=PERIODIC, ComTxModeTimeOffset=0, ComTxModeTimePeriod=0.04
          ComTxModeFalse
            ComTxMode: ComTxModeMode=NONE
      TxSPG_PropulsionCAN_PNC33_15629d15 (ComIPduGroup): ComIPduGroupHandleId=19, ComIPduGroupGroupRef=TxMPG_PropulsionCAN_3709a166
      TxSPG_PropulsionCAN_PNC26_7c1358db (ComIPduGroup): ComIPduGroupHandleId=15, ComIPduGroupGroupRef=TxMPG_PropulsionCAN_3709a166
      isBkpOfDstTrvld_1c9ea633_Rx (ComSignal):
        ComBitPosition = 20
        ComBitSize = 21
        ComSignalEndianness = BIG_ENDIAN
        ComSignalInitValue = 0
        ComSignalType = UINT32
        ComUpdateBitPosition = 21
        ComSignalAccess = ACCESS_NEEDED_BY_SWC_OR_COM
        ComHandleId = 69
        ComSystemTemplateSystemSignalRef = isBkpOfDstTrvld_mrx
      TxMPG_PropulsionCAN_3709a166 (ComIPduGroup): ComIPduGroupHandleId=10
      isHvBattUDynMinLim_28139c0a_Rx (ComSignal):
        ComBitPosition = 26
        ComBitSize = 11
        ComSignalEndianness = BIG_ENDIAN
        ComSignalInitValue = 0
        ComSignalType = UINT16
        ComUpdateBitPosition = 27
        ComSignalAccess = ACCESS_NEEDED_BY_SWC_OR_COM
        ComHandleId = 79
        ComSystemTemplateSystemSignalRef = isHvBattUDynMinLim_mrx
      igEngSt1WdSts_adcf75d2_Rx (ComSignalGroup): ComUpdateBitPosition=31, ComSignalGroupAccess=ACCESS_NEEDED_BY_SWC_OR_COM, ComHandleId=1, ComSystemTemplateSignalGroupRef=igEngSt1WdSts_mrx
        3 x ComGroupSignal, all with ComSignalEndianness=BIG_ENDIAN, ComSignalInitValue=0, ComSignalType=UINT8, ComSignalAccess=ACCESS_NEEDED_BY_SWC_OR_COM:
          isEngSt1WdStsChks_75cf5b53_Rx: ComBitPosition=39, ComBitSize=8, ComHandleId=4, ComSystemTemplateSystemSignalRef=isEngSt1WdStsChks_mrx
          isEngSt1WdStsCntr_cb1f19e9_Rx: ComBitPosition=47, ComBitSize=4, ComHandleId=5, ComSystemTemplateSystemSignalRef=isEngSt1WdStsCntr_mrx
          isEngSt1WdStsEngSt1WdSts_21868fa0_Rx: ComBitPosition=43, ComBitSize=4, ComHandleId=6, ComSystemTemplateSystemSignalRef=isEngSt1WdStsEngSt1WdSts_mrx
      igEscVariantToDmc_3c205019_Rx (ComSignalGroup): ComUpdateBitPosition=4, ComSignalGroupAccess=ACCESS_NEEDED_BY_SWC_OR_COM, ComHandleId=2, ComSystemTemplateSignalGroupRef=igEscVariantToDmc_mrx
        3 x ComGroupSignal, all with ComSignalEndianness=BIG_ENDIAN, ComSignalInitValue=0, ComSignalType=UINT8, ComSignalAccess=ACCESS_NEEDED_BY_SWC_OR_COM:
          isEscVariantToDmcEscVariantToDmc_daa2c955_Rx: ComBitPosition=23, ComBitSize=8, ComHandleId=9, ComSystemTemplateSystemSignalRef=isEscVariantToDmcEscVariantToDmc_mrx
          isEscVariantToDmcChks_9a33bac6_Rx: ComBitPosition=15, ComBitSize=8, ComHandleId=7, ComSystemTemplateSystemSignalRef=isEscVariantToDmcChks_mrx
          isEscVariantToDmcCntr_24e3f87c_Rx: ComBitPosition=3, ComBitSize=4, ComHandleId=8, ComSystemTemplateSystemSignalRef=isEscVariantToDmcCntr_mrx
      IemPropSignalIPdu03_cf0af65c_Tx (ComIPdu):
        ComIPduDirection = SEND
        ComIPduType = NORMAL
        ComIPduHandleId = 4
        ComIPduSignalProcessing = DEFERRED
        ComIPduCancellationSupport = false
        ComIPduGroupRef = TxSPG_PropulsionCAN_PNC24_921d39f7
        ComIPduGroupRef = TxSPG_PropulsionCAN_PNC25_e51a0961
        ComIPduGroupRef = TxSPG_PropulsionCAN_PNC26_7c1358db
        ComIPduGroupRef = TxSPG_PropulsionCAN_PNC27_0b14684d
        ComIPduGroupRef = TxSPG_PropulsionCAN_PNC29_ecac454a
        ComIPduGroupRef = TxSPG_PropulsionCAN_PNC35_fc013820
        ComIPduGroupRef = TxSPG_PropulsionCAN_PNC39_f5b7740b
        ComIPduSignalRef = isWhlMotClrRdyReq_189c9369_Tx
        ComIPduSignalRef = isWhlMotSysCoolgReq_32e8ee03_Tx
        ComIPduSignalRef = isWhlMotSysErrIndcnReq_d5e6edc2_Tx
        ComIPduSignalRef = isWhlMotSysInvrT_11341a35_Tx
        ComIPduSignalRef = isWhlMotSysMotT_54e003b6_Tx
        ComPduIdRef = IemPropSignalIPdu03_cf0af65c_Tx
        ComTxIPdu: ComTxIPduUnusedAreasDefault=0, ComMinimumDelayTime=0, ComTxIPduClearUpdateBit=Transmit
          ComTxModeTrue
            ComTxMode: ComTxModeMode=PERIODIC, ComTxModeTimeOffset=0, ComTxModeTimePeriod=0.6
          ComTxModeFalse
            ComTxMode: ComTxModeMode=NONE
      TxSPG_PropulsionCAN_PNC35_fc013820 (ComIPduGroup): ComIPduGroupHandleId=20, ComIPduGroupGroupRef=TxMPG_PropulsionCAN_3709a166
      TxSPG_PropulsionCAN_PNC30_8c6bccaf (ComIPduGroup): ComIPduGroupHandleId=18, ComIPduGroupGroupRef=TxMPG_PropulsionCAN_3709a166
      4 x ComSignal, all with ComSignalEndianness=BIG_ENDIAN, ComSignalAccess=ACCESS_NEEDED_BY_SWC_OR_COM:
        isWhlMotSysTqReq_f0fdb022_Rx: ComBitPosition=11, ComBitSize=12, ComSignalInitValue=2047, ComSignalType=UINT16, ComUpdateBitPosition=12, ComHandleId=90, ComSystemTemplateSystemSignalRef=isWhlMotSysTqReq_mrx
        isCooltFlowForDtElec_89c7c93c_Rx: ComBitPosition=41, ComBitSize=9, ComSignalInitValue=0, ComSignalType=UINT16, ComUpdateBitPosition=6, ComHandleId=71, ComSystemTemplateSystemSignalRef=isCooltFlowForDtElec_mrx
        isWhlMotSysInvrT_11341a35_Tx: ComBitPosition=7, ComBitSize=8, ComSignalInitValue=50, ComSignalType=UINT8, ComTransferProperty=PENDING, ComUpdateBitPosition=15, ComHandleId=77, ComSystemTemplateSystemSignalRef=isWhlMotSysInvrT_mtx
          ComFilter: ComFilterAlgorithm=ALWAYS
        isWhlMotSysCoolgReq_32e8ee03_Tx: ComBitPosition=14, ComBitSize=3, ComSignalInitValue=0, ComSignalType=UINT8, ComTransferProperty=PENDING, ComUpdateBitPosition=11, ComHandleId=70, ComSystemTemplateSystemSignalRef=isWhlMotSysCoolgReq_mtx
      TxSPG_PropulsionCAN_PNC16_573e0b18 (ComIPduGroup): ComIPduGroupHandleId=12, ComIPduGroupGroupRef=TxMPG_PropulsionCAN_3709a166
      BecmPropSignalIpdu02_e391682d_Rx (ComIPdu):
        ComIPduDirection = RECEIVE
        ComIPduType = NORMAL
        ComIPduHandleId = 1
        ComIPduSignalProcessing = DEFERRED
        ComIPduCancellationSupport = false
        ComIPduGroupRef = RxSPG_PropulsionCAN_PNC24_f9c65551
        ComIPduGroupRef = RxSPG_PropulsionCAN_PNC25_8ec165c7
        ComIPduGroupRef = RxSPG_PropulsionCAN_PNC26_17c8347d
        ComIPduGroupRef = RxSPG_PropulsionCAN_PNC29_877729ec
        ComIPduGroupRef = RxSPG_PropulsionCAN_PNC30_e7b0a009
        ComIPduGroupRef = RxSPG_PropulsionCAN_PNC35_97da5486
        ComIPduGroupRef = RxSPG_PropulsionCAN_PNC39_9e6c18ad
        ComIPduSignalRef = isHvBattUDynMinLim_28139c0a_Rx
        ComPduIdRef = BecmPropSignalIpdu02_e391682d_Rx
      CddObcPropSignalIPdu01_003f0830_Rx (ComIPdu):
        ComIPduDirection = RECEIVE
        ComIPduType = NORMAL
        ComIPduHandleId = 4
        ComIPduSignalProcessing = DEFERRED
        ComIPduCancellationSupport = false
        ComIPduGroupRef = RxSPG_PropulsionCAN_PNC24_f9c65551
        ComIPduGroupRef = RxSPG_PropulsionCAN_PNC25_8ec165c7
        ComIPduGroupRef = RxSPG_PropulsionCAN_PNC26_17c8347d
        ComIPduGroupRef = RxSPG_PropulsionCAN_PNC27_60cf04eb
        ComIPduGroupRef = RxSPG_PropulsionCAN_PNC29_877729ec
        ComIPduGroupRef = RxSPG_PropulsionCAN_PNC30_e7b0a009
        ComIPduSignalRef = isOnBdChrgrHndlSts1_677311c9_Rx
        ComPduIdRef = CddObcPropSignalIPdu01_003f0830_Rx
      3 x ComSignal, all with ComSignalEndianness=BIG_ENDIAN, ComSignalAccess=ACCESS_NEEDED_BY_SWC_OR_COM:
        isRearHeatPwrAllwd_c919804a_Rx: ComBitPosition=23, ComBitSize=8, ComSignalInitValue=0, ComSignalType=UINT8, ComUpdateBitPosition=15, ComHandleId=84, ComSystemTemplateSystemSignalRef=isRearHeatPwrAllwd_mrx
        isWhlMotSysPwrLimMin_79b86f03_Rx: ComBitPosition=23, ComBitSize=10, ComSignalInitValue=1022, ComSignalType=UINT16, ComUpdateBitPosition=29, ComHandleId=89, ComSystemTemplateSystemSignalRef=isWhlMotSysPwrLimMin_mrx
        isWhlMotSysIdc_56101b54_Tx: ComBitPosition=5, ComBitSize=14, ComSignalInitValue=8188, ComSignalType=UINT16, ComTransferProperty=PENDING, ComUpdateBitPosition=6, ComHandleId=76, ComSystemTemplateSystemSignalRef=isWhlMotSysIdc_mtx
          ComFilter: ComFilterAlgorithm=ALWAYS
      EcmPropSignalIPDU11_4ed5e30d_Rx (ComIPdu):
        ComIPduDirection = RECEIVE
        ComIPduType = NORMAL
        ComIPduHandleId = 10
        ComIPduSignalProcessing = DEFERRED
        ComIPduCancellationSupport = false
        ComIPduGroupRef = RxSPG_PropulsionCAN_PNC26_17c8347d
        ComIPduGroupRef = RxSPG_PropulsionCAN_PNC29_877729ec
        ComIPduGroupRef = RxSPG_PropulsionCAN_PNC35_97da5486
        ComIPduGroupRef = RxSPG_PropulsionCAN_PNC39_9e6c18ad
        ComIPduSignalRef = isCooltFlowForDtElec_89c7c93c_Rx
        ComIPduSignalRef = isCooltTSigForDtElec_f43a3873_Rx
        ComPduIdRef = EcmPropSignalIPDU11_4ed5e30d_Rx
      IemPropSignalIPdu06_bf6002d3_Tx (ComIPdu):
        ComIPduDirection = SEND
        ComIPduType = NORMAL
        ComIPduHandleId = 6
        ComIPduSignalProcessing = DEFERRED
        ComIPduCancellationSupport = false
        ComIPduGroupRef = TxSPG_PropulsionCAN_PNC24_921d39f7
        ComIPduGroupRef = TxSPG_PropulsionCAN_PNC25_e51a0961
        ComIPduGroupRef = TxSPG_PropulsionCAN_PNC26_7c1358db
        ComIPduGroupRef = TxSPG_PropulsionCAN_PNC27_0b14684d
        ComIPduGroupRef = TxSPG_PropulsionCAN_PNC29_ecac454a
        ComIPduSignalGroupRef = igIemGeneric_ab95030b_Tx
        ComPduIdRef = IemPropSignalIPdu06_bf6002d3_Tx
        ComTxIPdu: ComTxIPduUnusedAreasDefault=0, ComMinimumDelayTime=0
          ComTxModeTrue
            ComTxMode: ComTxModeMode=PERIODIC, ComTxModeTimeOffset=0, ComTxModeTimePeriod=0.1
          ComTxModeFalse
            ComTxMode: ComTxModeMode=NONE
      TxSPG_PropulsionCAN_PNC27_0b14684d (ComIPduGroup): ComIPduGroupHandleId=16, ComIPduGroupGroupRef=TxMPG_PropulsionCAN_3709a166
      isRearHeatModEnad_a110df41_Rx (ComSignal):
        ComBitPosition = 11
        ComBitSize = 2
        ComSignalEndianness = BIG_ENDIAN
        ComSignalInitValue = 2
        ComSignalType = UINT8
        ComUpdateBitPosition = 14
        ComSignalAccess = ACCESS_NEEDED_BY_SWC_OR_COM
        ComHandleId = 83
        ComSystemTemplateSystemSignalRef = isRearHeatModEnad_mrx
      PropulsionCAN_EiraSignal_Tx (ComSignal):
        ComBitPosition = 0
        ComSignalEndianness = opaque
        ComSignalInitValue = 0 0 0 0 0 0
        ComSignalType = UINT8_N
        ComSignalAccess = ACCESS_UNCLEAR
        ComSignalLength = 6
        ComHandleId = 0
        ComTransferProperty = PENDING
      PropulsionCAN_EiraIpdu_Tx (ComIPdu):
        ComIPduDirection = SEND
        ComIPduHandleId = 13
        ComIPduSignalProcessing = DEFERRED
        ComIPduType = NORMAL
        ComIPduCancellationSupport = false
        ComPduIdRef = PropulsionCAN_EiraUserData_Tx
        ComIPduSignalRef = PropulsionCAN_EiraSignal_Tx
        ComTxIPdu: ComMinimumDelayTime=0, ComTxIPduUnusedAreasDefault=0
          ComTxModeFalse
            ComTxMode: ComTxModeMode=NONE
          ComTxModeTrue
            ComTxMode: ComTxModeMode=NONE
    ComGeneral:
      ComConfigurationUseDet = true
      ComEnableSignalGroupArrayApi = false
      ComRetryFailedTransmitRequests = false
      ComSupportedIPduGroups = 22
      ComVersionInfoApi = false
      ComAdvancedIPduCallouts = true
      ComOptimizedIPduGroupHandling = false
      ComMetaDataSupport = false
      ComReceiveSignalMacroAPI = false
      ComDeferredEventCacheSupport = false
      ComMainfunctionTimingDomainSupport = false
      ComDescriptionRoutingCodeGeneration = false
      ComSafeBswChecks = false
      ComUserCbkHeaderFile = Appl_Cbk.h
      ComDescriptionGateway = false
      ComSignalGateway = false

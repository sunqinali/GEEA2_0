AUTOSAR XML (schema 4-2-2)
package /ActiveEcuC
  module config EcuC: implementation-config-variant=VARIANT-PRE-COMPILE, module-description=EcuC_Impl
    EcucPduCollection: PduIdTypeEnum=UINT8, PduLengthTypeEnum=UINT16
      115 x Pdu, all with J1939Requestable=false:
        VDDMPropSignalIPDU11_f7bbf892_Rx: PduLength=8
        BecmPropSignalIpdu02_e391682d_Rx: PduLength=8
        EcmPropSignalIPdu25_89df781c_Rx: PduLength=8, SysTPduToFrameMappingRef=EcmPropSignalIPdu25_map
        IemToEtcUudtDcmIpdu3_8a88a4e0_Tx: PduLength=8
        VgmToAllFuncDiagDcmIpdu_030e2fcd_Rx: PduLength=6
        VDDMPropSignalIPDU08_146446f0_Rx: PduLength=8, SysTPduToFrameMappingRef=VDDMPropSignalIPDU08_map
        EtcToAllJ1979OBDDiagDcmIpdu11_b7ab7660_Rx: PduLength=6
        IemPropSignalIPdu03_cf0af65c_Tx: PduLength=8
        IemPropSignalIPdu01_21049770_Tx: PduLength=8
        VddmBcmPropdTCSignalIPDU01_886bd56f_Rx: PduLength=8
        VDDMPropSignalIPDU05_e9cd0dca_Rx: PduLength=8
        IemPropSignalIPdu16_a67b3392_Tx: PduLength=8
        VDDMPropSignalIPDU16_69df6d31_Rx: PduLength=8
        EcmPropSignalIPdu24_045785fe_Rx: PduLength=8, SysTPduToFrameMappingRef=EcmPropSignalIPdu24_map
        CddObcPropSignalIPdu01_003f0830_Rx: PduLength=8
        BecmPropSignalIpdu01_7a983997_Rx: PduLength=8
        EcmPropSignalIPDU28_6fdbf3ae_Rx: PduLength=8, SysTPduToFrameMappingRef=EcmPropSignalIPDU28_map
        IemToEtcUudtDcmIpdu3_4ed50c54_Tx: PduLength=8
        BecmPropSignalIpdu01_e4f1b6c7_Rx: PduLength=8, SysTPduToFrameMappingRef=BecmPropSignalIpdu01_map
        IemEduPropSignalIPdu01_3346005e_Tx: PduLength=8
        IemToVgmJ1979OBDPropCanResNpdu11_72c85f7f_Tx: PduLength=8, SysTPduToFrameMappingRef=IemToVgmJ1979OBDPropCanResNpdu11_map
        VddmToIemPropDiagReqNpdu_b1f6d800_Rx: PduLength=8, SysTPduToFrameMappingRef=VddmToIemPropDiagReqNpdu_map
        IemPropSignalIPdu09_aee91317_Tx: PduLength=8, SysTPduToFrameMappingRef=IemPropSignalIPdu09_map
        IemPropSignalIPdu01_1988e981_Tx: PduLength=8, SysTPduToFrameMappingRef=IemPropSignalIPdu01_map
        ECMPropSignalIPDU04_b1fda267_Rx: PduLength=8, SysTPduToFrameMappingRef=ECMPropSignalIPDU04_map
        IemPropSignalIPdu02_5460e9e6_Tx: PduLength=8, SysTPduToFrameMappingRef=IemPropSignalIPdu02_map
        EcmPropSignalIPDU08_f2c9e4fc_Rx: PduLength=8, SysTPduToFrameMappingRef=EcmPropSignalIPDU08_map
        IemPropSignalIPdu07_c8673245_Tx: PduLength=8
        BecmPropSignalIpdu03_24914b42_Rx: PduLength=8, SysTPduToFrameMappingRef=BecmPropSignalIpdu03_map
        EcmPropSignalIPdu25_faea9d09_Rx: PduLength=8
        IemPropSignalIPdu06_0fd014ad_Tx: PduLength=8, SysTPduToFrameMappingRef=IemPropSignalIPdu06_map
        IemToEtcJ1979OBDDiagDcmIpdu11_525ada58_Tx: PduLength=4000
        IemToVddmPropDiagResNpdu_cef1039b_Tx: PduLength=8, SysTPduToFrameMappingRef=IemToVddmPropDiagResNpdu_map
        EtcToAllJ1979OBDDiagDcmIpdu11_f3f7d8ab_Rx: PduLength=6
        EcmPropSignalIPDU28_1c24086a_Rx: PduLength=8
        VgmToIemDiagDcmIpdu_81f41e2d_Rx: PduLength=4000
        ECMPropSignalIPDU06_ba4fcd25_Rx: PduLength=8
        SrsPropSignalIPdu02_4fa2d123_Rx: PduLength=8
        IemEduPropSignalIPdu01_a3cd4ce7_Tx: PduLength=8, SysTPduToFrameMappingRef=IemEduPropSignalIPdu01_map
        VDDMPropSignalIPDU16_765cb701_Rx: PduLength=8, SysTPduToFrameMappingRef=VDDMPropSignalIPDU16_map
        IemPropSignalIPdu12_a116f78b_Tx: PduLength=8
        IemPropSignalIPdu04_516e63ff_Tx: PduLength=8
        IemPropSignalIPdu14_8139e281_Tx: PduLength=8, SysTPduToFrameMappingRef=IemPropSignalIPdu14_map
        VDDMPropSignalIPDU19_f96070a0_Rx: PduLength=8
        VDDMPropSignalIPDU17_fbd44ae3_Rx: PduLength=8, SysTPduToFrameMappingRef=VDDMPropSignalIPDU17_map
        VddmBcmPropdTCSignalIPDU01_857b2e99_Rx: PduLength=8, SysTPduToFrameMappingRef=VddmBcmPropdTCSignalIPDU01_map
        IemPropSignalIPdu14_487552be_Tx: PduLength=8
        IemPropSignalIPdu08_58d82fd4_Tx: PduLength=8
        IemToEtcUudtDcmIpdu2_07005902_Tx: PduLength=8
        EcmPropSignalIPDU11_86a9e821_Rx: PduLength=8, SysTPduToFrameMappingRef=EcmPropSignalIPDU11_map
        VgmToIemJ1979OBDPropCanReqNpdu11_0f26f145_Rx: PduLength=8, SysTPduToFrameMappingRef=VgmToIemJ1979OBDPropCanReqNpdu11_map
        VgmToAllFuncJ1979OBDPropCanReqNpdu11_a7af92b3_Rx: PduLength=8, SysTPduToFrameMappingRef=VgmToAllFuncJ1979OBDPropCanReqNpdu11_map
        IemEduPropSignalIPdu02_aa4f51e4_Tx: PduLength=8
        EcmPropSignalIPDU08_2e126ae8_Rx: PduLength=8
        IemPropSignalIPdu02_b80dc6ca_Tx: PduLength=8
        VDDMPropdTCSignalIPdu38_4bda4dd7_Rx: PduLength=8, SysTPduToFrameMappingRef=VDDMPropdTCSignalIPdu38_map
        IemPropSignalIPdu06_bf6002d3_Tx: PduLength=8
        PropulsionCAN_c71a5358_Rx: PduLength=6
        EcmPropSignalIPdu24_8dedad9f_Rx: PduLength=8
        IemPropSignalIPdu12_1ae9e24f_Tx: PduLength=8, SysTPduToFrameMappingRef=IemPropSignalIPdu12_map
        VDDMPropSignalIPDU11_60044a2d_Rx: PduLength=8, SysTPduToFrameMappingRef=VDDMPropSignalIPDU11_map
        VgmToIemDiagDcmIpdu_cbf08236_Rx: PduLength=4000
        IemToVgmDiagDcmIpdu_411ec11e_Tx: PduLength=4000
        VddmPropSignalIPdu26_893fed53_Rx: PduLength=8, SysTPduToFrameMappingRef=VddmPropSignalIPdu26_map
        IemToEtcUudtDcmIpdu1_a0db6d78_Tx: PduLength=8
        ECMPropSignalIPDU02_2a2da2a9_Rx: PduLength=8, SysTPduToFrameMappingRef=ECMPropSignalIPDU02_map
        VddmPropSignalIPdu26_8fec2bf2_Rx: PduLength=8
        VDDMPropSignalIPDU05_753dbccf_Rx: PduLength=8, SysTPduToFrameMappingRef=VDDMPropSignalIPDU05_map
        IemPropSignalIPdu07_8258e94f_Tx: PduLength=8, SysTPduToFrameMappingRef=IemPropSignalIPdu07_map
        VDDMPropSignalIPDU18_5aed4d59_Rx: PduLength=8, SysTPduToFrameMappingRef=VDDMPropSignalIPDU18_map
        IemToEtcJ1979OBDDiagDcmIpdu11_da239b2d_Tx: PduLength=4000
        IemPropSignalIPdu08_2361eef5_Tx: PduLength=8, SysTPduToFrameMappingRef=IemPropSignalIPdu08_map
        IemPropSignalIPdu09_2fdf1f42_Tx: PduLength=8
        IemToEtcUudtDcmIpdu2_39d23cc2_Tx: PduLength=8
        IemPropSignalIPdu16_41591f04_Tx: PduLength=8, SysTPduToFrameMappingRef=IemPropSignalIPdu16_map
        SrsPropSignalIPdu02_30ca6a16_Rx: PduLength=8, SysTPduToFrameMappingRef=SrsPropSignalIPdu02_map
        IemPropNmPdu1_277f9a9b_Tx: PduLength=8, SysTPduToFrameMappingRef=IemPropNmPdu1_map
        VDDMPropSignalIPDU17_1ed85da7_Rx: PduLength=8
        VgmToAllFuncDiagDcmIpdu_89c72e24_Rx: PduLength=6
        ECMPropSignalIPDU02_bd22093c_Rx: PduLength=8
        BecmPropSignalIpdu02_a919b6a0_Rx: PduLength=8, SysTPduToFrameMappingRef=BecmPropSignalIpdu02_map
        EcmPropSignalIPDU11_4ed5e30d_Rx: PduLength=8
        UudtIemNPdu1_4b1dfe9b_Tx: PduLength=8, SysTPduToFrameMappingRef=UudtIemNPdu1_map
        ECMPropSignalIPDU05_3c755f85_Rx: PduLength=8, SysTPduToFrameMappingRef=ECMPropSignalIPDU05_map
        UudtIemNPdu3_8b7d031e_Tx: PduLength=8, SysTPduToFrameMappingRef=UudtIemNPdu3_map
        VddmToAllFuncPropDiagReqNpdu_86e6f41a_Rx: PduLength=8, SysTPduToFrameMappingRef=VddmToAllFuncPropDiagReqNpdu_map
        IemPropCanNmNode_6342b4e7_Rx: PduLength=8, SysTPduToFrameMappingRef=IgmPropNmPdu1_map
        CddObcPropSignalIPdu01_1ee0577a_Rx: PduLength=8, SysTPduToFrameMappingRef=CddObcPropSignalIPdu01_map
        ECMPropSignalIPDU04_5441ac09_Rx: PduLength=8
        ECMPropSignalIPDU06_719d5fe2_Rx: PduLength=8, SysTPduToFrameMappingRef=ECMPropSignalIPDU06_map
        BecmPropSignalIpdu03_949658bb_Rx: PduLength=8
        BecmPropSignalIpdu15_64eecccf_Rx: PduLength=8
        ECMPropSignalIPDU05_23469c9f_Rx: PduLength=8
        VDDMPropSignalIPDU06_38d5bca8_Rx: PduLength=8, SysTPduToFrameMappingRef=VDDMPropSignalIPDU06_map
        IemPropSignalIPdu04_cfb0e928_Tx: PduLength=8, SysTPduToFrameMappingRef=IemPropSignalIPdu04_map
        VDDMPropSignalIPDU06_70c45c70_Rx: PduLength=8
        VDDMPropSignalIPDU19_d765b0bb_Rx: PduLength=8, SysTPduToFrameMappingRef=VDDMPropSignalIPDU19_map
        VDDMPropdTCSignalIPdu38_808bfd3f_Rx: PduLength=8
        EtcToIemJ1979OBDDiagDcmIpdu11_ad182927_Rx: PduLength=4000
        IemPropSignalIPdu03_d9e81404_Tx: PduLength=8, SysTPduToFrameMappingRef=IemPropSignalIPdu03_map
        IemToEtcUudtDcmIpdu1_4ae85965_Tx: PduLength=8
        VDDMPropSignalIPDU08_977c7177_Rx: PduLength=8
        VDDMPropSignalIPDU18_8e674036_Rx: PduLength=8
        IemToVgmDiagDcmIpdu_ce8379a0_Tx: PduLength=4000
        UudtIemNPdu2_06f5fefc_Tx: PduLength=8, SysTPduToFrameMappingRef=UudtIemNPdu2_map
        BecmPropSignalIpdu15_f1c84025_Rx: PduLength=8, SysTPduToFrameMappingRef=BecmPropSignalIpdu15_map
        IemEduPropSignalIPdu02_ee254c80_Tx: PduLength=8, SysTPduToFrameMappingRef=IemEduPropSignalIPdu02_map
        EtcToIemJ1979OBDDiagDcmIpdu11_ac95f359_Rx: PduLength=4000
        PropulsionCAN_EiraUserData_Tx: PduLength=6
        UudtFcNPdu{1..3}: PduLength=8
        UudtDcmRx{1..3}: PduLength=8
    EcucGeneral:
      CPUType = CPU32Bit
      SizeOfInt = Size32Bit
      ByteOrder = LITTLE_ENDIAN
      BitOrder = LSB_to_MSB
      AtomicBitAccessInBitfield = false
      AtomicVariableAccess = Atomic32BitAccess
      SizeOfEnum = Size32Bit
      SizeOfROMPointer = Size32Bit
      SizeOfRAMPointer = Size32Bit
      BitFieldDataType = INT
      StructAlignment = Auto
      ArrayAlignment = Align8Bit
      StructInArrayAlignment = Auto
      DummyFunction = false
      EcuCSafeBswChecks = false
      DummyStatement = true
      DummyStatementKind = None
      ConditionalGenerating = true
      EcucBswImplementationCodeType = EcuCSourceCode
      EcuCUseStdReturnTypeForRte = false
      PostbuildLoadable: AlignmentFillPattern=255, PBROMStartAddress=0, PBRAMStartAddress=0, PBROMEndAddress=0, PBRAMEndAddress=0
      BswInitialization
        47 x InitFunction:
          BswM_Init: Header=BswM.h, InitPhase=NO_INIT, ConfigType=BswM_ConfigType, ConfigPtrName=BswM_Config_Ptr, ConfigPtrClass=BSWM_INIT_DATA, ModuleRef=BswM
          BswM_InitMemory: Header=BswM.h, InitPhase=INIT_MEMORY, ModuleRef=BswM
          CanIf_Init: Header=CanIf.h, InitPhase=INIT_TWO_IF, ConfigType=CanIf_ConfigType, ConfigPtrName=CanIf_Config_Ptr, ConfigPtrClass=CANIF_INIT_DATA, ModuleRef=CanIf
          CanIf_InitMemory: Header=CanIf.h, InitPhase=INIT_MEMORY, ModuleRef=CanIf
          CanNm_Init: Header=CanNm.h, InitPhase=INIT_TWO_NM, ConfigType=CanNm_ConfigType, ConfigPtrName=CanNm_Config_Ptr, ConfigPtrClass=CANNM_INIT_DATA, ModuleRef=CanNm
          CanNm_InitMemory: Header=CanNm.h, InitPhase=INIT_MEMORY, ModuleRef=CanNm
          CanSM_InitMemory: Header=CanSM_EcuM.h, InitPhase=INIT_MEMORY, ModuleRef=CanSM
          CanSM_Init: Header=CanSM_EcuM.h, InitPhase=INIT_TWO_SM, ConfigType=CanSM_ConfigType, ConfigPtrName=CanSM_Config_Ptr, ConfigPtrClass=CANSM_INIT_DATA, ModuleRef=CanSM
          CanTp_Init: Header=CanTp.h, InitPhase=INIT_TWO_TP, ConfigType=CanTp_ConfigType, ConfigPtrName=CanTp_Config_Ptr, ConfigPtrClass=CANTP_INIT_DATA, ModuleRef=CanTp
          CanTp_InitMemory: Header=CanTp.h, InitPhase=INIT_MEMORY, ModuleRef=CanTp
          Can_InitMemory: Header=Can.h, InitPhase=INIT_MEMORY, ModuleRef=Can
          Can_Init: Header=Can.h, InitPhase=INIT_TWO_DRV, ConfigType=Can_ConfigType, ConfigPtrName=Can_Config_Ptr, ConfigPtrClass=CAN_INIT_DATA, ModuleRef=Can
          ComM_InitMemory: Header=ComM.h, InitPhase=INIT_MEMORY, ModuleRef=ComM
          ComM_Init: Header=ComM.h, InitPhase=INIT_TWO_POST_NVMREADALL, ModuleRef=ComM
          Com_InitMemory: Header=Com.h, InitPhase=INIT_MEMORY, ModuleRef=Com
          Com_Init: Header=Com.h, InitPhase=INIT_TWO_COM, ConfigType=Com_ConfigType, ConfigPtrName=Com_Config_Ptr, ConfigPtrClass=COM_INIT_DATA, ModuleRef=Com
          Dcm_Init: Header=Dcm.h, InitPhase=INIT_TWO_POST_NVMREADALL, ConfigType=Dcm_ConfigType, ConfigPtrName=NULL_PTR, ConfigPtrClass=DCM_CONST, ModuleRef=Dcm
          Dcm_InitMemory: Header=Dcm.h, InitPhase=INIT_MEMORY, ModuleRef=Dcm
          Dem_Init: Header=Dem.h, InitPhase=INIT_TWO_POST_NVMREADALL, ConfigType=Dem_ConfigType, ConfigPtrName=Dem_Config_Ptr, ConfigPtrClass=DEM_INIT_DATA, ModuleRef=Dem
          Dem_InitMemory: Header=Dem.h, InitPhase=INIT_MEMORY, ModuleRef=Dem
          Dem_PreInit: Header=Dem.h, InitPhase=INIT_ZERO, ConfigType=Dem_ConfigType, ConfigPtrName=Dem_Config_Ptr, ConfigPtrClass=DEM_INIT_DATA, ModuleRef=Dem
          Det_Init: Header=Det.h, InitPhase=INIT_ZERO, ConfigType=Det_ConfigType, ConfigPtrName=Det_Config_Ptr, ConfigPtrClass=DET_INIT_DATA, ModuleRef=Det
          Det_InitMemory: Header=Det.h, InitPhase=INIT_MEMORY, ModuleRef=Det
          EcuM_Init: Header=EcuM.h, InitPhase=NO_INIT, ConfigType=EcuM_PbConfigType, ConfigPtrName=EcuM_Config_Ptr, ConfigPtrClass=ECUM_INIT_DATA, ModuleRef=EcuM
          Mcu_Init: Header=Mcu.h, InitPhase=INIT_ONE_EARLY, ConfigType=Mcu_ConfigType, ConfigPtrName=&Mcu_Config, ConfigPtrClass=AUTOMATIC, AdditionalInitCode=Mcu_InitClock(0);while (MCU_PLL_LOCKED != Mcu_GetPllStatus());Mcu_DistributePllClock();, ModuleRef=Mcu  # /ActiveEcuC/Mcu PLAIN_TEXT Created Mcu_Init by Extended Init XML Service
          Nm_InitMemory: Header=Nm.h, InitPhase=INIT_MEMORY, ModuleRef=Nm
          Nm_Init: Header=Nm.h, InitPhase=INIT_TWO_NM, ModuleRef=Nm
          PduR_InitMemory: Header=PduR.h, InitPhase=INIT_MEMORY, ModuleRef=PduR
          PduR_Init: Header=PduR.h, InitPhase=INIT_TWO_COM, ConfigType=PduR_PBConfigType, ConfigPtrName=PduR_Config_Ptr, ConfigPtrClass=PDUR_INIT_DATA, ModuleRef=PduR
          Rte_InitMemory: Header=Rte_Main.h, InitPhase=INIT_MEMORY, ModuleRef=Rte
          SchM_Init: Header=Rte_Main.h, InitPhase=NO_INIT, ModuleRef=Rte
          Port_Init: Header=Port.h, InitPhase=INIT_ONE_EARLY, ConfigType=Port_ConfigType, ConfigPtrName=&Port_Config, ConfigPtrClass=AUTOMATIC, ModuleRef=Port  # /ActiveEcuC/Port PLAIN_TEXT Created Port_Init by Extended Init XML Service
          Spi_Init: Header=Spi.h, InitPhase=INIT_ONE, ConfigType=Spi_ConfigType, ConfigPtrName=&Spi_Config, ConfigPtrClass=AUTOMATIC, ModuleRef=Spi  # /ActiveEcuC/Spi PLAIN_TEXT Created Spi_Init by Extended Init XML Service
          BswM_PreInit: Header=BswM.h, InitPhase=INIT_ONE, ConfigType=BswM_ConfigType, ConfigPtrName=BswM_Config_Ptr, ConfigPtrClass=BSWM_INIT_DATA, ModuleRef=BswM  # /ActiveEcuC/BswM PLAIN_TEXT PreInit function description of BswM in UnfilteredViewInInvariantProject (UnfilteredInvariantProjectModelView) .
          McalLib_Init: Header=McalLib.h, InitPhase=NO_INIT, ModuleRef=McalLib  # /ActiveEcuC/McalLib PLAIN_TEXT Created McalLib_Init by Extended Init XML Service
          PduR_PreInit: Header=PduR.h, InitPhase=INIT_ONE, ConfigType=PduR_PBConfigType, ConfigPtrName=PduR_Config_Ptr, ConfigPtrClass=PDUR_INIT_DATA, ModuleRef=PduR  # /ActiveEcuC/PduR PLAIN_TEXT PreInit function description of PduR in UnfilteredViewInInvariantProject (UnfilteredInvariantProjectModelView) .
          Rte_Start: Header=Rte_Main.h, InitPhase=INIT_THREE, ModuleRef=Rte  # /ActiveEcuC/Rte PLAIN_TEXT Automatically generated by EcuCBswInitFctConfigurationService.
          Rte_StartTiming: Header=Rte_Main.h, InitPhase=NO_INIT, ModuleRef=Rte  # /ActiveEcuC/Rte PLAIN_TEXT Automatically generated by EcuCBswInitFctConfigurationService.
          Brs_Init: Header=, InitPhase=NO_INIT, ModuleRef=vBRS  # /ActiveEcuC/vBRS PLAIN_TEXT Automatically generated by EcuCBswInitFctConfigurationService.
          vBaseEnv_Init: Header=, InitPhase=NO_INIT, ModuleRef=vBaseEnv  # /ActiveEcuC/vBaseEnv PLAIN_TEXT Created vBaseEnv_Init by Extended Init XML Service
          vLinkGen_Init: Header=vLinkGen_Lcfg.h, InitPhase=NO_INIT, ModuleRef=vLinkGen  # /ActiveEcuC/vLinkGen PLAIN_TEXT Dummy initialization of the vLinkGen
          BrsHw_EnableHwAccess: Header=BrsHw.h, InitPhase=INIT_ONE_LATE, ModuleRef=vBRS  # /ActiveEcuC/vBRS PLAIN_TEXT Automatically generated by EcuCBswInitFctConfigurationService.
          CanTrcv_30_Tja1145_InitMemory: Header=CanTrcv_30_Tja1145.h, InitPhase=INIT_MEMORY, ModuleRef=CanTrcv  # /ActiveEcuC/CanTrcv PLAIN_TEXT InitMemory function description of CanTrcv_30_Tja1145 in UnfilteredViewInInvariantProject (UnfilteredInvariantProjectModelView) .
          CanTrcv_30_Tja1145_Init: Header=CanTrcv_30_Tja1145.h, InitPhase=INIT_TWO_TRCV, ConfigType=CanTrcv_30_Tja1145_ConfigType, ConfigPtrName=CanTrcv_30_Tja1145_Config_Ptr, ConfigPtrClass=CANTRCV_30_TJA1145_INIT_DATA, ModuleRef=CanTrcv  # /ActiveEcuC/CanTrcv PLAIN_TEXT Init function description of CanTrcv_30_Tja1145 in UnfilteredViewInInvariantProject (UnfilteredInvariantProjectModelView) .
          Fee_Init: Header=Fee.h, InitPhase=INIT_ONE, ConfigType=Fee_ConfigType, ConfigPtrName=&Fee_Config, ConfigPtrClass=AUTOMATIC, ModuleRef=Fee  # /ActiveEcuC/Fee PLAIN_TEXT Created Fee_Init by Extended Init XML Service
          Fls_17_Dmu_Init: Header=Fls_17_Dmu.h, InitPhase=INIT_ONE, ConfigType=Fls_17_Dmu_ConfigType, ConfigPtrName=&Fls_17_Dmu_Config, ConfigPtrClass=AUTOMATIC, ModuleRef=Fls  # /ActiveEcuC/Fls PLAIN_TEXT Created Fls_17_Dmu_Init by Extended Init XML Service
          NvM_Init: Header=NvM.h, InitPhase=INIT_TWO_SYS, ModuleRef=NvM  # /ActiveEcuC/NvM PLAIN_TEXT Initialization of the NVRAM Manager, to make it ready for NvM_ReadAll being requested
    EcucHardware
      4 x EcucCoreDefinition:
        EcucCore{0..3}: EcucCoreId={0..3}
    EcucPartitionCollection
      6 x EcucPartition, all with PartitionCanBeRestarted=false, ASIL=QM:
        EcucPartition_Core0: EcucPartitionBswModuleExecution=true, EcucPartitionSoftwareComponentInstanceRef=COMPOSITIONTYPE.Det
        EcucPartition_Core{1..3}: EcucPartitionBswModuleExecution=false
        EcucPartition_SystemCore0: EcucPartitionBswModuleExecution=false, EcucPartitionSoftwareComponentInstanceRef=COMPOSITIONTYPE.Os_OsCore0_swc
        EcucPartition_SystemCore2: EcucPartitionBswModuleExecution=false, EcucPartitionSoftwareComponentInstanceRef=COMPOSITIONTYPE.Os_OsCore2_swc

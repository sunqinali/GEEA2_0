AUTOSAR XML (schema 00048)
package /ActiveEcuC
  module config Fee: implementation-config-variant=VARIANT-POST-BUILD-LOADABLE, module-description=Fee_Impl
    FeeGeneral:
      FeeDevErrorDetect = false
      FeeSafetyEnable = false
      FeeInitCheckApi = false
      FeeMainFunctionPeriod = 0.01
      FeePollingMode = true
      FeeSetModeSupported = true
      FeeVersionInfoApi = false
      FeeVirtualPageSize = 8
      FeeBlockTypeConfigured = FEE_DOUBLE_SECTOR_DATA_ONLY
    FeePublishedInformation: FeeBlockOverhead=17, FeePageOverhead=1
    FeeIfxSpecificConfig:
      FeeThresholdValue = 200
      FeeMaxBlockCount = 24
      FeeBlocksScannedPerCycle = 0
      FeeUseEraseSuspend = false
      FeeStateVarStructure = Fee_StateVar
      FeeUnConfigBlock = FEE_UNCONFIG_BLOCK_IGNORE
      FeeUnConfigBlkOverflowHandle = FEE_CONTINUE
      FeeGcRestart = FEE_GC_RESTART_INIT
      FeeGetCycleCountApi = false
      FeeEccErrorInfoApi = false
      FeeEraseAllEnable = true
      FeeGetPrevDataApi = false
      FeeCancelAllApi = false
      FeeMaxBytesPerCycle = FEE_MAX_BYTES_512
      FeeNvmIllegalStateNotification = NULL_PTR
      FeeQsIllegalStateNotification = NULL_PTR
      FeeQsHardenErrorNotification = NULL_PTR
      FeeVirginFlashIllegalState = false
    CommonPublishedInformation:
      ArMajorVersion = 4
      ArMinorVersion = 2
      ArPatchVersion = 2
      SwMajorVersion = 20
      SwMinorVersion = 0
      SwPatchVersion = 2
      ModuleId = 21
      VendorId = 17
      Release = _TRICORE_TC377
    14 x FeeBlockConfiguration, all with FeeQsBlockInstances=0, FeeQsBlockAddress=0, FeeQuasiStaticManager=false, FeeImmediateData=false, FeeNumberOfWriteCycles=0, FeeDeviceIndex=FlsGeneral:
      FeeBlock_ProgRequest: FeeBlockNumber=4, FeeBlockSize=32
      FeeBlock_NvMConfig: FeeBlockNumber=2, FeeBlockSize=4
      FeeBlock_NvMConfig_cons0: FeeBlockNumber=3, FeeBlockSize=4
      FeeBlock_DemStatus: FeeBlockNumber=8, FeeBlockSize=422
      FeeBlock_DemAdmin: FeeBlockNumber=6, FeeBlockSize=10
      FeeBlock_DemPrimary0: FeeBlockNumber=10, FeeBlockSize=232
      FeeBlock_DemPrimary1: FeeBlockNumber=12, FeeBlockSize=232
      FeeBlock_DemPrimary2: FeeBlockNumber=14, FeeBlockSize=232
      FeeBlock_DemPrimary3: FeeBlockNumber=16, FeeBlockSize=232
      FeeBlock_DemPrimary4: FeeBlockNumber=18, FeeBlockSize=232
      FeeBlock_DemPrimary5: FeeBlockNumber=20, FeeBlockSize=232
      FeeBlock_DemPrimary6: FeeBlockNumber=22, FeeBlockSize=232
      FeeBlock_DemPrimary7: FeeBlockNumber=24, FeeBlockSize=232
      FeeBlock_CarConfig: FeeBlockNumber=26, FeeBlockSize=16
    FeeDemEventParameterRefs

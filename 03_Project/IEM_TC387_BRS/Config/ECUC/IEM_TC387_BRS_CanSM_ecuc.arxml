AUTOSAR XML (schema 4-2-2)
package /ActiveEcuC
  module config CanSM: implementation-config-variant=VARIANT-PRE-COMPILE, module-description=CanSM_Impl
    CanSMConfiguration: CanSMModeRequestRepetitionMax=10, CanSMModeRequestRepetitionTime=0.1
      PropulsionCAN_c77d42b7 (CanSMManagerNetwork):
        CanSMBorCounterL1ToL2 = 5
        CanSMBorTimeL1 = 1
        CanSMBorTimeL2 = 3
        CanSMBorTimeTxEnsured = 5
        CanSMBorTxConfirmationPolling = false
        CanSMComMNetworkHandleRef = PropulsionCAN_IEM_19020f5a
        CanSMTransceiverId = CanIfTrcvCfg_Tja1145
        CanSMDemEventParameterRefs: CANSM_E_BUS_OFF=COM_Busoff
        PropulsionCAN_2f5e3e32 (CanSMController): CanSMControllerId=PropulsionCAN_6c6185ef
    CanSMGeneral: CanSMDevErrorDetect=true, CanSMMainFunctionTimePeriod=0.01, CanSMVersionInfoApi=false, CanSMBorCheckLevel=false, CanSMSetBaudrateApi=false
      CanSMGeneration: CanSMOutOfBoundsWriteSanitizer=false, CanSMOutOfBoundsReadSanitizer=false

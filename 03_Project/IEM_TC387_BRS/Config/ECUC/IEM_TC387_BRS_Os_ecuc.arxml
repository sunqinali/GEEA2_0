AUTOSAR XML (schema 4-2-2)
package /ActiveEcuC
  module config Os: implementation-config-variant=VARIANT-PRE-COMPILE, module-description=Os_Impl
    OsPublishedInformation: OsKernelVersion=7, OsPlatformName=TriCoreAurix
      TC39x (OsDerivativeInformation):
        OsMpuAlignment = 8
        OsStackAlignment = 8
        OsExceptionVectorTableAlignment = 256
        OsInterruptVectorTableAlignment = 8192
        OsHardwareManuals = User Manual: TC3XX_ts__TargetSpec_rev1v3v0.pdf V1.3.0, 2016-02 Errata Sheet: TC39x AA_Errata_Sheet_rev1v0_2016-06-08.pdf Rel. 1.0, 2016-06-08
        OsMpuPrivilegedRegionsConfigurable = false
        OsMpuMemoryGapSize = 16
        OsMpuEndAddressAccessible = false
        3 x OsHardwareTimer, all with OsHardwareTimerSize=32, OsHardwareTimerUnit=FRT, OsHardwareTimerType=STM:
          STM0: OsHardwareTimerBaseAddress=4026535936, OsHardwareTimerId=0
            STM0_Ch0 (OsHardwareTimerChannel): OsHardwareTimerChannelIntSource=768, OsHardwareTimerChannelOffset=0, OsHardwareTimerChannelId=0
            STM0_Ch1 (OsHardwareTimerChannel): OsHardwareTimerChannelIntSource=772, OsHardwareTimerChannelOffset=1, OsHardwareTimerChannelId=1
          STM2: OsHardwareTimerBaseAddress=4026536448, OsHardwareTimerId=2
            STM2_Ch0 (OsHardwareTimerChannel): OsHardwareTimerChannelIntSource=784, OsHardwareTimerChannelOffset=0, OsHardwareTimerChannelId=0
            STM2_Ch1 (OsHardwareTimerChannel): OsHardwareTimerChannelIntSource=788, OsHardwareTimerChannelOffset=1, OsHardwareTimerChannelId=1
          STM1: OsHardwareTimerBaseAddress=4026536192, OsHardwareTimerId=1
            STM1_Ch0 (OsHardwareTimerChannel): OsHardwareTimerChannelIntSource=776, OsHardwareTimerChannelOffset=0, OsHardwareTimerChannelId=0
            STM1_Ch1 (OsHardwareTimerChannel): OsHardwareTimerChannelIntSource=780, OsHardwareTimerChannelOffset=1, OsHardwareTimerChannelId=1
        AURIXTC3XX_IR (OsSystemIntCtrl): OsSystemIntCtrlMaxPrios=255, OsSystemIntCtrlPrioOrder=ASC, OsSystemIntCtrlMaxSources=8192, OsSystemIntCtrlBaseAddress=4026757120
        DMA (OsInterruptSupportedType):
          OsInterruptSupportedTypeSeparateSources = false
          OsInterruptSupportedTypeSeparatePriority = true
          OsInterruptSupportedTypeIsMapped = false
          OsInterruptSupportedTypePostActionRequired = false
        4 x OsHardwareTimer:
          STM4: OsHardwareTimerSize=32, OsHardwareTimerUnit=FRT, OsHardwareTimerBaseAddress=4026536960, OsHardwareTimerId=4, OsHardwareTimerType=STM
            STM4_Ch0 (OsHardwareTimerChannel): OsHardwareTimerChannelIntSource=800, OsHardwareTimerChannelOffset=0, OsHardwareTimerChannelId=0
            STM4_Ch1 (OsHardwareTimerChannel): OsHardwareTimerChannelIntSource=804, OsHardwareTimerChannelOffset=1, OsHardwareTimerChannelId=1
          STM3: OsHardwareTimerSize=32, OsHardwareTimerUnit=FRT, OsHardwareTimerBaseAddress=4026536704, OsHardwareTimerId=3, OsHardwareTimerType=STM
            STM3_Ch0 (OsHardwareTimerChannel): OsHardwareTimerChannelIntSource=792, OsHardwareTimerChannelOffset=0, OsHardwareTimerChannelId=0
            STM3_Ch1 (OsHardwareTimerChannel): OsHardwareTimerChannelIntSource=796, OsHardwareTimerChannelOffset=1, OsHardwareTimerChannelId=1
          STM5: OsHardwareTimerSize=32, OsHardwareTimerUnit=FRT, OsHardwareTimerBaseAddress=4026537216, OsHardwareTimerId=5, OsHardwareTimerType=STM
            STM5_Ch0 (OsHardwareTimerChannel): OsHardwareTimerChannelIntSource=808, OsHardwareTimerChannelOffset=0, OsHardwareTimerChannelId=0
            STM5_Ch1 (OsHardwareTimerChannel): OsHardwareTimerChannelIntSource=812, OsHardwareTimerChannelOffset=1, OsHardwareTimerChannelId=1
          GPT: OsHardwareTimerSize=16, OsHardwareTimerUnit=PIT, OsHardwareTimerBaseAddress=4026537984, OsHardwareTimerId=0, OsHardwareTimerType=PIT
            GPT_Ch0 (OsHardwareTimerChannel): OsHardwareTimerChannelIntSource=744, OsHardwareTimerChannelOffset=0, OsHardwareTimerChannelId=0
            GPT_Ch1 (OsHardwareTimerChannel): OsHardwareTimerChannelIntSource=756, OsHardwareTimerChannelOffset=1, OsHardwareTimerChannelId=1
        5 x OsPhysicalCore, all with OsPhysicalCoreType=TC1.6.2P, OsPhysicalCoreExceptionSources=8, OsPhysicalCorePrivelegedHwAccess=true:
          Core0: OsPhysicalCoreId=0, OsPhysicalCoreDefaultEntrySymbol=_start_tc0, OsPhysicalCoreMasterStartAllowed=true, OsPhysicalCoreIsAutostart=true, OsPhysicalCoreStackProtectionUnit=OsPhysicalCore0DataMpu
            OsPhysicalCore0DataMpu (OsPhysicalCoreMpu): OsPhysicalCoreMpuId=0, OsPhysicalCoreMpuMaxRegions=18, OsPhysicalCoreMpuType=DATA
            OsPhysicalCore0CodeMpu (OsPhysicalCoreMpu): OsPhysicalCoreMpuId=1, OsPhysicalCoreMpuMaxRegions=10, OsPhysicalCoreMpuType=CODE
          Core1: OsPhysicalCoreId=1, OsPhysicalCoreDefaultEntrySymbol=_start_tc1, OsPhysicalCoreMasterStartAllowed=false, OsPhysicalCoreIsAutostart=false, OsPhysicalCoreStackProtectionUnit=OsPhysicalCore1DataMpu
            OsPhysicalCore1DataMpu (OsPhysicalCoreMpu): OsPhysicalCoreMpuId=0, OsPhysicalCoreMpuMaxRegions=18, OsPhysicalCoreMpuType=DATA
            OsPhysicalCore1CodeMpu (OsPhysicalCoreMpu): OsPhysicalCoreMpuId=1, OsPhysicalCoreMpuMaxRegions=10, OsPhysicalCoreMpuType=CODE
          Core2: OsPhysicalCoreId=2, OsPhysicalCoreDefaultEntrySymbol=_start_tc2, OsPhysicalCoreMasterStartAllowed=false, OsPhysicalCoreIsAutostart=false, OsPhysicalCoreStackProtectionUnit=OsPhysicalCore2DataMpu
            OsPhysicalCore2DataMpu (OsPhysicalCoreMpu): OsPhysicalCoreMpuId=0, OsPhysicalCoreMpuMaxRegions=18, OsPhysicalCoreMpuType=DATA
            OsPhysicalCore2CodeMpu (OsPhysicalCoreMpu): OsPhysicalCoreMpuId=1, OsPhysicalCoreMpuMaxRegions=10, OsPhysicalCoreMpuType=CODE
          Core3: OsPhysicalCoreId=3, OsPhysicalCoreDefaultEntrySymbol=_start_tc3, OsPhysicalCoreMasterStartAllowed=false, OsPhysicalCoreIsAutostart=false, OsPhysicalCoreStackProtectionUnit=OsPhysicalCore3DataMpu
            OsPhysicalCore3CodeMpu (OsPhysicalCoreMpu): OsPhysicalCoreMpuId=1, OsPhysicalCoreMpuMaxRegions=10, OsPhysicalCoreMpuType=CODE
            OsPhysicalCore3DataMpu (OsPhysicalCoreMpu): OsPhysicalCoreMpuId=0, OsPhysicalCoreMpuMaxRegions=18, OsPhysicalCoreMpuType=DATA
          Core4: OsPhysicalCoreId=4, OsPhysicalCoreDefaultEntrySymbol=_start_tc4, OsPhysicalCoreMasterStartAllowed=false, OsPhysicalCoreIsAutostart=false, OsPhysicalCoreStackProtectionUnit=OsPhysicalCore4DataMpu
            OsPhysicalCore4DataMpu (OsPhysicalCoreMpu): OsPhysicalCoreMpuId=0, OsPhysicalCoreMpuMaxRegions=18, OsPhysicalCoreMpuType=DATA
            OsPhysicalCore4CodeMpu (OsPhysicalCoreMpu): OsPhysicalCoreMpuId=1, OsPhysicalCoreMpuMaxRegions=10, OsPhysicalCoreMpuType=CODE
        OsMemoryRegionSpecifics
          18 x OsMemoryRegionAccess:
            PS{2..4}_R: OsMemoryRegionAccessRights=R, OsMemoryRegionAccessType=PROTECTION_SET{2..4}
            PS0_W: OsMemoryRegionAccessRights=W, OsMemoryRegionAccessType=PROTECTION_SET0
            PS5_R: OsMemoryRegionAccessRights=R, OsMemoryRegionAccessType=PROTECTION_SET5
            PS0_R: OsMemoryRegionAccessRights=R, OsMemoryRegionAccessType=PROTECTION_SET0
            PS1_R: OsMemoryRegionAccessRights=R, OsMemoryRegionAccessType=PROTECTION_SET1
            PS4_X: OsMemoryRegionAccessRights=X, OsMemoryRegionAccessType=PROTECTION_SET4
            PS5_W: OsMemoryRegionAccessRights=W, OsMemoryRegionAccessType=PROTECTION_SET5
            PS5_X: OsMemoryRegionAccessRights=X, OsMemoryRegionAccessType=PROTECTION_SET5
            PS0_X: OsMemoryRegionAccessRights=X, OsMemoryRegionAccessType=PROTECTION_SET0
            PS1_W: OsMemoryRegionAccessRights=W, OsMemoryRegionAccessType=PROTECTION_SET1
            PS1_X: OsMemoryRegionAccessRights=X, OsMemoryRegionAccessType=PROTECTION_SET1
            PS2_W: OsMemoryRegionAccessRights=W, OsMemoryRegionAccessType=PROTECTION_SET2
            PS2_X: OsMemoryRegionAccessRights=X, OsMemoryRegionAccessType=PROTECTION_SET2
            PS3_W: OsMemoryRegionAccessRights=W, OsMemoryRegionAccessType=PROTECTION_SET3
            PS3_X: OsMemoryRegionAccessRights=X, OsMemoryRegionAccessType=PROTECTION_SET3
            PS4_W: OsMemoryRegionAccessRights=W, OsMemoryRegionAccessType=PROTECTION_SET4
        Core5 (OsPhysicalCore):
          OsPhysicalCoreId = 6
          OsPhysicalCoreDefaultEntrySymbol = _start_tc5
          OsPhysicalCoreType = TC1.6.2P
          OsPhysicalCoreExceptionSources = 8
          OsPhysicalCoreMasterStartAllowed = false
          OsPhysicalCorePrivelegedHwAccess = true
          OsPhysicalCoreIsAutostart = false
          OsPhysicalCoreStackProtectionUnit = OsPhysicalCore5DataMpu
          OsPhysicalCore5DataMpu (OsPhysicalCoreMpu): OsPhysicalCoreMpuId=0, OsPhysicalCoreMpuMaxRegions=18, OsPhysicalCoreMpuType=DATA
          OsPhysicalCore5CodeMpu (OsPhysicalCoreMpu): OsPhysicalCoreMpuId=1, OsPhysicalCoreMpuMaxRegions=10, OsPhysicalCoreMpuType=CODE
    OS_APPMODE_ANY (OsAppMode)
    OSDEFAULTAPPMODE (OsAppMode)
    OsOS:
      OsStackMonitoring = true
      OsStatus = EXTENDED
      OsUseGetServiceId = false
      OsUseParameterAccess = false
      OsUseResScheduler = false
      OsForcibleTermination = false
      OsGenerateCalloutStubs = true
      OsGenerateMemMap = COMPLETE
      OsGenerateMemMapForNearAddressing = true
      OsGenerateMemMapForThreads = false
      OsServiceProtection = false
      OsStackUsageMeasurement = false
      OsUseXSignalAsyncApiCalls = false
      OsFpuUsage = NONE
      OsScalabilityClass = SC3
      OsNumberOfCores = 4
      OsUseCase = STANDARD
      OsMasterCore = OsCore0
      OsSystemTimer = SystemTimer
      OsStackSummary
        32 x OsStack:
          OsCore0_Error: OsStackSize=1024, OsStackType=CORE_ERROR_STACK, OsStackCore=OsCore0, OsStackUser=OsCore0
          OsCore0_Init: OsStackSize=1024, OsStackType=CORE_INIT_STACK, OsStackCore=OsCore0, OsStackUser=OsCore0
          OsCore0_Kernel: OsStackSize=1024, OsStackType=CORE_KERNEL_STACK, OsStackCore=OsCore0, OsStackUser=OsCore0
          OsCore1_Error: OsStackSize=1024, OsStackType=CORE_ERROR_STACK, OsStackCore=OsCore1, OsStackUser=OsCore1
          OsCore1_Init: OsStackSize=1024, OsStackType=CORE_INIT_STACK, OsStackCore=OsCore1, OsStackUser=OsCore1
          OsCore1_Kernel: OsStackSize=1024, OsStackType=CORE_KERNEL_STACK, OsStackCore=OsCore1, OsStackUser=OsCore1
          OsCore2_Error: OsStackSize=1024, OsStackType=CORE_ERROR_STACK, OsStackCore=OsCore2, OsStackUser=OsCore2
          OsCore2_Init: OsStackSize=1024, OsStackType=CORE_INIT_STACK, OsStackCore=OsCore2, OsStackUser=OsCore2
          OsCore2_Kernel: OsStackSize=1024, OsStackType=CORE_KERNEL_STACK, OsStackCore=OsCore2, OsStackUser=OsCore2
          OsCore3_Error: OsStackSize=1024, OsStackType=CORE_ERROR_STACK, OsStackCore=OsCore3, OsStackUser=OsCore3
          OsCore3_Init: OsStackSize=1024, OsStackType=CORE_INIT_STACK, OsStackCore=OsCore3, OsStackUser=OsCore3
          OsCore3_Kernel: OsStackSize=1024, OsStackType=CORE_KERNEL_STACK, OsStackCore=OsCore3, OsStackUser=OsCore3
          OsCore0_Task_Prio20: OsStackSize=4096, OsStackType=TASK_SHARED_PRIORITY_STACK, OsStackCore=OsCore0, OsStackUser=Task_Bsw_10ms
          OsCore0_Task_Prio40: OsStackSize=2048, OsStackType=TASK_SHARED_PRIORITY_STACK, OsStackCore=OsCore0, OsStackUser=Task_Com_5ms
          OsCore2_Task_Prio10: OsStackSize=2048, OsStackType=TASK_SHARED_PRIORITY_STACK, OsStackCore=OsCore2, OsStackUser=Task_Appl_100ms
          OsCore2_Task_Prio15: OsStackSize=2048, OsStackType=TASK_SHARED_PRIORITY_STACK, OsStackCore=OsCore2, OsStackUser=Task_Appl_10ms
          OsCore0_Isr_Core: OsStackSize=1024, OsStackType=ISR_SHARED_CORE_STACK, OsStackCore=OsCore0, OsStackUser=CounterIsr_SystemTimer, OsStackUser=CanIsr_3
          OsCore2_Isr_Core: OsStackSize=1024, OsStackType=ISR_SHARED_CORE_STACK, OsStackCore=OsCore2, OsStackUser=Isr_SystemTimer_Core2
          OsCore{0..3}_Task_Prio4294967295: OsStackSize=1024, OsStackType=TASK_SHARED_PRIORITY_STACK, OsStackCore=OsCore{0..3}, OsStackUser=IdleTask_Core{0..3}
          OsCore1_Task_Prio5: OsStackSize=1024, OsStackType=TASK_SHARED_PRIORITY_STACK, OsStackCore=OsCore1, OsStackUser=Task_EcuM_Core1
          OsCore3_Task_Prio5: OsStackSize=1024, OsStackType=TASK_SHARED_PRIORITY_STACK, OsStackCore=OsCore3, OsStackUser=Task_EcuM_Core3
          OsCore0_Task_Prio49: OsStackSize=1024, OsStackType=TASK_SHARED_PRIORITY_STACK, OsStackCore=OsCore0, OsStackUser=Default_Init_Task_Trusted
          OsCore0_Task_Prio50: OsStackSize=8192, OsStackType=TASK_SHARED_PRIORITY_STACK, OsStackCore=OsCore0, OsStackUser=Default_Init_Task
          OsCore1_Task_Prio49: OsStackSize=1024, OsStackType=TASK_SHARED_PRIORITY_STACK, OsStackCore=OsCore1, OsStackUser=Default_Init_Task_Core1_Trusted
          OsCore1_Task_Prio50: OsStackSize=1024, OsStackType=TASK_SHARED_PRIORITY_STACK, OsStackCore=OsCore1, OsStackUser=Default_Init_Task_Core1
          OsCore2_Task_Prio49: OsStackSize=1024, OsStackType=TASK_SHARED_PRIORITY_STACK, OsStackCore=OsCore2, OsStackUser=Default_Init_Task_Core2_Trusted
          OsCore2_Task_Prio50: OsStackSize=1024, OsStackType=TASK_SHARED_PRIORITY_STACK, OsStackCore=OsCore2, OsStackUser=Default_Init_Task_Core2
          OsCore3_Task_Prio49: OsStackSize=1024, OsStackType=TASK_SHARED_PRIORITY_STACK, OsStackCore=OsCore3, OsStackUser=Default_Init_Task_Core3_Trusted
          OsCore3_Task_Prio50: OsStackSize=1024, OsStackType=TASK_SHARED_PRIORITY_STACK, OsStackCore=OsCore3, OsStackUser=Default_Init_Task_Core3
      OsHooks: OsErrorHook=true, OsPostTaskHook=false, OsPreTaskHook=false, OsShutdownHook=false, OsStartupHook=false
    SystemTimer (OsCounter):
      OsCounterMaxAllowedValue = 2147483647
      OsCounterMinCycle = 1
      OsCounterType = HARDWARE
      OsSecondsPerTick = 0.001
      OsCounterTicksPerBase = 12500
      OsCounterAccessingApplication = SystemApplication_OsCore{0..3}
      OsDriver: OsDriverHighResolution=false, OsDriverHardwareTimerChannelRef=GPT_Ch0, OsDriverIsrRef=CounterIsr_SystemTimer
    OsMemoryProtection
      16 x OsMemoryRegion:
        EXC_ALL_Core{0..2}: OsMemoryRegionStartAddress=0, OsMemoryRegionEndAddress=0xFFFFFFF8, OsMemoryRegionProtectionUnit=OsPhysicalCore{0..2}CodeMpu, OsMemoryRegionAccessRights=PS0_X, OsMemoryRegionAccessRights=PS1_X, OsMemoryRegionAccessRights=PS2_X, OsMemoryRegionAccessRights=PS3_X, OsMemoryRegionAccessRights=PS4_X, OsMemoryRegionAccessRights=PS5_X
        READ_ALL_Core{0..2}: OsMemoryRegionStartAddress=0, OsMemoryRegionEndAddress=0xFFFFFFF8, OsMemoryRegionProtectionUnit=OsPhysicalCore{0..2}DataMpu, OsMemoryRegionAccessRights=PS0_R, OsMemoryRegionAccessRights=PS1_R, OsMemoryRegionAccessRights=PS2_R, OsMemoryRegionAccessRights=PS3_R, OsMemoryRegionAccessRights=PS4_R, OsMemoryRegionAccessRights=PS5_R
        TRUSTED_WRITE_SPR_Core0: OsMemoryRegionEndAddress=0x7FFFFFF8, OsMemoryRegionStartAddress=_OS_CORE0_STACKS_END, OsMemoryRegionProtectionUnit=OsPhysicalCore0DataMpu, OsMemoryRegionAccessRights=PS0_W
        TRUSTED_WRITE_SPR_Core1: OsMemoryRegionEndAddress=0x6FFFFFF8, OsMemoryRegionStartAddress=_OS_CORE1_STACKS_END, OsMemoryRegionProtectionUnit=OsPhysicalCore1DataMpu, OsMemoryRegionAccessRights=PS0_W
        TRUSTED_WRITE_SPR_Core2: OsMemoryRegionEndAddress=0x5FFFFFF8, OsMemoryRegionStartAddress=_OS_CORE2_STACKS_END, OsMemoryRegionProtectionUnit=OsPhysicalCore2DataMpu, OsMemoryRegionAccessRights=PS0_W
        TRUSTED_WRITE_ALL_Core{0..2}: OsMemoryRegionStartAddress=0x80000000, OsMemoryRegionEndAddress=0xFFFFFFF8, OsMemoryRegionProtectionUnit=OsPhysicalCore{0..2}DataMpu, OsMemoryRegionAccessRights=PS0_W
        EXC_ALL_Core3: OsMemoryRegionStartAddress=0, OsMemoryRegionEndAddress=0xFFFFFFF8, OsMemoryRegionProtectionUnit=OsPhysicalCore3CodeMpu, OsMemoryRegionAccessRights=PS0_X, OsMemoryRegionAccessRights=PS1_X, OsMemoryRegionAccessRights=PS2_X, OsMemoryRegionAccessRights=PS3_X, OsMemoryRegionAccessRights=PS4_X, OsMemoryRegionAccessRights=PS5_X
        READ_ALL_Core3: OsMemoryRegionStartAddress=0, OsMemoryRegionEndAddress=0xFFFFFFF8, OsMemoryRegionProtectionUnit=OsPhysicalCore3DataMpu, OsMemoryRegionAccessRights=PS0_R, OsMemoryRegionAccessRights=PS1_R, OsMemoryRegionAccessRights=PS2_R, OsMemoryRegionAccessRights=PS3_R, OsMemoryRegionAccessRights=PS4_R, OsMemoryRegionAccessRights=PS5_R
        TRUSTED_WRITE_SPR_Core3: OsMemoryRegionEndAddress=0x4FFFFFF8, OsMemoryRegionStartAddress=_OS_CORE3_STACKS_END, OsMemoryRegionProtectionUnit=OsPhysicalCore3DataMpu, OsMemoryRegionAccessRights=PS0_W
        TRUSTED_WRITE_ALL_Core3: OsMemoryRegionStartAddress=0x80000000, OsMemoryRegionEndAddress=0xFFFFFFF8, OsMemoryRegionProtectionUnit=OsPhysicalCore3DataMpu, OsMemoryRegionAccessRights=PS0_W
    OsApplication:
      OsTrusted = true
      OsTrustedApplicationDelayTimingViolationCall = false
      OsTrustedApplicationWithProtection = false
      OsApplicationIsPrivileged = true
      OsAppUseTrustedFunctionStubs = false
      OsAppMemoryProtectionIdentifier = 4
      OsApplicationCoreRef = EcucCore0
      OsAppTaskRef = Task_Com_5ms
      OsAppTaskRef = Task_Bsw_10ms
      OsAppEcucPartitionRef = EcucPartition_Core0
      OsAppAlarmRef = Alarm_Com_5ms
      OsAppAlarmRef = Alarm_Bsw_10ms
      OsApplicationHooks: OsAppErrorHook=false, OsAppShutdownHook=false, OsAppStartupHook=false
    4 x OsCore, all with OsCoreIsAutosar=true:
      OsCore0: OsCoreIsAutostart=true, OsCoreEntrySymbol=_start_tc0, OsCorePhysicalCoreRef=Core0, OsCoreEcucCoreRef=EcucCore0, OsCoreSystemApplication=SystemApplication_OsCore0, OsCoreIdleTask=IdleTask_Core0
        OsCoreStacks:
          OsCoreKernelStackSize = 1024
          OsCoreStartupStackSize = 1024
          OsCoreShutdownStackSize = 1024
          OsCoreErrorStackSize = 1024
          OsCoreProtectionStackSize = 1024
          OsCoreInitStackSize = 1024
      OsCore1: OsCoreIsAutostart=false, OsCoreEntrySymbol=_start_tc1, OsCorePhysicalCoreRef=Core1, OsCoreEcucCoreRef=EcucCore1, OsCoreSystemApplication=SystemApplication_OsCore1, OsCoreIdleTask=IdleTask_Core1
        OsCoreStacks:
          OsCoreKernelStackSize = 1024
          OsCoreStartupStackSize = 1024
          OsCoreShutdownStackSize = 1024
          OsCoreErrorStackSize = 1024
          OsCoreProtectionStackSize = 1024
          OsCoreInitStackSize = 1024
      OsCore2: OsCoreIsAutostart=false, OsCoreEntrySymbol=_start_tc2, OsCorePhysicalCoreRef=Core2, OsCoreEcucCoreRef=EcucCore2, OsCoreSystemApplication=SystemApplication_OsCore2, OsCoreIdleTask=IdleTask_Core2
        OsCoreStacks:
          OsCoreKernelStackSize = 1024
          OsCoreStartupStackSize = 1024
          OsCoreShutdownStackSize = 1024
          OsCoreErrorStackSize = 1024
          OsCoreProtectionStackSize = 1024
          OsCoreInitStackSize = 1024
      OsCore3: OsCoreIsAutostart=false, OsCoreEntrySymbol=_start_tc3, OsCorePhysicalCoreRef=Core3, OsCoreEcucCoreRef=EcucCore3, OsCoreSystemApplication=SystemApplication_OsCore3, OsCoreIdleTask=IdleTask_Core3
        OsCoreStacks:
          OsCoreKernelStackSize = 1024
          OsCoreStartupStackSize = 1024
          OsCoreShutdownStackSize = 1024
          OsCoreErrorStackSize = 1024
          OsCoreProtectionStackSize = 1024
          OsCoreInitStackSize = 1024
    3 x OsApplication, all with OsTrusted=true, OsTrustedApplicationDelayTimingViolationCall=false, OsTrustedApplicationWithProtection=false, OsApplicationIsPrivileged=true, OsAppUseTrustedFunctionStubs=false:
      OsApplication_Core1: OsAppMemoryProtectionIdentifier=5, OsApplicationCoreRef=EcucCore1, OsAppEcucPartitionRef=EcucPartition_Core1, OsAppTaskRef=Task_EcuM_Core1
        OsApplicationHooks: OsAppErrorHook=false, OsAppShutdownHook=false, OsAppStartupHook=false
      OsApplication_Core2: OsAppMemoryProtectionIdentifier=4, OsApplicationCoreRef=EcucCore2, OsAppTaskRef=Task_Appl_10ms, OsAppTaskRef=Task_Appl_100ms, OsAppEcucPartitionRef=EcucPartition_Core2, OsAppAlarmRef=Alarm_Appl_10ms, OsAppAlarmRef=Alarm_Appl_100ms
        OsApplicationHooks: OsAppErrorHook=false, OsAppShutdownHook=false, OsAppStartupHook=false
      OsApplication_Core3: OsAppMemoryProtectionIdentifier=5, OsApplicationCoreRef=EcucCore3, OsAppEcucPartitionRef=EcucPartition_Core3, OsAppTaskRef=Task_EcuM_Core3
        OsApplicationHooks: OsAppErrorHook=false, OsAppShutdownHook=false, OsAppStartupHook=false
    8 x OsTask, all with OsTaskSchedule=FULL, OsTaskStackSharing=false, OsTaskUsesFpu=false, OsTaskAccessingApplication=SystemApplication_OsCore0, OsTaskAccessingApplication=SystemApplication_OsCore1, OsTaskAccessingApplication=SystemApplication_OsCore2, OsTaskAccessingApplication=SystemApplication_OsCore3:
      IdleTask_Core0: OsTaskActivation=1, OsTaskPriority=4294967295, OsTaskStackSize=1024, OsTaskType=AUTO
        OsTaskAutostart: OsTaskAppModeRef=OS_APPMODE_ANY
      IdleTask_Core1: OsTaskActivation=1, OsTaskPriority=4294967295, OsTaskStackSize=1024, OsTaskType=AUTO
        OsTaskAutostart: OsTaskAppModeRef=OS_APPMODE_ANY
      IdleTask_Core2: OsTaskActivation=1, OsTaskPriority=4294967295, OsTaskStackSize=1024, OsTaskType=AUTO
        OsTaskAutostart: OsTaskAppModeRef=OS_APPMODE_ANY
      IdleTask_Core3: OsTaskActivation=1, OsTaskPriority=4294967295, OsTaskStackSize=1024, OsTaskType=AUTO
        OsTaskAutostart: OsTaskAppModeRef=OS_APPMODE_ANY
      Task_Com_5ms: OsTaskActivation=5, OsTaskPriority=40, OsTaskStackSize=2048, OsTaskType=BASIC, OsTaskAccessingApplication=OsApplication_Core1, OsTaskAccessingApplication=OsApplication_Core2, OsTaskAccessingApplication=OsApplication_Core3
      Task_Bsw_10ms: OsTaskActivation=5, OsTaskPriority=20, OsTaskStackSize=4096, OsTaskType=BASIC, OsTaskResourceRef=EcuM_OsResource, OsTaskAccessingApplication=OsApplication_Core1, OsTaskAccessingApplication=OsApplication_Core2, OsTaskAccessingApplication=OsApplication_Core3
      Task_Appl_10ms: OsTaskActivation=1, OsTaskPriority=15, OsTaskStackSize=2048, OsTaskType=BASIC, OsTaskAccessingApplication=OsApplication, OsTaskAccessingApplication=OsApplication_Core1, OsTaskAccessingApplication=OsApplication_Core3
      Task_Appl_100ms: OsTaskActivation=1, OsTaskPriority=10, OsTaskStackSize=2048, OsTaskType=BASIC
    4 x OsAlarm, all with OsAlarmAccessingApplication=SystemApplication_OsCore0, OsAlarmAccessingApplication=SystemApplication_OsCore1, OsAlarmAccessingApplication=SystemApplication_OsCore2, OsAlarmAccessingApplication=SystemApplication_OsCore3:
      Alarm_Com_5ms: OsAlarmCounterRef=SystemTimer
        OsAlarmAction
          OsAlarmActivateTask: OsAlarmActivateTaskRef=Task_Com_5ms
        OsAlarmAutostart: OsAlarmAlarmTime=5, OsAlarmAutostartType=RELATIVE, OsAlarmCycleTime=5, OsAlarmAppModeRef=OSDEFAULTAPPMODE
      Alarm_Bsw_10ms: OsAlarmCounterRef=SystemTimer
        OsAlarmAction
          OsAlarmActivateTask: OsAlarmActivateTaskRef=Task_Bsw_10ms
        OsAlarmAutostart: OsAlarmAlarmTime=10, OsAlarmAutostartType=RELATIVE, OsAlarmCycleTime=10, OsAlarmAppModeRef=OSDEFAULTAPPMODE
      Alarm_Appl_10ms: OsAlarmCounterRef=SystemTimer_Core2
        OsAlarmAction
          OsAlarmActivateTask: OsAlarmActivateTaskRef=Task_Appl_10ms
        OsAlarmAutostart: OsAlarmAlarmTime=10, OsAlarmAutostartType=RELATIVE, OsAlarmCycleTime=10, OsAlarmAppModeRef=OSDEFAULTAPPMODE
      Alarm_Appl_100ms: OsAlarmCounterRef=SystemTimer_Core2
        OsAlarmAction
          OsAlarmActivateTask: OsAlarmActivateTaskRef=Task_Appl_100ms
        OsAlarmAutostart: OsAlarmAlarmTime=100, OsAlarmAutostartType=RELATIVE, OsAlarmCycleTime=100, OsAlarmAppModeRef=OSDEFAULTAPPMODE
    4 x OsApplication, all with OsTrusted=true, OsTrustedApplicationDelayTimingViolationCall=false, OsTrustedApplicationWithProtection=false, OsApplicationIsPrivileged=true, OsAppUseTrustedFunctionStubs=false:
      SystemApplication_OsCore0: OsAppMemoryProtectionIdentifier=0, OsApplicationCoreRef=EcucCore0, OsAppTaskRef=IdleTask_Core0, OsAppIsrRef=CounterIsr_SystemTimer, OsAppIsrRef=CanIsr_3, OsAppCounterRef=SystemTimer, OsAppEcucPartitionRef=EcucPartition_SystemCore0, OsAppTaskRef=Default_Init_Task, OsAppTaskRef=Default_Init_Task_Trusted
        OsApplicationHooks: OsAppErrorHook=false, OsAppShutdownHook=false, OsAppStartupHook=false
      SystemApplication_OsCore1: OsAppMemoryProtectionIdentifier=1, OsApplicationCoreRef=EcucCore1, OsAppTaskRef=IdleTask_Core1, OsAppTaskRef=Default_Init_Task_Core1, OsAppTaskRef=Default_Init_Task_Core1_Trusted
        OsApplicationHooks: OsAppErrorHook=false, OsAppShutdownHook=false, OsAppStartupHook=false
      SystemApplication_OsCore2: OsAppMemoryProtectionIdentifier=2, OsApplicationCoreRef=EcucCore2, OsAppTaskRef=IdleTask_Core2, OsAppIsrRef=Isr_SystemTimer_Core2, OsAppCounterRef=SystemTimer_Core2, OsAppEcucPartitionRef=EcucPartition_SystemCore2, OsAppTaskRef=Default_Init_Task_Core2, OsAppTaskRef=Default_Init_Task_Core2_Trusted
        OsApplicationHooks: OsAppErrorHook=false, OsAppShutdownHook=false, OsAppStartupHook=false
      SystemApplication_OsCore3: OsAppMemoryProtectionIdentifier=3, OsApplicationCoreRef=EcucCore3, OsAppTaskRef=IdleTask_Core3, OsAppTaskRef=Default_Init_Task_Core3, OsAppTaskRef=Default_Init_Task_Core3_Trusted
        OsApplicationHooks: OsAppErrorHook=false, OsAppShutdownHook=false, OsAppStartupHook=false
    CounterIsr_SystemTimer (OsIsr):
      OsIsrCategory = CATEGORY_2
      OsIsrInterruptType = EXTERNAL
      OsIsrInterruptSource = 744
      OsIsrInterruptPriority = 10
      OsIsrStackSize = 1024
      OsIsrEnableNesting = false
      OsIsrUsesFpu = false
      OsIsrInitialEnableInterruptSource = false
      OsIsrSpecialFunctionName = Os_TimerPitIsr
    SystemTimer_Core2 (OsCounter):
      OsCounterMaxAllowedValue = 2147483647
      OsCounterMinCycle = 1
      OsCounterTicksPerBase = 1
      OsCounterType = HARDWARE
      OsSecondsPerTick = 0.001
      OsCounterAccessingApplication = SystemApplication_OsCore{0..3}
      OsDriver: OsDriverHighResolution=false, OsDriverHardwareTimerChannelRef=STM2_Ch0, OsDriverIsrRef=Isr_SystemTimer_Core2
    Isr_SystemTimer_Core2 (OsIsr):
      OsIsrCategory = CATEGORY_2
      OsIsrInterruptType = EXTERNAL
      OsIsrInterruptSource = 784
      OsIsrInterruptPriority = 20
      OsIsrStackSize = 1024
      OsIsrEnableNesting = false
      OsIsrUsesFpu = false
      OsIsrInitialEnableInterruptSource = false
      OsIsrSpecialFunctionName = Os_TimerPfrtIsr
    EcuM_OsResource (OsResource):
      OsResourceProperty = STANDARD
      OsResourceAccessingApplication = OsApplication
      OsResourceAccessingApplication = OsApplication_Core{1..3}
      OsResourceAccessingApplication = SystemApplication_OsCore{0..3}
    10 x OsTask, all with OsTaskActivation=1, OsTaskSchedule=FULL, OsTaskStackSharing=false, OsTaskType=BASIC, OsTaskUsesFpu=false, OsTaskAccessingApplication=SystemApplication_OsCore0, OsTaskAccessingApplication=SystemApplication_OsCore1, OsTaskAccessingApplication=SystemApplication_OsCore2, OsTaskAccessingApplication=SystemApplication_OsCore3:
      Task_EcuM_Core1: OsTaskPriority=5, OsTaskStackSize=1024, OsTaskAccessingApplication=OsApplication, OsTaskAccessingApplication=OsApplication_Core2, OsTaskAccessingApplication=OsApplication_Core3
      Task_EcuM_Core3: OsTaskPriority=5, OsTaskStackSize=1024, OsTaskAccessingApplication=OsApplication, OsTaskAccessingApplication=OsApplication_Core1, OsTaskAccessingApplication=OsApplication_Core2
      Default_Init_Task: OsTaskPriority=50, OsTaskStackSize=8192
        OsTaskAutostart: OsTaskAppModeRef=OS_APPMODE_ANY
      Default_Init_Task_Trusted: OsTaskPriority=49, OsTaskStackSize=1024
        OsTaskAutostart: OsTaskAppModeRef=OS_APPMODE_ANY
      Default_Init_Task_Core1: OsTaskPriority=50, OsTaskStackSize=1024
        OsTaskAutostart: OsTaskAppModeRef=OS_APPMODE_ANY
      Default_Init_Task_Core1_Trusted: OsTaskPriority=49, OsTaskStackSize=1024
        OsTaskAutostart: OsTaskAppModeRef=OS_APPMODE_ANY
      Default_Init_Task_Core2: OsTaskPriority=50, OsTaskStackSize=1024
        OsTaskAutostart: OsTaskAppModeRef=OS_APPMODE_ANY
      Default_Init_Task_Core2_Trusted: OsTaskPriority=49, OsTaskStackSize=1024
        OsTaskAutostart: OsTaskAppModeRef=OS_APPMODE_ANY
      Default_Init_Task_Core3: OsTaskPriority=50, OsTaskStackSize=1024
        OsTaskAutostart: OsTaskAppModeRef=OS_APPMODE_ANY
      Default_Init_Task_Core3_Trusted: OsTaskPriority=49, OsTaskStackSize=1024
        OsTaskAutostart: OsTaskAppModeRef=OS_APPMODE_ANY
    CanIsr_3 (OsIsr):  # /ActiveEcuC/Can PLAIN_TEXT Can messages event (for a specific controllers)
      OsIsrInterruptPriority = 15
      OsIsrCategory = CATEGORY_2
      OsIsrInterruptType = EXTERNAL
      OsIsrInterruptSource = 1468
      OsIsrStackSize = 1024
      OsIsrEnableNesting = false
      OsIsrUsesFpu = false
      OsIsrInitialEnableInterruptSource = true

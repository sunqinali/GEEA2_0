AUTOSAR XML (schema 4-2-2)
package /ActiveEcuC
  module config ResourceM: implementation-config-variant=VARIANT-PRE-COMPILE
    ResourceMMcalConfig: ResourceMMasterCore=CORE0
      ResourceMMcalCore: ResourceMCoreID=CORE0
      ResourceMMcalCore_0 (ResourceMMcalCore): ResourceMCoreID=CORE0
        SPI_QSPI3 (ResourceMAllocation): ResourceMModuleName=SPI, ResourceMResourceRef=QSPI3
        SPI_QSPI4 (ResourceMAllocation): ResourceMModuleName=SPI, ResourceMResourceRef=QSPI4

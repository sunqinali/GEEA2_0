AUTOSAR XML (schema 00048)
package /ActiveEcuC
  module config vBaseEnv: implementation-config-variant=VARIANT-PRE-COMPILE, module-description=vBaseEnv_Impl
    vBaseEnvGeneral: vBaseEnvTestedDerivativeRef=TC397X_StepB
      34 x vBaseEnvMemLayoutHwRegion:
        DSPR0
        PSPR0
        DSPR1
        PSPR1
        DSPR2
        PSPR2
        DSPR3
        PSPR3
        DSPR4
        PSPR4
        DSPR5
        PSPR5
        PFlash0_Cached
        PFlash0_NonCached
        PFlash1_Cached
        PFlash1_NonCached
        PFlash2_Cached
        PFlash2_NonCached
        PFlash3_Cached
        PFlash3_NonCached
        PFlash4_Cached
        PFlash4_NonCached
        PFlash5_Cached
        PFlash5_NonCached
        LMU0_Cached
        LMU0_NonCached
        LMU1_Cached
        LMU1_NonCached
        LMU2_Cached
        LMU2_NonCached
        BMHD{0..3}
      4 x vBaseEnvDerivativeInformation, all with vBaseEnvCpuCoreAmount=6, vBaseEnvCpuMaxFrequency=300000000, vBaseEnvTestedDerivative=TC39x, vBaseEnvTestedDerivativeDescription=Infineon Aurix 2G TC39x Family, vBaseEnvAvailableChannels_Can=12, vBaseEnvAvailableChannels_Ethernet=1, vBaseEnvAvailableChannels_Flexray=4, vBaseEnvCpuCore=TC162, vBaseEnvAvailableChannels_Hyperbus=0, vBaseEnvAvailableChannels_I2c=0, vBaseEnvAvailableChannels_Spi=0:
        TC399X_StepA: vBaseEnvAvailableChannels_Lin=8
          vBaseEnvAdditionalParameters: vBaseEnvWatchdogGroup=B, vBaseEnvPllGroup=C, vBaseEnvPortGroup=B, vBaseEnvResetGroup=B, vBaseEnvDerivativeGroup=TC3xx
          34 x vBaseEnvMemLayoutHwRegion:
            DSPR0: vBaseEnvHwRegionStartAddress=1879048192, vBaseEnvHwRegionSize=245760, vBaseEnvHwRegionType=RAM
            PSPR0: vBaseEnvHwRegionStartAddress=1880096768, vBaseEnvHwRegionSize=65536, vBaseEnvHwRegionType=RAM
            DSPR1: vBaseEnvHwRegionStartAddress=1610612736, vBaseEnvHwRegionSize=245760, vBaseEnvHwRegionType=RAM
            PSPR1: vBaseEnvHwRegionStartAddress=1611661312, vBaseEnvHwRegionSize=65536, vBaseEnvHwRegionType=RAM
            DSPR2: vBaseEnvHwRegionStartAddress=1342177280, vBaseEnvHwRegionSize=98304, vBaseEnvHwRegionType=RAM
            PSPR2: vBaseEnvHwRegionStartAddress=1343225856, vBaseEnvHwRegionSize=65536, vBaseEnvHwRegionType=RAM
            DSPR3: vBaseEnvHwRegionStartAddress=1073741824, vBaseEnvHwRegionSize=98304, vBaseEnvHwRegionType=RAM
            PSPR3: vBaseEnvHwRegionStartAddress=1074790400, vBaseEnvHwRegionSize=98304, vBaseEnvHwRegionType=RAM
            DSPR4: vBaseEnvHwRegionStartAddress=805306368, vBaseEnvHwRegionSize=98304, vBaseEnvHwRegionType=RAM
            PSPR4: vBaseEnvHwRegionStartAddress=806354944, vBaseEnvHwRegionSize=98304, vBaseEnvHwRegionType=RAM
            DSPR5: vBaseEnvHwRegionSize=98304, vBaseEnvHwRegionStartAddress=268435456, vBaseEnvHwRegionType=RAM
            PSPR5: vBaseEnvHwRegionStartAddress=269484032, vBaseEnvHwRegionSize=98304, vBaseEnvHwRegionType=RAM
            PFlash0_Cached: vBaseEnvHwRegionStartAddress=2147483648, vBaseEnvHwRegionSize=3145728, vBaseEnvHwRegionType=ROM
            PFlash0_NonCached: vBaseEnvHwRegionStartAddress=2684354560, vBaseEnvHwRegionSize=3145728, vBaseEnvHwRegionType=ROM
            PFlash1_Cached: vBaseEnvHwRegionStartAddress=2150629376, vBaseEnvHwRegionSize=3145728, vBaseEnvHwRegionType=ROM
            PFlash1_NonCached: vBaseEnvHwRegionStartAddress=2687500288, vBaseEnvHwRegionSize=3145728, vBaseEnvHwRegionType=ROM
            PFlash2_Cached: vBaseEnvHwRegionStartAddress=2153775104, vBaseEnvHwRegionSize=3145728, vBaseEnvHwRegionType=ROM
            PFlash2_NonCached: vBaseEnvHwRegionStartAddress=2690646016, vBaseEnvHwRegionSize=3145728, vBaseEnvHwRegionType=ROM
            PFlash3_Cached: vBaseEnvHwRegionStartAddress=2156920832, vBaseEnvHwRegionSize=3145728, vBaseEnvHwRegionType=ROM
            PFlash3_NonCached: vBaseEnvHwRegionStartAddress=2693791744, vBaseEnvHwRegionSize=3145728, vBaseEnvHwRegionType=ROM
            PFlash4_Cached: vBaseEnvHwRegionStartAddress=2160066560, vBaseEnvHwRegionSize=3145728, vBaseEnvHwRegionType=ROM
            PFlash4_NonCached: vBaseEnvHwRegionStartAddress=2696937472, vBaseEnvHwRegionSize=3145728, vBaseEnvHwRegionType=ROM
            PFlash5_Cached: vBaseEnvHwRegionStartAddress=2163212288, vBaseEnvHwRegionSize=1048576, vBaseEnvHwRegionType=ROM
            PFlash5_NonCached: vBaseEnvHwRegionStartAddress=2700083200, vBaseEnvHwRegionSize=1048576, vBaseEnvHwRegionType=ROM
            LMU0_Cached: vBaseEnvHwRegionStartAddress=2416181248, vBaseEnvHwRegionSize=262144, vBaseEnvHwRegionType=RAM
            LMU0_NonCached: vBaseEnvHwRegionStartAddress=2953052160, vBaseEnvHwRegionSize=262144, vBaseEnvHwRegionType=RAM
            LMU1_Cached: vBaseEnvHwRegionStartAddress=2416443392, vBaseEnvHwRegionSize=262144, vBaseEnvHwRegionType=RAM
            LMU1_NonCached: vBaseEnvHwRegionStartAddress=2953314304, vBaseEnvHwRegionSize=262144, vBaseEnvHwRegionType=RAM
            LMU2_Cached: vBaseEnvHwRegionStartAddress=2416705536, vBaseEnvHwRegionSize=262144, vBaseEnvHwRegionType=RAM
            LMU2_NonCached: vBaseEnvHwRegionStartAddress=2953576448, vBaseEnvHwRegionSize=262144, vBaseEnvHwRegionType=RAM
            BMHD0: vBaseEnvHwRegionStartAddress=2940207104, vBaseEnvHwRegionSize=512, vBaseEnvHwRegionType=ROM
            BMHD1: vBaseEnvHwRegionStartAddress=2940207616, vBaseEnvHwRegionSize=512, vBaseEnvHwRegionType=ROM
            BMHD2: vBaseEnvHwRegionStartAddress=2940208128, vBaseEnvHwRegionSize=512, vBaseEnvHwRegionType=ROM
            BMHD3: vBaseEnvHwRegionStartAddress=2940208640, vBaseEnvHwRegionSize=512, vBaseEnvHwRegionType=ROM
        TC397X_StepA: vBaseEnvAvailableChannels_Lin=8
          vBaseEnvAdditionalParameters: vBaseEnvWatchdogGroup=B, vBaseEnvPllGroup=C, vBaseEnvPortGroup=B, vBaseEnvResetGroup=B, vBaseEnvDerivativeGroup=TC3xx
          34 x vBaseEnvMemLayoutHwRegion:
            DSPR0: vBaseEnvHwRegionStartAddress=1879048192, vBaseEnvHwRegionSize=245760, vBaseEnvHwRegionType=RAM
            PSPR0: vBaseEnvHwRegionStartAddress=1880096768, vBaseEnvHwRegionSize=65536, vBaseEnvHwRegionType=RAM
            DSPR1: vBaseEnvHwRegionStartAddress=1610612736, vBaseEnvHwRegionSize=245760, vBaseEnvHwRegionType=RAM
            PSPR1: vBaseEnvHwRegionStartAddress=1611661312, vBaseEnvHwRegionSize=65536, vBaseEnvHwRegionType=RAM
            DSPR2: vBaseEnvHwRegionStartAddress=1342177280, vBaseEnvHwRegionSize=98304, vBaseEnvHwRegionType=RAM
            PSPR2: vBaseEnvHwRegionStartAddress=1343225856, vBaseEnvHwRegionSize=65536, vBaseEnvHwRegionType=RAM
            DSPR3: vBaseEnvHwRegionStartAddress=1073741824, vBaseEnvHwRegionSize=98304, vBaseEnvHwRegionType=RAM
            PSPR3: vBaseEnvHwRegionStartAddress=1074790400, vBaseEnvHwRegionSize=98304, vBaseEnvHwRegionType=RAM
            DSPR4: vBaseEnvHwRegionStartAddress=805306368, vBaseEnvHwRegionSize=98304, vBaseEnvHwRegionType=RAM
            PSPR4: vBaseEnvHwRegionStartAddress=806354944, vBaseEnvHwRegionSize=98304, vBaseEnvHwRegionType=RAM
            DSPR5: vBaseEnvHwRegionSize=98304, vBaseEnvHwRegionStartAddress=268435456, vBaseEnvHwRegionType=RAM
            PSPR5: vBaseEnvHwRegionStartAddress=269484032, vBaseEnvHwRegionSize=98304, vBaseEnvHwRegionType=RAM
            PFlash0_Cached: vBaseEnvHwRegionStartAddress=2147483648, vBaseEnvHwRegionSize=3145728, vBaseEnvHwRegionType=ROM
            PFlash0_NonCached: vBaseEnvHwRegionStartAddress=2684354560, vBaseEnvHwRegionSize=3145728, vBaseEnvHwRegionType=ROM
            PFlash1_Cached: vBaseEnvHwRegionStartAddress=2150629376, vBaseEnvHwRegionSize=3145728, vBaseEnvHwRegionType=ROM
            PFlash1_NonCached: vBaseEnvHwRegionStartAddress=2687500288, vBaseEnvHwRegionSize=3145728, vBaseEnvHwRegionType=ROM
            PFlash2_Cached: vBaseEnvHwRegionStartAddress=2153775104, vBaseEnvHwRegionSize=3145728, vBaseEnvHwRegionType=ROM
            PFlash2_NonCached: vBaseEnvHwRegionStartAddress=2690646016, vBaseEnvHwRegionSize=3145728, vBaseEnvHwRegionType=ROM
            PFlash3_Cached: vBaseEnvHwRegionStartAddress=2156920832, vBaseEnvHwRegionSize=3145728, vBaseEnvHwRegionType=ROM
            PFlash3_NonCached: vBaseEnvHwRegionStartAddress=2693791744, vBaseEnvHwRegionSize=3145728, vBaseEnvHwRegionType=ROM
            PFlash4_Cached: vBaseEnvHwRegionStartAddress=2160066560, vBaseEnvHwRegionSize=3145728, vBaseEnvHwRegionType=ROM
            PFlash4_NonCached: vBaseEnvHwRegionStartAddress=2696937472, vBaseEnvHwRegionSize=3145728, vBaseEnvHwRegionType=ROM
            PFlash5_Cached: vBaseEnvHwRegionStartAddress=2163212288, vBaseEnvHwRegionSize=1048576, vBaseEnvHwRegionType=ROM
            PFlash5_NonCached: vBaseEnvHwRegionStartAddress=2700083200, vBaseEnvHwRegionSize=1048576, vBaseEnvHwRegionType=ROM
            LMU0_Cached: vBaseEnvHwRegionStartAddress=2416181248, vBaseEnvHwRegionSize=262144, vBaseEnvHwRegionType=RAM
            LMU0_NonCached: vBaseEnvHwRegionStartAddress=2953052160, vBaseEnvHwRegionSize=262144, vBaseEnvHwRegionType=RAM
            LMU1_Cached: vBaseEnvHwRegionStartAddress=2416443392, vBaseEnvHwRegionSize=262144, vBaseEnvHwRegionType=RAM
            LMU1_NonCached: vBaseEnvHwRegionStartAddress=2953314304, vBaseEnvHwRegionSize=262144, vBaseEnvHwRegionType=RAM
            LMU2_Cached: vBaseEnvHwRegionStartAddress=2416705536, vBaseEnvHwRegionSize=262144, vBaseEnvHwRegionType=RAM
            LMU2_NonCached: vBaseEnvHwRegionStartAddress=2953576448, vBaseEnvHwRegionSize=262144, vBaseEnvHwRegionType=RAM
            BMHD0: vBaseEnvHwRegionStartAddress=2940207104, vBaseEnvHwRegionSize=512, vBaseEnvHwRegionType=ROM
            BMHD1: vBaseEnvHwRegionStartAddress=2940207616, vBaseEnvHwRegionSize=512, vBaseEnvHwRegionType=ROM
            BMHD2: vBaseEnvHwRegionStartAddress=2940208128, vBaseEnvHwRegionSize=512, vBaseEnvHwRegionType=ROM
            BMHD3: vBaseEnvHwRegionStartAddress=2940208640, vBaseEnvHwRegionSize=512, vBaseEnvHwRegionType=ROM
        TC399X_StepB: vBaseEnvAvailableChannels_Lin=12
          vBaseEnvAdditionalParameters: vBaseEnvWatchdogGroup=B, vBaseEnvPllGroup=B, vBaseEnvPortGroup=B, vBaseEnvResetGroup=B, vBaseEnvDerivativeGroup=TC3xx
          34 x vBaseEnvMemLayoutHwRegion:
            DSPR0: vBaseEnvHwRegionStartAddress=1879048192, vBaseEnvHwRegionSize=245760, vBaseEnvHwRegionType=RAM
            PSPR0: vBaseEnvHwRegionStartAddress=1880096768, vBaseEnvHwRegionSize=65536, vBaseEnvHwRegionType=RAM
            DSPR1: vBaseEnvHwRegionStartAddress=1610612736, vBaseEnvHwRegionSize=245760, vBaseEnvHwRegionType=RAM
            PSPR1: vBaseEnvHwRegionStartAddress=1611661312, vBaseEnvHwRegionSize=65536, vBaseEnvHwRegionType=RAM
            DSPR2: vBaseEnvHwRegionStartAddress=1342177280, vBaseEnvHwRegionSize=98304, vBaseEnvHwRegionType=RAM
            PSPR2: vBaseEnvHwRegionStartAddress=1343225856, vBaseEnvHwRegionSize=65536, vBaseEnvHwRegionType=RAM
            DSPR3: vBaseEnvHwRegionStartAddress=1073741824, vBaseEnvHwRegionSize=98304, vBaseEnvHwRegionType=RAM
            PSPR3: vBaseEnvHwRegionStartAddress=1074790400, vBaseEnvHwRegionSize=98304, vBaseEnvHwRegionType=RAM
            DSPR4: vBaseEnvHwRegionStartAddress=805306368, vBaseEnvHwRegionSize=98304, vBaseEnvHwRegionType=RAM
            PSPR4: vBaseEnvHwRegionStartAddress=806354944, vBaseEnvHwRegionSize=98304, vBaseEnvHwRegionType=RAM
            DSPR5: vBaseEnvHwRegionSize=98304, vBaseEnvHwRegionStartAddress=268435456, vBaseEnvHwRegionType=RAM
            PSPR5: vBaseEnvHwRegionStartAddress=269484032, vBaseEnvHwRegionSize=98304, vBaseEnvHwRegionType=RAM
            PFlash0_Cached: vBaseEnvHwRegionStartAddress=2147483648, vBaseEnvHwRegionSize=3145728, vBaseEnvHwRegionType=ROM
            PFlash0_NonCached: vBaseEnvHwRegionStartAddress=2684354560, vBaseEnvHwRegionSize=3145728, vBaseEnvHwRegionType=ROM
            PFlash1_Cached: vBaseEnvHwRegionStartAddress=2150629376, vBaseEnvHwRegionSize=3145728, vBaseEnvHwRegionType=ROM
            PFlash1_NonCached: vBaseEnvHwRegionStartAddress=2687500288, vBaseEnvHwRegionSize=3145728, vBaseEnvHwRegionType=ROM
            PFlash2_Cached: vBaseEnvHwRegionStartAddress=2153775104, vBaseEnvHwRegionSize=3145728, vBaseEnvHwRegionType=ROM
            PFlash2_NonCached: vBaseEnvHwRegionStartAddress=2690646016, vBaseEnvHwRegionSize=3145728, vBaseEnvHwRegionType=ROM
            PFlash3_Cached: vBaseEnvHwRegionStartAddress=2156920832, vBaseEnvHwRegionSize=3145728, vBaseEnvHwRegionType=ROM
            PFlash3_NonCached: vBaseEnvHwRegionStartAddress=2693791744, vBaseEnvHwRegionSize=3145728, vBaseEnvHwRegionType=ROM
            PFlash4_Cached: vBaseEnvHwRegionStartAddress=2160066560, vBaseEnvHwRegionSize=3145728, vBaseEnvHwRegionType=ROM
            PFlash4_NonCached: vBaseEnvHwRegionStartAddress=2696937472, vBaseEnvHwRegionSize=3145728, vBaseEnvHwRegionType=ROM
            PFlash5_Cached: vBaseEnvHwRegionStartAddress=2163212288, vBaseEnvHwRegionSize=1048576, vBaseEnvHwRegionType=ROM
            PFlash5_NonCached: vBaseEnvHwRegionStartAddress=2700083200, vBaseEnvHwRegionSize=1048576, vBaseEnvHwRegionType=ROM
            LMU0_Cached: vBaseEnvHwRegionStartAddress=2416181248, vBaseEnvHwRegionSize=262144, vBaseEnvHwRegionType=RAM
            LMU0_NonCached: vBaseEnvHwRegionStartAddress=2953052160, vBaseEnvHwRegionSize=262144, vBaseEnvHwRegionType=RAM
            LMU1_Cached: vBaseEnvHwRegionStartAddress=2416443392, vBaseEnvHwRegionSize=262144, vBaseEnvHwRegionType=RAM
            LMU1_NonCached: vBaseEnvHwRegionStartAddress=2953314304, vBaseEnvHwRegionSize=262144, vBaseEnvHwRegionType=RAM
            LMU2_Cached: vBaseEnvHwRegionStartAddress=2416705536, vBaseEnvHwRegionSize=262144, vBaseEnvHwRegionType=RAM
            LMU2_NonCached: vBaseEnvHwRegionStartAddress=2953576448, vBaseEnvHwRegionSize=262144, vBaseEnvHwRegionType=RAM
            BMHD0: vBaseEnvHwRegionStartAddress=2940207104, vBaseEnvHwRegionSize=512, vBaseEnvHwRegionType=ROM
            BMHD1: vBaseEnvHwRegionStartAddress=2940207616, vBaseEnvHwRegionSize=512, vBaseEnvHwRegionType=ROM
            BMHD2: vBaseEnvHwRegionStartAddress=2940208128, vBaseEnvHwRegionSize=512, vBaseEnvHwRegionType=ROM
            BMHD3: vBaseEnvHwRegionStartAddress=2940208640, vBaseEnvHwRegionSize=512, vBaseEnvHwRegionType=ROM
        TC397X_StepB: vBaseEnvAvailableChannels_Lin=12
          vBaseEnvAdditionalParameters: vBaseEnvWatchdogGroup=B, vBaseEnvPllGroup=B, vBaseEnvPortGroup=B, vBaseEnvResetGroup=B, vBaseEnvDerivativeGroup=TC3xx
          34 x vBaseEnvMemLayoutHwRegion:
            DSPR0: vBaseEnvHwRegionStartAddress=1879048192, vBaseEnvHwRegionSize=245760, vBaseEnvHwRegionType=RAM
            PSPR0: vBaseEnvHwRegionStartAddress=1880096768, vBaseEnvHwRegionSize=65536, vBaseEnvHwRegionType=RAM
            DSPR1: vBaseEnvHwRegionStartAddress=1610612736, vBaseEnvHwRegionSize=245760, vBaseEnvHwRegionType=RAM
            PSPR1: vBaseEnvHwRegionStartAddress=1611661312, vBaseEnvHwRegionSize=65536, vBaseEnvHwRegionType=RAM
            DSPR2: vBaseEnvHwRegionStartAddress=1342177280, vBaseEnvHwRegionSize=98304, vBaseEnvHwRegionType=RAM
            PSPR2: vBaseEnvHwRegionStartAddress=1343225856, vBaseEnvHwRegionSize=65536, vBaseEnvHwRegionType=RAM
            DSPR3: vBaseEnvHwRegionStartAddress=1073741824, vBaseEnvHwRegionSize=98304, vBaseEnvHwRegionType=RAM
            PSPR3: vBaseEnvHwRegionStartAddress=1074790400, vBaseEnvHwRegionSize=98304, vBaseEnvHwRegionType=RAM
            DSPR4: vBaseEnvHwRegionStartAddress=805306368, vBaseEnvHwRegionSize=98304, vBaseEnvHwRegionType=RAM
            PSPR4: vBaseEnvHwRegionStartAddress=806354944, vBaseEnvHwRegionSize=98304, vBaseEnvHwRegionType=RAM
            DSPR5: vBaseEnvHwRegionSize=98304, vBaseEnvHwRegionStartAddress=268435456, vBaseEnvHwRegionType=RAM
            PSPR5: vBaseEnvHwRegionStartAddress=269484032, vBaseEnvHwRegionSize=98304, vBaseEnvHwRegionType=RAM
            PFlash0_Cached: vBaseEnvHwRegionStartAddress=2147483648, vBaseEnvHwRegionSize=3145728, vBaseEnvHwRegionType=ROM
            PFlash0_NonCached: vBaseEnvHwRegionStartAddress=2684354560, vBaseEnvHwRegionSize=3145728, vBaseEnvHwRegionType=ROM
            PFlash1_Cached: vBaseEnvHwRegionStartAddress=2150629376, vBaseEnvHwRegionSize=3145728, vBaseEnvHwRegionType=ROM
            PFlash1_NonCached: vBaseEnvHwRegionStartAddress=2687500288, vBaseEnvHwRegionSize=3145728, vBaseEnvHwRegionType=ROM
            PFlash2_Cached: vBaseEnvHwRegionStartAddress=2153775104, vBaseEnvHwRegionSize=3145728, vBaseEnvHwRegionType=ROM
            PFlash2_NonCached: vBaseEnvHwRegionStartAddress=2690646016, vBaseEnvHwRegionSize=3145728, vBaseEnvHwRegionType=ROM
            PFlash3_Cached: vBaseEnvHwRegionStartAddress=2156920832, vBaseEnvHwRegionSize=3145728, vBaseEnvHwRegionType=ROM
            PFlash3_NonCached: vBaseEnvHwRegionStartAddress=2693791744, vBaseEnvHwRegionSize=3145728, vBaseEnvHwRegionType=ROM
            PFlash4_Cached: vBaseEnvHwRegionStartAddress=2160066560, vBaseEnvHwRegionSize=3145728, vBaseEnvHwRegionType=ROM
            PFlash4_NonCached: vBaseEnvHwRegionStartAddress=2696937472, vBaseEnvHwRegionSize=3145728, vBaseEnvHwRegionType=ROM
            PFlash5_Cached: vBaseEnvHwRegionStartAddress=2163212288, vBaseEnvHwRegionSize=1048576, vBaseEnvHwRegionType=ROM
            PFlash5_NonCached: vBaseEnvHwRegionStartAddress=2700083200, vBaseEnvHwRegionSize=1048576, vBaseEnvHwRegionType=ROM
            LMU0_Cached: vBaseEnvHwRegionStartAddress=2416181248, vBaseEnvHwRegionSize=262144, vBaseEnvHwRegionType=RAM
            LMU0_NonCached: vBaseEnvHwRegionStartAddress=2953052160, vBaseEnvHwRegionSize=262144, vBaseEnvHwRegionType=RAM
            LMU1_Cached: vBaseEnvHwRegionStartAddress=2416443392, vBaseEnvHwRegionSize=262144, vBaseEnvHwRegionType=RAM
            LMU1_NonCached: vBaseEnvHwRegionStartAddress=2953314304, vBaseEnvHwRegionSize=262144, vBaseEnvHwRegionType=RAM
            LMU2_Cached: vBaseEnvHwRegionStartAddress=2416705536, vBaseEnvHwRegionSize=262144, vBaseEnvHwRegionType=RAM
            LMU2_NonCached: vBaseEnvHwRegionStartAddress=2953576448, vBaseEnvHwRegionSize=262144, vBaseEnvHwRegionType=RAM
            BMHD0: vBaseEnvHwRegionStartAddress=2940207104, vBaseEnvHwRegionSize=512, vBaseEnvHwRegionType=ROM
            BMHD1: vBaseEnvHwRegionStartAddress=2940207616, vBaseEnvHwRegionSize=512, vBaseEnvHwRegionType=ROM
            BMHD2: vBaseEnvHwRegionStartAddress=2940208128, vBaseEnvHwRegionSize=512, vBaseEnvHwRegionType=ROM
            BMHD3: vBaseEnvHwRegionStartAddress=2940208640, vBaseEnvHwRegionSize=512, vBaseEnvHwRegionType=ROM

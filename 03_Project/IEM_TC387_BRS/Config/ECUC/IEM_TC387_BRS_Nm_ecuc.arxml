AUTOSAR XML (schema 4-2-2)
package /ActiveEcuC
  module config Nm: implementation-config-variant=VARIANT-PRE-COMPILE, module-description=Nm_Impl
    NmGlobalConfig
      NmGlobalFeatures:
        NmBusSynchronizationEnabled = false
        NmComControlEnabled = false
        NmNodeDetectionEnabled = true
        NmNodeIdEnabled = true
        NmPduRxIndicationEnabled = true
        NmRemoteSleepIndEnabled = false
        NmRepeatMsgIndEnabled = false
        NmStateChangeIndEnabled = false
        NmUserDataEnabled = true
        NmCarWakeUpRxEnabled = false
        NmComUserDataSupport = true
        NmCoordinatorSupportEnabled = false
        NmMacroLayerEnabled = false
        NmCoordinatorSyncSupport = false
        NmRuntimeMeasurementSupport = false
        NmCoordinatorRequestChannelsInBusSleep = false
        NmCoordinatorPassiveStartUpForwarding = false
      NmGeneration:
        NmOutOfBoundsWriteSanitizer = false
        NmOutOfBoundsReadSanitizer = false
        NmShortSymbols = false
        NmInterfacesForDeactivatedData = false
        NmReferringKeysInComments = false
      NmGlobalProperties: NmDevErrorDetect=true, NmVersionInfoApi=false, NmSafeBswChecks=false
      NmGlobalConstants
    PropulsionCAN_IEM_19020f5a (NmChannelConfig):
      NmChannelSleepMaster = false
      NmPassiveModeEnabled = false
      NmSynchronizingNetwork = false
      NmChannelId = 0
      NmStateReportEnabled = false
      NmComMChannelRef = PropulsionCAN_IEM_19020f5a
      PropulsionCanNmCluster_99dff440 (NmBusType)
        NmStandardBusNmConfig: NmStandardBusType=NM_BUSNM_CANNM  # PropulsionCanNmCluster

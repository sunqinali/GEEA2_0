AUTOSAR XML (schema 00048)
package /ActiveEcuC
  module config CanTrcv: implementation-config-variant=VARIANT-PRE-COMPILE, module-description=CanTrcv_Impl
    CanTrcvGeneral:
      CanTrcvTimerType = None
      CanTrcvWaitTime = 220
      CanTrcvDevErrorDetect = true
      CanTrcvGetVersionInfo = false
      CanTrcvWakeUpSupport = CANTRCV_WAKEUP_BY_POLLING
      CanTrcvIndex = 0
      CanTrcvMainFunctionPeriod = 0.005
      CanTrcvSafeBswChecks = false
    CanTrcvConfigSet: CanTrcvSPICommRetries=5, CanTrcvSPICommTimeout=100
      CanTrcvChannel_Tja1145 (CanTrcvChannel):
        CanTrcvInitState = CANTRCV_OP_MODE_NORMAL
        CanTrcvChannelId = 0
        CanTrcvChannelUsed = true
        CanTrcvControlsPowerSupply = true
        CanTrcvHwPnSupport = true
        CanTrcvMaxBaudrate = 1000
        CanTrcvWakeupByBusUsed = false
        CanTrcvEnablePNMD = true
        CanTrcvFdTolerance = false
        CanTrcvWakeupSourceRef = ECUM_WKSOURCE_POWER
        CanTrcvPorWakeupSourceRef = ECUM_WKSOURCE_POWER
        CanTrcvSyserrWakeupSourceRef = ECUM_WKSOURCE_EXTERNAL_WDG
        CanTrcvPartialNetwork:
          CanTrcvBusErrFlag = false
          CanTrcvBaudRate = 500
          CanTrcvPnCanIdIsExtended = false
          CanTrcvPnEnabled = false
          CanTrcvPnFrameCanId = 0
          CanTrcvPnFrameCanIdMask = 0
          CanTrcvPnFrameDlc = 8
          CanTrcvPowerOnFlag = true
        CanTrcvAccess
          CanTrcvSpiSequence:
            CanTrcvSpiAccessSynchronous = false
            CanTrcvSpiSequenceName = SpiSequence_TJA1145_L
            CanTrcvSpiSequenceName = SpiSequence_TJA1145_M
            CanTrcvSpiSequenceName = SpiSequence_TJA1145_N
            3 x CanTrcvSpiSequenceAccess, all with CanTrcvSpiAccessSynchronous=true:
              SeqRWDataLarge: CanTrcvSpiSequenceIdentifier=SeqRWDataLarge, CanTrcvSpiSequenceName=SpiSequence_TJA1145_L
              SeqRWDataMedium: CanTrcvSpiSequenceIdentifier=SeqRWDataMedium, CanTrcvSpiSequenceName=SpiSequence_TJA1145_M
              SeqRWDataNormal: CanTrcvSpiSequenceIdentifier=SeqRWDataNormal, CanTrcvSpiSequenceName=SpiSequence_TJA1145_N

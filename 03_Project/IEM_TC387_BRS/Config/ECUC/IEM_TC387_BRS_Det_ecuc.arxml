AUTOSAR XML (schema 4-2-2)
package /ActiveEcuC
  module config Det: implementation-config-variant=VARIANT-PRE-COMPILE, module-description=Det_Impl
    DetGeneral:
      DetVersionInfoApi = false
      DetEnableDet = true
      DetExtDebugSupport = true
      DetGlobalFilterSize = 0
      DetBreakFilterSize = 0
      DetLogBufferSize = 8
      DetReportErrorRecursionLimit = 0
      DetReportRuntimeErrorRecursionLimit = 0
      DetReportTransientFaultRecursionLimit = 0
      DetDltFilterSize = 0
    DetNotification: DetErrorHook=Appl_Det_ErrorHook

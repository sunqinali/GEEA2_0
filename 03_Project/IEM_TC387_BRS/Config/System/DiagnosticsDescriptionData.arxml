[part 2 of 4: package /InitialEcuC]
AUTOSAR XML (schema 00045)
package /InitialEcuC  (continued)
  module config Dcm: module-description=Dcm_Impl  (continued)
    DcmConfigSet  (continued)
      DcmDsp: DcmDspMaxDidToRead=5  (continued)
        DID_F1AE_ECU_Software_Part_Numbers_Geely_DID_F1AE_1_Total_number_of_ECU_Software_Part_Numbers (DcmDspData):
          DcmDspDataSize = 8
          DcmDspDataType = UINT8
          DcmDspDataInfoRef = DataInfo_DID_F1AE_ECU_Software_Part_Numbers_Geely_DID_F1AE_1_Total_number_of_ECU_Software_Part_Numbers
        DataInfo_DID_F1AE_ECU_Software_Part_Numbers_Geely_DID_F1AE_1_Total_number_of_ECU_Software_Part_Numbers (DcmDspDataInfo): DcmDspDataFixedLength=true
        DID_F1AE_ECU_Software_Part_Numbers_Geely_BCD_part (DcmDspData): DcmDspDataSize=40, DcmDspDataType=UINT8_N, DcmDspDataInfoRef=DataInfo_DID_F1AE_ECU_Software_Part_Numbers_Geely_BCD_part
        DataInfo_DID_F1AE_ECU_Software_Part_Numbers_Geely_BCD_part (DcmDspDataInfo): DcmDspDataFixedLength=true
        DID_F1AE_ECU_Software_Part_Numbers_Geely_ASCII_part (DcmDspData): DcmDspDataSize=24, DcmDspDataType=UINT8_N, DcmDspDataInfoRef=DataInfo_DID_F1AE_ECU_Software_Part_Numbers_Geely_ASCII_part
        DataInfo_DID_F1AE_ECU_Software_Part_Numbers_Geely_ASCII_part (DcmDspDataInfo): DcmDspDataFixedLength=true
        DID_F1AF_ECU_Software_Extended_Part_Numbers_Geely_DID_F1AF_1_Total_number_of_ECU_Software_Part_Numbers (DcmDspData):
          DcmDspDataSize = 8
          DcmDspDataType = UINT8
          DcmDspDataInfoRef = DataInfo_DID_F1AF_ECU_Software_Extended_Part_Numbers_Geely_DID_F1AF_1_Total_number_of_ECU_Software_Part_Numbers
        DataInfo_DID_F1AF_ECU_Software_Extended_Part_Numbers_Geely_DID_F1AF_1_Total_number_of_ECU_Software_Part_Numbers (DcmDspDataInfo): DcmDspDataFixedLength=true
        DID_F1AF_ECU_Software_Extended_Part_Numbers_Geely_BCD_part (DcmDspData): DcmDspDataSize=40, DcmDspDataType=UINT8_N, DcmDspDataInfoRef=DataInfo_DID_F1AF_ECU_Software_Extended_Part_Numbers_Geely_BCD_part
        DataInfo_DID_F1AF_ECU_Software_Extended_Part_Numbers_Geely_BCD_part (DcmDspDataInfo): DcmDspDataFixedLength=true
        DID_F1AF_ECU_Software_Extended_Part_Numbers_Geely_ASCII_part (DcmDspData): DcmDspDataSize=24, DcmDspDataType=UINT8_N, DcmDspDataInfoRef=DataInfo_DID_F1AF_ECU_Software_Extended_Part_Numbers_Geely_ASCII_part
        DataInfo_DID_F1AF_ECU_Software_Extended_Part_Numbers_Geely_ASCII_part (DcmDspDataInfo): DcmDspDataFixedLength=true
        DID_F1AF_ECU_Software_Extended_Part_Numbers_Geely_BCD_part_001 (DcmDspData): DcmDspDataSize=40, DcmDspDataType=UINT8_N, DcmDspDataInfoRef=DataInfo_DID_F1AF_ECU_Software_Extended_Part_Numbers_Geely_BCD_part_001
        DataInfo_DID_F1AF_ECU_Software_Extended_Part_Numbers_Geely_BCD_part_001 (DcmDspDataInfo): DcmDspDataFixedLength=true
        DID_F1AF_ECU_Software_Extended_Part_Numbers_Geely_ASCII_part_001 (DcmDspData): DcmDspDataSize=24, DcmDspDataType=UINT8_N, DcmDspDataInfoRef=DataInfo_DID_F1AF_ECU_Software_Extended_Part_Numbers_Geely_ASCII_part_001
        DataInfo_DID_F1AF_ECU_Software_Extended_Part_Numbers_Geely_ASCII_part_001 (DcmDspDataInfo): DcmDspDataFixedLength=true
        DID_F1AF_ECU_Software_Extended_Part_Numbers_Geely_BCD_part_002 (DcmDspData): DcmDspDataSize=40, DcmDspDataType=UINT8_N, DcmDspDataInfoRef=DataInfo_DID_F1AF_ECU_Software_Extended_Part_Numbers_Geely_BCD_part_002
        DataInfo_DID_F1AF_ECU_Software_Extended_Part_Numbers_Geely_BCD_part_002 (DcmDspDataInfo): DcmDspDataFixedLength=true
        DID_F1AF_ECU_Software_Extended_Part_Numbers_Geely_ASCII_part_002 (DcmDspData): DcmDspDataSize=24, DcmDspDataType=UINT8_N, DcmDspDataInfoRef=DataInfo_DID_F1AF_ECU_Software_Extended_Part_Numbers_Geely_ASCII_part_002
        DataInfo_DID_F1AF_ECU_Software_Extended_Part_Numbers_Geely_ASCII_part_002 (DcmDspDataInfo): DcmDspDataFixedLength=true
        DID_F1AF_ECU_Software_Extended_Part_Numbers_Geely_BCD_part_003 (DcmDspData): DcmDspDataSize=40, DcmDspDataType=UINT8_N, DcmDspDataInfoRef=DataInfo_DID_F1AF_ECU_Software_Extended_Part_Numbers_Geely_BCD_part_003
        DataInfo_DID_F1AF_ECU_Software_Extended_Part_Numbers_Geely_BCD_part_003 (DcmDspDataInfo): DcmDspDataFixedLength=true
        DID_F1AF_ECU_Software_Extended_Part_Numbers_Geely_ASCII_part_003 (DcmDspData): DcmDspDataSize=24, DcmDspDataType=UINT8_N, DcmDspDataInfoRef=DataInfo_DID_F1AF_ECU_Software_Extended_Part_Numbers_Geely_ASCII_part_003
        DataInfo_DID_F1AF_ECU_Software_Extended_Part_Numbers_Geely_ASCII_part_003 (DcmDspDataInfo): DcmDspDataFixedLength=true
        96 x DcmDspDid:
          DID_40E0_Secret_Key_Immobilizer_Target_3: DcmDspDidIdentifier=16607, DcmDspDidInfoRef=DidInfo_DID_40E0_Secret_Key_Immobilizer_Target_3
            DID_40DF_Secret_Key_Immobilizer_Target_2 (DcmDspDidSignal): DcmDspDidDataPos=0, DcmDspDidDataRef=DID_40E0_Secret_Key_Immobilizer_Target_3_DID_40DF_Secret_Key_Immobilizer_Target_2
          DID_D003_Vehicle_Speed: DcmDspDidIdentifier=53251, DcmDspDidInfoRef=DidInfo_DID_D003_Vehicle_Speed
            DID_D003_Vehicle_Speed (DcmDspDidSignal): DcmDspDidDataPos=0, DcmDspDidDataRef=DID_D003_Vehicle_Speed_DID_D003_Vehicle_Speed
          DID_D005_High_Quiescent_Current_Fault_Identification_Data: DcmDspDidIdentifier=53253, DcmDspDidInfoRef=DidInfo_DID_D005_High_Quiescent_Current_Fault_Identification_Data
            85 x DcmDspDidSignal:
              DID_D005_1_1st_System_Global_Time_the_time_when_the_DID_is_triggered: DcmDspDidDataPos=0, DcmDspDidDataRef=DID_D005_High_Quiescent_Current_Fault_Identification_Data_DID_D005_1_1st_System_Global_Time_the_time_when_the_DID_is_triggered
              DID_D005_2_1st_Global_time_when_Functionality_Activity_level_Sleep_in_the_ECU: DcmDspDidDataPos=32, DcmDspDidDataRef=DID_D005_High_Quiescent_Current_Fault_Identification_Data_DID_D005_2_1st_Global_time_when_Functionality_Activity_level_Sa38038bb
              D005_1st_Functionality_Activity_Level_PNC24: DcmDspDidDataPos=64, DcmDspDidDataRef=DID_D005_High_Quiescent_Current_Fault_Identification_Data_D005_1st_Functionality_Activity_Level_PNC24
              D005_1st_Functionality_Activity_Level_PNC25: DcmDspDidDataPos=72, DcmDspDidDataRef=DID_D005_High_Quiescent_Current_Fault_Identification_Data_D005_1st_Functionality_Activity_Level_PNC25
              D005_1st_Functionality_Activity_Level_PNC26: DcmDspDidDataPos=80, DcmDspDidDataRef=DID_D005_High_Quiescent_Current_Fault_Identification_Data_D005_1st_Functionality_Activity_Level_PNC26
              D005_1st_Functionality_Activity_Level_PNC27: DcmDspDidDataPos=88, DcmDspDidDataRef=DID_D005_High_Quiescent_Current_Fault_Identification_Data_D005_1st_Functionality_Activity_Level_PNC27
              D005_1st_Functionality_Activity_Level_PNC29: DcmDspDidDataPos=96, DcmDspDidDataRef=DID_D005_High_Quiescent_Current_Fault_Identification_Data_D005_1st_Functionality_Activity_Level_PNC29
              D005_1st_Functionality_Activity_Level_PNC30: DcmDspDidDataPos=104, DcmDspDidDataRef=DID_D005_High_Quiescent_Current_Fault_Identification_Data_D005_1st_Functionality_Activity_Level_PNC30
              D005_1st_Functionality_Activity_Level_PNC35: DcmDspDidDataPos=112, DcmDspDidDataRef=DID_D005_High_Quiescent_Current_Fault_Identification_Data_D005_1st_Functionality_Activity_Level_PNC35
              D005_1st_Functionality_Activity_Level_PNC39: DcmDspDidDataPos=120, DcmDspDidDataRef=DID_D005_High_Quiescent_Current_Fault_Identification_Data_D005_1st_Functionality_Activity_Level_PNC39
              Reserved_PNC_1st: DcmDspDidDataPos=128, DcmDspDidDataRef=DID_D005_High_Quiescent_Current_Fault_Identification_Data_Reserved_PNC_1st
              Functionality_Activity_Level_Detect_CPSR_Keep_Active_1st: DcmDspDidDataPos=184, DcmDspDidDataRef=DID_D005_High_Quiescent_Current_Fault_Identification_Data_Functionality_Activity_Level_Detect_CPSR_Keep_Active_1st
              Functionality_Activity_Level_Detect_Motor_Speed_Abnormal_1st: DcmDspDidDataPos=192, DcmDspDidDataRef=DID_D005_High_Quiescent_Current_Fault_Identification_Data_Functionality_Activity_Level_Detect_Motor_Speed_Abnormal_1st
              Functionality_Activity_Level_Detect_DC_Bus_voltage_Abnormal_1st: DcmDspDidDataPos=200, DcmDspDidDataRef=DID_D005_High_Quiescent_Current_Fault_Identification_Data_Functionality_Activity_Level_Detect_DC_Bus_voltage_Abnormal_1st
              Reserved_Data_Field_1st: DcmDspDidDataPos=208, DcmDspDidDataRef=DID_D005_High_Quiescent_Current_Fault_Identification_Data_Reserved_Data_Field_1st
              Bitfield_1th: DcmDspDidDataPos=384, DcmDspDidDataRef=DID_D005_High_Quiescent_Current_Fault_Identification_Data_Bitfield_1th
              DID_D005_1st_Usage_Mode_when_DID_is_triggered: DcmDspDidDataPos=392, DcmDspDidDataRef=DID_D005_High_Quiescent_Current_Fault_Identification_Data_DID_D005_1st_Usage_Mode_when_DID_is_triggered
              DID_D005_2st_System_Global_Time_the_time_when_the_DID_is_triggered: DcmDspDidDataPos=400, DcmDspDidDataRef=DID_D005_High_Quiescent_Current_Fault_Identification_Data_DID_D005_2st_System_Global_Time_the_time_when_the_DID_is_triggered
              DID_D005_2st_Global_time_when_Functionality_Activity_level_Sleep_in_the_ECU: DcmDspDidDataPos=432, DcmDspDidDataRef=DID_D005_High_Quiescent_Current_Fault_Identification_Data_DID_D005_2st_Global_time_when_Functionality_Activity_level_Sleb7289ace
              D005_2st_Functionality_Activity_Level_PNC24: DcmDspDidDataPos=464, DcmDspDidDataRef=DID_D005_High_Quiescent_Current_Fault_Identification_Data_D005_2st_Functionality_Activity_Level_PNC24
              D005_2st_Functionality_Activity_Level_PNC25: DcmDspDidDataPos=472, DcmDspDidDataRef=DID_D005_High_Quiescent_Current_Fault_Identification_Data_D005_2st_Functionality_Activity_Level_PNC25
              D005_2st_Functionality_Activity_Level_PNC26: DcmDspDidDataPos=480, DcmDspDidDataRef=DID_D005_High_Quiescent_Current_Fault_Identification_Data_D005_2st_Functionality_Activity_Level_PNC26
              D005_2st_Functionality_Activity_Level_PNC27: DcmDspDidDataPos=488, DcmDspDidDataRef=DID_D005_High_Quiescent_Current_Fault_Identification_Data_D005_2st_Functionality_Activity_Level_PNC27
              D005_2st_Functionality_Activity_Level_PNC29: DcmDspDidDataPos=496, DcmDspDidDataRef=DID_D005_High_Quiescent_Current_Fault_Identification_Data_D005_2st_Functionality_Activity_Level_PNC29
              D005_2st_Functionality_Activity_Level_PNC30: DcmDspDidDataPos=504, DcmDspDidDataRef=DID_D005_High_Quiescent_Current_Fault_Identification_Data_D005_2st_Functionality_Activity_Level_PNC30
              D005_2st_Functionality_Activity_Level_PNC35: DcmDspDidDataPos=512, DcmDspDidDataRef=DID_D005_High_Quiescent_Current_Fault_Identification_Data_D005_2st_Functionality_Activity_Level_PNC35
              D005_2st_Functionality_Activity_Level_PNC39: DcmDspDidDataPos=520, DcmDspDidDataRef=DID_D005_High_Quiescent_Current_Fault_Identification_Data_D005_2st_Functionality_Activity_Level_PNC39
              Reserved_PNC_2st: DcmDspDidDataPos=528, DcmDspDidDataRef=DID_D005_High_Quiescent_Current_Fault_Identification_Data_Reserved_PNC_2st
              Functionality_Activity_Level_Detect_CPSR_Keep_Active_2st: DcmDspDidDataPos=584, DcmDspDidDataRef=DID_D005_High_Quiescent_Current_Fault_Identification_Data_Functionality_Activity_Level_Detect_CPSR_Keep_Active_2st
              Functionality_Activity_Level_Detect_Motor_Speed_Abnormal_2st: DcmDspDidDataPos=592, DcmDspDidDataRef=DID_D005_High_Quiescent_Current_Fault_Identification_Data_Functionality_Activity_Level_Detect_Motor_Speed_Abnormal_2st
              Functionality_Activity_Level_Detect_DC_Bus_voltage_Abnormal_2st: DcmDspDidDataPos=600, DcmDspDidDataRef=DID_D005_High_Quiescent_Current_Fault_Identification_Data_Functionality_Activity_Level_Detect_DC_Bus_voltage_Abnormal_2st
              Reserved_Data_Field_2st: DcmDspDidDataPos=608, DcmDspDidDataRef=DID_D005_High_Quiescent_Current_Fault_Identification_Data_Reserved_Data_Field_2st
              Bitfield_2th: DcmDspDidDataPos=784, DcmDspDidDataRef=DID_D005_High_Quiescent_Current_Fault_Identification_Data_Bitfield_2th
              DID_D005_2st_Usage_Mode_when_DID_is_triggered: DcmDspDidDataPos=792, DcmDspDidDataRef=DID_D005_High_Quiescent_Current_Fault_Identification_Data_DID_D005_2st_Usage_Mode_when_DID_is_triggered
              DID_D005_3st_System_Global_Time_the_time_when_the_DID_is_triggered: DcmDspDidDataPos=800, DcmDspDidDataRef=DID_D005_High_Quiescent_Current_Fault_Identification_Data_DID_D005_3st_System_Global_Time_the_time_when_the_DID_is_triggered
              DID_D005_3st_Global_time_when_Functionality_Activity_level_Sleep_in_the_ECU: DcmDspDidDataPos=832, DcmDspDidDataRef=DID_D005_High_Quiescent_Current_Fault_Identification_Data_DID_D005_3st_Global_time_when_Functionality_Activity_level_Slefec137d1
              D005_3st_Functionality_Activity_Level_PNC24: DcmDspDidDataPos=864, DcmDspDidDataRef=DID_D005_High_Quiescent_Current_Fault_Identification_Data_D005_3st_Functionality_Activity_Level_PNC24
              D005_3st_Functionality_Activity_Level_PNC25: DcmDspDidDataPos=872, DcmDspDidDataRef=DID_D005_High_Quiescent_Current_Fault_Identification_Data_D005_3st_Functionality_Activity_Level_PNC25
              D005_3st_Functionality_Activity_Level_PNC26: DcmDspDidDataPos=880, DcmDspDidDataRef=DID_D005_High_Quiescent_Current_Fault_Identification_Data_D005_3st_Functionality_Activity_Level_PNC26
              D005_3st_Functionality_Activity_Level_PNC27: DcmDspDidDataPos=888, DcmDspDidDataRef=DID_D005_High_Quiescent_Current_Fault_Identification_Data_D005_3st_Functionality_Activity_Level_PNC27
              D005_3st_Functionality_Activity_Level_PNC29: DcmDspDidDataPos=896, DcmDspDidDataRef=DID_D005_High_Quiescent_Current_Fault_Identification_Data_D005_3st_Functionality_Activity_Level_PNC29
              D005_3st_Functionality_Activity_Level_PNC30: DcmDspDidDataPos=904, DcmDspDidDataRef=DID_D005_High_Quiescent_Current_Fault_Identification_Data_D005_3st_Functionality_Activity_Level_PNC30
              D005_3st_Functionality_Activity_Level_PNC35: DcmDspDidDataPos=912, DcmDspDidDataRef=DID_D005_High_Quiescent_Current_Fault_Identification_Data_D005_3st_Functionality_Activity_Level_PNC35
              D005_3st_Functionality_Activity_Level_PNC39: DcmDspDidDataPos=920, DcmDspDidDataRef=DID_D005_High_Quiescent_Current_Fault_Identification_Data_D005_3st_Functionality_Activity_Level_PNC39
              Reserved_PNC_3st: DcmDspDidDataPos=928, DcmDspDidDataRef=DID_D005_High_Quiescent_Current_Fault_Identification_Data_Reserved_PNC_3st
              Functionality_Activity_Level_Detect_CPSR_Keep_Active_3st: DcmDspDidDataPos=984, DcmDspDidDataRef=DID_D005_High_Quiescent_Current_Fault_Identification_Data_Functionality_Activity_Level_Detect_CPSR_Keep_Active_3st
              Functionality_Activity_Level_Detect_Motor_Speed_Abnormal_3st: DcmDspDidDataPos=992, DcmDspDidDataRef=DID_D005_High_Quiescent_Current_Fault_Identification_Data_Functionality_Activity_Level_Detect_Motor_Speed_Abnormal_3st
              Functionality_Activity_Level_Detect_DC_Bus_voltage_Abnormal3st: DcmDspDidDataPos=1000, DcmDspDidDataRef=DID_D005_High_Quiescent_Current_Fault_Identification_Data_Functionality_Activity_Level_Detect_DC_Bus_voltage_Abnormal3st
              Reserved_Data_Field_3st: DcmDspDidDataPos=1008, DcmDspDidDataRef=DID_D005_High_Quiescent_Current_Fault_Identification_Data_Reserved_Data_Field_3st
              Bitfield_3th: DcmDspDidDataPos=1184, DcmDspDidDataRef=DID_D005_High_Quiescent_Current_Fault_Identification_Data_Bitfield_3th
              DID_D005_3st_Usage_Mode_when_DID_is_triggered: DcmDspDidDataPos=1192, DcmDspDidDataRef=DID_D005_High_Quiescent_Current_Fault_Identification_Data_DID_D005_3st_Usage_Mode_when_DID_is_triggered
              DID_D005_4st_System_Global_Time_the_time_when_the_DID_is_triggered: DcmDspDidDataPos=1200, DcmDspDidDataRef=DID_D005_High_Quiescent_Current_Fault_Identification_Data_DID_D005_4st_System_Global_Time_the_time_when_the_DID_is_triggered
              DID_D005_4st_Global_time_when_Functionality_Activity_level_Sleep_in_the_ECU: DcmDspDidDataPos=1232, DcmDspDidDataRef=DID_D005_High_Quiescent_Current_Fault_Identification_Data_DID_D005_4st_Global_time_when_Functionality_Activity_level_Sled82c72cd
              D005_4st_Functionality_Activity_Level_PNC24: DcmDspDidDataPos=1264, DcmDspDidDataRef=DID_D005_High_Quiescent_Current_Fault_Identification_Data_D005_4st_Functionality_Activity_Level_PNC24
              D005_4st_Functionality_Activity_Level_PNC25: DcmDspDidDataPos=1272, DcmDspDidDataRef=DID_D005_High_Quiescent_Current_Fault_Identification_Data_D005_4st_Functionality_Activity_Level_PNC25
              D005_4st_Functionality_Activity_Level_PNC26: DcmDspDidDataPos=1280, DcmDspDidDataRef=DID_D005_High_Quiescent_Current_Fault_Identification_Data_D005_4st_Functionality_Activity_Level_PNC26
              D005_4st_Functionality_Activity_Level_PNC27: DcmDspDidDataPos=1288, DcmDspDidDataRef=DID_D005_High_Quiescent_Current_Fault_Identification_Data_D005_4st_Functionality_Activity_Level_PNC27
              D005_4st_Functionality_Activity_Level_PNC29: DcmDspDidDataPos=1296, DcmDspDidDataRef=DID_D005_High_Quiescent_Current_Fault_Identification_Data_D005_4st_Functionality_Activity_Level_PNC29
              D005_4st_Functionality_Activity_Level_PNC30: DcmDspDidDataPos=1304, DcmDspDidDataRef=DID_D005_High_Quiescent_Current_Fault_Identification_Data_D005_4st_Functionality_Activity_Level_PNC30
              D005_4st_Functionality_Activity_Level_PNC35: DcmDspDidDataPos=1312, DcmDspDidDataRef=DID_D005_High_Quiescent_Current_Fault_Identification_Data_D005_4st_Functionality_Activity_Level_PNC35
              D005_4st_Functionality_Activity_Level_PNC39: DcmDspDidDataPos=1320, DcmDspDidDataRef=DID_D005_High_Quiescent_Current_Fault_Identification_Data_D005_4st_Functionality_Activity_Level_PNC39
              Reserved_PNC_4st: DcmDspDidDataPos=1328, DcmDspDidDataRef=DID_D005_High_Quiescent_Current_Fault_Identification_Data_Reserved_PNC_4st
              Functionality_Activity_Level_Detect_CPSR_Keep_Active_4st: DcmDspDidDataPos=1384, DcmDspDidDataRef=DID_D005_High_Quiescent_Current_Fault_Identification_Data_Functionality_Activity_Level_Detect_CPSR_Keep_Active_4st
              Functionality_Activity_Level_Detect_Motor_Speed_Abnormal_4st: DcmDspDidDataPos=1392, DcmDspDidDataRef=DID_D005_High_Quiescent_Current_Fault_Identification_Data_Functionality_Activity_Level_Detect_Motor_Speed_Abnormal_4st
              Functionality_Activity_Level_Detect_DC_Bus_voltage_Abnormal_4st: DcmDspDidDataPos=1400, DcmDspDidDataRef=DID_D005_High_Quiescent_Current_Fault_Identification_Data_Functionality_Activity_Level_Detect_DC_Bus_voltage_Abnormal_4st
              Reserved_Data_Field_4st: DcmDspDidDataPos=1408, DcmDspDidDataRef=DID_D005_High_Quiescent_Current_Fault_Identification_Data_Reserved_Data_Field_4st
              Bitfield_4th: DcmDspDidDataPos=1584, DcmDspDidDataRef=DID_D005_High_Quiescent_Current_Fault_Identification_Data_Bitfield_4th
              DID_D005_4st_Usage_Mode_when_DID_is_triggered: DcmDspDidDataPos=1592, DcmDspDidDataRef=DID_D005_High_Quiescent_Current_Fault_Identification_Data_DID_D005_4st_Usage_Mode_when_DID_is_triggered
              DID_D005_5st_System_Global_Time_the_time_when_the_DID_is_triggered: DcmDspDidDataPos=1600, DcmDspDidDataRef=DID_D005_High_Quiescent_Current_Fault_Identification_Data_DID_D005_5st_System_Global_Time_the_time_when_the_DID_is_triggered
              DID_D005_5st_Global_time_when_Functionality_Activity_level_Sleep_in_the_ECU: DcmDspDidDataPos=1632, DcmDspDidDataRef=DID_D005_High_Quiescent_Current_Fault_Identification_Data_DID_D005_5st_Global_time_when_Functionality_Activity_level_Sle91c5dfd2
              D005_5st_Functionality_Activity_Level_PNC24: DcmDspDidDataPos=1664, DcmDspDidDataRef=DID_D005_High_Quiescent_Current_Fault_Identification_Data_D005_5st_Functionality_Activity_Level_PNC24
              D005_5st_Functionality_Activity_Level_PNC25: DcmDspDidDataPos=1672, DcmDspDidDataRef=DID_D005_High_Quiescent_Current_Fault_Identification_Data_D005_5st_Functionality_Activity_Level_PNC25
              D005_5st_Functionality_Activity_Level_PNC26: DcmDspDidDataPos=1680, DcmDspDidDataRef=DID_D005_High_Quiescent_Current_Fault_Identification_Data_D005_5st_Functionality_Activity_Level_PNC26
              D005_5st_Functionality_Activity_Level_PNC27: DcmDspDidDataPos=1688, DcmDspDidDataRef=DID_D005_High_Quiescent_Current_Fault_Identification_Data_D005_5st_Functionality_Activity_Level_PNC27
              D005_5st_Functionality_Activity_Level_PNC29: DcmDspDidDataPos=1696, DcmDspDidDataRef=DID_D005_High_Quiescent_Current_Fault_Identification_Data_D005_5st_Functionality_Activity_Level_PNC29
              D005_5st_Functionality_Activity_Level_PNC30: DcmDspDidDataPos=1704, DcmDspDidDataRef=DID_D005_High_Quiescent_Current_Fault_Identification_Data_D005_5st_Functionality_Activity_Level_PNC30
              D005_5st_Functionality_Activity_Level_PNC35: DcmDspDidDataPos=1712, DcmDspDidDataRef=DID_D005_High_Quiescent_Current_Fault_Identification_Data_D005_5st_Functionality_Activity_Level_PNC35
              D005_5st_Functionality_Activity_Level_PNC39: DcmDspDidDataPos=1720, DcmDspDidDataRef=DID_D005_High_Quiescent_Current_Fault_Identification_Data_D005_5st_Functionality_Activity_Level_PNC39
              Reserved_PNC_5st: DcmDspDidDataPos=1728, DcmDspDidDataRef=DID_D005_High_Quiescent_Current_Fault_Identification_Data_Reserved_PNC_5st
              Functionality_Activity_Level_Detect_CPSR_Keep_Active_5st: DcmDspDidDataPos=1784, DcmDspDidDataRef=DID_D005_High_Quiescent_Current_Fault_Identification_Data_Functionality_Activity_Level_Detect_CPSR_Keep_Active_5st
              Functionality_Activity_Level_Detect_Motor_Speed_Abnormal_5st: DcmDspDidDataPos=1792, DcmDspDidDataRef=DID_D005_High_Quiescent_Current_Fault_Identification_Data_Functionality_Activity_Level_Detect_Motor_Speed_Abnormal_5st
              Functionality_Activity_Level_Detect_DC_Bus_voltage_Abnormal_5st: DcmDspDidDataPos=1800, DcmDspDidDataRef=DID_D005_High_Quiescent_Current_Fault_Identification_Data_Functionality_Activity_Level_Detect_DC_Bus_voltage_Abnormal_5st
              Reserved_Data_Field_5st: DcmDspDidDataPos=1808, DcmDspDidDataRef=DID_D005_High_Quiescent_Current_Fault_Identification_Data_Reserved_Data_Field_5st
              Bitfield_5th: DcmDspDidDataPos=1984, DcmDspDidDataRef=DID_D005_High_Quiescent_Current_Fault_Identification_Data_Bitfield_5th
              DID_D005_5st_Usage_Mode_when_DID_is_triggered: DcmDspDidDataPos=1992, DcmDspDidDataRef=DID_D005_High_Quiescent_Current_Fault_Identification_Data_DID_D005_5st_Usage_Mode_when_DID_is_triggered
          DID_D03A_swAuth_Public_Key_CheckSum: DcmDspDidIdentifier=53306, DcmDspDidInfoRef=DidInfo_DID_D03A_swAuth_Public_Key_CheckSum
            DID_D03A_swAuth_Public_Key_CheckSum (DcmDspDidSignal): DcmDspDidDataPos=0, DcmDspDidDataRef=DID_D03A_swAuth_Public_Key_CheckSum_DID_D03A_swAuth_Public_Key_CheckSum
          DID_D09A_High_Quiescent_Current_Function_Activation_Deactivation: DcmDspDidIdentifier=53402, DcmDspDidInfoRef=DidInfo_DID_D09A_High_Quiescent_Current_Function_Activation_Deactivation
            DID_D09A_High_Quiescent_Current_Function_ActivationDeactivation (DcmDspDidSignal):
              DcmDspDidDataPos = 0
              DcmDspDidDataRef = DID_D09A_High_Quiescent_Current_Function_Activation_Deactivation_DID_D09A_High_Quiescent_Current_Function_ActivationDeactivation
          DID_D0B5_SDB_version: DcmDspDidIdentifier=53429, DcmDspDidInfoRef=DidInfo_DID_D0B5_SDB_version
            SDB_version (DcmDspDidSignal): DcmDspDidDataPos=0, DcmDspDidDataRef=DID_D0B5_SDB_version_SDB_version
          DID_D12F_Security_Constant_Level_11_12: DcmDspDidIdentifier=53551, DcmDspDidInfoRef=DidInfo_DID_D12F_Security_Constant_Level_11_12
            DID_D12F_Security_Constant_Level_1112 (DcmDspDidSignal): DcmDspDidDataPos=0, DcmDspDidDataRef=DID_D12F_Security_Constant_Level_11_12_DID_D12F_Security_Constant_Level_1112
          DID_D134_Car_Mode: DcmDspDidIdentifier=53556, DcmDspDidInfoRef=DidInfo_DID_D134_Car_Mode
            DID_D134_Car_Mode (DcmDspDidSignal): DcmDspDidDataPos=0, DcmDspDidDataRef=DID_D134_Car_Mode_DID_D134_Car_Mode
          DID_D211_Network_Management_History_Propulsion_CAN: DcmDspDidIdentifier=53777, DcmDspDidInfoRef=DidInfo_DID_D211_Network_Management_History_Propulsion_CAN
            20 x DcmDspDidSignal:
              DID_D211_1_Latest_State_NM_History: DcmDspDidDataPos=0, DcmDspDidDataRef=DID_D211_Network_Management_History_Propulsion_CAN_DID_D211_1_Latest_State_NM_History
              DID_D211_2_Latest_State_Global_Real_Time: DcmDspDidDataPos=8, DcmDspDidDataRef=DID_D211_Network_Management_History_Propulsion_CAN_DID_D211_2_Latest_State_Global_Real_Time
              DID_D211_3_2nd_Latest_State_NM_History: DcmDspDidDataPos=40, DcmDspDidDataRef=DID_D211_Network_Management_History_Propulsion_CAN_DID_D211_3_2nd_Latest_State_NM_History
              DID_D211_4_2nd_Latest_State_Global_Real_Time: DcmDspDidDataPos=48, DcmDspDidDataRef=DID_D211_Network_Management_History_Propulsion_CAN_DID_D211_4_2nd_Latest_State_Global_Real_Time
              DID_D211_5_3rd_Latest_State_NM_History: DcmDspDidDataPos=80, DcmDspDidDataRef=DID_D211_Network_Management_History_Propulsion_CAN_DID_D211_5_3rd_Latest_State_NM_History
              DID_D211_6_3rd_Latest_State_Global_Real_Time: DcmDspDidDataPos=88, DcmDspDidDataRef=DID_D211_Network_Management_History_Propulsion_CAN_DID_D211_6_3rd_Latest_State_Global_Real_Time
              DID_D211_7_4th_Latest_State_NM_History: DcmDspDidDataPos=120, DcmDspDidDataRef=DID_D211_Network_Management_History_Propulsion_CAN_DID_D211_7_4th_Latest_State_NM_History
              DID_D211_8_4th_Latest_State_Global_Real_Time: DcmDspDidDataPos=128, DcmDspDidDataRef=DID_D211_Network_Management_History_Propulsion_CAN_DID_D211_8_4th_Latest_State_Global_Real_Time
              DID_D211_9_5th_Latest_State_NM_History: DcmDspDidDataPos=160, DcmDspDidDataRef=DID_D211_Network_Management_History_Propulsion_CAN_DID_D211_9_5th_Latest_State_NM_History
              DID_D211_10_5th_Latest_State_Global_Real_Time: DcmDspDidDataPos=168, DcmDspDidDataRef=DID_D211_Network_Management_History_Propulsion_CAN_DID_D211_10_5th_Latest_State_Global_Real_Time
              DID_D211_11_6th_Latest_State_NM_History: DcmDspDidDataPos=200, DcmDspDidDataRef=DID_D211_Network_Management_History_Propulsion_CAN_DID_D211_11_6th_Latest_State_NM_History
              DID_D211_12_6th_Latest_State_Global_Real_Time: DcmDspDidDataPos=208, DcmDspDidDataRef=DID_D211_Network_Management_History_Propulsion_CAN_DID_D211_12_6th_Latest_State_Global_Real_Time
              DID_D211_13_7th_Latest_State_NM_History: DcmDspDidDataPos=240, DcmDspDidDataRef=DID_D211_Network_Management_History_Propulsion_CAN_DID_D211_13_7th_Latest_State_NM_History
              DID_D211_14_7th_Latest_State_Global_Real_Time: DcmDspDidDataPos=248, DcmDspDidDataRef=DID_D211_Network_Management_History_Propulsion_CAN_DID_D211_14_7th_Latest_State_Global_Real_Time
              DID_D211_15_8th_Latest_State_NM_History: DcmDspDidDataPos=280, DcmDspDidDataRef=DID_D211_Network_Management_History_Propulsion_CAN_DID_D211_15_8th_Latest_State_NM_History
              DID_D211_16_8th_Latest_State_Global_Real_Time: DcmDspDidDataPos=288, DcmDspDidDataRef=DID_D211_Network_Management_History_Propulsion_CAN_DID_D211_16_8th_Latest_State_Global_Real_Time
              DID_D211_17_9th_Latest_State_NM_History: DcmDspDidDataPos=320, DcmDspDidDataRef=DID_D211_Network_Management_History_Propulsion_CAN_DID_D211_17_9th_Latest_State_NM_History
              DID_D211_18_9th_Latest_State_Global_Real_Time: DcmDspDidDataPos=328, DcmDspDidDataRef=DID_D211_Network_Management_History_Propulsion_CAN_DID_D211_18_9th_Latest_State_Global_Real_Time
              DID_D211_19_10th_Latest_State_NM_History: DcmDspDidDataPos=360, DcmDspDidDataRef=DID_D211_Network_Management_History_Propulsion_CAN_DID_D211_19_10th_Latest_State_NM_History
              DID_D211_20_10th_Latest_State_Global_Real_Time: DcmDspDidDataPos=368, DcmDspDidDataRef=DID_D211_Network_Management_History_Propulsion_CAN_DID_D211_20_10th_Latest_State_Global_Real_Time
          DID_DD00_Global_Real_Time: DcmDspDidIdentifier=56576, DcmDspDidInfoRef=DidInfo_DID_DD00_Global_Real_Time
            DID_DD00_Global_Real_Time (DcmDspDidSignal): DcmDspDidDataPos=0, DcmDspDidDataRef=DID_DD00_Global_Real_Time_DID_DD00_Global_Real_Time
          DID_DD01_Total_Distance: DcmDspDidIdentifier=56577, DcmDspDidInfoRef=DidInfo_DID_DD01_Total_Distance
            DID_DD01_Total_Distance (DcmDspDidSignal): DcmDspDidDataPos=0, DcmDspDidDataRef=DID_DD01_Total_Distance_DID_DD01_Total_Distance
          DID_DD02_Vehicle_Battery_Voltage: DcmDspDidIdentifier=56578, DcmDspDidInfoRef=DidInfo_DID_DD02_Vehicle_Battery_Voltage
            DID_DD02_Vehicle_Battery_Voltage (DcmDspDidSignal): DcmDspDidDataPos=0, DcmDspDidDataRef=DID_DD02_Vehicle_Battery_Voltage_DID_DD02_Vehicle_Battery_Voltage
          DID_DD0A_Usage_Mode: DcmDspDidIdentifier=56586, DcmDspDidInfoRef=DidInfo_DID_DD0A_Usage_Mode
            DID_DD0A_Usage_Mode (DcmDspDidSignal): DcmDspDidDataPos=0, DcmDspDidDataRef=DID_DD0A_Usage_Mode_DID_DD0A_Usage_Mode
          DID_DD0C_Electric_Power_Level: DcmDspDidIdentifier=56588, DcmDspDidInfoRef=DidInfo_DID_DD0C_Electric_Power_Level
            DID_DD0C_Electric_Power_Level (DcmDspDidSignal): DcmDspDidDataPos=0, DcmDspDidDataRef=DID_DD0C_Electric_Power_Level_DID_DD0C_Electric_Power_Level
          DID_E103_Car_Configuration_Parameter_Faults: DcmDspDidIdentifier=57603, DcmDspDidInfoRef=DidInfo_DID_E103_Car_Configuration_Parameter_Faults
            21 x DcmDspDidSignal:
              DID_E103_1_Number_of_invalid_car_configuration_parameter_values_recognised: DcmDspDidDataPos=0, DcmDspDidDataRef=DID_E103_Car_Configuration_Parameter_Faults_DID_E103_1_Number_of_invalid_car_configuration_parameter_values_recognised
              DID_E103_2_1st_parameter_number_of_the_car_configuration_data_that_is_invalid: DcmDspDidDataPos=8, DcmDspDidDataRef=DID_E103_Car_Configuration_Parameter_Faults_DID_E103_2_1st_parameter_number_of_the_car_configuration_data_that_is_invalid
              DID_E103_3_1st_parameter_invalid_value: DcmDspDidDataPos=24, DcmDspDidDataRef=DID_E103_Car_Configuration_Parameter_Faults_DID_E103_3_1st_parameter_invalid_value
              DID_E103_4_2nd_parameter_number_of_the_car_configuration_data_that_is_invalid: DcmDspDidDataPos=32, DcmDspDidDataRef=DID_E103_Car_Configuration_Parameter_Faults_DID_E103_4_2nd_parameter_number_of_the_car_configuration_data_that_is_invalid
              DID_E103_5_2nd_parameter_invalid_value: DcmDspDidDataPos=48, DcmDspDidDataRef=DID_E103_Car_Configuration_Parameter_Faults_DID_E103_5_2nd_parameter_invalid_value
              DID_E103_6_3rd_parameter_number_of_the_car_configuration_data_that_is_invalid: DcmDspDidDataPos=56, DcmDspDidDataRef=DID_E103_Car_Configuration_Parameter_Faults_DID_E103_6_3rd_parameter_number_of_the_car_configuration_data_that_is_invalid
              DID_E103_7_3rd_parameter_invalid_value: DcmDspDidDataPos=72, DcmDspDidDataRef=DID_E103_Car_Configuration_Parameter_Faults_DID_E103_7_3rd_parameter_invalid_value
              DID_E103_8_4th_parameter_number_of_the_car_configuration_data_that_is_invalid: DcmDspDidDataPos=80, DcmDspDidDataRef=DID_E103_Car_Configuration_Parameter_Faults_DID_E103_8_4th_parameter_number_of_the_car_configuration_data_that_is_invalid
              DID_E103_9_4th_parameter_invalid_value: DcmDspDidDataPos=96, DcmDspDidDataRef=DID_E103_Car_Configuration_Parameter_Faults_DID_E103_9_4th_parameter_invalid_value
              DID_E103_10_5th_parameter_number_of_the_car_configuration_data_that_is_invalid: DcmDspDidDataPos=104, DcmDspDidDataRef=DID_E103_Car_Configuration_Parameter_Faults_DID_E103_10_5th_parameter_number_of_the_car_configuration_data_that_is_invalid
              DID_E103_11_5th_parameter_invalid_value: DcmDspDidDataPos=120, DcmDspDidDataRef=DID_E103_Car_Configuration_Parameter_Faults_DID_E103_11_5th_parameter_invalid_value
              DID_E103_12_6th_parameter_number_of_the_car_configuration_data_that_is_invalid: DcmDspDidDataPos=128, DcmDspDidDataRef=DID_E103_Car_Configuration_Parameter_Faults_DID_E103_12_6th_parameter_number_of_the_car_configuration_data_that_is_invalid
              DID_E103_13_6th_parameter_invalid_value: DcmDspDidDataPos=144, DcmDspDidDataRef=DID_E103_Car_Configuration_Parameter_Faults_DID_E103_13_6th_parameter_invalid_value
              DID_E103_14_7th_parameter_number_of_the_car_configuration_data_that_is_invalid: DcmDspDidDataPos=152, DcmDspDidDataRef=DID_E103_Car_Configuration_Parameter_Faults_DID_E103_14_7th_parameter_number_of_the_car_configuration_data_that_is_invalid
              DID_E103_15_7th_parameter_invalid_value: DcmDspDidDataPos=168, DcmDspDidDataRef=DID_E103_Car_Configuration_Parameter_Faults_DID_E103_15_7th_parameter_invalid_value
              DID_E103_16_8th_parameter_number_of_the_car_configuration_data_that_is_invalid: DcmDspDidDataPos=176, DcmDspDidDataRef=DID_E103_Car_Configuration_Parameter_Faults_DID_E103_16_8th_parameter_number_of_the_car_configuration_data_that_is_invalid
              DID_E103_17_8th_parameter_invalid_value: DcmDspDidDataPos=192, DcmDspDidDataRef=DID_E103_Car_Configuration_Parameter_Faults_DID_E103_17_8th_parameter_invalid_value
              DID_E103_18_9th_parameter_number_of_the_car_configuration_data_that_is_invalid: DcmDspDidDataPos=200, DcmDspDidDataRef=DID_E103_Car_Configuration_Parameter_Faults_DID_E103_18_9th_parameter_number_of_the_car_configuration_data_that_is_invalid
              DID_E103_19_9th_parameter_invalid_value: DcmDspDidDataPos=216, DcmDspDidDataRef=DID_E103_Car_Configuration_Parameter_Faults_DID_E103_19_9th_parameter_invalid_value
              DID_E103_20_10th_parameter_number_of_the_car_configuration_data_that_is_invalid: DcmDspDidDataPos=224, DcmDspDidDataRef=DID_E103_Car_Configuration_Parameter_Faults_DID_E103_20_10th_parameter_number_of_the_car_configuration_data_that_is_invalid
              DID_E103_21_10th_parameter_invalid_value: DcmDspDidDataPos=240, DcmDspDidDataRef=DID_E103_Car_Configuration_Parameter_Faults_DID_E103_21_10th_parameter_invalid_value
          DID_E300_HVDC_Voltage: DcmDspDidIdentifier=58112, DcmDspDidInfoRef=DidInfo_DID_E300_HVDC_Voltage
            DID_E300_HVDC_Voltage (DcmDspDidSignal): DcmDspDidDataPos=0, DcmDspDidDataRef=DID_E300_HVDC_Voltage_DID_E300_HVDC_Voltage
          DID_E301_HVDC_Current: DcmDspDidIdentifier=58113, DcmDspDidInfoRef=DidInfo_DID_E301_HVDC_Current
            DID_E301_HVDC_Current_ (DcmDspDidSignal): DcmDspDidDataPos=0, DcmDspDidDataRef=DID_E301_HVDC_Current_DID_E301_HVDC_Current_
          DID_E303_Motor_Speed: DcmDspDidIdentifier=58115, DcmDspDidInfoRef=DidInfo_DID_E303_Motor_Speed
            DID_E303_Motor_Speed_ (DcmDspDidSignal): DcmDspDidDataPos=0, DcmDspDidDataRef=DID_E303_Motor_Speed_DID_E303_Motor_Speed_
          DID_E304_Actual_Torque: DcmDspDidIdentifier=58116, DcmDspDidInfoRef=DidInfo_DID_E304_Actual_Torque
            DID_E304_Actual_Torque (DcmDspDidSignal): DcmDspDidDataPos=0, DcmDspDidDataRef=DID_E304_Actual_Torque_DID_E304_Actual_Torque
          DID_E305_Inverter_IGBT_Junction_Temp: DcmDspDidIdentifier=58117, DcmDspDidInfoRef=DidInfo_DID_E305_Inverter_IGBT_Junction_Temp
            DID_E305_Inverter_IGBT_Junction_Temp (DcmDspDidSignal): DcmDspDidDataPos=0, DcmDspDidDataRef=DID_E305_Inverter_IGBT_Junction_Temp_DID_E305_Inverter_IGBT_Junction_Temp
          DID_E306_Motor_Temperature: DcmDspDidIdentifier=58118, DcmDspDidInfoRef=DidInfo_DID_E306_Motor_Temperature
            DID_E306_Motor_Temperature (DcmDspDidSignal): DcmDspDidDataPos=0, DcmDspDidDataRef=DID_E306_Motor_Temperature_DID_E306_Motor_Temperature
          DID_E307_System_Mode: DcmDspDidIdentifier=58119, DcmDspDidInfoRef=DidInfo_DID_E307_System_Mode
            DID_E307_System_Mode (DcmDspDidSignal): DcmDspDidDataPos=0, DcmDspDidDataRef=DID_E307_System_Mode_DID_E307_System_Mode
          DID_E308_ECM_Torque_Request: DcmDspDidIdentifier=58120, DcmDspDidInfoRef=DidInfo_DID_E308_ECM_Torque_Request
            DID_E308_ECM_Torque_Request (DcmDspDidSignal): DcmDspDidDataPos=0, DcmDspDidDataRef=DID_E308_ECM_Torque_Request_DID_E308_ECM_Torque_Request
          DID_E309_ECM_Mode_Request: DcmDspDidIdentifier=58121, DcmDspDidInfoRef=DidInfo_DID_E309_ECM_Mode_Request
            DID_E309_ECM_Mode_Request (DcmDspDidSignal): DcmDspDidDataPos=0, DcmDspDidDataRef=DID_E309_ECM_Mode_Request_DID_E309_ECM_Mode_Request
          DID_E310_IEM_MGM_Derating_Status: DcmDspDidIdentifier=58128, DcmDspDidInfoRef=DidInfo_DID_E310_IEM_MGM_Derating_Status
            DID_E310_IEMMGM_Derating_Status (DcmDspDidSignal): DcmDspDidDataPos=0, DcmDspDidDataRef=DID_E310_IEM_MGM_Derating_Status_DID_E310_IEMMGM_Derating_Status
          DID_E311_Crash_Status: DcmDspDidIdentifier=58129, DcmDspDidInfoRef=DidInfo_DID_E311_Crash_Status
            DID_E311_Crash_Status (DcmDspDidSignal): DcmDspDidDataPos=0, DcmDspDidDataRef=DID_E311_Crash_Status_DID_E311_Crash_Status
          DID_E312_Wheel_Speed: DcmDspDidIdentifier=58130, DcmDspDidInfoRef=DidInfo_DID_E312_Wheel_Speed
            DID_E312_Wheel_Speed (DcmDspDidSignal): DcmDspDidDataPos=0, DcmDspDidDataRef=DID_E312_Wheel_Speed_DID_E312_Wheel_Speed
          DID_E313_Active_discharge_status: DcmDspDidIdentifier=58131, DcmDspDidInfoRef=DidInfo_DID_E313_Active_discharge_status
            DID_E313_Active_discharge_status (DcmDspDidSignal): DcmDspDidDataPos=0, DcmDspDidDataRef=DID_E313_Active_discharge_status_DID_E313_Active_discharge_status
          DID_E314_Available_Torque_maximum: DcmDspDidIdentifier=58132, DcmDspDidInfoRef=DidInfo_DID_E314_Available_Torque_maximum
            DID_E314_Available_Torque_maximum (DcmDspDidSignal): DcmDspDidDataPos=0, DcmDspDidDataRef=DID_E314_Available_Torque_maximum_DID_E314_Available_Torque_maximum
          DID_E315_Available_Torque_minimum: DcmDspDidIdentifier=58133, DcmDspDidInfoRef=DidInfo_DID_E315_Available_Torque_minimum
            DID_E315_Available_Torque_minimum (DcmDspDidSignal): DcmDspDidDataPos=0, DcmDspDidDataRef=DID_E315_Available_Torque_minimum_DID_E315_Available_Torque_minimum
          DID_E319_Torque_Direction: DcmDspDidIdentifier=58137, DcmDspDidInfoRef=DidInfo_DID_E319_Torque_Direction
            DID_E319_Torque_Direction (DcmDspDidSignal): DcmDspDidDataPos=0, DcmDspDidDataRef=DID_E319_Torque_Direction_DID_E319_Torque_Direction
          DID_E320_System_Mode_Mismatch: DcmDspDidIdentifier=58144, DcmDspDidInfoRef=DidInfo_DID_E320_System_Mode_Mismatch
            DID_E320_System_Mode_Mismatch (DcmDspDidSignal): DcmDspDidDataPos=0, DcmDspDidDataRef=DID_E320_System_Mode_Mismatch_DID_E320_System_Mode_Mismatch
          DID_E324_Motor_Derating_reason_of_IEM_MGM: DcmDspDidIdentifier=58148, DcmDspDidInfoRef=DidInfo_DID_E324_Motor_Derating_reason_of_IEM_MGM
            DID_E324_Motor_Derating_reason_of_IEMMGM (DcmDspDidSignal): DcmDspDidDataPos=0, DcmDspDidDataRef=DID_E324_Motor_Derating_reason_of_IEM_MGM_DID_E324_Motor_Derating_reason_of_IEMMGM
          DID_E331_Software_Version: DcmDspDidIdentifier=58161, DcmDspDidInfoRef=DidInfo_DID_E331_Software_Version
            3 x DcmDspDidSignal:
              DID_E331_1_ASW_Software_Version: DcmDspDidDataPos=0, DcmDspDidDataRef=DID_E331_Software_Version_DID_E331_1_ASW_Software_Version
              DID_E331_2_BSW_Software_Version: DcmDspDidDataPos=64, DcmDspDidDataRef=DID_E331_Software_Version_DID_E331_2_BSW_Software_Version
              DID_E331_3_Calibration_Data_Software_Version: DcmDspDidDataPos=128, DcmDspDidDataRef=DID_E331_Software_Version_DID_E331_3_Calibration_Data_Software_Version
          DID_E333_2002_State: DcmDspDidIdentifier=58163, DcmDspDidInfoRef=DidInfo_DID_E333_2002_State
            8 x DcmDspDidSignal:
              INVALID_SHORTNAME_2002_Hu: DcmDspDidDataPos=0, DcmDspDidDataRef=DID_E333_2002_State_2002_Hu
              INVALID_SHORTNAME_2002_Hv: DcmDspDidDataPos=8, DcmDspDidDataRef=DID_E333_2002_State_2002_Hv
              INVALID_SHORTNAME_2002_Hw: DcmDspDidDataPos=16, DcmDspDidDataRef=DID_E333_2002_State_2002_Hw
              INVALID_SHORTNAME_2002_Lu: DcmDspDidDataPos=24, DcmDspDidDataRef=DID_E333_2002_State_2002_Lu
              INVALID_SHORTNAME_2002_Lv: DcmDspDidDataPos=32, DcmDspDidDataRef=DID_E333_2002_State_2002_Lv
              INVALID_SHORTNAME_2002_Lw: DcmDspDidDataPos=40, DcmDspDidDataRef=DID_E333_2002_State_2002_Lw
              INVALID_SHORTNAME_2002_H_Ser: DcmDspDidDataPos=48, DcmDspDidDataRef=DID_E333_2002_State_2002_H_Ser
              INVALID_SHORTNAME_2002_L_Ser: DcmDspDidDataPos=56, DcmDspDidDataRef=DID_E333_2002_State_2002_L_Ser
          DID_E335_d_axis_current_setpoint: DcmDspDidIdentifier=58165, DcmDspDidInfoRef=DidInfo_DID_E335_d_axis_current_setpoint
            DID_E335_d_axis_current_setpoint (DcmDspDidSignal): DcmDspDidDataPos=0, DcmDspDidDataRef=DID_E335_d_axis_current_setpoint_DID_E335_d_axis_current_setpoint
          DID_E336_d_axis_current_feedback: DcmDspDidIdentifier=58166, DcmDspDidInfoRef=DidInfo_DID_E336_d_axis_current_feedback
            DID_E336_d_axis_current_feedback (DcmDspDidSignal): DcmDspDidDataPos=0, DcmDspDidDataRef=DID_E336_d_axis_current_feedback_DID_E336_d_axis_current_feedback
          DID_E337_q_axis_current_setpoint: DcmDspDidIdentifier=58167, DcmDspDidInfoRef=DidInfo_DID_E337_q_axis_current_setpoint
            DID_E337_q_axis_current_setpoint (DcmDspDidSignal): DcmDspDidDataPos=0, DcmDspDidDataRef=DID_E337_q_axis_current_setpoint_DID_E337_q_axis_current_setpoint
          DID_E338_q_axis_current_feedback: DcmDspDidIdentifier=58168, DcmDspDidInfoRef=DidInfo_DID_E338_q_axis_current_feedback
            DID_E338_q_axis_current_feedback (DcmDspDidSignal): DcmDspDidDataPos=0, DcmDspDidDataRef=DID_E338_q_axis_current_feedback_DID_E338_q_axis_current_feedback
          DID_E339_d_axis_voltage: DcmDspDidIdentifier=58169, DcmDspDidInfoRef=DidInfo_DID_E339_d_axis_voltage
            DID_E339_d_axis_voltage (DcmDspDidSignal): DcmDspDidDataPos=0, DcmDspDidDataRef=DID_E339_d_axis_voltage_DID_E339_d_axis_voltage
          DID_E341_q_axis_voltage: DcmDspDidIdentifier=58177, DcmDspDidInfoRef=DidInfo_DID_E341_q_axis_voltage
            DID_E341_q_axis_voltage (DcmDspDidSignal): DcmDspDidDataPos=0, DcmDspDidDataRef=DID_E341_q_axis_voltage_DID_E341_q_axis_voltage
          DID_E346_ECM_Torque_Allowed_Status: DcmDspDidIdentifier=58182, DcmDspDidInfoRef=DidInfo_DID_E346_ECM_Torque_Allowed_Status
            DID_E346_ECM_Torque_Allowed_Status (DcmDspDidSignal): DcmDspDidDataPos=0, DcmDspDidDataRef=DID_E346_ECM_Torque_Allowed_Status_DID_E346_ECM_Torque_Allowed_Status
          DID_E347_IGBT_Max_Temperature: DcmDspDidIdentifier=58183, DcmDspDidInfoRef=DidInfo_DID_E347_IGBT_Max_Temperature
            DID_E347_IGBT_Max_Temperature (DcmDspDidSignal): DcmDspDidDataPos=0, DcmDspDidDataRef=DID_E347_IGBT_Max_Temperature_DID_E347_IGBT_Max_Temperature
          DID_E348_Phase_U_PWM_duty: DcmDspDidIdentifier=58184, DcmDspDidInfoRef=DidInfo_DID_E348_Phase_U_PWM_duty
            DID_E348_Phase_U_PWM_duty (DcmDspDidSignal): DcmDspDidDataPos=0, DcmDspDidDataRef=DID_E348_Phase_U_PWM_duty_DID_E348_Phase_U_PWM_duty
          DID_E349_Phase_V_PWM_duty: DcmDspDidIdentifier=58185, DcmDspDidInfoRef=DidInfo_DID_E349_Phase_V_PWM_duty
            DID_E349_Phase_V_PWM_duty (DcmDspDidSignal): DcmDspDidDataPos=0, DcmDspDidDataRef=DID_E349_Phase_V_PWM_duty_DID_E349_Phase_V_PWM_duty
          DID_E350_Phase_W_PWM_duty: DcmDspDidIdentifier=58192, DcmDspDidInfoRef=DidInfo_DID_E350_Phase_W_PWM_duty
            DID_E350_Phase_W_PWM_duty (DcmDspDidSignal): DcmDspDidDataPos=0, DcmDspDidDataRef=DID_E350_Phase_W_PWM_duty_DID_E350_Phase_W_PWM_duty
          DID_E353_Flux_weakening_correction_factor: DcmDspDidIdentifier=58195, DcmDspDidInfoRef=DidInfo_DID_E353_Flux_weakening_correction_factor
            DID_E353_Flux_weakening_correction_factor (DcmDspDidSignal): DcmDspDidDataPos=0, DcmDspDidDataRef=DID_E353_Flux_weakening_correction_factor_DID_E353_Flux_weakening_correction_factor
          DID_E357_Resolve_compensated_angle: DcmDspDidIdentifier=58199, DcmDspDidInfoRef=DidInfo_DID_E357_Resolve_compensated_angle
            DID_E357_Resolve_compensated_angle (DcmDspDidSignal): DcmDspDidDataPos=0, DcmDspDidDataRef=DID_E357_Resolve_compensated_angle_DID_E357_Resolve_compensated_angle
          DID_E358_Resolve_angle: DcmDspDidIdentifier=58200, DcmDspDidInfoRef=DidInfo_DID_E358_Resolve_angle
            DID_E358_Resolve_angle (DcmDspDidSignal): DcmDspDidDataPos=0, DcmDspDidDataRef=DID_E358_Resolve_angle_DID_E358_Resolve_angle
          DID_E363_Modulation_index: DcmDspDidIdentifier=58211, DcmDspDidInfoRef=DidInfo_DID_E363_Modulation_index
            DID_E363_Modulation_index (DcmDspDidSignal): DcmDspDidDataPos=0, DcmDspDidDataRef=DID_E363_Modulation_index_DID_E363_Modulation_index
          DID_E364_AURIX_Fault_Indication: DcmDspDidIdentifier=58212, DcmDspDidInfoRef=DidInfo_DID_E364_AURIX_Fault_Indication
            DID_E364_AURIX_Fault_Indication (DcmDspDidSignal): DcmDspDidDataPos=0, DcmDspDidDataRef=DID_E364_AURIX_Fault_Indication_DID_E364_AURIX_Fault_Indication
          DID_ED20_Complete_set_of_ECU_part_serial_numbers_Geely: DcmDspDidIdentifier=60704, DcmDspDidInfoRef=DidInfo_DID_ED20_Complete_set_of_ECU_part_serial_numbers_Geely
            11 x DcmDspDidSignal:
              BCD_part: DcmDspDidDataPos=0, DcmDspDidDataRef=DID_ED20_Complete_set_of_ECU_part_serial_numbers_Geely_BCD_part
              ASCII_part: DcmDspDidDataPos=40, DcmDspDidDataRef=DID_ED20_Complete_set_of_ECU_part_serial_numbers_Geely_ASCII_part
              BCD_part_001: DcmDspDidDataPos=64, DcmDspDidDataRef=DID_ED20_Complete_set_of_ECU_part_serial_numbers_Geely_BCD_part_001
              ASCII_part_001: DcmDspDidDataPos=104, DcmDspDidDataRef=DID_ED20_Complete_set_of_ECU_part_serial_numbers_Geely_ASCII_part_001
              BCD_part_002: DcmDspDidDataPos=128, DcmDspDidDataRef=DID_ED20_Complete_set_of_ECU_part_serial_numbers_Geely_BCD_part_002
              ASCII_part_002: DcmDspDidDataPos=168, DcmDspDidDataRef=DID_ED20_Complete_set_of_ECU_part_serial_numbers_Geely_ASCII_part_002
              DID_F18C_ECU_Serial_Number: DcmDspDidDataPos=192, DcmDspDidDataRef=DID_ED20_Complete_set_of_ECU_part_serial_numbers_Geely_DID_F18C_ECU_Serial_Number
              DID_F1AE_1_Total_number_of_ECU_Software_Part_Numbers: DcmDspDidDataPos=224, DcmDspDidDataRef=DID_ED20_Complete_set_of_ECU_part_serial_numbers_Geely_DID_F1AE_1_Total_number_of_ECU_Software_Part_Numbers
              BCD_part_003: DcmDspDidDataPos=232, DcmDspDidDataRef=DID_ED20_Complete_set_of_ECU_part_serial_numbers_Geely_BCD_part_003
              ASCII_part_003: DcmDspDidDataPos=272, DcmDspDidDataRef=DID_ED20_Complete_set_of_ECU_part_serial_numbers_Geely_ASCII_part_003
              Reserved: DcmDspDidDataPos=296, DcmDspDidDataRef=DID_ED20_Complete_set_of_ECU_part_serial_numbers_Geely_Reserved
          DID_EDA0_Complete_ECU_Part_Serial_Number_s: DcmDspDidIdentifier=60832, DcmDspDidInfoRef=DidInfo_DID_EDA0_Complete_ECU_Part_Serial_Number_s
            11 x DcmDspDidSignal:
              F120_Application_Diagnostic_Database_Part_Number: DcmDspDidDataPos=0, DcmDspDidDataRef=DID_EDA0_Complete_ECU_Part_Serial_Number_s_F120_Application_Diagnostic_Database_Part_Number
              F120_Application_Diagnostic_Database_Part_Number1: DcmDspDidDataPos=32, DcmDspDidDataRef=DID_EDA0_Complete_ECU_Part_Serial_Number_s_F120_Application_Diagnostic_Database_Part_Number1
              DID_F12A_ECU_Delivery_Assembly_Part_Number_1: DcmDspDidDataPos=56, DcmDspDidDataRef=DID_EDA0_Complete_ECU_Part_Serial_Number_s_DID_F12A_ECU_Delivery_Assembly_Part_Number_1
              DID_F12A_ECU_Delivery_Assembly_Part_Number1_1: DcmDspDidDataPos=88, DcmDspDidDataRef=DID_EDA0_Complete_ECU_Part_Serial_Number_s_DID_F12A_ECU_Delivery_Assembly_Part_Number1_1
              DID_F12B_ECU_Delivery_Assembly_Part_Number: DcmDspDidDataPos=112, DcmDspDidDataRef=DID_EDA0_Complete_ECU_Part_Serial_Number_s_DID_F12B_ECU_Delivery_Assembly_Part_Number
              DID_F12B_ECU_Delivery_Assembly_Part_Number1: DcmDspDidDataPos=144, DcmDspDidDataRef=DID_EDA0_Complete_ECU_Part_Serial_Number_s_DID_F12B_ECU_Delivery_Assembly_Part_Number1
              DID_F18C_ECU_Serial_Number: DcmDspDidDataPos=168, DcmDspDidDataRef=DID_EDA0_Complete_ECU_Part_Serial_Number_s_DID_F18C_ECU_Serial_Number
              DID_F12E_1_Total_number_of_ECU_Software_Part_Numbers: DcmDspDidDataPos=200, DcmDspDidDataRef=DID_EDA0_Complete_ECU_Part_Serial_Number_s_DID_F12E_1_Total_number_of_ECU_Software_Part_Numbers
              BCD_part: DcmDspDidDataPos=208, DcmDspDidDataRef=DID_EDA0_Complete_ECU_Part_Serial_Number_s_BCD_part
              ASCII_part: DcmDspDidDataPos=240, DcmDspDidDataRef=DID_EDA0_Complete_ECU_Part_Serial_Number_s_ASCII_part
              Reserved: DcmDspDidDataPos=264, DcmDspDidDataRef=DID_EDA0_Complete_ECU_Part_Serial_Number_s_Reserved
          DID_EE9A_Inverter_Coolant_Temperature: DcmDspDidIdentifier=61082, DcmDspDidInfoRef=DidInfo_DID_EE9A_Inverter_Coolant_Temperature
            DID_EE9A_Inverter_Coolant_Temperature (DcmDspDidSignal): DcmDspDidDataPos=0, DcmDspDidDataRef=DID_EE9A_Inverter_Coolant_Temperature_DID_EE9A_Inverter_Coolant_Temperature
          DID_EE9C_Transient_Phase_Current_A: DcmDspDidIdentifier=61084, DcmDspDidInfoRef=DidInfo_DID_EE9C_Transient_Phase_Current_A
            DID_EE9C_Transient_Phase_Current_A (DcmDspDidSignal): DcmDspDidDataPos=0, DcmDspDidDataRef=DID_EE9C_Transient_Phase_Current_A_DID_EE9C_Transient_Phase_Current_A
          DID_EE9D_Transient_Phase_Current_B: DcmDspDidIdentifier=61085, DcmDspDidInfoRef=DidInfo_DID_EE9D_Transient_Phase_Current_B
            DID_EE9D_Transient_Phase_Current_B (DcmDspDidSignal): DcmDspDidDataPos=0, DcmDspDidDataRef=DID_EE9D_Transient_Phase_Current_B_DID_EE9D_Transient_Phase_Current_B
          DID_EE9E_Transient_Phase_Current_C: DcmDspDidIdentifier=61086, DcmDspDidInfoRef=DidInfo_DID_EE9E_Transient_Phase_Current_C
            DID_EE9E_Transient_Phase_Current_C (DcmDspDidSignal): DcmDspDidDataPos=0, DcmDspDidDataRef=DID_EE9E_Transient_Phase_Current_C_DID_EE9E_Transient_Phase_Current_C
          DID_EE9F_Gate_Status: DcmDspDidIdentifier=61087, DcmDspDidInfoRef=DidInfo_DID_EE9F_Gate_Status
            DID_EE9F_Gate_Status (DcmDspDidSignal): DcmDspDidDataPos=0, DcmDspDidDataRef=DID_EE9F_Gate_Status_DID_EE9F_Gate_Status
          DID_EEB2_Three_Phase_Motor_Current_RMS_Current: DcmDspDidIdentifier=61106, DcmDspDidInfoRef=DidInfo_DID_EEB2_Three_Phase_Motor_Current_RMS_Current
            DID_EEB2_Three_Phase_Motor_Current_RMS_Current (DcmDspDidSignal): DcmDspDidDataPos=0, DcmDspDidDataRef=DID_EEB2_Three_Phase_Motor_Current_RMS_Current_DID_EEB2_Three_Phase_Motor_Current_RMS_Current
          DID_EEB5_IEM_MGM_current_torque: DcmDspDidIdentifier=61109, DcmDspDidInfoRef=DidInfo_DID_EEB5_IEM_MGM_current_torque
            DID_EEB5_IEMMGM_current_torque (DcmDspDidSignal): DcmDspDidDataPos=0, DcmDspDidDataRef=DID_EEB5_IEM_MGM_current_torque_DID_EEB5_IEMMGM_current_torque
          DID_EEB6_ECM_Power_Limitation_maximum: DcmDspDidIdentifier=61110, DcmDspDidInfoRef=DidInfo_DID_EEB6_ECM_Power_Limitation_maximum
            DID_EEB6_ECM_Power_Limitation_maximum (DcmDspDidSignal): DcmDspDidDataPos=0, DcmDspDidDataRef=DID_EEB6_ECM_Power_Limitation_maximum_DID_EEB6_ECM_Power_Limitation_maximum
          DID_EEB7_ECM_Power_Limitation_minimum: DcmDspDidIdentifier=61111, DcmDspDidInfoRef=DidInfo_DID_EEB7_ECM_Power_Limitation_minimum
            DID_EEB7_ECM_Power_Limitation_minimum (DcmDspDidSignal): DcmDspDidDataPos=0, DcmDspDidDataRef=DID_EEB7_ECM_Power_Limitation_minimum_DID_EEB7_ECM_Power_Limitation_minimum
          DID_EEB8_HV_voltage_received_from_BECM: DcmDspDidIdentifier=61112, DcmDspDidInfoRef=DidInfo_DID_EEB8_HV_voltage_received_from_BECM
            DID_EEB8_HV_voltage_received_from_BECM (DcmDspDidSignal): DcmDspDidDataPos=0, DcmDspDidDataRef=DID_EEB8_HV_voltage_received_from_BECM_DID_EEB8_HV_voltage_received_from_BECM
          DID_EEBD_IEM_MGM_rotor_offset_angle: DcmDspDidIdentifier=61117, DcmDspDidInfoRef=DidInfo_DID_EEBD_IEM_MGM_rotor_offset_angle
            DID_EEBD_IEMMGM_rotor_offset_angle (DcmDspDidSignal): DcmDspDidDataPos=0, DcmDspDidDataRef=DID_EEBD_IEM_MGM_rotor_offset_angle_DID_EEBD_IEMMGM_rotor_offset_angle
          DID_EEBE_Offset_angle_status: DcmDspDidIdentifier=61118, DcmDspDidInfoRef=DidInfo_DID_EEBE_Offset_angle_status
            DID_EEBE_Offset_angle_status (DcmDspDidSignal): DcmDspDidDataPos=0, DcmDspDidDataRef=DID_EEBE_Offset_angle_status_DID_EEBE_Offset_angle_status
          DID_EEBF_HV_Main_Relay_Status: DcmDspDidIdentifier=61119, DcmDspDidInfoRef=DidInfo_DID_EEBF_HV_Main_Relay_Status
            DID_EEBF_HV_Main_Relay_Status (DcmDspDidSignal): DcmDspDidDataPos=0, DcmDspDidDataRef=DID_EEBF_HV_Main_Relay_Status_DID_EEBF_HV_Main_Relay_Status
          DID_EEC3_ECU_power_supply_Voltage: DcmDspDidIdentifier=61123, DcmDspDidInfoRef=DidInfo_DID_EEC3_ECU_power_supply_Voltage
            DID_EEC3_ECU_power_supply_Voltage (DcmDspDidSignal): DcmDspDidDataPos=0, DcmDspDidDataRef=DID_EEC3_ECU_power_supply_Voltage_DID_EEC3_ECU_power_supply_Voltage
          DID_EEC4_Charging_Power_Sustain_Relay_CPSR_Voltage: DcmDspDidIdentifier=61124, DcmDspDidInfoRef=DidInfo_DID_EEC4_Charging_Power_Sustain_Relay_CPSR_Voltage
            DID_EEC4_Charging_Power_Sustain_RelayCPSR_Voltage (DcmDspDidSignal): DcmDspDidDataPos=0, DcmDspDidDataRef=DID_EEC4_Charging_Power_Sustain_Relay_CPSR_Voltage_DID_EEC4_Charging_Power_Sustain_RelayCPSR_Voltage
          DID_EEC5_ImobEng2_node_status: DcmDspDidIdentifier=61125, DcmDspDidInfoRef=DidInfo_DID_EEC5_ImobEng2_node_status
            DID_EEC5_ImobEng2_node_status (DcmDspDidSignal): DcmDspDidDataPos=0, DcmDspDidDataRef=DID_EEC5_ImobEng2_node_status_DID_EEC5_ImobEng2_node_status
          DID_EED1_Safty_monitor_Fault_Indication: DcmDspDidIdentifier=61137, DcmDspDidInfoRef=DidInfo_DID_EED1_Safty_monitor_Fault_Indication
            4 x DcmDspDidSignal:
              EED1_0: DcmDspDidDataPos=0, DcmDspDidDataRef=DID_EED1_Safty_monitor_Fault_Indication_EED1_0
              EED1_1: DcmDspDidDataPos=8, DcmDspDidDataRef=DID_EED1_Safty_monitor_Fault_Indication_EED1_1
              EED1_2: DcmDspDidDataPos=16, DcmDspDidDataRef=DID_EED1_Safty_monitor_Fault_Indication_EED1_2
              EED1_3: DcmDspDidDataPos=24, DcmDspDidDataRef=DID_EED1_Safty_monitor_Fault_Indication_EED1_3
          DID_0xEEC7_1: DcmDspDidIdentifier=61138, DcmDspDidInfoRef=DidInfo_DID_0xEEC7_1
            DID_EED2_SaftyTorque (DcmDspDidSignal): DcmDspDidDataPos=0, DcmDspDidDataRef=DID_0xEEC7_1_DID_EED2_SaftyTorque
          DID_EED3_Safety_speed: DcmDspDidIdentifier=61139, DcmDspDidInfoRef=DidInfo_DID_EED3_Safety_speed
            DID_EED3_Safety_speed (DcmDspDidSignal): DcmDspDidDataPos=0, DcmDspDidDataRef=DID_EED3_Safety_speed_DID_EED3_Safety_speed
          DID_EED4_Safty_Function_Mode: DcmDspDidIdentifier=61140, DcmDspDidInfoRef=DidInfo_DID_EED4_Safty_Function_Mode
            DID_EED4_Safty_Function_Mode (DcmDspDidSignal): DcmDspDidDataPos=0, DcmDspDidDataRef=DID_EED4_Safty_Function_Mode_DID_EED4_Safty_Function_Mode
          DID_EED5_Safety_Torque_QF_factor: DcmDspDidIdentifier=61141, DcmDspDidInfoRef=DidInfo_DID_EED5_Safety_Torque_QF_factor
            EED5_Safety_Torque_Quality_factor (DcmDspDidSignal): DcmDspDidDataPos=0, DcmDspDidDataRef=DID_EED5_Safety_Torque_QF_factor_EED5_Safety_Torque_Quality_factor
          DID_EEFD_Sofware_Project_Version: DcmDspDidIdentifier=61181, DcmDspDidInfoRef=DidInfo_DID_EEFD_Sofware_Project_Version
            DID_EEFD_Clutch_Control_Fault_Indication (DcmDspDidSignal): DcmDspDidDataPos=0, DcmDspDidDataRef=DID_EEFD_Sofware_Project_Version_DID_EEFD_Clutch_Control_Fault_Indication
          DID_EF0A_Active_Discharge_Time: DcmDspDidIdentifier=61194, DcmDspDidInfoRef=DidInfo_DID_EF0A_Active_Discharge_Time
            DID_EF0A_Active_Discharge_Time (DcmDspDidSignal): DcmDspDidDataPos=0, DcmDspDidDataRef=DID_EF0A_Active_Discharge_Time_DID_EF0A_Active_Discharge_Time
          DID_EF1B_EOL_config_word_A: DcmDspDidIdentifier=61211, DcmDspDidInfoRef=DidInfo_DID_EF1B_EOL_config_word_A
            DID_EF1B_EOL_config_word_A (DcmDspDidSignal): DcmDspDidDataPos=0, DcmDspDidDataRef=DID_EF1B_EOL_config_word_A_DID_EF1B_EOL_config_word_A
          DID_EF1C_EOL_config_word_B: DcmDspDidIdentifier=61212, DcmDspDidInfoRef=DidInfo_DID_EF1C_EOL_config_word_B
            DID_EF1C_EOL_config_word_B (DcmDspDidSignal): DcmDspDidDataPos=0, DcmDspDidDataRef=DID_EF1C_EOL_config_word_B_DID_EF1C_EOL_config_word_B
          DID_EF1D_EOL_config_word_C: DcmDspDidIdentifier=61213, DcmDspDidInfoRef=DidInfo_DID_EF1D_EOL_config_word_C
            DID_EF1D_EOL_config_word_C (DcmDspDidSignal): DcmDspDidDataPos=0, DcmDspDidDataRef=DID_EF1D_EOL_config_word_C_DID_EF1D_EOL_config_word_C
          Application_Diagnostic_Database_Part_Number: DcmDspDidIdentifier=61728, DcmDspDidInfoRef=DidInfo_Application_Diagnostic_Database_Part_Number
            Partnumber_Main (DcmDspDidSignal): DcmDspDidDataPos=0, DcmDspDidDataRef=Application_Diagnostic_Database_Part_Number_Partnumber_Main
            Partnumber_Variant (DcmDspDidSignal): DcmDspDidDataPos=32, DcmDspDidDataRef=Application_Diagnostic_Database_Part_Number_Partnumber_Variant
          DID_F121_Primary_Bootloader_Diagnostic_Database_Part_Number: DcmDspDidIdentifier=61729, DcmDspDidInfoRef=DidInfo_DID_F121_Primary_Bootloader_Diagnostic_Database_Part_Number
            BCD_part (DcmDspDidSignal): DcmDspDidDataPos=0, DcmDspDidDataRef=DID_F121_Primary_Bootloader_Diagnostic_Database_Part_Number_BCD_part
            ASCII_part (DcmDspDidSignal): DcmDspDidDataPos=32, DcmDspDidDataRef=DID_F121_Primary_Bootloader_Diagnostic_Database_Part_Number_ASCII_part
          DID_F125_Primary_Bootloader_Software_Part_Number: DcmDspDidIdentifier=61733, DcmDspDidInfoRef=DidInfo_DID_F125_Primary_Bootloader_Software_Part_Number
            BCD_part (DcmDspDidSignal): DcmDspDidDataPos=0, DcmDspDidDataRef=DID_F125_Primary_Bootloader_Software_Part_Number_BCD_part
            ASCII_part (DcmDspDidSignal): DcmDspDidDataPos=32, DcmDspDidDataRef=DID_F125_Primary_Bootloader_Software_Part_Number_ASCII_part
          DID_F126_Autosar_BSW_Cluster_Versions: DcmDspDidIdentifier=61734, DcmDspDidInfoRef=DidInfo_DID_F126_Autosar_BSW_Cluster_Versions
            45 x DcmDspDidSignal:
              DID_F126_1_DIAG_CLUSTER_VENDOR_ID: DcmDspDidDataPos=0, DcmDspDidDataRef=DID_F126_Autosar_BSW_Cluster_Versions_DID_F126_1_DIAG_CLUSTER_VENDOR_ID
              DID_F126_2_DIAG_CLUSTER_SW_MAJOR_VERSION: DcmDspDidDataPos=16, DcmDspDidDataRef=DID_F126_Autosar_BSW_Cluster_Versions_DID_F126_2_DIAG_CLUSTER_SW_MAJOR_VERSION
              DID_F126_3_DIAG_CLUSTER_SW_MINOR_VERSION: DcmDspDidDataPos=24, DcmDspDidDataRef=DID_F126_Autosar_BSW_Cluster_Versions_DID_F126_3_DIAG_CLUSTER_SW_MINOR_VERSION
              DID_F126_4_DIAG_CLUSTER_SW_PATCH_VERSION: DcmDspDidDataPos=32, DcmDspDidDataRef=DID_F126_Autosar_BSW_Cluster_Versions_DID_F126_4_DIAG_CLUSTER_SW_PATCH_VERSION
              DID_F126_5_DIAG_CLUSTER_AR_RELEASE_MAJOR_VERSION: DcmDspDidDataPos=40, DcmDspDidDataRef=DID_F126_Autosar_BSW_Cluster_Versions_DID_F126_5_DIAG_CLUSTER_AR_RELEASE_MAJOR_VERSION
              DID_F126_6_DIAG_CLUSTER_AR_RELEASE_MINOR_VERSION: DcmDspDidDataPos=48, DcmDspDidDataRef=DID_F126_Autosar_BSW_Cluster_Versions_DID_F126_6_DIAG_CLUSTER_AR_RELEASE_MINOR_VERSION
              DID_F126_7_DIAG_CLUSTER_AR_RELEASE_REVISION_VERSION: DcmDspDidDataPos=56, DcmDspDidDataRef=DID_F126_Autosar_BSW_Cluster_Versions_DID_F126_7_DIAG_CLUSTER_AR_RELEASE_REVISION_VERSION
              DID_F126_8_DIAG_CLUSTER_VCC_DEM_VERSION: DcmDspDidDataPos=64, DcmDspDidDataRef=DID_F126_Autosar_BSW_Cluster_Versions_DID_F126_8_DIAG_CLUSTER_VCC_DEM_VERSION
              DID_F126_9_DIAG_CLUSTER_VCC_DCM_VERSION: DcmDspDidDataPos=72, DcmDspDidDataRef=DID_F126_Autosar_BSW_Cluster_Versions_DID_F126_9_DIAG_CLUSTER_VCC_DCM_VERSION
              DID_F126_10_DIAG_CLUSTER_VCC_FIM_VERSION: DcmDspDidDataPos=80, DcmDspDidDataRef=DID_F126_Autosar_BSW_Cluster_Versions_DID_F126_10_DIAG_CLUSTER_VCC_FIM_VERSION
              DID_F126_11_MODEMGMT_CLUSTER_VENDOR_ID: DcmDspDidDataPos=88, DcmDspDidDataRef=DID_F126_Autosar_BSW_Cluster_Versions_DID_F126_11_MODEMGMT_CLUSTER_VENDOR_ID
              DID_F126_12_MODEMGMT_CLUSTER_SW_MAJOR_VERSION: DcmDspDidDataPos=104, DcmDspDidDataRef=DID_F126_Autosar_BSW_Cluster_Versions_DID_F126_12_MODEMGMT_CLUSTER_SW_MAJOR_VERSION
              DID_F126_13_MODEMGMT_CLUSTER_SW_MINOR_VERSION: DcmDspDidDataPos=112, DcmDspDidDataRef=DID_F126_Autosar_BSW_Cluster_Versions_DID_F126_13_MODEMGMT_CLUSTER_SW_MINOR_VERSION
              DID_F126_14_MODEMGMT_CLUSTER_SW_PATCH_VERSION: DcmDspDidDataPos=120, DcmDspDidDataRef=DID_F126_Autosar_BSW_Cluster_Versions_DID_F126_14_MODEMGMT_CLUSTER_SW_PATCH_VERSION
              DID_F126_15_MODEMGMT_CLUSTER_AR_RELEASE_MAJOR_VERSION: DcmDspDidDataPos=128, DcmDspDidDataRef=DID_F126_Autosar_BSW_Cluster_Versions_DID_F126_15_MODEMGMT_CLUSTER_AR_RELEASE_MAJOR_VERSION
              DID_F126_16_MODEMGMT_CLUSTER_AR_RELEASE_MINOR_VERSION: DcmDspDidDataPos=136, DcmDspDidDataRef=DID_F126_Autosar_BSW_Cluster_Versions_DID_F126_16_MODEMGMT_CLUSTER_AR_RELEASE_MINOR_VERSION
              DID_F126_17_MODEMGMT_CLUSTER_AR_RELEASE_REVISION_VERSION: DcmDspDidDataPos=144, DcmDspDidDataRef=DID_F126_Autosar_BSW_Cluster_Versions_DID_F126_17_MODEMGMT_CLUSTER_AR_RELEASE_REVISION_VERSION
              DID_F126_18_COM_CLUSTER_VENDOR_ID: DcmDspDidDataPos=152, DcmDspDidDataRef=DID_F126_Autosar_BSW_Cluster_Versions_DID_F126_18_COM_CLUSTER_VENDOR_ID
              DID_F126_19_COM_CLUSTER_SW_MAJOR_VERSION: DcmDspDidDataPos=168, DcmDspDidDataRef=DID_F126_Autosar_BSW_Cluster_Versions_DID_F126_19_COM_CLUSTER_SW_MAJOR_VERSION
              DID_F126_20_COM_CLUSTER_SW_MINOR_VERSION: DcmDspDidDataPos=176, DcmDspDidDataRef=DID_F126_Autosar_BSW_Cluster_Versions_DID_F126_20_COM_CLUSTER_SW_MINOR_VERSION
              DID_F126_21_COM_CLUSTER_SW_PATCH_VERSION: DcmDspDidDataPos=184, DcmDspDidDataRef=DID_F126_Autosar_BSW_Cluster_Versions_DID_F126_21_COM_CLUSTER_SW_PATCH_VERSION
              DID_F126_22_COM_CLUSTER_AR_RELEASE_MAJOR_VERSION: DcmDspDidDataPos=192, DcmDspDidDataRef=DID_F126_Autosar_BSW_Cluster_Versions_DID_F126_22_COM_CLUSTER_AR_RELEASE_MAJOR_VERSION
              DID_F126_23_COM_CLUSTER_AR_RELEASE_MINOR_VERSION: DcmDspDidDataPos=200, DcmDspDidDataRef=DID_F126_Autosar_BSW_Cluster_Versions_DID_F126_23_COM_CLUSTER_AR_RELEASE_MINOR_VERSION
              DID_F126_24_COM_CLUSTER_AR_RELEASE_REVISION_VERSION: DcmDspDidDataPos=208, DcmDspDidDataRef=DID_F126_Autosar_BSW_Cluster_Versions_DID_F126_24_COM_CLUSTER_AR_RELEASE_REVISION_VERSION
              DID_F126_25_CAN_CLUSTER_VENDOR_ID: DcmDspDidDataPos=216, DcmDspDidDataRef=DID_F126_Autosar_BSW_Cluster_Versions_DID_F126_25_CAN_CLUSTER_VENDOR_ID
              DID_F126_26_CAN_CLUSTER_SW_MAJOR_VERSION: DcmDspDidDataPos=232, DcmDspDidDataRef=DID_F126_Autosar_BSW_Cluster_Versions_DID_F126_26_CAN_CLUSTER_SW_MAJOR_VERSION
              DID_F126_27_CAN_CLUSTER_SW_MINOR_VERSION: DcmDspDidDataPos=240, DcmDspDidDataRef=DID_F126_Autosar_BSW_Cluster_Versions_DID_F126_27_CAN_CLUSTER_SW_MINOR_VERSION
              DID_F126_28_CAN_CLUSTER_SW_PATCH_VERSION: DcmDspDidDataPos=248, DcmDspDidDataRef=DID_F126_Autosar_BSW_Cluster_Versions_DID_F126_28_CAN_CLUSTER_SW_PATCH_VERSION
              DID_F126_29_CAN_CLUSTER_AR_RELEASE_MAJOR_VERSION: DcmDspDidDataPos=256, DcmDspDidDataRef=DID_F126_Autosar_BSW_Cluster_Versions_DID_F126_29_CAN_CLUSTER_AR_RELEASE_MAJOR_VERSION
              DID_F126_30_CAN_CLUSTER_AR_RELEASE_MINOR_VERSION: DcmDspDidDataPos=264, DcmDspDidDataRef=DID_F126_Autosar_BSW_Cluster_Versions_DID_F126_30_CAN_CLUSTER_AR_RELEASE_MINOR_VERSION
              DID_F126_31_CAN_CLUSTER_AR_RELEASE_REVISION_VERSION: DcmDspDidDataPos=272, DcmDspDidDataRef=DID_F126_Autosar_BSW_Cluster_Versions_DID_F126_31_CAN_CLUSTER_AR_RELEASE_REVISION_VERSION
              DID_F126_32_FLEXRAY_CLUSTER_VENDOR_ID: DcmDspDidDataPos=280, DcmDspDidDataRef=DID_F126_Autosar_BSW_Cluster_Versions_DID_F126_32_FLEXRAY_CLUSTER_VENDOR_ID
              DID_F126_33_FLEXRAY_CLUSTER_SW_MAJOR_VERSION: DcmDspDidDataPos=296, DcmDspDidDataRef=DID_F126_Autosar_BSW_Cluster_Versions_DID_F126_33_FLEXRAY_CLUSTER_SW_MAJOR_VERSION
              DID_F126_34_FLEXRAY_CLUSTER_SW_MINOR_VERSION: DcmDspDidDataPos=304, DcmDspDidDataRef=DID_F126_Autosar_BSW_Cluster_Versions_DID_F126_34_FLEXRAY_CLUSTER_SW_MINOR_VERSION
              DID_F126_35_FLEXRAY_CLUSTER_SW_PATCH_VERSION: DcmDspDidDataPos=312, DcmDspDidDataRef=DID_F126_Autosar_BSW_Cluster_Versions_DID_F126_35_FLEXRAY_CLUSTER_SW_PATCH_VERSION
              DID_F126_36_FLEXRAY_CLUSTER_AR_RELEASE_MAJOR_VERSION: DcmDspDidDataPos=320, DcmDspDidDataRef=DID_F126_Autosar_BSW_Cluster_Versions_DID_F126_36_FLEXRAY_CLUSTER_AR_RELEASE_MAJOR_VERSION
              DID_F126_37_FLEXRAY_CLUSTER_AR_RELEASE_MINOR_VERSION: DcmDspDidDataPos=328, DcmDspDidDataRef=DID_F126_Autosar_BSW_Cluster_Versions_DID_F126_37_FLEXRAY_CLUSTER_AR_RELEASE_MINOR_VERSION
              DID_F126_38_FLEXRAY_CLUSTER_AR_RELEASE_REVISION_VERSION: DcmDspDidDataPos=336, DcmDspDidDataRef=DID_F126_Autosar_BSW_Cluster_Versions_DID_F126_38_FLEXRAY_CLUSTER_AR_RELEASE_REVISION_VERSION
              DID_F126_39_LIN_CLUSTER_VENDOR_ID: DcmDspDidDataPos=344, DcmDspDidDataRef=DID_F126_Autosar_BSW_Cluster_Versions_DID_F126_39_LIN_CLUSTER_VENDOR_ID
              DID_F126_40_LIN_CLUSTER_SW_MAJOR_VERSION: DcmDspDidDataPos=360, DcmDspDidDataRef=DID_F126_Autosar_BSW_Cluster_Versions_DID_F126_40_LIN_CLUSTER_SW_MAJOR_VERSION
              DID_F126_41_LIN_CLUSTER_SW_MINOR_VERSION: DcmDspDidDataPos=368, DcmDspDidDataRef=DID_F126_Autosar_BSW_Cluster_Versions_DID_F126_41_LIN_CLUSTER_SW_MINOR_VERSION
              DID_F126_42_LIN_CLUSTER_SW_PATCH_VERSION: DcmDspDidDataPos=376, DcmDspDidDataRef=DID_F126_Autosar_BSW_Cluster_Versions_DID_F126_42_LIN_CLUSTER_SW_PATCH_VERSION
              DID_F126_43_LIN_CLUSTER_AR_RELEASE_MAJOR_VERSION: DcmDspDidDataPos=384, DcmDspDidDataRef=DID_F126_Autosar_BSW_Cluster_Versions_DID_F126_43_LIN_CLUSTER_AR_RELEASE_MAJOR_VERSION
              DID_F126_44_LIN_CLUSTER_AR_RELEASE_MINOR_VERSION: DcmDspDidDataPos=392, DcmDspDidDataRef=DID_F126_Autosar_BSW_Cluster_Versions_DID_F126_44_LIN_CLUSTER_AR_RELEASE_MINOR_VERSION
              DID_F126_45_LIN_CLUSTER_AR_RELEASE_REVISION_VERSION: DcmDspDidDataPos=400, DcmDspDidDataRef=DID_F126_Autosar_BSW_Cluster_Versions_DID_F126_45_LIN_CLUSTER_AR_RELEASE_REVISION_VERSION
          DID_F12A_ECU_Core_Assembly_Part_Number: DcmDspDidIdentifier=61738, DcmDspDidInfoRef=DidInfo_DID_F12A_ECU_Core_Assembly_Part_Number
            BCD_part (DcmDspDidSignal): DcmDspDidDataPos=0, DcmDspDidDataRef=DID_F12A_ECU_Core_Assembly_Part_Number_BCD_part
            ASCII_part (DcmDspDidSignal): DcmDspDidDataPos=32, DcmDspDidDataRef=DID_F12A_ECU_Core_Assembly_Part_Number_ASCII_part
          DID_F12B_ECU_Delivery_Assembly_Part_Number: DcmDspDidIdentifier=61739, DcmDspDidInfoRef=DidInfo_DID_F12B_ECU_Delivery_Assembly_Part_Number
            BCD_part (DcmDspDidSignal): DcmDspDidDataPos=0, DcmDspDidDataRef=DID_F12B_ECU_Delivery_Assembly_Part_Number_BCD_part
            ASCII_part (DcmDspDidSignal): DcmDspDidDataPos=32, DcmDspDidDataRef=DID_F12B_ECU_Delivery_Assembly_Part_Number_ASCII_part
          DID_F12E_ECU_Software_Part_Numbers: DcmDspDidIdentifier=61742, DcmDspDidInfoRef=DidInfo_DID_F12E_ECU_Software_Part_Numbers
            3 x DcmDspDidSignal:
              DID_F12E_1_ECU_Software: DcmDspDidDataPos=0, DcmDspDidDataRef=DID_F12E_ECU_Software_Part_Numbers_DID_F12E_1_ECU_Software
              BCD_part: DcmDspDidDataPos=8, DcmDspDidDataRef=DID_F12E_ECU_Software_Part_Numbers_BCD_part
              ASCII_part: DcmDspDidDataPos=40, DcmDspDidDataRef=DID_F12E_ECU_Software_Part_Numbers_ASCII_part
          DID_F12F_ECU_Software_Extended_Part_Numbers: DcmDspDidIdentifier=61743, DcmDspDidInfoRef=DidInfo_DID_F12F_ECU_Software_Extended_Part_Numbers
            21 x DcmDspDidSignal:
              DID_F12F_1_Total_number_of_ECU_Software_Part_Numbers: DcmDspDidDataPos=0, DcmDspDidDataRef=DID_F12F_ECU_Software_Extended_Part_Numbers_DID_F12F_1_Total_number_of_ECU_Software_Part_Numbers
              BCD_part: DcmDspDidDataPos=8, DcmDspDidDataRef=DID_F12F_ECU_Software_Extended_Part_Numbers_BCD_part
              ASCII_part: DcmDspDidDataPos=40, DcmDspDidDataRef=DID_F12F_ECU_Software_Extended_Part_Numbers_ASCII_part
              BCD_part_001: DcmDspDidDataPos=64, DcmDspDidDataRef=DID_F12F_ECU_Software_Extended_Part_Numbers_BCD_part_001
              ASCII_part_001: DcmDspDidDataPos=96, DcmDspDidDataRef=DID_F12F_ECU_Software_Extended_Part_Numbers_ASCII_part_001
              BCD_part_002: DcmDspDidDataPos=120, DcmDspDidDataRef=DID_F12F_ECU_Software_Extended_Part_Numbers_BCD_part_002
              ASCII_part_002: DcmDspDidDataPos=152, DcmDspDidDataRef=DID_F12F_ECU_Software_Extended_Part_Numbers_ASCII_part_002
              BCD_part_003: DcmDspDidDataPos=176, DcmDspDidDataRef=DID_F12F_ECU_Software_Extended_Part_Numbers_BCD_part_003
              ASCII_part_003: DcmDspDidDataPos=208, DcmDspDidDataRef=DID_F12F_ECU_Software_Extended_Part_Numbers_ASCII_part_003
              BCD_part_004: DcmDspDidDataPos=232, DcmDspDidDataRef=DID_F12F_ECU_Software_Extended_Part_Numbers_BCD_part_004
              ASCII_part_004: DcmDspDidDataPos=264, DcmDspDidDataRef=DID_F12F_ECU_Software_Extended_Part_Numbers_ASCII_part_004
              BCD_part_005: DcmDspDidDataPos=288, DcmDspDidDataRef=DID_F12F_ECU_Software_Extended_Part_Numbers_BCD_part_005
              ASCII_part_005: DcmDspDidDataPos=320, DcmDspDidDataRef=DID_F12F_ECU_Software_Extended_Part_Numbers_ASCII_part_005
              BCD_part_006: DcmDspDidDataPos=344, DcmDspDidDataRef=DID_F12F_ECU_Software_Extended_Part_Numbers_BCD_part_006
              ASCII_part_006: DcmDspDidDataPos=376, DcmDspDidDataRef=DID_F12F_ECU_Software_Extended_Part_Numbers_ASCII_part_006
              BCD_part_007: DcmDspDidDataPos=400, DcmDspDidDataRef=DID_F12F_ECU_Software_Extended_Part_Numbers_BCD_part_007
              ASCII_part_007: DcmDspDidDataPos=432, DcmDspDidDataRef=DID_F12F_ECU_Software_Extended_Part_Numbers_ASCII_part_007
              BCD_part_008: DcmDspDidDataPos=456, DcmDspDidDataRef=DID_F12F_ECU_Software_Extended_Part_Numbers_BCD_part_008
              ASCII_part_008: DcmDspDidDataPos=488, DcmDspDidDataRef=DID_F12F_ECU_Software_Extended_Part_Numbers_ASCII_part_008
              BCD_part_009: DcmDspDidDataPos=512, DcmDspDidDataRef=DID_F12F_ECU_Software_Extended_Part_Numbers_BCD_part_009
              ASCII_part_009: DcmDspDidDataPos=544, DcmDspDidDataRef=DID_F12F_ECU_Software_Extended_Part_Numbers_ASCII_part_009
          DID_F186_Active_Diagnostic_Session: DcmDspDidIdentifier=61830, DcmDspDidInfoRef=DidInfo_DID_F186_Active_Diagnostic_Session
            DID_F186_Active_Diagnostic_Session (DcmDspDidSignal): DcmDspDidDataPos=0, DcmDspDidDataRef=DID_F186_Active_Diagnostic_Session_DID_F186_Active_Diagnostic_Session
          DID_F18C_ECU_Serial_Number: DcmDspDidIdentifier=61836, DcmDspDidInfoRef=DidInfo_DID_F18C_ECU_Serial_Number
            DID_F18C_ECU_Serial_Number (DcmDspDidSignal): DcmDspDidDataPos=0, DcmDspDidDataRef=DID_F18C_ECU_Serial_Number_DID_F18C_ECU_Serial_Number
          DID_F1A0_Application_Diagnostic_Database_Part_Number_Geely: DcmDspDidIdentifier=61856, DcmDspDidInfoRef=DidInfo_DID_F1A0_Application_Diagnostic_Database_Part_Number_Geely
            BCD_part (DcmDspDidSignal): DcmDspDidDataPos=0, DcmDspDidDataRef=DID_F1A0_Application_Diagnostic_Database_Part_Number_Geely_BCD_part
            ASCII_part (DcmDspDidSignal): DcmDspDidDataPos=40, DcmDspDidDataRef=DID_F1A0_Application_Diagnostic_Database_Part_Number_Geely_ASCII_part
          DID_F1A1_Primary_Bootloader_Diagnostic_Database_Part_Number_Geely: DcmDspDidIdentifier=61857, DcmDspDidInfoRef=DidInfo_DID_F1A1_Primary_Bootloader_Diagnostic_Database_Part_Number_Geely
            BCD_part (DcmDspDidSignal): DcmDspDidDataPos=0, DcmDspDidDataRef=DID_F1A1_Primary_Bootloader_Diagnostic_Database_Part_Number_Geely_BCD_part
            ASCII_part (DcmDspDidSignal): DcmDspDidDataPos=40, DcmDspDidDataRef=DID_F1A1_Primary_Bootloader_Diagnostic_Database_Part_Number_Geely_ASCII_part
          DID_F1A5_Primary_Bootloader_Software_Part_Number_Geely: DcmDspDidIdentifier=61861, DcmDspDidInfoRef=DidInfo_DID_F1A5_Primary_Bootloader_Software_Part_Number_Geely
            BCD_part (DcmDspDidSignal): DcmDspDidDataPos=0, DcmDspDidDataRef=DID_F1A5_Primary_Bootloader_Software_Part_Number_Geely_BCD_part
            ASCII_part (DcmDspDidSignal): DcmDspDidDataPos=40, DcmDspDidDataRef=DID_F1A5_Primary_Bootloader_Software_Part_Number_Geely_ASCII_part
          DID_F1AA_ECU_Core_Assembly_Part_Number_Geely: DcmDspDidIdentifier=61866, DcmDspDidInfoRef=DidInfo_DID_F1AA_ECU_Core_Assembly_Part_Number_Geely
            BCD_part (DcmDspDidSignal): DcmDspDidDataPos=0, DcmDspDidDataRef=DID_F1AA_ECU_Core_Assembly_Part_Number_Geely_BCD_part
            ASCII_part (DcmDspDidSignal): DcmDspDidDataPos=40, DcmDspDidDataRef=DID_F1AA_ECU_Core_Assembly_Part_Number_Geely_ASCII_part
          DID_F1AB_ECU_Delivery_Assembly_Part_Number_Geely: DcmDspDidIdentifier=61867, DcmDspDidInfoRef=DidInfo_DID_F1AB_ECU_Delivery_Assembly_Part_Number_Geely
            BCD_part (DcmDspDidSignal): DcmDspDidDataPos=0, DcmDspDidDataRef=DID_F1AB_ECU_Delivery_Assembly_Part_Number_Geely_BCD_part
            ASCII_part (DcmDspDidSignal): DcmDspDidDataPos=40, DcmDspDidDataRef=DID_F1AB_ECU_Delivery_Assembly_Part_Number_Geely_ASCII_part
          DID_F1AE_ECU_Software_Part_Numbers_Geely: DcmDspDidIdentifier=61870, DcmDspDidInfoRef=DidInfo_DID_F1AE_ECU_Software_Part_Numbers_Geely
            3 x DcmDspDidSignal:
              DID_F1AE_1_Total_number_of_ECU_Software_Part_Numbers: DcmDspDidDataPos=0, DcmDspDidDataRef=DID_F1AE_ECU_Software_Part_Numbers_Geely_DID_F1AE_1_Total_number_of_ECU_Software_Part_Numbers
              BCD_part: DcmDspDidDataPos=8, DcmDspDidDataRef=DID_F1AE_ECU_Software_Part_Numbers_Geely_BCD_part
              ASCII_part: DcmDspDidDataPos=48, DcmDspDidDataRef=DID_F1AE_ECU_Software_Part_Numbers_Geely_ASCII_part
          DID_F1AF_ECU_Software_Extended_Part_Numbers_Geely: DcmDspDidIdentifier=61871, DcmDspDidInfoRef=DidInfo_DID_F1AF_ECU_Software_Extended_Part_Numbers_Geely
            9 x DcmDspDidSignal:
              DID_F1AF_1_Total_number_of_ECU_Software_Part_Numbers: DcmDspDidDataPos=0, DcmDspDidDataRef=DID_F1AF_ECU_Software_Extended_Part_Numbers_Geely_DID_F1AF_1_Total_number_of_ECU_Software_Part_Numbers
              BCD_part: DcmDspDidDataPos=8, DcmDspDidDataRef=DID_F1AF_ECU_Software_Extended_Part_Numbers_Geely_BCD_part
              ASCII_part: DcmDspDidDataPos=48, DcmDspDidDataRef=DID_F1AF_ECU_Software_Extended_Part_Numbers_Geely_ASCII_part
              BCD_part_001: DcmDspDidDataPos=72, DcmDspDidDataRef=DID_F1AF_ECU_Software_Extended_Part_Numbers_Geely_BCD_part_001
              ASCII_part_001: DcmDspDidDataPos=112, DcmDspDidDataRef=DID_F1AF_ECU_Software_Extended_Part_Numbers_Geely_ASCII_part_001
              BCD_part_002: DcmDspDidDataPos=136, DcmDspDidDataRef=DID_F1AF_ECU_Software_Extended_Part_Numbers_Geely_BCD_part_002
              ASCII_part_002: DcmDspDidDataPos=176, DcmDspDidDataRef=DID_F1AF_ECU_Software_Extended_Part_Numbers_Geely_ASCII_part_002
              BCD_part_003: DcmDspDidDataPos=200, DcmDspDidDataRef=DID_F1AF_ECU_Software_Extended_Part_Numbers_Geely_BCD_part_003
              ASCII_part_003: DcmDspDidDataPos=240, DcmDspDidDataRef=DID_F1AF_ECU_Software_Extended_Part_Numbers_Geely_ASCII_part_003
        96 x DcmDspDidInfo:
          DidInfo_DID_40E0_Secret_Key_Immobilizer_Target_3
            DcmDspDidAccess
              DcmDspDidRead: DcmDspDidReadSessionRef=extendedDiagnosticSession, DcmDspDidReadSecurityLevelRef=ImmoUnlocked_Level_4
              DcmDspDidWrite: DcmDspDidWriteSessionRef=extendedDiagnosticSession, DcmDspDidWriteSecurityLevelRef=ImmoUnlocked_Level_4
          DidInfo_DID_D003_Vehicle_Speed
            DcmDspDidAccess
              DcmDspDidRead: DcmDspDidReadSessionRef=defaultSession, DcmDspDidReadSessionRef=extendedDiagnosticSession
          DidInfo_DID_D005_High_Quiescent_Current_Fault_Identification_Data
            DcmDspDidAccess
              DcmDspDidRead: DcmDspDidReadSessionRef=defaultSession, DcmDspDidReadSessionRef=extendedDiagnosticSession
          DidInfo_DID_D03A_swAuth_Public_Key_CheckSum
            DcmDspDidAccess
              DcmDspDidRead: DcmDspDidReadSessionRef=defaultSession, DcmDspDidReadSessionRef=extendedDiagnosticSession
          DidInfo_DID_D09A_High_Quiescent_Current_Function_Activation_Deactivation
            DcmDspDidAccess
              DcmDspDidRead: DcmDspDidReadSessionRef=defaultSession, DcmDspDidReadSessionRef=extendedDiagnosticSession
              DcmDspDidWrite: DcmDspDidWriteSessionRef=extendedDiagnosticSession, DcmDspDidWriteSecurityLevelRef=CommonUnlock_Level_3
          DidInfo_DID_D0B5_SDB_version
            DcmDspDidAccess
              DcmDspDidRead: DcmDspDidReadSessionRef=defaultSession, DcmDspDidReadSessionRef=extendedDiagnosticSession
          DidInfo_DID_D12F_Security_Constant_Level_11_12
            DcmDspDidAccess
              DcmDspDidRead: DcmDspDidReadSessionRef=extendedDiagnosticSession, DcmDspDidReadSecurityLevelRef=ImmoUnlocked_Level_4
              DcmDspDidWrite: DcmDspDidWriteSessionRef=extendedDiagnosticSession, DcmDspDidWriteSecurityLevelRef=ImmoUnlocked_Level_4
          DidInfo_DID_D134_Car_Mode
            DcmDspDidAccess
              DcmDspDidRead: DcmDspDidReadSessionRef=defaultSession, DcmDspDidReadSessionRef=extendedDiagnosticSession
          DidInfo_DID_D211_Network_Management_History_Propulsion_CAN
            DcmDspDidAccess
              DcmDspDidRead: DcmDspDidReadSessionRef=defaultSession, DcmDspDidReadSessionRef=extendedDiagnosticSession
          DidInfo_DID_DD00_Global_Real_Time
            DcmDspDidAccess
              DcmDspDidRead: DcmDspDidReadSessionRef=defaultSession, DcmDspDidReadSessionRef=extendedDiagnosticSession
          DidInfo_DID_DD01_Total_Distance
            DcmDspDidAccess
              DcmDspDidRead: DcmDspDidReadSessionRef=defaultSession, DcmDspDidReadSessionRef=extendedDiagnosticSession
          DidInfo_DID_DD02_Vehicle_Battery_Voltage
            DcmDspDidAccess
              DcmDspDidRead: DcmDspDidReadSessionRef=defaultSession, DcmDspDidReadSessionRef=extendedDiagnosticSession
          DidInfo_DID_DD0A_Usage_Mode
            DcmDspDidAccess
              DcmDspDidRead: DcmDspDidReadSessionRef=defaultSession, DcmDspDidReadSessionRef=extendedDiagnosticSession
          DidInfo_DID_DD0C_Electric_Power_Level
            DcmDspDidAccess
              DcmDspDidRead: DcmDspDidReadSessionRef=defaultSession, DcmDspDidReadSessionRef=extendedDiagnosticSession
          DidInfo_DID_E103_Car_Configuration_Parameter_Faults
            DcmDspDidAccess
              DcmDspDidRead: DcmDspDidReadSessionRef=defaultSession, DcmDspDidReadSessionRef=extendedDiagnosticSession
          DidInfo_DID_E300_HVDC_Voltage
            DcmDspDidAccess
              DcmDspDidRead: DcmDspDidReadSessionRef=defaultSession, DcmDspDidReadSessionRef=extendedDiagnosticSession
          DidInfo_DID_E301_HVDC_Current
            DcmDspDidAccess
              DcmDspDidRead: DcmDspDidReadSessionRef=defaultSession, DcmDspDidReadSessionRef=extendedDiagnosticSession
          DidInfo_DID_E303_Motor_Speed
            DcmDspDidAccess
              DcmDspDidRead: DcmDspDidReadSessionRef=defaultSession, DcmDspDidReadSessionRef=extendedDiagnosticSession
          DidInfo_DID_E304_Actual_Torque
            DcmDspDidAccess
              DcmDspDidRead: DcmDspDidReadSessionRef=defaultSession, DcmDspDidReadSessionRef=extendedDiagnosticSession
          DidInfo_DID_E305_Inverter_IGBT_Junction_Temp
            DcmDspDidAccess
              DcmDspDidRead: DcmDspDidReadSessionRef=defaultSession, DcmDspDidReadSessionRef=extendedDiagnosticSession
          DidInfo_DID_E306_Motor_Temperature
            DcmDspDidAccess
              DcmDspDidRead: DcmDspDidReadSessionRef=defaultSession, DcmDspDidReadSessionRef=extendedDiagnosticSession
          DidInfo_DID_E307_System_Mode
            DcmDspDidAccess
              DcmDspDidRead: DcmDspDidReadSessionRef=defaultSession, DcmDspDidReadSessionRef=extendedDiagnosticSession
          DidInfo_DID_E308_ECM_Torque_Request
            DcmDspDidAccess
              DcmDspDidRead: DcmDspDidReadSessionRef=defaultSession, DcmDspDidReadSessionRef=extendedDiagnosticSession
          DidInfo_DID_E309_ECM_Mode_Request
            DcmDspDidAccess
              DcmDspDidRead: DcmDspDidReadSessionRef=defaultSession, DcmDspDidReadSessionRef=extendedDiagnosticSession
          DidInfo_DID_E310_IEM_MGM_Derating_Status
            DcmDspDidAccess
              DcmDspDidRead: DcmDspDidReadSessionRef=defaultSession, DcmDspDidReadSessionRef=extendedDiagnosticSession
          DidInfo_DID_E311_Crash_Status
            DcmDspDidAccess
              DcmDspDidRead: DcmDspDidReadSessionRef=defaultSession, DcmDspDidReadSessionRef=extendedDiagnosticSession
          DidInfo_DID_E312_Wheel_Speed
            DcmDspDidAccess
              DcmDspDidRead: DcmDspDidReadSessionRef=defaultSession, DcmDspDidReadSessionRef=extendedDiagnosticSession
          DidInfo_DID_E313_Active_discharge_status
            DcmDspDidAccess
              DcmDspDidRead: DcmDspDidReadSessionRef=defaultSession, DcmDspDidReadSessionRef=extendedDiagnosticSession
          DidInfo_DID_E314_Available_Torque_maximum
            DcmDspDidAccess
              DcmDspDidRead: DcmDspDidReadSessionRef=defaultSession, DcmDspDidReadSessionRef=extendedDiagnosticSession
          DidInfo_DID_E315_Available_Torque_minimum
            DcmDspDidAccess
              DcmDspDidRead: DcmDspDidReadSessionRef=defaultSession, DcmDspDidReadSessionRef=extendedDiagnosticSession
          DidInfo_DID_E319_Torque_Direction
            DcmDspDidAccess
              DcmDspDidRead: DcmDspDidReadSessionRef=defaultSession, DcmDspDidReadSessionRef=extendedDiagnosticSession
          DidInfo_DID_E320_System_Mode_Mismatch
            DcmDspDidAccess
              DcmDspDidRead: DcmDspDidReadSessionRef=defaultSession, DcmDspDidReadSessionRef=extendedDiagnosticSession
          DidInfo_DID_E324_Motor_Derating_reason_of_IEM_MGM
            DcmDspDidAccess
              DcmDspDidRead: DcmDspDidReadSessionRef=defaultSession, DcmDspDidReadSessionRef=extendedDiagnosticSession
          DidInfo_DID_E331_Software_Version
            DcmDspDidAccess
              DcmDspDidRead: DcmDspDidReadSessionRef=defaultSession, DcmDspDidReadSessionRef=extendedDiagnosticSession
          DidInfo_DID_E333_2002_State
            DcmDspDidAccess
              DcmDspDidRead
              DcmDspDidWrite: DcmDspDidWriteSessionRef=extendedDiagnosticSession
          DidInfo_DID_E335_d_axis_current_setpoint
            DcmDspDidAccess
              DcmDspDidRead: DcmDspDidReadSessionRef=defaultSession, DcmDspDidReadSessionRef=extendedDiagnosticSession
          DidInfo_DID_E336_d_axis_current_feedback
            DcmDspDidAccess
              DcmDspDidRead: DcmDspDidReadSessionRef=defaultSession, DcmDspDidReadSessionRef=extendedDiagnosticSession
          DidInfo_DID_E337_q_axis_current_setpoint
            DcmDspDidAccess
              DcmDspDidRead: DcmDspDidReadSessionRef=defaultSession, DcmDspDidReadSessionRef=extendedDiagnosticSession
          DidInfo_DID_E338_q_axis_current_feedback
            DcmDspDidAccess
              DcmDspDidRead: DcmDspDidReadSessionRef=defaultSession, DcmDspDidReadSessionRef=extendedDiagnosticSession
          DidInfo_DID_E339_d_axis_voltage
            DcmDspDidAccess
              DcmDspDidRead: DcmDspDidReadSessionRef=defaultSession, DcmDspDidReadSessionRef=extendedDiagnosticSession
          DidInfo_DID_E341_q_axis_voltage
            DcmDspDidAccess
              DcmDspDidRead: DcmDspDidReadSessionRef=defaultSession, DcmDspDidReadSessionRef=extendedDiagnosticSession
          DidInfo_DID_E346_ECM_Torque_Allowed_Status
            DcmDspDidAccess
              DcmDspDidRead: DcmDspDidReadSessionRef=defaultSession, DcmDspDidReadSessionRef=extendedDiagnosticSession
          DidInfo_DID_E347_IGBT_Max_Temperature
            DcmDspDidAccess
              DcmDspDidRead: DcmDspDidReadSessionRef=defaultSession, DcmDspDidReadSessionRef=extendedDiagnosticSession
          DidInfo_DID_E348_Phase_U_PWM_duty
            DcmDspDidAccess
              DcmDspDidRead: DcmDspDidReadSessionRef=defaultSession, DcmDspDidReadSessionRef=extendedDiagnosticSession
          DidInfo_DID_E349_Phase_V_PWM_duty
            DcmDspDidAccess
              DcmDspDidRead: DcmDspDidReadSessionRef=defaultSession, DcmDspDidReadSessionRef=extendedDiagnosticSession
          DidInfo_DID_E350_Phase_W_PWM_duty
            DcmDspDidAccess
              DcmDspDidRead: DcmDspDidReadSessionRef=defaultSession, DcmDspDidReadSessionRef=extendedDiagnosticSession
          DidInfo_DID_E353_Flux_weakening_correction_factor
            DcmDspDidAccess
              DcmDspDidRead: DcmDspDidReadSessionRef=defaultSession, DcmDspDidReadSessionRef=extendedDiagnosticSession
          DidInfo_DID_E357_Resolve_compensated_angle
            DcmDspDidAccess
              DcmDspDidRead: DcmDspDidReadSessionRef=defaultSession, DcmDspDidReadSessionRef=extendedDiagnosticSession
          DidInfo_DID_E358_Resolve_angle
            DcmDspDidAccess
              DcmDspDidRead: DcmDspDidReadSessionRef=defaultSession, DcmDspDidReadSessionRef=extendedDiagnosticSession
          DidInfo_DID_E363_Modulation_index
            DcmDspDidAccess
              DcmDspDidRead: DcmDspDidReadSessionRef=defaultSession, DcmDspDidReadSessionRef=extendedDiagnosticSession
          DidInfo_DID_E364_AURIX_Fault_Indication
            DcmDspDidAccess
              DcmDspDidRead: DcmDspDidReadSessionRef=defaultSession, DcmDspDidReadSessionRef=extendedDiagnosticSession
          DidInfo_DID_ED20_Complete_set_of_ECU_part_serial_numbers_Geely
            DcmDspDidAccess
              DcmDspDidRead: DcmDspDidReadSessionRef=defaultSession, DcmDspDidReadSessionRef=extendedDiagnosticSession
          DidInfo_DID_EDA0_Complete_ECU_Part_Serial_Number_s
            DcmDspDidAccess
              DcmDspDidRead: DcmDspDidReadSessionRef=defaultSession, DcmDspDidReadSessionRef=extendedDiagnosticSession
          DidInfo_DID_EE9A_Inverter_Coolant_Temperature
            DcmDspDidAccess
              DcmDspDidRead: DcmDspDidReadSessionRef=defaultSession, DcmDspDidReadSessionRef=extendedDiagnosticSession
          DidInfo_DID_EE9C_Transient_Phase_Current_A
            DcmDspDidAccess
              DcmDspDidRead: DcmDspDidReadSessionRef=defaultSession, DcmDspDidReadSessionRef=extendedDiagnosticSession
          DidInfo_DID_EE9D_Transient_Phase_Current_B
            DcmDspDidAccess
              DcmDspDidRead: DcmDspDidReadSessionRef=defaultSession, DcmDspDidReadSessionRef=extendedDiagnosticSession
          DidInfo_DID_EE9E_Transient_Phase_Current_C
            DcmDspDidAccess
              DcmDspDidRead: DcmDspDidReadSessionRef=defaultSession, DcmDspDidReadSessionRef=extendedDiagnosticSession
          DidInfo_DID_EE9F_Gate_Status
            DcmDspDidAccess
              DcmDspDidRead: DcmDspDidReadSessionRef=defaultSession, DcmDspDidReadSessionRef=extendedDiagnosticSession
          DidInfo_DID_EEB2_Three_Phase_Motor_Current_RMS_Current
            DcmDspDidAccess
              DcmDspDidRead: DcmDspDidReadSessionRef=defaultSession, DcmDspDidReadSessionRef=extendedDiagnosticSession
          DidInfo_DID_EEB5_IEM_MGM_current_torque
            DcmDspDidAccess
              DcmDspDidRead: DcmDspDidReadSessionRef=defaultSession, DcmDspDidReadSessionRef=extendedDiagnosticSession
          DidInfo_DID_EEB6_ECM_Power_Limitation_maximum
            DcmDspDidAccess
              DcmDspDidRead: DcmDspDidReadSessionRef=defaultSession, DcmDspDidReadSessionRef=extendedDiagnosticSession
          DidInfo_DID_EEB7_ECM_Power_Limitation_minimum
            DcmDspDidAccess
              DcmDspDidRead: DcmDspDidReadSessionRef=defaultSession, DcmDspDidReadSessionRef=extendedDiagnosticSession
          DidInfo_DID_EEB8_HV_voltage_received_from_BECM
            DcmDspDidAccess
              DcmDspDidRead: DcmDspDidReadSessionRef=defaultSession, DcmDspDidReadSessionRef=extendedDiagnosticSession
          DidInfo_DID_EEBD_IEM_MGM_rotor_offset_angle
            DcmDspDidAccess
              DcmDspDidRead: DcmDspDidReadSessionRef=defaultSession, DcmDspDidReadSessionRef=extendedDiagnosticSession
              DcmDspDidWrite: DcmDspDidWriteSessionRef=extendedDiagnosticSession, DcmDspDidWriteSecurityLevelRef=CommonUnlock_Level_3
          DidInfo_DID_EEBE_Offset_angle_status
            DcmDspDidAccess
              DcmDspDidRead: DcmDspDidReadSessionRef=defaultSession, DcmDspDidReadSessionRef=extendedDiagnosticSession
          DidInfo_DID_EEBF_HV_Main_Relay_Status
            DcmDspDidAccess
              DcmDspDidRead: DcmDspDidReadSessionRef=defaultSession, DcmDspDidReadSessionRef=extendedDiagnosticSession
          DidInfo_DID_EEC3_ECU_power_supply_Voltage
            DcmDspDidAccess
              DcmDspDidRead: DcmDspDidReadSessionRef=defaultSession, DcmDspDidReadSessionRef=extendedDiagnosticSession
          DidInfo_DID_EEC4_Charging_Power_Sustain_Relay_CPSR_Voltage
            DcmDspDidAccess
              DcmDspDidRead: DcmDspDidReadSessionRef=defaultSession, DcmDspDidReadSessionRef=extendedDiagnosticSession
          DidInfo_DID_EEC5_ImobEng2_node_status
            DcmDspDidAccess
              DcmDspDidRead: DcmDspDidReadSessionRef=defaultSession, DcmDspDidReadSessionRef=extendedDiagnosticSession
          DidInfo_DID_EED1_Safty_monitor_Fault_Indication
            DcmDspDidAccess
              DcmDspDidRead
          DidInfo_DID_0xEEC7_1
            DcmDspDidAccess
              DcmDspDidRead
          DidInfo_DID_EED3_Safety_speed
            DcmDspDidAccess
              DcmDspDidRead
          DidInfo_DID_EED4_Safty_Function_Mode
            DcmDspDidAccess
              DcmDspDidRead
          DidInfo_DID_EED5_Safety_Torque_QF_factor
            DcmDspDidAccess
              DcmDspDidRead
          DidInfo_DID_EEFD_Sofware_Project_Version
            DcmDspDidAccess
              DcmDspDidRead: DcmDspDidReadSessionRef=defaultSession, DcmDspDidReadSessionRef=extendedDiagnosticSession
          DidInfo_DID_EF0A_Active_Discharge_Time
            DcmDspDidAccess
              DcmDspDidRead
          DidInfo_DID_EF1B_EOL_config_word_A
            DcmDspDidAccess
              DcmDspDidRead
              DcmDspDidWrite: DcmDspDidWriteSessionRef=extendedDiagnosticSession, DcmDspDidWriteSecurityLevelRef=CommonUnlock_Level_3
          DidInfo_DID_EF1C_EOL_config_word_B
            DcmDspDidAccess
              DcmDspDidRead
              DcmDspDidWrite: DcmDspDidWriteSessionRef=extendedDiagnosticSession, DcmDspDidWriteSecurityLevelRef=CommonUnlock_Level_3
          DidInfo_DID_EF1D_EOL_config_word_C
            DcmDspDidAccess
              DcmDspDidRead
              DcmDspDidWrite: DcmDspDidWriteSessionRef=extendedDiagnosticSession, DcmDspDidWriteSecurityLevelRef=CommonUnlock_Level_3
          DidInfo_Application_Diagnostic_Database_Part_Number
            DcmDspDidAccess
              DcmDspDidRead: DcmDspDidReadSessionRef=defaultSession, DcmDspDidReadSessionRef=extendedDiagnosticSession
          DidInfo_DID_F121_Primary_Bootloader_Diagnostic_Database_Part_Number
            DcmDspDidAccess
              DcmDspDidRead: DcmDspDidReadSessionRef=defaultSession, DcmDspDidReadSessionRef=extendedDiagnosticSession
          DidInfo_DID_F125_Primary_Bootloader_Software_Part_Number
            DcmDspDidAccess
              DcmDspDidRead: DcmDspDidReadSessionRef=defaultSession, DcmDspDidReadSessionRef=extendedDiagnosticSession
          DidInfo_DID_F126_Autosar_BSW_Cluster_Versions
            DcmDspDidAccess
              DcmDspDidRead: DcmDspDidReadSessionRef=defaultSession, DcmDspDidReadSessionRef=extendedDiagnosticSession
          DidInfo_DID_F12A_ECU_Core_Assembly_Part_Number
            DcmDspDidAccess
              DcmDspDidRead: DcmDspDidReadSessionRef=defaultSession, DcmDspDidReadSessionRef=extendedDiagnosticSession
          DidInfo_DID_F12B_ECU_Delivery_Assembly_Part_Number
            DcmDspDidAccess
              DcmDspDidRead: DcmDspDidReadSessionRef=defaultSession, DcmDspDidReadSessionRef=extendedDiagnosticSession
          DidInfo_DID_F12E_ECU_Software_Part_Numbers
            DcmDspDidAccess
              DcmDspDidRead: DcmDspDidReadSessionRef=defaultSession, DcmDspDidReadSessionRef=extendedDiagnosticSession
          DidInfo_DID_F12F_ECU_Software_Extended_Part_Numbers
            DcmDspDidAccess
              DcmDspDidRead: DcmDspDidReadSessionRef=defaultSession, DcmDspDidReadSessionRef=extendedDiagnosticSession
          DidInfo_DID_F186_Active_Diagnostic_Session
            DcmDspDidAccess
              DcmDspDidRead: DcmDspDidReadSessionRef=defaultSession, DcmDspDidReadSessionRef=extendedDiagnosticSession
          DidInfo_DID_F18C_ECU_Serial_Number
            DcmDspDidAccess
              DcmDspDidRead: DcmDspDidReadSessionRef=defaultSession, DcmDspDidReadSessionRef=extendedDiagnosticSession
          DidInfo_DID_F1A0_Application_Diagnostic_Database_Part_Number_Geely
            DcmDspDidAccess
              DcmDspDidRead: DcmDspDidReadSessionRef=defaultSession, DcmDspDidReadSessionRef=extendedDiagnosticSession
          DidInfo_DID_F1A1_Primary_Bootloader_Diagnostic_Database_Part_Number_Geely
            DcmDspDidAccess
              DcmDspDidRead: DcmDspDidReadSessionRef=defaultSession, DcmDspDidReadSessionRef=extendedDiagnosticSession
          DidInfo_DID_F1A5_Primary_Bootloader_Software_Part_Number_Geely
            DcmDspDidAccess
              DcmDspDidRead: DcmDspDidReadSessionRef=defaultSession, DcmDspDidReadSessionRef=extendedDiagnosticSession
          DidInfo_DID_F1AA_ECU_Core_Assembly_Part_Number_Geely
            DcmDspDidAccess
              DcmDspDidRead: DcmDspDidReadSessionRef=defaultSession, DcmDspDidReadSessionRef=extendedDiagnosticSession
          DidInfo_DID_F1AB_ECU_Delivery_Assembly_Part_Number_Geely
            DcmDspDidAccess
              DcmDspDidRead: DcmDspDidReadSessionRef=defaultSession, DcmDspDidReadSessionRef=extendedDiagnosticSession
          DidInfo_DID_F1AE_ECU_Software_Part_Numbers_Geely
            DcmDspDidAccess
              DcmDspDidRead: DcmDspDidReadSessionRef=defaultSession, DcmDspDidReadSessionRef=extendedDiagnosticSession
          DidInfo_DID_F1AF_ECU_Software_Extended_Part_Numbers_Geely
            DcmDspDidAccess
              DcmDspDidRead: DcmDspDidReadSessionRef=defaultSession, DcmDspDidReadSessionRef=extendedDiagnosticSession
        6 x DcmDspRoutine:
          Check_programming_pre_conditions: DcmDspRequestResultsRoutineSupported=false, DcmDspStopRoutineSupported=false, DcmDspRoutineIdentifier=518, DcmDspRoutineInfoRef=RoutineInfo_Check_programming_pre_conditions
          P_Lock: DcmDspRequestResultsRoutineSupported=true, DcmDspStopRoutineSupported=true, DcmDspRoutineIdentifier=12389, DcmDspRoutineInfoRef=RoutineInfo_P_Lock
          Starter_Generator_Position_Sensors_Calibration: DcmDspRequestResultsRoutineSupported=true, DcmDspStopRoutineSupported=true, DcmDspRoutineIdentifier=16385, DcmDspRoutineInfoRef=RoutineInfo_Starter_Generator_Position_Sensors_Calibration
          Routine_Reserved_1: DcmDspRequestResultsRoutineSupported=true, DcmDspStopRoutineSupported=true, DcmDspRoutineIdentifier=16397, DcmDspRoutineInfoRef=RoutineInfo_Routine_Reserved_1
          Routine_Reserved_2: DcmDspRequestResultsRoutineSupported=true, DcmDspStopRoutineSupported=true, DcmDspRoutineIdentifier=16398, DcmDspRoutineInfoRef=RoutineInfo_Routine_Reserved_2
          Routine_Reserved_3: DcmDspRequestResultsRoutineSupported=true, DcmDspStopRoutineSupported=true, DcmDspRoutineIdentifier=16399, DcmDspRoutineInfoRef=RoutineInfo_Routine_Reserved_3
        6 x DcmDspRoutineInfo:
          RoutineInfo_Check_programming_pre_conditions
            DcmDspRoutineAuthorization: DcmDspRoutineSessionRef=defaultSession
            DcmDspStartRoutineOut
              Out_New_Bit_Field (DcmDspStartRoutineOutSignal): DcmDspRoutineSignalLength=8, DcmDspRoutineSignalType=UINT8, DcmDspRoutineSignalPos=0
              Out_RID_0206_Start_Pr_3_Condition_Fullfilled_To_Enter_Programming_Session (DcmDspStartRoutineOutSignal): DcmDspRoutineSignalLength=8, DcmDspRoutineSignalType=UINT8, DcmDspRoutineSignalPos=8
          RoutineInfo_P_Lock
            DcmDspRoutineAuthorization: DcmDspRoutineSessionRef=extendedDiagnosticSession, DcmDspRoutineSecurityLevelRef=CommonUnlock_Level_3
            DcmDspStartRoutineIn
              In_P_Lock_State_Request (DcmDspStartRoutineInSignal): DcmDspRoutineSignalLength=8, DcmDspRoutineSignalType=UINT8, DcmDspRoutineSignalPos=0
            DcmDspStartRoutineOut
              Out_New_Bit_Field (DcmDspStartRoutineOutSignal): DcmDspRoutineSignalLength=8, DcmDspRoutineSignalType=UINT8, DcmDspRoutineSignalPos=0
            DcmDspRoutineStopOut
              Out_New_Bit_Field (DcmDspRoutineStopOutSignal): DcmDspRoutineSignalLength=8, DcmDspRoutineSignalType=UINT8, DcmDspRoutineSignalPos=0
            DcmDspRoutineRequestResOut
              Out_New_Bit_Field (DcmDspRoutineRequestResOutSignal): DcmDspRoutineSignalLength=8, DcmDspRoutineSignalType=UINT8, DcmDspRoutineSignalPos=0
              Out_P_Lock_Status (DcmDspRoutineRequestResOutSignal): DcmDspRoutineSignalLength=8, DcmDspRoutineSignalType=UINT8, DcmDspRoutineSignalPos=8
          RoutineInfo_Starter_Generator_Position_Sensors_Calibration
            DcmDspRoutineAuthorization: DcmDspRoutineSessionRef=extendedDiagnosticSession, DcmDspRoutineSecurityLevelRef=CommonUnlock_Level_3
            DcmDspStartRoutineOut
              Out_Bitfield (DcmDspStartRoutineOutSignal): DcmDspRoutineSignalLength=8, DcmDspRoutineSignalType=UINT8, DcmDspRoutineSignalPos=0
            DcmDspRoutineStopOut
              Out_Bitfield (DcmDspRoutineStopOutSignal): DcmDspRoutineSignalLength=8, DcmDspRoutineSignalType=UINT8, DcmDspRoutineSignalPos=0
            DcmDspRoutineRequestResOut
              Out_Bitfield (DcmDspRoutineRequestResOutSignal): DcmDspRoutineSignalLength=8, DcmDspRoutineSignalType=UINT8, DcmDspRoutineSignalPos=0
              Out_RID_4001_RequestResult_Pr_3_Calibration_result (DcmDspRoutineRequestResOutSignal): DcmDspRoutineSignalLength=16, DcmDspRoutineSignalType=UINT16, DcmDspRoutineSignalEndianness=BIG_ENDIAN, DcmDspRoutineSignalPos=8
          RoutineInfo_Routine_Reserved_1
            DcmDspRoutineAuthorization: DcmDspRoutineSessionRef=extendedDiagnosticSession, DcmDspRoutineSecurityLevelRef=CommonUnlock_Level_3
            DcmDspStartRoutineIn
              3 x DcmDspStartRoutineInSignal, all with DcmDspRoutineSignalLength=8, DcmDspRoutineSignalType=UINT8:
                In_InputData1: DcmDspRoutineSignalPos=0
                In_InputData2: DcmDspRoutineSignalPos=8
                In_InputData3: DcmDspRoutineSignalPos=16
            DcmDspStartRoutineOut
              3 x DcmDspStartRoutineOutSignal, all with DcmDspRoutineSignalLength=8, DcmDspRoutineSignalType=UINT8:
                Out_Data_01_1: DcmDspRoutineSignalPos=0
                Out_Data_01_2: DcmDspRoutineSignalPos=8
                Out_Data_01_3: DcmDspRoutineSignalPos=16
            DcmDspRoutineStopOut
              Out_New_Bit_Field (DcmDspRoutineStopOutSignal): DcmDspRoutineSignalLength=8, DcmDspRoutineSignalType=UINT8, DcmDspRoutineSignalPos=0
            DcmDspRoutineRequestResOut
              3 x DcmDspRoutineRequestResOutSignal, all with DcmDspRoutineSignalLength=8, DcmDspRoutineSignalType=UINT8:
                Out_Data_03_1: DcmDspRoutineSignalPos=0
                Out_Data_03_2: DcmDspRoutineSignalPos=8
                Out_Data_03_3: DcmDspRoutineSignalPos=16
          RoutineInfo_Routine_Reserved_2
            DcmDspRoutineAuthorization: DcmDspRoutineSessionRef=extendedDiagnosticSession, DcmDspRoutineSecurityLevelRef=CommonUnlock_Level_3
            DcmDspStartRoutineIn
              3 x DcmDspStartRoutineInSignal, all with DcmDspRoutineSignalLength=8, DcmDspRoutineSignalType=UINT8:
                In_InputData1: DcmDspRoutineSignalPos=0
                In_InputData2: DcmDspRoutineSignalPos=8
                In_InputData3: DcmDspRoutineSignalPos=16
            DcmDspStartRoutineOut
              3 x DcmDspStartRoutineOutSignal, all with DcmDspRoutineSignalLength=8, DcmDspRoutineSignalType=UINT8:
                Out_Data_01_1: DcmDspRoutineSignalPos=0
                Out_Data_01_2: DcmDspRoutineSignalPos=8
                Out_Data_01_3: DcmDspRoutineSignalPos=16
            DcmDspRoutineStopOut
              Out_New_Bit_Field (DcmDspRoutineStopOutSignal): DcmDspRoutineSignalLength=8, DcmDspRoutineSignalType=UINT8, DcmDspRoutineSignalPos=0
            DcmDspRoutineRequestResOut
              3 x DcmDspRoutineRequestResOutSignal, all with DcmDspRoutineSignalLength=8, DcmDspRoutineSignalType=UINT8:
                Out_Data_03_1: DcmDspRoutineSignalPos=0
                Out_Data_03_2: DcmDspRoutineSignalPos=8
                Out_Data_03_3: DcmDspRoutineSignalPos=16
          RoutineInfo_Routine_Reserved_3
            DcmDspRoutineAuthorization: DcmDspRoutineSessionRef=extendedDiagnosticSession
            DcmDspStartRoutineIn
              3 x DcmDspStartRoutineInSignal, all with DcmDspRoutineSignalLength=8, DcmDspRoutineSignalType=UINT8:
                In_InputData1: DcmDspRoutineSignalPos=0
                In_InputData2: DcmDspRoutineSignalPos=8
                In_InputData3: DcmDspRoutineSignalPos=16
            DcmDspStartRoutineOut
              3 x DcmDspStartRoutineOutSignal, all with DcmDspRoutineSignalLength=8, DcmDspRoutineSignalType=UINT8:
                Out_Data_01_1: DcmDspRoutineSignalPos=0
                Out_Data_01_2: DcmDspRoutineSignalPos=8
                Out_Data_01_3: DcmDspRoutineSignalPos=16
            DcmDspRoutineStopOut
              Out_New_Bit_Field (DcmDspRoutineStopOutSignal): DcmDspRoutineSignalLength=8, DcmDspRoutineSignalType=UINT8, DcmDspRoutineSignalPos=0
            DcmDspRoutineRequestResOut
              3 x DcmDspRoutineRequestResOutSignal, all with DcmDspRoutineSignalLength=8, DcmDspRoutineSignalType=UINT8:
                Out_Data_03_1: DcmDspRoutineSignalPos=0
                Out_Data_03_2: DcmDspRoutineSignalPos=8
                Out_Data_03_3: DcmDspRoutineSignalPos=16
        DcmDspSecurity
          CommonUnlock_Level_3 (DcmDspSecurityRow):
            DcmDspSecurityDelayTime = 10
            DcmDspSecurityDelayTimeOnBoot = 0
            DcmDspSecurityKeySize = 3
            DcmDspSecurityLevel = 3
            DcmDspSecurityNumAttDelay = 3
            DcmDspSecuritySeedSize = 3
          ImmoUnlocked_Level_4 (DcmDspSecurityRow):
            DcmDspSecurityDelayTime = 10
            DcmDspSecurityDelayTimeOnBoot = 0
            DcmDspSecurityKeySize = 3
            DcmDspSecurityLevel = 9
            DcmDspSecurityNumAttDelay = 3
            DcmDspSecuritySeedSize = 3
        DcmDspSession
          3 x DcmDspSessionRow, all with DcmDspSessionP2ServerMax=0.05, DcmDspSessionP2StarServerMax=5:
            defaultSession: DcmDspSessionLevel=1, DcmDspSessionForBoot=DCM_NO_BOOT
            programmingSession: DcmDspSessionLevel=2
            extendedDiagnosticSession: DcmDspSessionLevel=3, DcmDspSessionForBoot=DCM_NO_BOOT
  module config Dem: module-description=Dem_Impl
    DemConfigSet
      DTCClass_PS_P15_U_FLT (DemDTCClass): DemDTCSeverity=DEM_DTC_SEV_MAINTENANCE_ONLY, DemUdsDTC=438300
      PS_P15_U_FLT (DemEventParameter):
        DemEventKind = DEM_EVENT_KIND_SWC
        DemMaxNumberFreezeFrameRecords = 2
        DemDTCClassRef = DTCClass_PS_P15_U_FLT
        DemExtendedDataClassRef = ExtendedDataClass_5ecd55b9
        DemFreezeFrameClassRef = FreezeFrameClass_c3111450
        DemEventClass:
          DemAgingAllowed = true
          DemAgingCycleCounterThreshold = 40
          DemEventDestination = DEM_DTC_ORIGIN_PRIMARY_MEMORY
          DemEventPriority = 1
          DemEventFailureCycleCounterThreshold = 0
          DemAgingCycleRef = PowerCycle
          DemEnableConditionGroupRef = EnableConditionGroup_7ab46a93
          DemOperationCycleRef = PowerCycle
          DemDebounceAlgorithmClass
            DemDebounceCounterBased: DemDebounceCounterDecrementStepSize=128, DemDebounceCounterIncrementStepSize=127, DemDebounceCounterJumpDown=true, DemDebounceCounterJumpUp=true
          IndicatorAttribute_WarningIndicator (DemIndicatorAttribute): DemIndicatorFailureCycleSource=DEM_FAILURE_CYCLE_EVENT, DemIndicatorHealingCycleRef=PowerCycle, DemIndicatorRef=WarningIndicator
      DTCClass_PS_P15_V_FLT (DemDTCClass): DemDTCSeverity=DEM_DTC_SEV_MAINTENANCE_ONLY, DemUdsDTC=439068
      PS_P15_V_FLT (DemEventParameter):
        DemEventKind = DEM_EVENT_KIND_SWC
        DemMaxNumberFreezeFrameRecords = 2
        DemDTCClassRef = DTCClass_PS_P15_V_FLT
        DemExtendedDataClassRef = ExtendedDataClass_5ecd55b9
        DemFreezeFrameClassRef = FreezeFrameClass_c3111450
        DemEventClass:
          DemAgingAllowed = true
          DemAgingCycleCounterThreshold = 40
          DemEventDestination = DEM_DTC_ORIGIN_PRIMARY_MEMORY
          DemEventPriority = 1
          DemEventFailureCycleCounterThreshold = 0
          DemAgingCycleRef = PowerCycle
          DemEnableConditionGroupRef = EnableConditionGroup_7ab46a93
          DemOperationCycleRef = PowerCycle
          DemDebounceAlgorithmClass
            DemDebounceCounterBased: DemDebounceCounterDecrementStepSize=128, DemDebounceCounterIncrementStepSize=127, DemDebounceCounterJumpDown=true, DemDebounceCounterJumpUp=true
          IndicatorAttribute_WarningIndicator (DemIndicatorAttribute): DemIndicatorFailureCycleSource=DEM_FAILURE_CYCLE_EVENT, DemIndicatorHealingCycleRef=PowerCycle, DemIndicatorRef=WarningIndicator
      DTCClass_PS_P15_W_FLT (DemDTCClass): DemDTCSeverity=DEM_DTC_SEV_MAINTENANCE_ONLY, DemUdsDTC=452124
      PS_P15_W_FLT (DemEventParameter):
        DemEventKind = DEM_EVENT_KIND_SWC
        DemMaxNumberFreezeFrameRecords = 2
        DemDTCClassRef = DTCClass_PS_P15_W_FLT
        DemExtendedDataClassRef = ExtendedDataClass_5ecd55b9
        DemFreezeFrameClassRef = FreezeFrameClass_c3111450
        DemEventClass:
          DemAgingAllowed = true
          DemAgingCycleCounterThreshold = 40
          DemEventDestination = DEM_DTC_ORIGIN_PRIMARY_MEMORY
          DemEventPriority = 1
          DemEventFailureCycleCounterThreshold = 0
          DemAgingCycleRef = PowerCycle
          DemEnableConditionGroupRef = EnableConditionGroup_7ab46a93
          DemOperationCycleRef = PowerCycle
          DemDebounceAlgorithmClass
            DemDebounceCounterBased: DemDebounceCounterDecrementStepSize=128, DemDebounceCounterIncrementStepSize=127, DemDebounceCounterJumpDown=true, DemDebounceCounterJumpUp=true
          IndicatorAttribute_WarningIndicator (DemIndicatorAttribute): DemIndicatorFailureCycleSource=DEM_FAILURE_CYCLE_EVENT, DemIndicatorHealingCycleRef=PowerCycle, DemIndicatorRef=WarningIndicator
      DTCClass_PS_WhlSnsr_FLT (DemDTCClass): DemDTCSeverity=DEM_DTC_SEV_IMMEDIATELY, DemUdsDTC=466945
      PS_WhlSnsr_FLT (DemEventParameter):
        DemEventKind = DEM_EVENT_KIND_SWC
        DemMaxNumberFreezeFrameRecords = 2
        DemDTCClassRef = DTCClass_PS_WhlSnsr_FLT
        DemExtendedDataClassRef = ExtendedDataClass_5ecd55b9
        DemFreezeFrameClassRef = FreezeFrameClass_dc4c3f47
        DemEventClass:
          DemAgingAllowed = true
          DemAgingCycleCounterThreshold = 40
          DemEventDestination = DEM_DTC_ORIGIN_PRIMARY_MEMORY
          DemEventPriority = 1
          DemEventFailureCycleCounterThreshold = 0
          DemAgingCycleRef = PowerCycle
          DemEnableConditionGroupRef = EnableConditionGroup_06a6aa19
          DemOperationCycleRef = PowerCycle
          DemDebounceAlgorithmClass
            DemDebounceCounterBased: DemDebounceCounterDecrementStepSize=128, DemDebounceCounterIncrementStepSize=127, DemDebounceCounterJumpDown=true, DemDebounceCounterJumpUp=true
          IndicatorAttribute_WarningIndicator (DemIndicatorAttribute): DemIndicatorFailureCycleSource=DEM_FAILURE_CYCLE_EVENT, DemIndicatorHealingCycleRef=PowerCycle, DemIndicatorRef=WarningIndicator
      DTCClass_DiagC_ClutchService (DemDTCClass): DemDTCSeverity=DEM_DTC_SEV_IMMEDIATELY, DemUdsDTC=528530
      DiagC_ClutchService (DemEventParameter):
        DemEventKind = DEM_EVENT_KIND_SWC
        DemMaxNumberFreezeFrameRecords = 2
        DemDTCClassRef = DTCClass_DiagC_ClutchService
        DemExtendedDataClassRef = ExtendedDataClass_5ecd55b9
        DemFreezeFrameClassRef = FreezeFrameClass_dc4c3f47
        DemEventClass:
          DemAgingAllowed = true
          DemAgingCycleCounterThreshold = 40
          DemEventDestination = DEM_DTC_ORIGIN_PRIMARY_MEMORY
          DemEventPriority = 1
          DemEventFailureCycleCounterThreshold = 0
          DemAgingCycleRef = PowerCycle
          DemEnableConditionGroupRef = EnableConditionGroup_06a6aa19
          DemOperationCycleRef = PowerCycle
          DemDebounceAlgorithmClass
            DemDebounceCounterBased: DemDebounceCounterDecrementStepSize=128, DemDebounceCounterIncrementStepSize=127, DemDebounceCounterJumpDown=true, DemDebounceCounterJumpUp=true
          IndicatorAttribute_WarningIndicator (DemIndicatorAttribute): DemIndicatorFailureCycleSource=DEM_FAILURE_CYCLE_EVENT, DemIndicatorHealingCycleRef=PowerCycle, DemIndicatorRef=WarningIndicator
      DTCClass_Ga_MoveOverThd (DemDTCClass): DemDTCSeverity=DEM_DTC_SEV_IMMEDIATELY, DemUdsDTC=528532
      Ga_MoveOverThd (DemEventParameter):
        DemEventKind = DEM_EVENT_KIND_SWC
        DemMaxNumberFreezeFrameRecords = 2
        DemDTCClassRef = DTCClass_Ga_MoveOverThd
        DemExtendedDataClassRef = ExtendedDataClass_5ecd55b9
        DemFreezeFrameClassRef = FreezeFrameClass_dc4c3f47
        DemEventClass:
          DemAgingAllowed = true
          DemAgingCycleCounterThreshold = 40
          DemEventDestination = DEM_DTC_ORIGIN_PRIMARY_MEMORY
          DemEventPriority = 1
          DemEventFailureCycleCounterThreshold = 0
          DemAgingCycleRef = PowerCycle
          DemEnableConditionGroupRef = EnableConditionGroup_06a6aa19
          DemOperationCycleRef = PowerCycle
          DemDebounceAlgorithmClass
            DemDebounceCounterBased: DemDebounceCounterDecrementStepSize=128, DemDebounceCounterIncrementStepSize=127, DemDebounceCounterJumpDown=true, DemDebounceCounterJumpUp=true
          IndicatorAttribute_WarningIndicator (DemIndicatorAttribute): DemIndicatorFailureCycleSource=DEM_FAILURE_CYCLE_EVENT, DemIndicatorHealingCycleRef=PowerCycle, DemIndicatorRef=WarningIndicator
      DTCClass_Ga_ZeroFindDistanFailure (DemDTCClass): DemDTCSeverity=DEM_DTC_SEV_IMMEDIATELY, DemUdsDTC=528537
      Ga_ZeroFindDistanFailure (DemEventParameter):
        DemEventKind = DEM_EVENT_KIND_SWC
        DemMaxNumberFreezeFrameRecords = 2
        DemDTCClassRef = DTCClass_Ga_ZeroFindDistanFailure
        DemExtendedDataClassRef = ExtendedDataClass_5ecd55b9
        DemFreezeFrameClassRef = FreezeFrameClass_dc4c3f47
        DemEventClass:
          DemAgingAllowed = true
          DemAgingCycleCounterThreshold = 40
          DemEventDestination = DEM_DTC_ORIGIN_PRIMARY_MEMORY
          DemEventPriority = 1
          DemEventFailureCycleCounterThreshold = 0
          DemAgingCycleRef = PowerCycle
          DemEnableConditionGroupRef = EnableConditionGroup_06a6aa19
          DemOperationCycleRef = PowerCycle
          DemDebounceAlgorithmClass
            DemDebounceCounterBased: DemDebounceCounterDecrementStepSize=128, DemDebounceCounterIncrementStepSize=127, DemDebounceCounterJumpDown=true, DemDebounceCounterJumpUp=true
          IndicatorAttribute_WarningIndicator (DemIndicatorAttribute): DemIndicatorFailureCycleSource=DEM_FAILURE_CYCLE_EVENT, DemIndicatorHealingCycleRef=PowerCycle, DemIndicatorRef=WarningIndicator
      DTCClass_PS_KL30_BACKUP_FLT (DemDTCClass): DemDTCSeverity=DEM_DTC_SEV_MAINTENANCE_ONLY, DemUdsDTC=662370
      PS_KL30_BACKUP_FLT (DemEventParameter):
        DemEventKind = DEM_EVENT_KIND_SWC
        DemMaxNumberFreezeFrameRecords = 2
        DemDTCClassRef = DTCClass_PS_KL30_BACKUP_FLT
        DemExtendedDataClassRef = ExtendedDataClass_5ecd55b9
        DemFreezeFrameClassRef = FreezeFrameClass_c3111450
        DemEventClass:
          DemAgingAllowed = true
          DemAgingCycleCounterThreshold = 40
          DemEventDestination = DEM_DTC_ORIGIN_PRIMARY_MEMORY
          DemEventPriority = 1
          DemEventFailureCycleCounterThreshold = 0
          DemAgingCycleRef = PowerCycle
          DemEnableConditionGroupRef = EnableConditionGroup_7ab46a93
          DemOperationCycleRef = PowerCycle
          DemDebounceAlgorithmClass
            DemDebounceCounterBased: DemDebounceCounterDecrementStepSize=128, DemDebounceCounterIncrementStepSize=127, DemDebounceCounterJumpDown=true, DemDebounceCounterJumpUp=true
          IndicatorAttribute_WarningIndicator (DemIndicatorAttribute): DemIndicatorFailureCycleSource=DEM_FAILURE_CYCLE_EVENT, DemIndicatorHealingCycleRef=PowerCycle, DemIndicatorRef=WarningIndicator
      DTCClass_PS_KL30_RNG_LO (DemDTCClass): DemDTCSeverity=DEM_DTC_SEV_IMMEDIATELY, DemUdsDTC=662434
      PS_KL30_RNG_LO (DemEventParameter):
        DemEventKind = DEM_EVENT_KIND_SWC
        DemMaxNumberFreezeFrameRecords = 2
        DemDTCClassRef = DTCClass_PS_KL30_RNG_LO
        DemExtendedDataClassRef = ExtendedDataClass_5ecd55b9
        DemFreezeFrameClassRef = FreezeFrameClass_c3111450
        DemEventClass:
          DemAgingAllowed = true
          DemAgingCycleCounterThreshold = 40
          DemEventDestination = DEM_DTC_ORIGIN_PRIMARY_MEMORY
          DemEventPriority = 1
          DemEventFailureCycleCounterThreshold = 0
          DemAgingCycleRef = PowerCycle
          DemEnableConditionGroupRef = EnableConditionGroup_7ab46a93
          DemOperationCycleRef = PowerCycle
          DemDebounceAlgorithmClass
            DemDebounceCounterBased: DemDebounceCounterDecrementStepSize=128, DemDebounceCounterIncrementStepSize=127, DemDebounceCounterJumpDown=true, DemDebounceCounterJumpUp=true
          IndicatorAttribute_WarningIndicator (DemIndicatorAttribute): DemIndicatorFailureCycleSource=DEM_FAILURE_CYCLE_EVENT, DemIndicatorHealingCycleRef=PowerCycle, DemIndicatorRef=WarningIndicator
      DTCClass_PS_KL30_RNG_HI (DemDTCClass): DemDTCSeverity=DEM_DTC_SEV_IMMEDIATELY, DemUdsDTC=662435
      PS_KL30_RNG_HI (DemEventParameter):
        DemEventKind = DEM_EVENT_KIND_SWC
        DemMaxNumberFreezeFrameRecords = 2
        DemDTCClassRef = DTCClass_PS_KL30_RNG_HI
        DemExtendedDataClassRef = ExtendedDataClass_5ecd55b9
        DemFreezeFrameClassRef = FreezeFrameClass_c3111450
        DemEventClass:
          DemAgingAllowed = true
          DemAgingCycleCounterThreshold = 40
          DemEventDestination = DEM_DTC_ORIGIN_PRIMARY_MEMORY
          DemEventPriority = 2
          DemEventFailureCycleCounterThreshold = 0
          DemAgingCycleRef = PowerCycle
          DemEnableConditionGroupRef = EnableConditionGroup_7ab46a93
          DemOperationCycleRef = PowerCycle
          DemDebounceAlgorithmClass
            DemDebounceCounterBased: DemDebounceCounterDecrementStepSize=128, DemDebounceCounterIncrementStepSize=127, DemDebounceCounterJumpDown=true, DemDebounceCounterJumpUp=true
          IndicatorAttribute_WarningIndicator (DemIndicatorAttribute): DemIndicatorFailureCycleSource=DEM_FAILURE_CYCLE_EVENT, DemIndicatorHealingCycleRef=PowerCycle, DemIndicatorRef=WarningIndicator
      DTCClass_INV_EM_STATOR_TEMP_ELE_FLT (DemDTCClass): DemDTCSeverity=DEM_DTC_SEV_MAINTENANCE_ONLY, DemUdsDTC=666113
      INV_EM_STATOR_TEMP_ELE_FLT (DemEventParameter):
        DemEventKind = DEM_EVENT_KIND_SWC
        DemMaxNumberFreezeFrameRecords = 2
        DemDTCClassRef = DTCClass_INV_EM_STATOR_TEMP_ELE_FLT
        DemExtendedDataClassRef = ExtendedDataClass_5ecd55b9
        DemFreezeFrameClassRef = FreezeFrameClass_c3111450
        DemEventClass:
          DemAgingAllowed = true
          DemAgingCycleCounterThreshold = 40
          DemEventDestination = DEM_DTC_ORIGIN_PRIMARY_MEMORY
          DemEventPriority = 1
          DemEventFailureCycleCounterThreshold = 0
          DemAgingCycleRef = PowerCycle
          DemEnableConditionGroupRef = EnableConditionGroup_7ab46a93
          DemOperationCycleRef = PowerCycle
          DemDebounceAlgorithmClass
            DemDebounceCounterBased: DemDebounceCounterDecrementStepSize=128, DemDebounceCounterIncrementStepSize=127, DemDebounceCounterJumpDown=true, DemDebounceCounterJumpUp=true
          IndicatorAttribute_WarningIndicator (DemIndicatorAttribute): DemIndicatorFailureCycleSource=DEM_FAILURE_CYCLE_EVENT, DemIndicatorHealingCycleRef=PowerCycle, DemIndicatorRef=WarningIndicator
      DTCClass_INV_EM_STATOR_TEMP_RNG_HI (DemDTCClass): DemDTCSeverity=DEM_DTC_SEV_MAINTENANCE_ONLY, DemUdsDTC=666129
      INV_EM_STATOR_TEMP_RNG_HI (DemEventParameter):
        DemEventKind = DEM_EVENT_KIND_SWC
        DemMaxNumberFreezeFrameRecords = 2
        DemDTCClassRef = DTCClass_INV_EM_STATOR_TEMP_RNG_HI
        DemExtendedDataClassRef = ExtendedDataClass_5ecd55b9
        DemFreezeFrameClassRef = FreezeFrameClass_c3111450
        DemEventClass:
          DemAgingAllowed = true
          DemAgingCycleCounterThreshold = 40
          DemEventDestination = DEM_DTC_ORIGIN_PRIMARY_MEMORY
          DemEventPriority = 1
          DemEventFailureCycleCounterThreshold = 0
          DemAgingCycleRef = PowerCycle
          DemEnableConditionGroupRef = EnableConditionGroup_7ab46a93
          DemOperationCycleRef = PowerCycle
          DemDebounceAlgorithmClass
            DemDebounceCounterBased: DemDebounceCounterDecrementStepSize=128, DemDebounceCounterIncrementStepSize=127, DemDebounceCounterJumpDown=true, DemDebounceCounterJumpUp=true
          IndicatorAttribute_WarningIndicator (DemIndicatorAttribute): DemIndicatorFailureCycleSource=DEM_FAILURE_CYCLE_EVENT, DemIndicatorHealingCycleRef=PowerCycle, DemIndicatorRef=WarningIndicator
      DTCClass_INV_EM_STATOR_TEMP_RNG_LO (DemDTCClass): DemDTCSeverity=DEM_DTC_SEV_MAINTENANCE_ONLY, DemUdsDTC=666130
      INV_EM_STATOR_TEMP_RNG_LO (DemEventParameter):
        DemEventKind = DEM_EVENT_KIND_SWC
        DemMaxNumberFreezeFrameRecords = 2
        DemDTCClassRef = DTCClass_INV_EM_STATOR_TEMP_RNG_LO
        DemExtendedDataClassRef = ExtendedDataClass_5ecd55b9
        DemFreezeFrameClassRef = FreezeFrameClass_c3111450
        DemEventClass:
          DemAgingAllowed = true
          DemAgingCycleCounterThreshold = 40
          DemEventDestination = DEM_DTC_ORIGIN_PRIMARY_MEMORY
          DemEventPriority = 1
          DemEventFailureCycleCounterThreshold = 0
          DemAgingCycleRef = PowerCycle
          DemEnableConditionGroupRef = EnableConditionGroup_7ab46a93
          DemOperationCycleRef = PowerCycle
          DemDebounceAlgorithmClass
            DemDebounceCounterBased: DemDebounceCounterDecrementStepSize=128, DemDebounceCounterIncrementStepSize=127, DemDebounceCounterJumpDown=true, DemDebounceCounterJumpUp=true
          IndicatorAttribute_WarningIndicator (DemIndicatorAttribute): DemIndicatorFailureCycleSource=DEM_FAILURE_CYCLE_EVENT, DemIndicatorHealingCycleRef=PowerCycle, DemIndicatorRef=WarningIndicator
      DTCClass_INV_EM_STATOR_TEMP_RNG_NOK (DemDTCClass): DemDTCSeverity=DEM_DTC_SEV_MAINTENANCE_ONLY, DemUdsDTC=666140
      INV_EM_STATOR_TEMP_RNG_NOK (DemEventParameter):
        DemEventKind = DEM_EVENT_KIND_SWC
        DemMaxNumberFreezeFrameRecords = 2
        DemDTCClassRef = DTCClass_INV_EM_STATOR_TEMP_RNG_NOK
        DemExtendedDataClassRef = ExtendedDataClass_5ecd55b9
        DemFreezeFrameClassRef = FreezeFrameClass_c3111450
        DemEventClass:
          DemAgingAllowed = true
          DemAgingCycleCounterThreshold = 40
          DemEventDestination = DEM_DTC_ORIGIN_PRIMARY_MEMORY
          DemEventPriority = 1
          DemEventFailureCycleCounterThreshold = 0
          DemAgingCycleRef = PowerCycle
          DemEnableConditionGroupRef = EnableConditionGroup_7ab46a93
          DemOperationCycleRef = PowerCycle
          DemDebounceAlgorithmClass
            DemDebounceCounterBased: DemDebounceCounterDecrementStepSize=128, DemDebounceCounterIncrementStepSize=127, DemDebounceCounterJumpDown=true, DemDebounceCounterJumpUp=true
          IndicatorAttribute_WarningIndicator (DemIndicatorAttribute): DemIndicatorFailureCycleSource=DEM_FAILURE_CYCLE_EVENT, DemIndicatorHealingCycleRef=PowerCycle, DemIndicatorRef=WarningIndicator
      DTCClass_INV_EM_STATOR_TEMP_GRDT (DemDTCClass): DemDTCSeverity=DEM_DTC_SEV_MAINTENANCE_ONLY, DemUdsDTC=666151
      INV_EM_STATOR_TEMP_GRDT (DemEventParameter):
        DemEventKind = DEM_EVENT_KIND_SWC
        DemMaxNumberFreezeFrameRecords = 2
        DemDTCClassRef = DTCClass_INV_EM_STATOR_TEMP_GRDT
        DemExtendedDataClassRef = ExtendedDataClass_5ecd55b9
        DemFreezeFrameClassRef = FreezeFrameClass_c3111450
        DemEventClass:
          DemAgingAllowed = true
          DemAgingCycleCounterThreshold = 40
          DemEventDestination = DEM_DTC_ORIGIN_PRIMARY_MEMORY
          DemEventPriority = 2
          DemEventFailureCycleCounterThreshold = 0
          DemAgingCycleRef = PowerCycle
          DemEnableConditionGroupRef = EnableConditionGroup_90577524
          DemOperationCycleRef = PowerCycle
          DemDebounceAlgorithmClass
            DemDebounceCounterBased: DemDebounceCounterDecrementStepSize=128, DemDebounceCounterIncrementStepSize=127, DemDebounceCounterJumpDown=true, DemDebounceCounterJumpUp=true
          IndicatorAttribute_WarningIndicator (DemIndicatorAttribute): DemIndicatorFailureCycleSource=DEM_FAILURE_CYCLE_EVENT, DemIndicatorHealingCycleRef=PowerCycle, DemIndicatorRef=WarningIndicator
      DTCClass_INV_EM_STATOR_TEMP_RNG_SWT (DemDTCClass): DemDTCSeverity=DEM_DTC_SEV_MAINTENANCE_ONLY, DemUdsDTC=666154
      INV_EM_STATOR_TEMP_RNG_SWT (DemEventParameter):
        DemEventKind = DEM_EVENT_KIND_SWC
        DemMaxNumberFreezeFrameRecords = 2
        DemDTCClassRef = DTCClass_INV_EM_STATOR_TEMP_RNG_SWT
        DemExtendedDataClassRef = ExtendedDataClass_5ecd55b9
        DemFreezeFrameClassRef = FreezeFrameClass_c3111450
        DemEventClass:
          DemAgingAllowed = true
          DemAgingCycleCounterThreshold = 40
          DemEventDestination = DEM_DTC_ORIGIN_PRIMARY_MEMORY
          DemEventPriority = 1
          DemEventFailureCycleCounterThreshold = 0
          DemAgingCycleRef = PowerCycle
          DemEnableConditionGroupRef = EnableConditionGroup_7ab46a93
          DemOperationCycleRef = PowerCycle
          DemDebounceAlgorithmClass
            DemDebounceCounterBased: DemDebounceCounterDecrementStepSize=128, DemDebounceCounterIncrementStepSize=127, DemDebounceCounterJumpDown=true, DemDebounceCounterJumpUp=true
          IndicatorAttribute_WarningIndicator (DemIndicatorAttribute): DemIndicatorFailureCycleSource=DEM_FAILURE_CYCLE_EVENT, DemIndicatorHealingCycleRef=PowerCycle, DemIndicatorRef=WarningIndicator
      DTCClass_INV_EM_STATOR_TEMP2_ELE_FLT (DemDTCClass): DemDTCSeverity=DEM_DTC_SEV_MAINTENANCE_ONLY, DemUdsDTC=667649
      INV_EM_STATOR_TEMP2_ELE_FLT (DemEventParameter):
        DemEventKind = DEM_EVENT_KIND_SWC
        DemMaxNumberFreezeFrameRecords = 2
        DemDTCClassRef = DTCClass_INV_EM_STATOR_TEMP2_ELE_FLT
        DemExtendedDataClassRef = ExtendedDataClass_5ecd55b9
        DemFreezeFrameClassRef = FreezeFrameClass_c3111450
        DemEventClass:
          DemAgingAllowed = true
          DemAgingCycleCounterThreshold = 40
          DemEventDestination = DEM_DTC_ORIGIN_PRIMARY_MEMORY
          DemEventPriority = 1
          DemEventFailureCycleCounterThreshold = 0
          DemAgingCycleRef = PowerCycle
          DemEnableConditionGroupRef = EnableConditionGroup_7ab46a93
          DemOperationCycleRef = PowerCycle
          DemDebounceAlgorithmClass
            DemDebounceCounterBased: DemDebounceCounterDecrementStepSize=128, DemDebounceCounterIncrementStepSize=127, DemDebounceCounterJumpDown=true, DemDebounceCounterJumpUp=true
          IndicatorAttribute_WarningIndicator (DemIndicatorAttribute): DemIndicatorFailureCycleSource=DEM_FAILURE_CYCLE_EVENT, DemIndicatorHealingCycleRef=PowerCycle, DemIndicatorRef=WarningIndicator
      DTCClass_INV_EM_STATOR_TEMP2_RNG_HI (DemDTCClass): DemDTCSeverity=DEM_DTC_SEV_MAINTENANCE_ONLY, DemUdsDTC=667665
      INV_EM_STATOR_TEMP2_RNG_HI (DemEventParameter):
        DemEventKind = DEM_EVENT_KIND_SWC
        DemMaxNumberFreezeFrameRecords = 2
        DemDTCClassRef = DTCClass_INV_EM_STATOR_TEMP2_RNG_HI
        DemExtendedDataClassRef = ExtendedDataClass_5ecd55b9
        DemFreezeFrameClassRef = FreezeFrameClass_c3111450
        DemEventClass:
          DemAgingAllowed = true
          DemAgingCycleCounterThreshold = 40
          DemEventDestination = DEM_DTC_ORIGIN_PRIMARY_MEMORY
          DemEventPriority = 1
          DemEventFailureCycleCounterThreshold = 0
          DemAgingCycleRef = PowerCycle
          DemEnableConditionGroupRef = EnableConditionGroup_7ab46a93
          DemOperationCycleRef = PowerCycle
          DemDebounceAlgorithmClass
            DemDebounceCounterBased: DemDebounceCounterDecrementStepSize=128, DemDebounceCounterIncrementStepSize=127, DemDebounceCounterJumpDown=true, DemDebounceCounterJumpUp=true
          IndicatorAttribute_WarningIndicator (DemIndicatorAttribute): DemIndicatorFailureCycleSource=DEM_FAILURE_CYCLE_EVENT, DemIndicatorHealingCycleRef=PowerCycle, DemIndicatorRef=WarningIndicator
      DTCClass_INV_EM_STATOR_TEMP2_RNG_LO (DemDTCClass): DemDTCSeverity=DEM_DTC_SEV_MAINTENANCE_ONLY, DemUdsDTC=667666
      INV_EM_STATOR_TEMP2_RNG_LO (DemEventParameter):
        DemEventKind = DEM_EVENT_KIND_SWC
        DemMaxNumberFreezeFrameRecords = 2
        DemDTCClassRef = DTCClass_INV_EM_STATOR_TEMP2_RNG_LO
        DemExtendedDataClassRef = ExtendedDataClass_5ecd55b9
        DemFreezeFrameClassRef = FreezeFrameClass_c3111450
        DemEventClass:
          DemAgingAllowed = true
          DemAgingCycleCounterThreshold = 40
          DemEventDestination = DEM_DTC_ORIGIN_PRIMARY_MEMORY
          DemEventPriority = 1
          DemEventFailureCycleCounterThreshold = 0
          DemAgingCycleRef = PowerCycle
          DemEnableConditionGroupRef = EnableConditionGroup_7ab46a93
          DemOperationCycleRef = PowerCycle
          DemDebounceAlgorithmClass
            DemDebounceCounterBased: DemDebounceCounterDecrementStepSize=128, DemDebounceCounterIncrementStepSize=127, DemDebounceCounterJumpDown=true, DemDebounceCounterJumpUp=true
          IndicatorAttribute_WarningIndicator (DemIndicatorAttribute): DemIndicatorFailureCycleSource=DEM_FAILURE_CYCLE_EVENT, DemIndicatorHealingCycleRef=PowerCycle, DemIndicatorRef=WarningIndicator
      DTCClass_INV_EM_STATOR_TEMP2_RNG_NOK (DemDTCClass): DemDTCSeverity=DEM_DTC_SEV_MAINTENANCE_ONLY, DemUdsDTC=667676
      INV_EM_STATOR_TEMP2_RNG_NOK (DemEventParameter):
        DemEventKind = DEM_EVENT_KIND_SWC
        DemMaxNumberFreezeFrameRecords = 2
        DemDTCClassRef = DTCClass_INV_EM_STATOR_TEMP2_RNG_NOK
        DemExtendedDataClassRef = ExtendedDataClass_5ecd55b9
        DemFreezeFrameClassRef = FreezeFrameClass_c3111450
        DemEventClass:
          DemAgingAllowed = true
          DemAgingCycleCounterThreshold = 40
          DemEventDestination = DEM_DTC_ORIGIN_PRIMARY_MEMORY
          DemEventPriority = 1
          DemEventFailureCycleCounterThreshold = 0
          DemAgingCycleRef = PowerCycle
          DemEnableConditionGroupRef = EnableConditionGroup_7ab46a93
          DemOperationCycleRef = PowerCycle
          DemDebounceAlgorithmClass
            DemDebounceCounterBased: DemDebounceCounterDecrementStepSize=128, DemDebounceCounterIncrementStepSize=127, DemDebounceCounterJumpDown=true, DemDebounceCounterJumpUp=true
          IndicatorAttribute_WarningIndicator (DemIndicatorAttribute): DemIndicatorFailureCycleSource=DEM_FAILURE_CYCLE_EVENT, DemIndicatorHealingCycleRef=PowerCycle, DemIndicatorRef=WarningIndicator
      DTCClass_INV_EM_STATOR_TEMP2_GRDT (DemDTCClass): DemDTCSeverity=DEM_DTC_SEV_MAINTENANCE_ONLY, DemUdsDTC=667687
      INV_EM_STATOR_TEMP2_GRDT (DemEventParameter):
        DemEventKind = DEM_EVENT_KIND_SWC
        DemMaxNumberFreezeFrameRecords = 2
        DemDTCClassRef = DTCClass_INV_EM_STATOR_TEMP2_GRDT
        DemExtendedDataClassRef = ExtendedDataClass_5ecd55b9
        DemFreezeFrameClassRef = FreezeFrameClass_c3111450
        DemEventClass:
          DemAgingAllowed = true
          DemAgingCycleCounterThreshold = 40
          DemEventDestination = DEM_DTC_ORIGIN_PRIMARY_MEMORY
          DemEventPriority = 1
          DemEventFailureCycleCounterThreshold = 0
          DemAgingCycleRef = PowerCycle
          DemEnableConditionGroupRef = EnableConditionGroup_90577524
          DemOperationCycleRef = PowerCycle
          DemDebounceAlgorithmClass
            DemDebounceCounterBased: DemDebounceCounterDecrementStepSize=128, DemDebounceCounterIncrementStepSize=127, DemDebounceCounterJumpDown=true, DemDebounceCounterJumpUp=true
          IndicatorAttribute_WarningIndicator (DemIndicatorAttribute): DemIndicatorFailureCycleSource=DEM_FAILURE_CYCLE_EVENT, DemIndicatorHealingCycleRef=PowerCycle, DemIndicatorRef=WarningIndicator
      DTCClass_INV_EM_STATOR_TEMP2_RNG_SWT (DemDTCClass): DemDTCSeverity=DEM_DTC_SEV_MAINTENANCE_ONLY, DemUdsDTC=667690
      INV_EM_STATOR_TEMP2_RNG_SWT (DemEventParameter):
        DemEventKind = DEM_EVENT_KIND_SWC
        DemMaxNumberFreezeFrameRecords = 2
        DemDTCClassRef = DTCClass_INV_EM_STATOR_TEMP2_RNG_SWT
        DemExtendedDataClassRef = ExtendedDataClass_5ecd55b9
        DemFreezeFrameClassRef = FreezeFrameClass_c3111450
        DemEventClass:
          DemAgingAllowed = true
          DemAgingCycleCounterThreshold = 40
          DemEventDestination = DEM_DTC_ORIGIN_PRIMARY_MEMORY
          DemEventPriority = 1
          DemEventFailureCycleCounterThreshold = 0
          DemAgingCycleRef = PowerCycle
          DemEnableConditionGroupRef = EnableConditionGroup_7ab46a93
          DemOperationCycleRef = PowerCycle
          DemDebounceAlgorithmClass
            DemDebounceCounterBased: DemDebounceCounterDecrementStepSize=128, DemDebounceCounterIncrementStepSize=127, DemDebounceCounterJumpDown=true, DemDebounceCounterJumpUp=true
          IndicatorAttribute_WarningIndicator (DemIndicatorAttribute): DemIndicatorFailureCycleSource=DEM_FAILURE_CYCLE_EVENT, DemIndicatorHealingCycleRef=PowerCycle, DemIndicatorRef=WarningIndicator
      DTCClass_INV_IAC_U_AMP (DemDTCClass): DemDTCSeverity=DEM_DTC_SEV_IMMEDIATELY, DemUdsDTC=679202
      INV_IAC_U_AMP (DemEventParameter):
        DemEventKind = DEM_EVENT_KIND_SWC
        DemMaxNumberFreezeFrameRecords = 2
        DemDTCClassRef = DTCClass_INV_IAC_U_AMP
        DemExtendedDataClassRef = ExtendedDataClass_5ecd55b9
        DemFreezeFrameClassRef = FreezeFrameClass_c3111450
        DemEventClass:
          DemAgingAllowed = true
          DemAgingCycleCounterThreshold = 40
          DemEventDestination = DEM_DTC_ORIGIN_PRIMARY_MEMORY
          DemEventPriority = 1
          DemEventFailureCycleCounterThreshold = 0
          DemAgingCycleRef = PowerCycle
          DemEnableConditionGroupRef = EnableConditionGroup_0d30bf3f
          DemOperationCycleRef = PowerCycle
          DemDebounceAlgorithmClass
            DemDebounceCounterBased: DemDebounceCounterDecrementStepSize=128, DemDebounceCounterIncrementStepSize=127, DemDebounceCounterJumpDown=true, DemDebounceCounterJumpUp=true
          IndicatorAttribute_WarningIndicator (DemIndicatorAttribute): DemIndicatorFailureCycleSource=DEM_FAILURE_CYCLE_EVENT, DemIndicatorHealingCycleRef=PowerCycle, DemIndicatorRef=WarningIndicator
      DTCClass_INV_IAC_V_AMP (DemDTCClass): DemDTCSeverity=DEM_DTC_SEV_IMMEDIATELY, DemUdsDTC=679970
      INV_IAC_V_AMP (DemEventParameter):
        DemEventKind = DEM_EVENT_KIND_SWC
        DemMaxNumberFreezeFrameRecords = 2
        DemDTCClassRef = DTCClass_INV_IAC_V_AMP
        DemExtendedDataClassRef = ExtendedDataClass_5ecd55b9
        DemFreezeFrameClassRef = FreezeFrameClass_c3111450
        DemEventClass:
          DemAgingAllowed = true
          DemAgingCycleCounterThreshold = 40
          DemEventDestination = DEM_DTC_ORIGIN_PRIMARY_MEMORY
          DemEventPriority = 1
          DemEventFailureCycleCounterThreshold = 0
          DemAgingCycleRef = PowerCycle
          DemEnableConditionGroupRef = EnableConditionGroup_0d30bf3f
          DemOperationCycleRef = PowerCycle
          DemDebounceAlgorithmClass
            DemDebounceCounterBased: DemDebounceCounterDecrementStepSize=128, DemDebounceCounterIncrementStepSize=127, DemDebounceCounterJumpDown=true, DemDebounceCounterJumpUp=true
          IndicatorAttribute_WarningIndicator (DemIndicatorAttribute): DemIndicatorFailureCycleSource=DEM_FAILURE_CYCLE_EVENT, DemIndicatorHealingCycleRef=PowerCycle, DemIndicatorRef=WarningIndicator
      DTCClass_INV_IAC_W_AMP (DemDTCClass): DemDTCSeverity=DEM_DTC_SEV_IMMEDIATELY, DemUdsDTC=680738
      INV_IAC_W_AMP (DemEventParameter):
        DemEventKind = DEM_EVENT_KIND_SWC
        DemMaxNumberFreezeFrameRecords = 2
        DemDTCClassRef = DTCClass_INV_IAC_W_AMP
        DemExtendedDataClassRef = ExtendedDataClass_5ecd55b9
        DemFreezeFrameClassRef = FreezeFrameClass_c3111450
        DemEventClass:
          DemAgingAllowed = true
          DemAgingCycleCounterThreshold = 40
          DemEventDestination = DEM_DTC_ORIGIN_PRIMARY_MEMORY
          DemEventPriority = 1
          DemEventFailureCycleCounterThreshold = 0
          DemAgingCycleRef = PowerCycle
          DemEnableConditionGroupRef = EnableConditionGroup_0d30bf3f
          DemOperationCycleRef = PowerCycle
          DemDebounceAlgorithmClass
            DemDebounceCounterBased: DemDebounceCounterDecrementStepSize=128, DemDebounceCounterIncrementStepSize=127, DemDebounceCounterJumpDown=true, DemDebounceCounterJumpUp=true
          IndicatorAttribute_WarningIndicator (DemIndicatorAttribute): DemIndicatorFailureCycleSource=DEM_FAILURE_CYCLE_EVENT, DemIndicatorHealingCycleRef=PowerCycle, DemIndicatorRef=WarningIndicator
      DTCClass_VcEvEMPerfPlaus (DemDTCClass): DemDTCSeverity=DEM_DTC_SEV_IMMEDIATELY, DemUdsDTC=692370

[part 1 of 4: package /InitialEcuC]
AUTOSAR XML (schema 00045)
package /InitialEcuC
  ecuc value collection InitialEcuC: ecuc-values=[Dcm, Dem]
  module config Dcm: module-description=Dcm_Impl
    DcmConfigSet
      DcmGeneral
      DcmDsd
        DcmDsdServiceTable
          9 x DcmDsdService:
            DiagSessionControl: DcmDsdSidTabServiceId=16, DcmDsdSidTabSubfuncAvail=true
              3 x DcmDsdSubService:
                Default: DcmDsdSubServiceId=1
                Programming: DcmDsdSubServiceId=2
                Extended: DcmDsdSubServiceId=3, DcmDsdSubServiceSessionLevelRef=defaultSession, DcmDsdSubServiceSessionLevelRef=extendedDiagnosticSession
            EcuReset: DcmDsdSidTabServiceId=17, DcmDsdSidTabSubfuncAvail=true
              Hard (DcmDsdSubService): DcmDsdSubServiceId=1
            ClearDiagInfo: DcmDsdSidTabServiceId=20, DcmDsdSidTabSubfuncAvail=false, DcmDsdSidTabSessionLevelRef=defaultSession, DcmDsdSidTabSessionLevelRef=extendedDiagnosticSession
            ReadDtcInfo: DcmDsdSidTabServiceId=25, DcmDsdSidTabSubfuncAvail=true, DcmDsdSidTabSessionLevelRef=defaultSession, DcmDsdSidTabSessionLevelRef=extendedDiagnosticSession
              5 x DcmDsdSubService, all with DcmDsdSubServiceSessionLevelRef=defaultSession, DcmDsdSubServiceSessionLevelRef=extendedDiagnosticSession:
                RDTCBSM: DcmDsdSubServiceId=2
                RDTCSSI: DcmDsdSubServiceId=3
                RDTCSSBDTC: DcmDsdSubServiceId=4
                RDTCEDRBDN: DcmDsdSubServiceId=6
                RSUPDTC: DcmDsdSubServiceId=10
            ReadDataById: DcmDsdSidTabServiceId=34, DcmDsdSidTabSubfuncAvail=false
            SecurityAccess: DcmDsdSidTabServiceId=39, DcmDsdSidTabSubfuncAvail=true, DcmDsdSidTabSessionLevelRef=extendedDiagnosticSession
              4 x DcmDsdSubService, all with DcmDsdSubServiceSessionLevelRef=extendedDiagnosticSession:
                SeedLevel1_Request: DcmDsdSubServiceId=5
                KeyLevel1_Send: DcmDsdSubServiceId=6
                Level_4_RequestSeedImmo_Request: DcmDsdSubServiceId=17
                Level_4_SendKeyImmo_Send: DcmDsdSubServiceId=18
            WriteDataById: DcmDsdSidTabServiceId=46, DcmDsdSidTabSubfuncAvail=false, DcmDsdSidTabSessionLevelRef=extendedDiagnosticSession
            RoutineControl: DcmDsdSidTabServiceId=49, DcmDsdSidTabSubfuncAvail=true, DcmDsdSidTabSessionLevelRef=defaultSession, DcmDsdSidTabSessionLevelRef=extendedDiagnosticSession
            TesterPresent: DcmDsdSidTabServiceId=62, DcmDsdSidTabSubfuncAvail=true
              TesterPresent (DcmDsdSubService): DcmDsdSubServiceId=0
      DcmDsp: DcmDspMaxDidToRead=5
        DID_40E0_Secret_Key_Immobilizer_Target_3_DID_40DF_Secret_Key_Immobilizer_Target_2 (DcmDspData):
          DcmDspDataSize = 256
          DcmDspDataType = UINT8_N
          DcmDspDataInfoRef = DataInfo_DID_40E0_Secret_Key_Immobilizer_Target_3_DID_40DF_Secret_Key_Immobilizer_Target_2
        DataInfo_DID_40E0_Secret_Key_Immobilizer_Target_3_DID_40DF_Secret_Key_Immobilizer_Target_2 (DcmDspDataInfo): DcmDspDataFixedLength=true
        DID_D003_Vehicle_Speed_DID_D003_Vehicle_Speed (DcmDspData): DcmDspDataSize=16, DcmDspDataType=UINT16, DcmDspDataInfoRef=DataInfo_DID_D003_Vehicle_Speed_DID_D003_Vehicle_Speed
        DataInfo_DID_D003_Vehicle_Speed_DID_D003_Vehicle_Speed (DcmDspDataInfo): DcmDspDataFixedLength=true
        DID_D005_High_Quiescent_Current_Fault_Identification_Data_DID_D005_1_1st_System_Global_Time_the_time_when_the_DID_is_triggered (DcmDspData):
          DcmDspDataSize = 32
          DcmDspDataType = UINT32
          DcmDspDataInfoRef = DataInfo_DID_D005_High_Quiescent_Current_Fault_Identification_Data_DID_D005_1_1st_System_Global_Time_the_time_when_the_D1ec8d60e
        DataInfo_DID_D005_High_Quiescent_Current_Fault_Identification_Data_DID_D005_1_1st_System_Global_Time_the_time_when_the_D1ec8d60e (DcmDspDataInfo): DcmDspDataFixedLength=true
        DID_D005_High_Quiescent_Current_Fault_Identification_Data_DID_D005_2_1st_Global_time_when_Functionality_Activity_level_Sa38038bb (DcmDspData):
          DcmDspDataSize = 32
          DcmDspDataType = UINT32
          DcmDspDataInfoRef = DataInfo_DID_D005_High_Quiescent_Current_Fault_Identification_Data_DID_D005_2_1st_Global_time_when_Functionality_Activit6a6f0b62
        DataInfo_DID_D005_High_Quiescent_Current_Fault_Identification_Data_DID_D005_2_1st_Global_time_when_Functionality_Activit6a6f0b62 (DcmDspDataInfo): DcmDspDataFixedLength=true
        DID_D005_High_Quiescent_Current_Fault_Identification_Data_D005_1st_Functionality_Activity_Level_PNC24 (DcmDspData):
          DcmDspDataSize = 8
          DcmDspDataType = UINT8
          DcmDspDataInfoRef = DataInfo_DID_D005_High_Quiescent_Current_Fault_Identification_Data_D005_1st_Functionality_Activity_Level_PNC24
        DataInfo_DID_D005_High_Quiescent_Current_Fault_Identification_Data_D005_1st_Functionality_Activity_Level_PNC24 (DcmDspDataInfo): DcmDspDataFixedLength=true
        DID_D005_High_Quiescent_Current_Fault_Identification_Data_D005_1st_Functionality_Activity_Level_PNC25 (DcmDspData):
          DcmDspDataSize = 8
          DcmDspDataType = UINT8
          DcmDspDataInfoRef = DataInfo_DID_D005_High_Quiescent_Current_Fault_Identification_Data_D005_1st_Functionality_Activity_Level_PNC25
        DataInfo_DID_D005_High_Quiescent_Current_Fault_Identification_Data_D005_1st_Functionality_Activity_Level_PNC25 (DcmDspDataInfo): DcmDspDataFixedLength=true
        DID_D005_High_Quiescent_Current_Fault_Identification_Data_D005_1st_Functionality_Activity_Level_PNC26 (DcmDspData):
          DcmDspDataSize = 8
          DcmDspDataType = UINT8
          DcmDspDataInfoRef = DataInfo_DID_D005_High_Quiescent_Current_Fault_Identification_Data_D005_1st_Functionality_Activity_Level_PNC26
        DataInfo_DID_D005_High_Quiescent_Current_Fault_Identification_Data_D005_1st_Functionality_Activity_Level_PNC26 (DcmDspDataInfo): DcmDspDataFixedLength=true
        DID_D005_High_Quiescent_Current_Fault_Identification_Data_D005_1st_Functionality_Activity_Level_PNC27 (DcmDspData):
          DcmDspDataSize = 8
          DcmDspDataType = UINT8
          DcmDspDataInfoRef = DataInfo_DID_D005_High_Quiescent_Current_Fault_Identification_Data_D005_1st_Functionality_Activity_Level_PNC27
        DataInfo_DID_D005_High_Quiescent_Current_Fault_Identification_Data_D005_1st_Functionality_Activity_Level_PNC27 (DcmDspDataInfo): DcmDspDataFixedLength=true
        DID_D005_High_Quiescent_Current_Fault_Identification_Data_D005_1st_Functionality_Activity_Level_PNC29 (DcmDspData):
          DcmDspDataSize = 8
          DcmDspDataType = UINT8
          DcmDspDataInfoRef = DataInfo_DID_D005_High_Quiescent_Current_Fault_Identification_Data_D005_1st_Functionality_Activity_Level_PNC29
        DataInfo_DID_D005_High_Quiescent_Current_Fault_Identification_Data_D005_1st_Functionality_Activity_Level_PNC29 (DcmDspDataInfo): DcmDspDataFixedLength=true
        DID_D005_High_Quiescent_Current_Fault_Identification_Data_D005_1st_Functionality_Activity_Level_PNC30 (DcmDspData):
          DcmDspDataSize = 8
          DcmDspDataType = UINT8
          DcmDspDataInfoRef = DataInfo_DID_D005_High_Quiescent_Current_Fault_Identification_Data_D005_1st_Functionality_Activity_Level_PNC30
        DataInfo_DID_D005_High_Quiescent_Current_Fault_Identification_Data_D005_1st_Functionality_Activity_Level_PNC30 (DcmDspDataInfo): DcmDspDataFixedLength=true
        DID_D005_High_Quiescent_Current_Fault_Identification_Data_D005_1st_Functionality_Activity_Level_PNC35 (DcmDspData):
          DcmDspDataSize = 8
          DcmDspDataType = UINT8
          DcmDspDataInfoRef = DataInfo_DID_D005_High_Quiescent_Current_Fault_Identification_Data_D005_1st_Functionality_Activity_Level_PNC35
        DataInfo_DID_D005_High_Quiescent_Current_Fault_Identification_Data_D005_1st_Functionality_Activity_Level_PNC35 (DcmDspDataInfo): DcmDspDataFixedLength=true
        DID_D005_High_Quiescent_Current_Fault_Identification_Data_D005_1st_Functionality_Activity_Level_PNC39 (DcmDspData):
          DcmDspDataSize = 8
          DcmDspDataType = UINT8
          DcmDspDataInfoRef = DataInfo_DID_D005_High_Quiescent_Current_Fault_Identification_Data_D005_1st_Functionality_Activity_Level_PNC39
        DataInfo_DID_D005_High_Quiescent_Current_Fault_Identification_Data_D005_1st_Functionality_Activity_Level_PNC39 (DcmDspDataInfo): DcmDspDataFixedLength=true
        DID_D005_High_Quiescent_Current_Fault_Identification_Data_Reserved_PNC_1st (DcmDspData): DcmDspDataSize=56, DcmDspDataType=UINT8_N, DcmDspDataInfoRef=DataInfo_DID_D005_High_Quiescent_Current_Fault_Identification_Data_Reserved_PNC_1st
        DataInfo_DID_D005_High_Quiescent_Current_Fault_Identification_Data_Reserved_PNC_1st (DcmDspDataInfo): DcmDspDataFixedLength=true
        DID_D005_High_Quiescent_Current_Fault_Identification_Data_Functionality_Activity_Level_Detect_CPSR_Keep_Active_1st (DcmDspData):
          DcmDspDataSize = 8
          DcmDspDataType = UINT8
          DcmDspDataInfoRef = DataInfo_DID_D005_High_Quiescent_Current_Fault_Identification_Data_Functionality_Activity_Level_Detect_CPSR_Keep_Active_1st
        DataInfo_DID_D005_High_Quiescent_Current_Fault_Identification_Data_Functionality_Activity_Level_Detect_CPSR_Keep_Active_1st (DcmDspDataInfo): DcmDspDataFixedLength=true
        DID_D005_High_Quiescent_Current_Fault_Identification_Data_Functionality_Activity_Level_Detect_Motor_Speed_Abnormal_1st (DcmDspData):
          DcmDspDataSize = 8
          DcmDspDataType = UINT8
          DcmDspDataInfoRef = DataInfo_DID_D005_High_Quiescent_Current_Fault_Identification_Data_Functionality_Activity_Level_Detect_Motor_Speed_Abnormal_1st
        DataInfo_DID_D005_High_Quiescent_Current_Fault_Identification_Data_Functionality_Activity_Level_Detect_Motor_Speed_Abnormal_1st (DcmDspDataInfo): DcmDspDataFixedLength=true
        DID_D005_High_Quiescent_Current_Fault_Identification_Data_Functionality_Activity_Level_Detect_DC_Bus_voltage_Abnormal_1st (DcmDspData):
          DcmDspDataSize = 8
          DcmDspDataType = UINT8
          DcmDspDataInfoRef = DataInfo_DID_D005_High_Quiescent_Current_Fault_Identification_Data_Functionality_Activity_Level_Detect_DC_Bus_voltage_Ab895ea3c2
        DataInfo_DID_D005_High_Quiescent_Current_Fault_Identification_Data_Functionality_Activity_Level_Detect_DC_Bus_voltage_Ab895ea3c2 (DcmDspDataInfo): DcmDspDataFixedLength=true
        DID_D005_High_Quiescent_Current_Fault_Identification_Data_Reserved_Data_Field_1st (DcmDspData):
          DcmDspDataSize = 176
          DcmDspDataType = UINT8_N
          DcmDspDataInfoRef = DataInfo_DID_D005_High_Quiescent_Current_Fault_Identification_Data_Reserved_Data_Field_1st
        DataInfo_DID_D005_High_Quiescent_Current_Fault_Identification_Data_Reserved_Data_Field_1st (DcmDspDataInfo): DcmDspDataFixedLength=true
        DID_D005_High_Quiescent_Current_Fault_Identification_Data_Bitfield_1th (DcmDspData): DcmDspDataSize=8, DcmDspDataType=UINT8_N, DcmDspDataInfoRef=DataInfo_DID_D005_High_Quiescent_Current_Fault_Identification_Data_Bitfield_1th
        DataInfo_DID_D005_High_Quiescent_Current_Fault_Identification_Data_Bitfield_1th (DcmDspDataInfo): DcmDspDataFixedLength=true
        DID_D005_High_Quiescent_Current_Fault_Identification_Data_DID_D005_1st_Usage_Mode_when_DID_is_triggered (DcmDspData):
          DcmDspDataSize = 8
          DcmDspDataType = UINT8
          DcmDspDataInfoRef = DataInfo_DID_D005_High_Quiescent_Current_Fault_Identification_Data_DID_D005_1st_Usage_Mode_when_DID_is_triggered
        DataInfo_DID_D005_High_Quiescent_Current_Fault_Identification_Data_DID_D005_1st_Usage_Mode_when_DID_is_triggered (DcmDspDataInfo): DcmDspDataFixedLength=true
        DID_D005_High_Quiescent_Current_Fault_Identification_Data_DID_D005_2st_System_Global_Time_the_time_when_the_DID_is_triggered (DcmDspData):
          DcmDspDataSize = 32
          DcmDspDataType = UINT32
          DcmDspDataInfoRef = DataInfo_DID_D005_High_Quiescent_Current_Fault_Identification_Data_DID_D005_2st_System_Global_Time_the_time_when_the_DID40fc1757
        DataInfo_DID_D005_High_Quiescent_Current_Fault_Identification_Data_DID_D005_2st_System_Global_Time_the_time_when_the_DID40fc1757 (DcmDspDataInfo): DcmDspDataFixedLength=true
        DID_D005_High_Quiescent_Current_Fault_Identification_Data_DID_D005_2st_Global_time_when_Functionality_Activity_level_Sleb7289ace (DcmDspData):
          DcmDspDataSize = 32
          DcmDspDataType = UINT32
          DcmDspDataInfoRef = DataInfo_DID_D005_High_Quiescent_Current_Fault_Identification_Data_DID_D005_2st_Global_time_when_Functionality_Activity_c77cfb46
        DataInfo_DID_D005_High_Quiescent_Current_Fault_Identification_Data_DID_D005_2st_Global_time_when_Functionality_Activity_c77cfb46 (DcmDspDataInfo): DcmDspDataFixedLength=true
        DID_D005_High_Quiescent_Current_Fault_Identification_Data_D005_2st_Functionality_Activity_Level_PNC24 (DcmDspData):
          DcmDspDataSize = 8
          DcmDspDataType = UINT8
          DcmDspDataInfoRef = DataInfo_DID_D005_High_Quiescent_Current_Fault_Identification_Data_D005_2st_Functionality_Activity_Level_PNC24
        DataInfo_DID_D005_High_Quiescent_Current_Fault_Identification_Data_D005_2st_Functionality_Activity_Level_PNC24 (DcmDspDataInfo): DcmDspDataFixedLength=true
        DID_D005_High_Quiescent_Current_Fault_Identification_Data_D005_2st_Functionality_Activity_Level_PNC25 (DcmDspData):
          DcmDspDataSize = 8
          DcmDspDataType = UINT8
          DcmDspDataInfoRef = DataInfo_DID_D005_High_Quiescent_Current_Fault_Identification_Data_D005_2st_Functionality_Activity_Level_PNC25
        DataInfo_DID_D005_High_Quiescent_Current_Fault_Identification_Data_D005_2st_Functionality_Activity_Level_PNC25 (DcmDspDataInfo): DcmDspDataFixedLength=true
        DID_D005_High_Quiescent_Current_Fault_Identification_Data_D005_2st_Functionality_Activity_Level_PNC26 (DcmDspData):
          DcmDspDataSize = 8
          DcmDspDataType = UINT8
          DcmDspDataInfoRef = DataInfo_DID_D005_High_Quiescent_Current_Fault_Identification_Data_D005_2st_Functionality_Activity_Level_PNC26
        DataInfo_DID_D005_High_Quiescent_Current_Fault_Identification_Data_D005_2st_Functionality_Activity_Level_PNC26 (DcmDspDataInfo): DcmDspDataFixedLength=true
        DID_D005_High_Quiescent_Current_Fault_Identification_Data_D005_2st_Functionality_Activity_Level_PNC27 (DcmDspData):
          DcmDspDataSize = 8
          DcmDspDataType = UINT8
          DcmDspDataInfoRef = DataInfo_DID_D005_High_Quiescent_Current_Fault_Identification_Data_D005_2st_Functionality_Activity_Level_PNC27
        DataInfo_DID_D005_High_Quiescent_Current_Fault_Identification_Data_D005_2st_Functionality_Activity_Level_PNC27 (DcmDspDataInfo): DcmDspDataFixedLength=true
        DID_D005_High_Quiescent_Current_Fault_Identification_Data_D005_2st_Functionality_Activity_Level_PNC29 (DcmDspData):
          DcmDspDataSize = 8
          DcmDspDataType = UINT8
          DcmDspDataInfoRef = DataInfo_DID_D005_High_Quiescent_Current_Fault_Identification_Data_D005_2st_Functionality_Activity_Level_PNC29
        DataInfo_DID_D005_High_Quiescent_Current_Fault_Identification_Data_D005_2st_Functionality_Activity_Level_PNC29 (DcmDspDataInfo): DcmDspDataFixedLength=true
        DID_D005_High_Quiescent_Current_Fault_Identification_Data_D005_2st_Functionality_Activity_Level_PNC30 (DcmDspData):
          DcmDspDataSize = 8
          DcmDspDataType = UINT8
          DcmDspDataInfoRef = DataInfo_DID_D005_High_Quiescent_Current_Fault_Identification_Data_D005_2st_Functionality_Activity_Level_PNC30
        DataInfo_DID_D005_High_Quiescent_Current_Fault_Identification_Data_D005_2st_Functionality_Activity_Level_PNC30 (DcmDspDataInfo): DcmDspDataFixedLength=true
        DID_D005_High_Quiescent_Current_Fault_Identification_Data_D005_2st_Functionality_Activity_Level_PNC35 (DcmDspData):
          DcmDspDataSize = 8
          DcmDspDataType = UINT8
          DcmDspDataInfoRef = DataInfo_DID_D005_High_Quiescent_Current_Fault_Identification_Data_D005_2st_Functionality_Activity_Level_PNC35
        DataInfo_DID_D005_High_Quiescent_Current_Fault_Identification_Data_D005_2st_Functionality_Activity_Level_PNC35 (DcmDspDataInfo): DcmDspDataFixedLength=true
        DID_D005_High_Quiescent_Current_Fault_Identification_Data_D005_2st_Functionality_Activity_Level_PNC39 (DcmDspData):
          DcmDspDataSize = 8
          DcmDspDataType = UINT8
          DcmDspDataInfoRef = DataInfo_DID_D005_High_Quiescent_Current_Fault_Identification_Data_D005_2st_Functionality_Activity_Level_PNC39
        DataInfo_DID_D005_High_Quiescent_Current_Fault_Identification_Data_D005_2st_Functionality_Activity_Level_PNC39 (DcmDspDataInfo): DcmDspDataFixedLength=true
        DID_D005_High_Quiescent_Current_Fault_Identification_Data_Reserved_PNC_2st (DcmDspData): DcmDspDataSize=56, DcmDspDataType=UINT8_N, DcmDspDataInfoRef=DataInfo_DID_D005_High_Quiescent_Current_Fault_Identification_Data_Reserved_PNC_2st
        DataInfo_DID_D005_High_Quiescent_Current_Fault_Identification_Data_Reserved_PNC_2st (DcmDspDataInfo): DcmDspDataFixedLength=true
        DID_D005_High_Quiescent_Current_Fault_Identification_Data_Functionality_Activity_Level_Detect_CPSR_Keep_Active_2st (DcmDspData):
          DcmDspDataSize = 8
          DcmDspDataType = UINT8
          DcmDspDataInfoRef = DataInfo_DID_D005_High_Quiescent_Current_Fault_Identification_Data_Functionality_Activity_Level_Detect_CPSR_Keep_Active_2st
        DataInfo_DID_D005_High_Quiescent_Current_Fault_Identification_Data_Functionality_Activity_Level_Detect_CPSR_Keep_Active_2st (DcmDspDataInfo): DcmDspDataFixedLength=true
        DID_D005_High_Quiescent_Current_Fault_Identification_Data_Functionality_Activity_Level_Detect_Motor_Speed_Abnormal_2st (DcmDspData):
          DcmDspDataSize = 8
          DcmDspDataType = UINT8
          DcmDspDataInfoRef = DataInfo_DID_D005_High_Quiescent_Current_Fault_Identification_Data_Functionality_Activity_Level_Detect_Motor_Speed_Abnormal_2st
        DataInfo_DID_D005_High_Quiescent_Current_Fault_Identification_Data_Functionality_Activity_Level_Detect_Motor_Speed_Abnormal_2st (DcmDspDataInfo): DcmDspDataFixedLength=true
        DID_D005_High_Quiescent_Current_Fault_Identification_Data_Functionality_Activity_Level_Detect_DC_Bus_voltage_Abnormal_2st (DcmDspData):
          DcmDspDataSize = 8
          DcmDspDataType = UINT8
          DcmDspDataInfoRef = DataInfo_DID_D005_High_Quiescent_Current_Fault_Identification_Data_Functionality_Activity_Level_Detect_DC_Bus_voltage_Ab8b181d9b
        DataInfo_DID_D005_High_Quiescent_Current_Fault_Identification_Data_Functionality_Activity_Level_Detect_DC_Bus_voltage_Ab8b181d9b (DcmDspDataInfo): DcmDspDataFixedLength=true
        DID_D005_High_Quiescent_Current_Fault_Identification_Data_Reserved_Data_Field_2st (DcmDspData):
          DcmDspDataSize = 176
          DcmDspDataType = UINT8_N
          DcmDspDataInfoRef = DataInfo_DID_D005_High_Quiescent_Current_Fault_Identification_Data_Reserved_Data_Field_2st
        DataInfo_DID_D005_High_Quiescent_Current_Fault_Identification_Data_Reserved_Data_Field_2st (DcmDspDataInfo): DcmDspDataFixedLength=true
        DID_D005_High_Quiescent_Current_Fault_Identification_Data_Bitfield_2th (DcmDspData): DcmDspDataSize=8, DcmDspDataType=UINT8_N, DcmDspDataInfoRef=DataInfo_DID_D005_High_Quiescent_Current_Fault_Identification_Data_Bitfield_2th
        DataInfo_DID_D005_High_Quiescent_Current_Fault_Identification_Data_Bitfield_2th (DcmDspDataInfo): DcmDspDataFixedLength=true
        DID_D005_High_Quiescent_Current_Fault_Identification_Data_DID_D005_2st_Usage_Mode_when_DID_is_triggered (DcmDspData):
          DcmDspDataSize = 8
          DcmDspDataType = UINT8
          DcmDspDataInfoRef = DataInfo_DID_D005_High_Quiescent_Current_Fault_Identification_Data_DID_D005_2st_Usage_Mode_when_DID_is_triggered
        DataInfo_DID_D005_High_Quiescent_Current_Fault_Identification_Data_DID_D005_2st_Usage_Mode_when_DID_is_triggered (DcmDspDataInfo): DcmDspDataFixedLength=true
        DID_D005_High_Quiescent_Current_Fault_Identification_Data_DID_D005_3st_System_Global_Time_the_time_when_the_DID_is_triggered (DcmDspData):
          DcmDspDataSize = 32
          DcmDspDataType = UINT32
          DcmDspDataInfoRef = DataInfo_DID_D005_High_Quiescent_Current_Fault_Identification_Data_DID_D005_3st_System_Global_Time_the_time_when_the_DID5856c533
        DataInfo_DID_D005_High_Quiescent_Current_Fault_Identification_Data_DID_D005_3st_System_Global_Time_the_time_when_the_DID5856c533 (DcmDspDataInfo): DcmDspDataFixedLength=true
        DID_D005_High_Quiescent_Current_Fault_Identification_Data_DID_D005_3st_Global_time_when_Functionality_Activity_level_Slefec137d1 (DcmDspData):
          DcmDspDataSize = 32
          DcmDspDataType = UINT32
          DcmDspDataInfoRef = DataInfo_DID_D005_High_Quiescent_Current_Fault_Identification_Data_DID_D005_3st_Global_time_when_Functionality_Activity_8e955659
        DataInfo_DID_D005_High_Quiescent_Current_Fault_Identification_Data_DID_D005_3st_Global_time_when_Functionality_Activity_8e955659 (DcmDspDataInfo): DcmDspDataFixedLength=true
        DID_D005_High_Quiescent_Current_Fault_Identification_Data_D005_3st_Functionality_Activity_Level_PNC24 (DcmDspData):
          DcmDspDataSize = 8
          DcmDspDataType = UINT8
          DcmDspDataInfoRef = DataInfo_DID_D005_High_Quiescent_Current_Fault_Identification_Data_D005_3st_Functionality_Activity_Level_PNC24
        DataInfo_DID_D005_High_Quiescent_Current_Fault_Identification_Data_D005_3st_Functionality_Activity_Level_PNC24 (DcmDspDataInfo): DcmDspDataFixedLength=true
        DID_D005_High_Quiescent_Current_Fault_Identification_Data_D005_3st_Functionality_Activity_Level_PNC25 (DcmDspData):
          DcmDspDataSize = 8
          DcmDspDataType = UINT8
          DcmDspDataInfoRef = DataInfo_DID_D005_High_Quiescent_Current_Fault_Identification_Data_D005_3st_Functionality_Activity_Level_PNC25
        DataInfo_DID_D005_High_Quiescent_Current_Fault_Identification_Data_D005_3st_Functionality_Activity_Level_PNC25 (DcmDspDataInfo): DcmDspDataFixedLength=true
        DID_D005_High_Quiescent_Current_Fault_Identification_Data_D005_3st_Functionality_Activity_Level_PNC26 (DcmDspData):
          DcmDspDataSize = 8
          DcmDspDataType = UINT8
          DcmDspDataInfoRef = DataInfo_DID_D005_High_Quiescent_Current_Fault_Identification_Data_D005_3st_Functionality_Activity_Level_PNC26
        DataInfo_DID_D005_High_Quiescent_Current_Fault_Identification_Data_D005_3st_Functionality_Activity_Level_PNC26 (DcmDspDataInfo): DcmDspDataFixedLength=true
        DID_D005_High_Quiescent_Current_Fault_Identification_Data_D005_3st_Functionality_Activity_Level_PNC27 (DcmDspData):
          DcmDspDataSize = 8
          DcmDspDataType = UINT8
          DcmDspDataInfoRef = DataInfo_DID_D005_High_Quiescent_Current_Fault_Identification_Data_D005_3st_Functionality_Activity_Level_PNC27
        DataInfo_DID_D005_High_Quiescent_Current_Fault_Identification_Data_D005_3st_Functionality_Activity_Level_PNC27 (DcmDspDataInfo): DcmDspDataFixedLength=true
        DID_D005_High_Quiescent_Current_Fault_Identification_Data_D005_3st_Functionality_Activity_Level_PNC29 (DcmDspData):
          DcmDspDataSize = 8
          DcmDspDataType = UINT8
          DcmDspDataInfoRef = DataInfo_DID_D005_High_Quiescent_Current_Fault_Identification_Data_D005_3st_Functionality_Activity_Level_PNC29
        DataInfo_DID_D005_High_Quiescent_Current_Fault_Identification_Data_D005_3st_Functionality_Activity_Level_PNC29 (DcmDspDataInfo): DcmDspDataFixedLength=true
        DID_D005_High_Quiescent_Current_Fault_Identification_Data_D005_3st_Functionality_Activity_Level_PNC30 (DcmDspData):
          DcmDspDataSize = 8
          DcmDspDataType = UINT8
          DcmDspDataInfoRef = DataInfo_DID_D005_High_Quiescent_Current_Fault_Identification_Data_D005_3st_Functionality_Activity_Level_PNC30
        DataInfo_DID_D005_High_Quiescent_Current_Fault_Identification_Data_D005_3st_Functionality_Activity_Level_PNC30 (DcmDspDataInfo): DcmDspDataFixedLength=true
        DID_D005_High_Quiescent_Current_Fault_Identification_Data_D005_3st_Functionality_Activity_Level_PNC35 (DcmDspData):
          DcmDspDataSize = 8
          DcmDspDataType = UINT8
          DcmDspDataInfoRef = DataInfo_DID_D005_High_Quiescent_Current_Fault_Identification_Data_D005_3st_Functionality_Activity_Level_PNC35
        DataInfo_DID_D005_High_Quiescent_Current_Fault_Identification_Data_D005_3st_Functionality_Activity_Level_PNC35 (DcmDspDataInfo): DcmDspDataFixedLength=true
        DID_D005_High_Quiescent_Current_Fault_Identification_Data_D005_3st_Functionality_Activity_Level_PNC39 (DcmDspData):
          DcmDspDataSize = 8
          DcmDspDataType = UINT8
          DcmDspDataInfoRef = DataInfo_DID_D005_High_Quiescent_Current_Fault_Identification_Data_D005_3st_Functionality_Activity_Level_PNC39
        DataInfo_DID_D005_High_Quiescent_Current_Fault_Identification_Data_D005_3st_Functionality_Activity_Level_PNC39 (DcmDspDataInfo): DcmDspDataFixedLength=true
        DID_D005_High_Quiescent_Current_Fault_Identification_Data_Reserved_PNC_3st (DcmDspData): DcmDspDataSize=56, DcmDspDataType=UINT8_N, DcmDspDataInfoRef=DataInfo_DID_D005_High_Quiescent_Current_Fault_Identification_Data_Reserved_PNC_3st
        DataInfo_DID_D005_High_Quiescent_Current_Fault_Identification_Data_Reserved_PNC_3st (DcmDspDataInfo): DcmDspDataFixedLength=true
        DID_D005_High_Quiescent_Current_Fault_Identification_Data_Functionality_Activity_Level_Detect_CPSR_Keep_Active_3st (DcmDspData):
          DcmDspDataSize = 8
          DcmDspDataType = UINT8
          DcmDspDataInfoRef = DataInfo_DID_D005_High_Quiescent_Current_Fault_Identification_Data_Functionality_Activity_Level_Detect_CPSR_Keep_Active_3st
        DataInfo_DID_D005_High_Quiescent_Current_Fault_Identification_Data_Functionality_Activity_Level_Detect_CPSR_Keep_Active_3st (DcmDspDataInfo): DcmDspDataFixedLength=true
        DID_D005_High_Quiescent_Current_Fault_Identification_Data_Functionality_Activity_Level_Detect_Motor_Speed_Abnormal_3st (DcmDspData):
          DcmDspDataSize = 8
          DcmDspDataType = UINT8
          DcmDspDataInfoRef = DataInfo_DID_D005_High_Quiescent_Current_Fault_Identification_Data_Functionality_Activity_Level_Detect_Motor_Speed_Abnormal_3st
        DataInfo_DID_D005_High_Quiescent_Current_Fault_Identification_Data_Functionality_Activity_Level_Detect_Motor_Speed_Abnormal_3st (DcmDspDataInfo): DcmDspDataFixedLength=true
        DID_D005_High_Quiescent_Current_Fault_Identification_Data_Functionality_Activity_Level_Detect_DC_Bus_voltage_Abnormal3st (DcmDspData):
          DcmDspDataSize = 8
          DcmDspDataType = UINT8
          DcmDspDataInfoRef = DataInfo_DID_D005_High_Quiescent_Current_Fault_Identification_Data_Functionality_Activity_Level_Detect_DC_Bus_voltage_Ab9f04d8ab
        DataInfo_DID_D005_High_Quiescent_Current_Fault_Identification_Data_Functionality_Activity_Level_Detect_DC_Bus_voltage_Ab9f04d8ab (DcmDspDataInfo): DcmDspDataFixedLength=true
        DID_D005_High_Quiescent_Current_Fault_Identification_Data_Reserved_Data_Field_3st (DcmDspData):
          DcmDspDataSize = 176
          DcmDspDataType = UINT8_N
          DcmDspDataInfoRef = DataInfo_DID_D005_High_Quiescent_Current_Fault_Identification_Data_Reserved_Data_Field_3st
        DataInfo_DID_D005_High_Quiescent_Current_Fault_Identification_Data_Reserved_Data_Field_3st (DcmDspDataInfo): DcmDspDataFixedLength=true
        DID_D005_High_Quiescent_Current_Fault_Identification_Data_Bitfield_3th (DcmDspData): DcmDspDataSize=8, DcmDspDataType=UINT8_N, DcmDspDataInfoRef=DataInfo_DID_D005_High_Quiescent_Current_Fault_Identification_Data_Bitfield_3th
        DataInfo_DID_D005_High_Quiescent_Current_Fault_Identification_Data_Bitfield_3th (DcmDspDataInfo): DcmDspDataFixedLength=true
        DID_D005_High_Quiescent_Current_Fault_Identification_Data_DID_D005_3st_Usage_Mode_when_DID_is_triggered (DcmDspData):
          DcmDspDataSize = 8
          DcmDspDataType = UINT8
          DcmDspDataInfoRef = DataInfo_DID_D005_High_Quiescent_Current_Fault_Identification_Data_DID_D005_3st_Usage_Mode_when_DID_is_triggered
        DataInfo_DID_D005_High_Quiescent_Current_Fault_Identification_Data_DID_D005_3st_Usage_Mode_when_DID_is_triggered (DcmDspDataInfo): DcmDspDataFixedLength=true
        DID_D005_High_Quiescent_Current_Fault_Identification_Data_DID_D005_4st_System_Global_Time_the_time_when_the_DID_is_triggered (DcmDspData):
          DcmDspDataSize = 32
          DcmDspDataType = UINT32
          DcmDspDataInfoRef = DataInfo_DID_D005_High_Quiescent_Current_Fault_Identification_Data_DID_D005_4st_System_Global_Time_the_time_when_the_DID1302fa0f
        DataInfo_DID_D005_High_Quiescent_Current_Fault_Identification_Data_DID_D005_4st_System_Global_Time_the_time_when_the_DID1302fa0f (DcmDspDataInfo): DcmDspDataFixedLength=true
        DID_D005_High_Quiescent_Current_Fault_Identification_Data_DID_D005_4st_Global_time_when_Functionality_Activity_level_Sled82c72cd (DcmDspData):
          DcmDspDataSize = 32
          DcmDspDataType = UINT32
          DcmDspDataInfoRef = DataInfo_DID_D005_High_Quiescent_Current_Fault_Identification_Data_DID_D005_4st_Global_time_when_Functionality_Activity_a8781345
        DataInfo_DID_D005_High_Quiescent_Current_Fault_Identification_Data_DID_D005_4st_Global_time_when_Functionality_Activity_a8781345 (DcmDspDataInfo): DcmDspDataFixedLength=true
        DID_D005_High_Quiescent_Current_Fault_Identification_Data_D005_4st_Functionality_Activity_Level_PNC24 (DcmDspData):
          DcmDspDataSize = 8
          DcmDspDataType = UINT8
          DcmDspDataInfoRef = DataInfo_DID_D005_High_Quiescent_Current_Fault_Identification_Data_D005_4st_Functionality_Activity_Level_PNC24
        DataInfo_DID_D005_High_Quiescent_Current_Fault_Identification_Data_D005_4st_Functionality_Activity_Level_PNC24 (DcmDspDataInfo): DcmDspDataFixedLength=true
        DID_D005_High_Quiescent_Current_Fault_Identification_Data_D005_4st_Functionality_Activity_Level_PNC25 (DcmDspData):
          DcmDspDataSize = 8
          DcmDspDataType = UINT8
          DcmDspDataInfoRef = DataInfo_DID_D005_High_Quiescent_Current_Fault_Identification_Data_D005_4st_Functionality_Activity_Level_PNC25
        DataInfo_DID_D005_High_Quiescent_Current_Fault_Identification_Data_D005_4st_Functionality_Activity_Level_PNC25 (DcmDspDataInfo): DcmDspDataFixedLength=true
        DID_D005_High_Quiescent_Current_Fault_Identification_Data_D005_4st_Functionality_Activity_Level_PNC26 (DcmDspData):
          DcmDspDataSize = 8
          DcmDspDataType = UINT8
          DcmDspDataInfoRef = DataInfo_DID_D005_High_Quiescent_Current_Fault_Identification_Data_D005_4st_Functionality_Activity_Level_PNC26
        DataInfo_DID_D005_High_Quiescent_Current_Fault_Identification_Data_D005_4st_Functionality_Activity_Level_PNC26 (DcmDspDataInfo): DcmDspDataFixedLength=true
        DID_D005_High_Quiescent_Current_Fault_Identification_Data_D005_4st_Functionality_Activity_Level_PNC27 (DcmDspData):
          DcmDspDataSize = 8
          DcmDspDataType = UINT8
          DcmDspDataInfoRef = DataInfo_DID_D005_High_Quiescent_Current_Fault_Identification_Data_D005_4st_Functionality_Activity_Level_PNC27
        DataInfo_DID_D005_High_Quiescent_Current_Fault_Identification_Data_D005_4st_Functionality_Activity_Level_PNC27 (DcmDspDataInfo): DcmDspDataFixedLength=true
        DID_D005_High_Quiescent_Current_Fault_Identification_Data_D005_4st_Functionality_Activity_Level_PNC29 (DcmDspData):
          DcmDspDataSize = 8
          DcmDspDataType = UINT8
          DcmDspDataInfoRef = DataInfo_DID_D005_High_Quiescent_Current_Fault_Identification_Data_D005_4st_Functionality_Activity_Level_PNC29
        DataInfo_DID_D005_High_Quiescent_Current_Fault_Identification_Data_D005_4st_Functionality_Activity_Level_PNC29 (DcmDspDataInfo): DcmDspDataFixedLength=true
        DID_D005_High_Quiescent_Current_Fault_Identification_Data_D005_4st_Functionality_Activity_Level_PNC30 (DcmDspData):
          DcmDspDataSize = 8
          DcmDspDataType = UINT8
          DcmDspDataInfoRef = DataInfo_DID_D005_High_Quiescent_Current_Fault_Identification_Data_D005_4st_Functionality_Activity_Level_PNC30
        DataInfo_DID_D005_High_Quiescent_Current_Fault_Identification_Data_D005_4st_Functionality_Activity_Level_PNC30 (DcmDspDataInfo): DcmDspDataFixedLength=true
        DID_D005_High_Quiescent_Current_Fault_Identification_Data_D005_4st_Functionality_Activity_Level_PNC35 (DcmDspData):
          DcmDspDataSize = 8
          DcmDspDataType = UINT8
          DcmDspDataInfoRef = DataInfo_DID_D005_High_Quiescent_Current_Fault_Identification_Data_D005_4st_Functionality_Activity_Level_PNC35
        DataInfo_DID_D005_High_Quiescent_Current_Fault_Identification_Data_D005_4st_Functionality_Activity_Level_PNC35 (DcmDspDataInfo): DcmDspDataFixedLength=true
        DID_D005_High_Quiescent_Current_Fault_Identification_Data_D005_4st_Functionality_Activity_Level_PNC39 (DcmDspData):
          DcmDspDataSize = 8
          DcmDspDataType = UINT8
          DcmDspDataInfoRef = DataInfo_DID_D005_High_Quiescent_Current_Fault_Identification_Data_D005_4st_Functionality_Activity_Level_PNC39
        DataInfo_DID_D005_High_Quiescent_Current_Fault_Identification_Data_D005_4st_Functionality_Activity_Level_PNC39 (DcmDspDataInfo): DcmDspDataFixedLength=true
        DID_D005_High_Quiescent_Current_Fault_Identification_Data_Reserved_PNC_4st (DcmDspData): DcmDspDataSize=56, DcmDspDataType=UINT8_N, DcmDspDataInfoRef=DataInfo_DID_D005_High_Quiescent_Current_Fault_Identification_Data_Reserved_PNC_4st
        DataInfo_DID_D005_High_Quiescent_Current_Fault_Identification_Data_Reserved_PNC_4st (DcmDspDataInfo): DcmDspDataFixedLength=true
        DID_D005_High_Quiescent_Current_Fault_Identification_Data_Functionality_Activity_Level_Detect_CPSR_Keep_Active_4st (DcmDspData):
          DcmDspDataSize = 8
          DcmDspDataType = UINT8
          DcmDspDataInfoRef = DataInfo_DID_D005_High_Quiescent_Current_Fault_Identification_Data_Functionality_Activity_Level_Detect_CPSR_Keep_Active_4st
        DataInfo_DID_D005_High_Quiescent_Current_Fault_Identification_Data_Functionality_Activity_Level_Detect_CPSR_Keep_Active_4st (DcmDspDataInfo): DcmDspDataFixedLength=true
        DID_D005_High_Quiescent_Current_Fault_Identification_Data_Functionality_Activity_Level_Detect_Motor_Speed_Abnormal_4st (DcmDspData):
          DcmDspDataSize = 8
          DcmDspDataType = UINT8
          DcmDspDataInfoRef = DataInfo_DID_D005_High_Quiescent_Current_Fault_Identification_Data_Functionality_Activity_Level_Detect_Motor_Speed_Abnormal_4st
        DataInfo_DID_D005_High_Quiescent_Current_Fault_Identification_Data_Functionality_Activity_Level_Detect_Motor_Speed_Abnormal_4st (DcmDspDataInfo): DcmDspDataFixedLength=true
        DID_D005_High_Quiescent_Current_Fault_Identification_Data_Functionality_Activity_Level_Detect_DC_Bus_voltage_Abnormal_4st (DcmDspData):
          DcmDspDataSize = 8
          DcmDspDataType = UINT8
          DcmDspDataInfoRef = DataInfo_DID_D005_High_Quiescent_Current_Fault_Identification_Data_Functionality_Activity_Level_Detect_DC_Bus_voltage_Ab8f956129
        DataInfo_DID_D005_High_Quiescent_Current_Fault_Identification_Data_Functionality_Activity_Level_Detect_DC_Bus_voltage_Ab8f956129 (DcmDspDataInfo): DcmDspDataFixedLength=true
        DID_D005_High_Quiescent_Current_Fault_Identification_Data_Reserved_Data_Field_4st (DcmDspData):
          DcmDspDataSize = 176
          DcmDspDataType = UINT8_N
          DcmDspDataInfoRef = DataInfo_DID_D005_High_Quiescent_Current_Fault_Identification_Data_Reserved_Data_Field_4st
        DataInfo_DID_D005_High_Quiescent_Current_Fault_Identification_Data_Reserved_Data_Field_4st (DcmDspDataInfo): DcmDspDataFixedLength=true
        DID_D005_High_Quiescent_Current_Fault_Identification_Data_Bitfield_4th (DcmDspData): DcmDspDataSize=8, DcmDspDataType=UINT8_N, DcmDspDataInfoRef=DataInfo_DID_D005_High_Quiescent_Current_Fault_Identification_Data_Bitfield_4th
        DataInfo_DID_D005_High_Quiescent_Current_Fault_Identification_Data_Bitfield_4th (DcmDspDataInfo): DcmDspDataFixedLength=true
        DID_D005_High_Quiescent_Current_Fault_Identification_Data_DID_D005_4st_Usage_Mode_when_DID_is_triggered (DcmDspData):
          DcmDspDataSize = 8
          DcmDspDataType = UINT8
          DcmDspDataInfoRef = DataInfo_DID_D005_High_Quiescent_Current_Fault_Identification_Data_DID_D005_4st_Usage_Mode_when_DID_is_triggered
        DataInfo_DID_D005_High_Quiescent_Current_Fault_Identification_Data_DID_D005_4st_Usage_Mode_when_DID_is_triggered (DcmDspDataInfo): DcmDspDataFixedLength=true
        DID_D005_High_Quiescent_Current_Fault_Identification_Data_DID_D005_5st_System_Global_Time_the_time_when_the_DID_is_triggered (DcmDspData):
          DcmDspDataSize = 32
          DcmDspDataType = UINT32
          DcmDspDataInfoRef = DataInfo_DID_D005_High_Quiescent_Current_Fault_Identification_Data_DID_D005_5st_System_Global_Time_the_time_when_the_DIDba8286b
        DataInfo_DID_D005_High_Quiescent_Current_Fault_Identification_Data_DID_D005_5st_System_Global_Time_the_time_when_the_DIDba8286b (DcmDspDataInfo): DcmDspDataFixedLength=true
        DID_D005_High_Quiescent_Current_Fault_Identification_Data_DID_D005_5st_Global_time_when_Functionality_Activity_level_Sle91c5dfd2 (DcmDspData):
          DcmDspDataSize = 32
          DcmDspDataType = UINT32
          DcmDspDataInfoRef = DataInfo_DID_D005_High_Quiescent_Current_Fault_Identification_Data_DID_D005_5st_Global_time_when_Functionality_Activity_e191be5a
        DataInfo_DID_D005_High_Quiescent_Current_Fault_Identification_Data_DID_D005_5st_Global_time_when_Functionality_Activity_e191be5a (DcmDspDataInfo): DcmDspDataFixedLength=true
        DID_D005_High_Quiescent_Current_Fault_Identification_Data_D005_5st_Functionality_Activity_Level_PNC24 (DcmDspData):
          DcmDspDataSize = 8
          DcmDspDataType = UINT8
          DcmDspDataInfoRef = DataInfo_DID_D005_High_Quiescent_Current_Fault_Identification_Data_D005_5st_Functionality_Activity_Level_PNC24
        DataInfo_DID_D005_High_Quiescent_Current_Fault_Identification_Data_D005_5st_Functionality_Activity_Level_PNC24 (DcmDspDataInfo): DcmDspDataFixedLength=true
        DID_D005_High_Quiescent_Current_Fault_Identification_Data_D005_5st_Functionality_Activity_Level_PNC25 (DcmDspData):
          DcmDspDataSize = 8
          DcmDspDataType = UINT8
          DcmDspDataInfoRef = DataInfo_DID_D005_High_Quiescent_Current_Fault_Identification_Data_D005_5st_Functionality_Activity_Level_PNC25
        DataInfo_DID_D005_High_Quiescent_Current_Fault_Identification_Data_D005_5st_Functionality_Activity_Level_PNC25 (DcmDspDataInfo): DcmDspDataFixedLength=true
        DID_D005_High_Quiescent_Current_Fault_Identification_Data_D005_5st_Functionality_Activity_Level_PNC26 (DcmDspData):
          DcmDspDataSize = 8
          DcmDspDataType = UINT8
          DcmDspDataInfoRef = DataInfo_DID_D005_High_Quiescent_Current_Fault_Identification_Data_D005_5st_Functionality_Activity_Level_PNC26
        DataInfo_DID_D005_High_Quiescent_Current_Fault_Identification_Data_D005_5st_Functionality_Activity_Level_PNC26 (DcmDspDataInfo): DcmDspDataFixedLength=true
        DID_D005_High_Quiescent_Current_Fault_Identification_Data_D005_5st_Functionality_Activity_Level_PNC27 (DcmDspData):
          DcmDspDataSize = 8
          DcmDspDataType = UINT8
          DcmDspDataInfoRef = DataInfo_DID_D005_High_Quiescent_Current_Fault_Identification_Data_D005_5st_Functionality_Activity_Level_PNC27
        DataInfo_DID_D005_High_Quiescent_Current_Fault_Identification_Data_D005_5st_Functionality_Activity_Level_PNC27 (DcmDspDataInfo): DcmDspDataFixedLength=true
        DID_D005_High_Quiescent_Current_Fault_Identification_Data_D005_5st_Functionality_Activity_Level_PNC29 (DcmDspData):
          DcmDspDataSize = 8
          DcmDspDataType = UINT8
          DcmDspDataInfoRef = DataInfo_DID_D005_High_Quiescent_Current_Fault_Identification_Data_D005_5st_Functionality_Activity_Level_PNC29
        DataInfo_DID_D005_High_Quiescent_Current_Fault_Identification_Data_D005_5st_Functionality_Activity_Level_PNC29 (DcmDspDataInfo): DcmDspDataFixedLength=true
        DID_D005_High_Quiescent_Current_Fault_Identification_Data_D005_5st_Functionality_Activity_Level_PNC30 (DcmDspData):
          DcmDspDataSize = 8
          DcmDspDataType = UINT8
          DcmDspDataInfoRef = DataInfo_DID_D005_High_Quiescent_Current_Fault_Identification_Data_D005_5st_Functionality_Activity_Level_PNC30
        DataInfo_DID_D005_High_Quiescent_Current_Fault_Identification_Data_D005_5st_Functionality_Activity_Level_PNC30 (DcmDspDataInfo): DcmDspDataFixedLength=true
        DID_D005_High_Quiescent_Current_Fault_Identification_Data_D005_5st_Functionality_Activity_Level_PNC35 (DcmDspData):
          DcmDspDataSize = 8
          DcmDspDataType = UINT8
          DcmDspDataInfoRef = DataInfo_DID_D005_High_Quiescent_Current_Fault_Identification_Data_D005_5st_Functionality_Activity_Level_PNC35
        DataInfo_DID_D005_High_Quiescent_Current_Fault_Identification_Data_D005_5st_Functionality_Activity_Level_PNC35 (DcmDspDataInfo): DcmDspDataFixedLength=true
        DID_D005_High_Quiescent_Current_Fault_Identification_Data_D005_5st_Functionality_Activity_Level_PNC39 (DcmDspData):
          DcmDspDataSize = 8
          DcmDspDataType = UINT8
          DcmDspDataInfoRef = DataInfo_DID_D005_High_Quiescent_Current_Fault_Identification_Data_D005_5st_Functionality_Activity_Level_PNC39
        DataInfo_DID_D005_High_Quiescent_Current_Fault_Identification_Data_D005_5st_Functionality_Activity_Level_PNC39 (DcmDspDataInfo): DcmDspDataFixedLength=true
        DID_D005_High_Quiescent_Current_Fault_Identification_Data_Reserved_PNC_5st (DcmDspData): DcmDspDataSize=56, DcmDspDataType=UINT8_N, DcmDspDataInfoRef=DataInfo_DID_D005_High_Quiescent_Current_Fault_Identification_Data_Reserved_PNC_5st
        DataInfo_DID_D005_High_Quiescent_Current_Fault_Identification_Data_Reserved_PNC_5st (DcmDspDataInfo): DcmDspDataFixedLength=true
        DID_D005_High_Quiescent_Current_Fault_Identification_Data_Functionality_Activity_Level_Detect_CPSR_Keep_Active_5st (DcmDspData):
          DcmDspDataSize = 8
          DcmDspDataType = UINT8
          DcmDspDataInfoRef = DataInfo_DID_D005_High_Quiescent_Current_Fault_Identification_Data_Functionality_Activity_Level_Detect_CPSR_Keep_Active_5st
        DataInfo_DID_D005_High_Quiescent_Current_Fault_Identification_Data_Functionality_Activity_Level_Detect_CPSR_Keep_Active_5st (DcmDspDataInfo): DcmDspDataFixedLength=true
        DID_D005_High_Quiescent_Current_Fault_Identification_Data_Functionality_Activity_Level_Detect_Motor_Speed_Abnormal_5st (DcmDspData):
          DcmDspDataSize = 8
          DcmDspDataType = UINT8
          DcmDspDataInfoRef = DataInfo_DID_D005_High_Quiescent_Current_Fault_Identification_Data_Functionality_Activity_Level_Detect_Motor_Speed_Abnormal_5st
        DataInfo_DID_D005_High_Quiescent_Current_Fault_Identification_Data_Functionality_Activity_Level_Detect_Motor_Speed_Abnormal_5st (DcmDspDataInfo): DcmDspDataFixedLength=true
        DID_D005_High_Quiescent_Current_Fault_Identification_Data_Functionality_Activity_Level_Detect_DC_Bus_voltage_Abnormal_5st (DcmDspData):
          DcmDspDataSize = 8
          DcmDspDataType = UINT8
          DcmDspDataInfoRef = DataInfo_DID_D005_High_Quiescent_Current_Fault_Identification_Data_Functionality_Activity_Level_Detect_DC_Bus_voltage_Ab8e570b1e
        DataInfo_DID_D005_High_Quiescent_Current_Fault_Identification_Data_Functionality_Activity_Level_Detect_DC_Bus_voltage_Ab8e570b1e (DcmDspDataInfo): DcmDspDataFixedLength=true
        DID_D005_High_Quiescent_Current_Fault_Identification_Data_Reserved_Data_Field_5st (DcmDspData):
          DcmDspDataSize = 176
          DcmDspDataType = UINT8_N
          DcmDspDataInfoRef = DataInfo_DID_D005_High_Quiescent_Current_Fault_Identification_Data_Reserved_Data_Field_5st
        DataInfo_DID_D005_High_Quiescent_Current_Fault_Identification_Data_Reserved_Data_Field_5st (DcmDspDataInfo): DcmDspDataFixedLength=true
        DID_D005_High_Quiescent_Current_Fault_Identification_Data_Bitfield_5th (DcmDspData): DcmDspDataSize=8, DcmDspDataType=UINT8_N, DcmDspDataInfoRef=DataInfo_DID_D005_High_Quiescent_Current_Fault_Identification_Data_Bitfield_5th
        DataInfo_DID_D005_High_Quiescent_Current_Fault_Identification_Data_Bitfield_5th (DcmDspDataInfo): DcmDspDataFixedLength=true
        DID_D005_High_Quiescent_Current_Fault_Identification_Data_DID_D005_5st_Usage_Mode_when_DID_is_triggered (DcmDspData):
          DcmDspDataSize = 8
          DcmDspDataType = UINT8
          DcmDspDataInfoRef = DataInfo_DID_D005_High_Quiescent_Current_Fault_Identification_Data_DID_D005_5st_Usage_Mode_when_DID_is_triggered
        DataInfo_DID_D005_High_Quiescent_Current_Fault_Identification_Data_DID_D005_5st_Usage_Mode_when_DID_is_triggered (DcmDspDataInfo): DcmDspDataFixedLength=true
        DID_D03A_swAuth_Public_Key_CheckSum_DID_D03A_swAuth_Public_Key_CheckSum (DcmDspData): DcmDspDataSize=256, DcmDspDataType=UINT8_N, DcmDspDataInfoRef=DataInfo_DID_D03A_swAuth_Public_Key_CheckSum_DID_D03A_swAuth_Public_Key_CheckSum
        DataInfo_DID_D03A_swAuth_Public_Key_CheckSum_DID_D03A_swAuth_Public_Key_CheckSum (DcmDspDataInfo): DcmDspDataFixedLength=true
        DID_D09A_High_Quiescent_Current_Function_Activation_Deactivation_DID_D09A_High_Quiescent_Current_Function_ActivationDeactivation (DcmDspData):
          DcmDspDataSize = 8
          DcmDspDataType = UINT8
          DcmDspDataInfoRef = DataInfo_DID_D09A_High_Quiescent_Current_Function_Activation_Deactivation_DID_D09A_High_Quiescent_Current_Function_Activ93b79a05
        DataInfo_DID_D09A_High_Quiescent_Current_Function_Activation_Deactivation_DID_D09A_High_Quiescent_Current_Function_Activ93b79a05 (DcmDspDataInfo): DcmDspDataFixedLength=true
        DID_D0B5_SDB_version_SDB_version (DcmDspData): DcmDspDataSize=24, DcmDspDataType=UINT8_N, DcmDspDataInfoRef=DataInfo_DID_D0B5_SDB_version_SDB_version
        DataInfo_DID_D0B5_SDB_version_SDB_version (DcmDspDataInfo): DcmDspDataFixedLength=true
        DID_D12F_Security_Constant_Level_11_12_DID_D12F_Security_Constant_Level_1112 (DcmDspData):
          DcmDspDataSize = 40
          DcmDspDataType = UINT8_N
          DcmDspDataInfoRef = DataInfo_DID_D12F_Security_Constant_Level_11_12_DID_D12F_Security_Constant_Level_1112
        DataInfo_DID_D12F_Security_Constant_Level_11_12_DID_D12F_Security_Constant_Level_1112 (DcmDspDataInfo): DcmDspDataFixedLength=true
        DID_D134_Car_Mode_DID_D134_Car_Mode (DcmDspData): DcmDspDataSize=8, DcmDspDataType=UINT8, DcmDspDataInfoRef=DataInfo_DID_D134_Car_Mode_DID_D134_Car_Mode
        DataInfo_DID_D134_Car_Mode_DID_D134_Car_Mode (DcmDspDataInfo): DcmDspDataFixedLength=true
        DID_D211_Network_Management_History_Propulsion_CAN_DID_D211_1_Latest_State_NM_History (DcmDspData):
          DcmDspDataSize = 8
          DcmDspDataType = UINT8
          DcmDspDataInfoRef = DataInfo_DID_D211_Network_Management_History_Propulsion_CAN_DID_D211_1_Latest_State_NM_History
        DataInfo_DID_D211_Network_Management_History_Propulsion_CAN_DID_D211_1_Latest_State_NM_History (DcmDspDataInfo): DcmDspDataFixedLength=true
        DID_D211_Network_Management_History_Propulsion_CAN_DID_D211_2_Latest_State_Global_Real_Time (DcmDspData):
          DcmDspDataSize = 32
          DcmDspDataType = UINT32
          DcmDspDataInfoRef = DataInfo_DID_D211_Network_Management_History_Propulsion_CAN_DID_D211_2_Latest_State_Global_Real_Time
        DataInfo_DID_D211_Network_Management_History_Propulsion_CAN_DID_D211_2_Latest_State_Global_Real_Time (DcmDspDataInfo): DcmDspDataFixedLength=true
        DID_D211_Network_Management_History_Propulsion_CAN_DID_D211_3_2nd_Latest_State_NM_History (DcmDspData):
          DcmDspDataSize = 8
          DcmDspDataType = UINT8
          DcmDspDataInfoRef = DataInfo_DID_D211_Network_Management_History_Propulsion_CAN_DID_D211_3_2nd_Latest_State_NM_History
        DataInfo_DID_D211_Network_Management_History_Propulsion_CAN_DID_D211_3_2nd_Latest_State_NM_History (DcmDspDataInfo): DcmDspDataFixedLength=true
        DID_D211_Network_Management_History_Propulsion_CAN_DID_D211_4_2nd_Latest_State_Global_Real_Time (DcmDspData):
          DcmDspDataSize = 32
          DcmDspDataType = UINT32
          DcmDspDataInfoRef = DataInfo_DID_D211_Network_Management_History_Propulsion_CAN_DID_D211_4_2nd_Latest_State_Global_Real_Time
        DataInfo_DID_D211_Network_Management_History_Propulsion_CAN_DID_D211_4_2nd_Latest_State_Global_Real_Time (DcmDspDataInfo): DcmDspDataFixedLength=true
        DID_D211_Network_Management_History_Propulsion_CAN_DID_D211_5_3rd_Latest_State_NM_History (DcmDspData):
          DcmDspDataSize = 8
          DcmDspDataType = UINT8
          DcmDspDataInfoRef = DataInfo_DID_D211_Network_Management_History_Propulsion_CAN_DID_D211_5_3rd_Latest_State_NM_History
        DataInfo_DID_D211_Network_Management_History_Propulsion_CAN_DID_D211_5_3rd_Latest_State_NM_History (DcmDspDataInfo): DcmDspDataFixedLength=true
        DID_D211_Network_Management_History_Propulsion_CAN_DID_D211_6_3rd_Latest_State_Global_Real_Time (DcmDspData):
          DcmDspDataSize = 32
          DcmDspDataType = UINT32
          DcmDspDataInfoRef = DataInfo_DID_D211_Network_Management_History_Propulsion_CAN_DID_D211_6_3rd_Latest_State_Global_Real_Time
        DataInfo_DID_D211_Network_Management_History_Propulsion_CAN_DID_D211_6_3rd_Latest_State_Global_Real_Time (DcmDspDataInfo): DcmDspDataFixedLength=true
        DID_D211_Network_Management_History_Propulsion_CAN_DID_D211_7_4th_Latest_State_NM_History (DcmDspData):
          DcmDspDataSize = 8
          DcmDspDataType = UINT8
          DcmDspDataInfoRef = DataInfo_DID_D211_Network_Management_History_Propulsion_CAN_DID_D211_7_4th_Latest_State_NM_History
        DataInfo_DID_D211_Network_Management_History_Propulsion_CAN_DID_D211_7_4th_Latest_State_NM_History (DcmDspDataInfo): DcmDspDataFixedLength=true
        DID_D211_Network_Management_History_Propulsion_CAN_DID_D211_8_4th_Latest_State_Global_Real_Time (DcmDspData):
          DcmDspDataSize = 32
          DcmDspDataType = UINT32
          DcmDspDataInfoRef = DataInfo_DID_D211_Network_Management_History_Propulsion_CAN_DID_D211_8_4th_Latest_State_Global_Real_Time
        DataInfo_DID_D211_Network_Management_History_Propulsion_CAN_DID_D211_8_4th_Latest_State_Global_Real_Time (DcmDspDataInfo): DcmDspDataFixedLength=true
        DID_D211_Network_Management_History_Propulsion_CAN_DID_D211_9_5th_Latest_State_NM_History (DcmDspData):
          DcmDspDataSize = 8
          DcmDspDataType = UINT8
          DcmDspDataInfoRef = DataInfo_DID_D211_Network_Management_History_Propulsion_CAN_DID_D211_9_5th_Latest_State_NM_History
        DataInfo_DID_D211_Network_Management_History_Propulsion_CAN_DID_D211_9_5th_Latest_State_NM_History (DcmDspDataInfo): DcmDspDataFixedLength=true
        DID_D211_Network_Management_History_Propulsion_CAN_DID_D211_10_5th_Latest_State_Global_Real_Time (DcmDspData):
          DcmDspDataSize = 32
          DcmDspDataType = UINT32
          DcmDspDataInfoRef = DataInfo_DID_D211_Network_Management_History_Propulsion_CAN_DID_D211_10_5th_Latest_State_Global_Real_Time
        DataInfo_DID_D211_Network_Management_History_Propulsion_CAN_DID_D211_10_5th_Latest_State_Global_Real_Time (DcmDspDataInfo): DcmDspDataFixedLength=true
        DID_D211_Network_Management_History_Propulsion_CAN_DID_D211_11_6th_Latest_State_NM_History (DcmDspData):
          DcmDspDataSize = 8
          DcmDspDataType = UINT8
          DcmDspDataInfoRef = DataInfo_DID_D211_Network_Management_History_Propulsion_CAN_DID_D211_11_6th_Latest_State_NM_History
        DataInfo_DID_D211_Network_Management_History_Propulsion_CAN_DID_D211_11_6th_Latest_State_NM_History (DcmDspDataInfo): DcmDspDataFixedLength=true
        DID_D211_Network_Management_History_Propulsion_CAN_DID_D211_12_6th_Latest_State_Global_Real_Time (DcmDspData):
          DcmDspDataSize = 32
          DcmDspDataType = UINT32
          DcmDspDataInfoRef = DataInfo_DID_D211_Network_Management_History_Propulsion_CAN_DID_D211_12_6th_Latest_State_Global_Real_Time
        DataInfo_DID_D211_Network_Management_History_Propulsion_CAN_DID_D211_12_6th_Latest_State_Global_Real_Time (DcmDspDataInfo): DcmDspDataFixedLength=true
        DID_D211_Network_Management_History_Propulsion_CAN_DID_D211_13_7th_Latest_State_NM_History (DcmDspData):
          DcmDspDataSize = 8
          DcmDspDataType = UINT8
          DcmDspDataInfoRef = DataInfo_DID_D211_Network_Management_History_Propulsion_CAN_DID_D211_13_7th_Latest_State_NM_History
        DataInfo_DID_D211_Network_Management_History_Propulsion_CAN_DID_D211_13_7th_Latest_State_NM_History (DcmDspDataInfo): DcmDspDataFixedLength=true
        DID_D211_Network_Management_History_Propulsion_CAN_DID_D211_14_7th_Latest_State_Global_Real_Time (DcmDspData):
          DcmDspDataSize = 32
          DcmDspDataType = UINT32
          DcmDspDataInfoRef = DataInfo_DID_D211_Network_Management_History_Propulsion_CAN_DID_D211_14_7th_Latest_State_Global_Real_Time
        DataInfo_DID_D211_Network_Management_History_Propulsion_CAN_DID_D211_14_7th_Latest_State_Global_Real_Time (DcmDspDataInfo): DcmDspDataFixedLength=true
        DID_D211_Network_Management_History_Propulsion_CAN_DID_D211_15_8th_Latest_State_NM_History (DcmDspData):
          DcmDspDataSize = 8
          DcmDspDataType = UINT8
          DcmDspDataInfoRef = DataInfo_DID_D211_Network_Management_History_Propulsion_CAN_DID_D211_15_8th_Latest_State_NM_History
        DataInfo_DID_D211_Network_Management_History_Propulsion_CAN_DID_D211_15_8th_Latest_State_NM_History (DcmDspDataInfo): DcmDspDataFixedLength=true
        DID_D211_Network_Management_History_Propulsion_CAN_DID_D211_16_8th_Latest_State_Global_Real_Time (DcmDspData):
          DcmDspDataSize = 32
          DcmDspDataType = UINT32
          DcmDspDataInfoRef = DataInfo_DID_D211_Network_Management_History_Propulsion_CAN_DID_D211_16_8th_Latest_State_Global_Real_Time
        DataInfo_DID_D211_Network_Management_History_Propulsion_CAN_DID_D211_16_8th_Latest_State_Global_Real_Time (DcmDspDataInfo): DcmDspDataFixedLength=true
        DID_D211_Network_Management_History_Propulsion_CAN_DID_D211_17_9th_Latest_State_NM_History (DcmDspData):
          DcmDspDataSize = 8
          DcmDspDataType = UINT8
          DcmDspDataInfoRef = DataInfo_DID_D211_Network_Management_History_Propulsion_CAN_DID_D211_17_9th_Latest_State_NM_History
        DataInfo_DID_D211_Network_Management_History_Propulsion_CAN_DID_D211_17_9th_Latest_State_NM_History (DcmDspDataInfo): DcmDspDataFixedLength=true
        DID_D211_Network_Management_History_Propulsion_CAN_DID_D211_18_9th_Latest_State_Global_Real_Time (DcmDspData):
          DcmDspDataSize = 32
          DcmDspDataType = UINT32
          DcmDspDataInfoRef = DataInfo_DID_D211_Network_Management_History_Propulsion_CAN_DID_D211_18_9th_Latest_State_Global_Real_Time
        DataInfo_DID_D211_Network_Management_History_Propulsion_CAN_DID_D211_18_9th_Latest_State_Global_Real_Time (DcmDspDataInfo): DcmDspDataFixedLength=true
        DID_D211_Network_Management_History_Propulsion_CAN_DID_D211_19_10th_Latest_State_NM_History (DcmDspData):
          DcmDspDataSize = 8
          DcmDspDataType = UINT8
          DcmDspDataInfoRef = DataInfo_DID_D211_Network_Management_History_Propulsion_CAN_DID_D211_19_10th_Latest_State_NM_History
        DataInfo_DID_D211_Network_Management_History_Propulsion_CAN_DID_D211_19_10th_Latest_State_NM_History (DcmDspDataInfo): DcmDspDataFixedLength=true
        DID_D211_Network_Management_History_Propulsion_CAN_DID_D211_20_10th_Latest_State_Global_Real_Time (DcmDspData):
          DcmDspDataSize = 32
          DcmDspDataType = UINT32
          DcmDspDataInfoRef = DataInfo_DID_D211_Network_Management_History_Propulsion_CAN_DID_D211_20_10th_Latest_State_Global_Real_Time
        DataInfo_DID_D211_Network_Management_History_Propulsion_CAN_DID_D211_20_10th_Latest_State_Global_Real_Time (DcmDspDataInfo): DcmDspDataFixedLength=true
        DID_DD00_Global_Real_Time_DID_DD00_Global_Real_Time (DcmDspData): DcmDspDataSize=32, DcmDspDataType=UINT32, DcmDspDataInfoRef=DataInfo_DID_DD00_Global_Real_Time_DID_DD00_Global_Real_Time
        DataInfo_DID_DD00_Global_Real_Time_DID_DD00_Global_Real_Time (DcmDspDataInfo): DcmDspDataFixedLength=true
        DID_DD01_Total_Distance_DID_DD01_Total_Distance (DcmDspData): DcmDspDataSize=24, DcmDspDataType=UINT8_N, DcmDspDataInfoRef=DataInfo_DID_DD01_Total_Distance_DID_DD01_Total_Distance
        DataInfo_DID_DD01_Total_Distance_DID_DD01_Total_Distance (DcmDspDataInfo): DcmDspDataFixedLength=true
        DID_DD02_Vehicle_Battery_Voltage_DID_DD02_Vehicle_Battery_Voltage (DcmDspData): DcmDspDataSize=8, DcmDspDataType=UINT8, DcmDspDataInfoRef=DataInfo_DID_DD02_Vehicle_Battery_Voltage_DID_DD02_Vehicle_Battery_Voltage
        DataInfo_DID_DD02_Vehicle_Battery_Voltage_DID_DD02_Vehicle_Battery_Voltage (DcmDspDataInfo): DcmDspDataFixedLength=true
        DID_DD0A_Usage_Mode_DID_DD0A_Usage_Mode (DcmDspData): DcmDspDataSize=8, DcmDspDataType=UINT8, DcmDspDataInfoRef=DataInfo_DID_DD0A_Usage_Mode_DID_DD0A_Usage_Mode
        DataInfo_DID_DD0A_Usage_Mode_DID_DD0A_Usage_Mode (DcmDspDataInfo): DcmDspDataFixedLength=true
        DID_DD0C_Electric_Power_Level_DID_DD0C_Electric_Power_Level (DcmDspData): DcmDspDataSize=8, DcmDspDataType=UINT8, DcmDspDataInfoRef=DataInfo_DID_DD0C_Electric_Power_Level_DID_DD0C_Electric_Power_Level
        DataInfo_DID_DD0C_Electric_Power_Level_DID_DD0C_Electric_Power_Level (DcmDspDataInfo): DcmDspDataFixedLength=true
        DID_E103_Car_Configuration_Parameter_Faults_DID_E103_1_Number_of_invalid_car_configuration_parameter_values_recognised (DcmDspData):
          DcmDspDataSize = 8
          DcmDspDataType = UINT8
          DcmDspDataInfoRef = DataInfo_DID_E103_Car_Configuration_Parameter_Faults_DID_E103_1_Number_of_invalid_car_configuration_parameter_values_recognised
        DataInfo_DID_E103_Car_Configuration_Parameter_Faults_DID_E103_1_Number_of_invalid_car_configuration_parameter_values_recognised (DcmDspDataInfo): DcmDspDataFixedLength=true
        DID_E103_Car_Configuration_Parameter_Faults_DID_E103_2_1st_parameter_number_of_the_car_configuration_data_that_is_invalid (DcmDspData):
          DcmDspDataSize = 16
          DcmDspDataType = UINT16
          DcmDspDataInfoRef = DataInfo_DID_E103_Car_Configuration_Parameter_Faults_DID_E103_2_1st_parameter_number_of_the_car_configuration_data_that_d6896c26
        DataInfo_DID_E103_Car_Configuration_Parameter_Faults_DID_E103_2_1st_parameter_number_of_the_car_configuration_data_that_d6896c26 (DcmDspDataInfo): DcmDspDataFixedLength=true
        DID_E103_Car_Configuration_Parameter_Faults_DID_E103_3_1st_parameter_invalid_value (DcmDspData):
          DcmDspDataSize = 8
          DcmDspDataType = UINT8
          DcmDspDataInfoRef = DataInfo_DID_E103_Car_Configuration_Parameter_Faults_DID_E103_3_1st_parameter_invalid_value
        DataInfo_DID_E103_Car_Configuration_Parameter_Faults_DID_E103_3_1st_parameter_invalid_value (DcmDspDataInfo): DcmDspDataFixedLength=true
        DID_E103_Car_Configuration_Parameter_Faults_DID_E103_4_2nd_parameter_number_of_the_car_configuration_data_that_is_invalid (DcmDspData):
          DcmDspDataSize = 16
          DcmDspDataType = UINT16
          DcmDspDataInfoRef = DataInfo_DID_E103_Car_Configuration_Parameter_Faults_DID_E103_4_2nd_parameter_number_of_the_car_configuration_data_that_461cabb1
        DataInfo_DID_E103_Car_Configuration_Parameter_Faults_DID_E103_4_2nd_parameter_number_of_the_car_configuration_data_that_461cabb1 (DcmDspDataInfo): DcmDspDataFixedLength=true
        DID_E103_Car_Configuration_Parameter_Faults_DID_E103_5_2nd_parameter_invalid_value (DcmDspData):
          DcmDspDataSize = 8
          DcmDspDataType = UINT8
          DcmDspDataInfoRef = DataInfo_DID_E103_Car_Configuration_Parameter_Faults_DID_E103_5_2nd_parameter_invalid_value
        DataInfo_DID_E103_Car_Configuration_Parameter_Faults_DID_E103_5_2nd_parameter_invalid_value (DcmDspDataInfo): DcmDspDataFixedLength=true
        DID_E103_Car_Configuration_Parameter_Faults_DID_E103_6_3rd_parameter_number_of_the_car_configuration_data_that_is_invalid (DcmDspData):
          DcmDspDataSize = 16
          DcmDspDataType = UINT16
          DcmDspDataInfoRef = DataInfo_DID_E103_Car_Configuration_Parameter_Faults_DID_E103_6_3rd_parameter_number_of_the_car_configuration_data_that_1458f62a
        DataInfo_DID_E103_Car_Configuration_Parameter_Faults_DID_E103_6_3rd_parameter_number_of_the_car_configuration_data_that_1458f62a (DcmDspDataInfo): DcmDspDataFixedLength=true
        DID_E103_Car_Configuration_Parameter_Faults_DID_E103_7_3rd_parameter_invalid_value (DcmDspData):
          DcmDspDataSize = 8
          DcmDspDataType = UINT8
          DcmDspDataInfoRef = DataInfo_DID_E103_Car_Configuration_Parameter_Faults_DID_E103_7_3rd_parameter_invalid_value
        DataInfo_DID_E103_Car_Configuration_Parameter_Faults_DID_E103_7_3rd_parameter_invalid_value (DcmDspDataInfo): DcmDspDataFixedLength=true
        DID_E103_Car_Configuration_Parameter_Faults_DID_E103_8_4th_parameter_number_of_the_car_configuration_data_that_is_invalid (DcmDspData):
          DcmDspDataSize = 16
          DcmDspDataType = UINT16
          DcmDspDataInfoRef = DataInfo_DID_E103_Car_Configuration_Parameter_Faults_DID_E103_8_4th_parameter_number_of_the_car_configuration_data_that_6f100f46
        DataInfo_DID_E103_Car_Configuration_Parameter_Faults_DID_E103_8_4th_parameter_number_of_the_car_configuration_data_that_6f100f46 (DcmDspDataInfo): DcmDspDataFixedLength=true
        DID_E103_Car_Configuration_Parameter_Faults_DID_E103_9_4th_parameter_invalid_value (DcmDspData):
          DcmDspDataSize = 8
          DcmDspDataType = UINT8
          DcmDspDataInfoRef = DataInfo_DID_E103_Car_Configuration_Parameter_Faults_DID_E103_9_4th_parameter_invalid_value
        DataInfo_DID_E103_Car_Configuration_Parameter_Faults_DID_E103_9_4th_parameter_invalid_value (DcmDspDataInfo): DcmDspDataFixedLength=true
        DID_E103_Car_Configuration_Parameter_Faults_DID_E103_10_5th_parameter_number_of_the_car_configuration_data_that_is_invalid (DcmDspData):
          DcmDspDataSize = 16
          DcmDspDataType = UINT16
          DcmDspDataInfoRef = DataInfo_DID_E103_Car_Configuration_Parameter_Faults_DID_E103_10_5th_parameter_number_of_the_car_configuration_data_thatbe0dd04
        DataInfo_DID_E103_Car_Configuration_Parameter_Faults_DID_E103_10_5th_parameter_number_of_the_car_configuration_data_thatbe0dd04 (DcmDspDataInfo): DcmDspDataFixedLength=true
        DID_E103_Car_Configuration_Parameter_Faults_DID_E103_11_5th_parameter_invalid_value (DcmDspData):
          DcmDspDataSize = 8
          DcmDspDataType = UINT8
          DcmDspDataInfoRef = DataInfo_DID_E103_Car_Configuration_Parameter_Faults_DID_E103_11_5th_parameter_invalid_value
        DataInfo_DID_E103_Car_Configuration_Parameter_Faults_DID_E103_11_5th_parameter_invalid_value (DcmDspDataInfo): DcmDspDataFixedLength=true
        DID_E103_Car_Configuration_Parameter_Faults_DID_E103_12_6th_parameter_number_of_the_car_configuration_data_that_is_invalid (DcmDspData):
          DcmDspDataSize = 16
          DcmDspDataType = UINT16
          DcmDspDataInfoRef = DataInfo_DID_E103_Car_Configuration_Parameter_Faults_DID_E103_12_6th_parameter_number_of_the_car_configuration_data_that1ba11a61
        DataInfo_DID_E103_Car_Configuration_Parameter_Faults_DID_E103_12_6th_parameter_number_of_the_car_configuration_data_that1ba11a61 (DcmDspDataInfo): DcmDspDataFixedLength=true
        DID_E103_Car_Configuration_Parameter_Faults_DID_E103_13_6th_parameter_invalid_value (DcmDspData):
          DcmDspDataSize = 8
          DcmDspDataType = UINT8
          DcmDspDataInfoRef = DataInfo_DID_E103_Car_Configuration_Parameter_Faults_DID_E103_13_6th_parameter_invalid_value
        DataInfo_DID_E103_Car_Configuration_Parameter_Faults_DID_E103_13_6th_parameter_invalid_value (DcmDspDataInfo): DcmDspDataFixedLength=true
        DID_E103_Car_Configuration_Parameter_Faults_DID_E103_14_7th_parameter_number_of_the_car_configuration_data_that_is_invalid (DcmDspData):
          DcmDspDataSize = 16
          DcmDspDataType = UINT16
          DcmDspDataInfoRef = DataInfo_DID_E103_Car_Configuration_Parameter_Faults_DID_E103_14_7th_parameter_number_of_the_car_configuration_data_thatd7b4e1f3
        DataInfo_DID_E103_Car_Configuration_Parameter_Faults_DID_E103_14_7th_parameter_number_of_the_car_configuration_data_thatd7b4e1f3 (DcmDspDataInfo): DcmDspDataFixedLength=true
        DID_E103_Car_Configuration_Parameter_Faults_DID_E103_15_7th_parameter_invalid_value (DcmDspData):
          DcmDspDataSize = 8
          DcmDspDataType = UINT8
          DcmDspDataInfoRef = DataInfo_DID_E103_Car_Configuration_Parameter_Faults_DID_E103_15_7th_parameter_invalid_value
        DataInfo_DID_E103_Car_Configuration_Parameter_Faults_DID_E103_15_7th_parameter_invalid_value (DcmDspDataInfo): DcmDspDataFixedLength=true
        DID_E103_Car_Configuration_Parameter_Faults_DID_E103_16_8th_parameter_number_of_the_car_configuration_data_that_is_invalid (DcmDspData):
          DcmDspDataSize = 16
          DcmDspDataType = UINT16
          DcmDspDataInfoRef = DataInfo_DID_E103_Car_Configuration_Parameter_Faults_DID_E103_16_8th_parameter_number_of_the_car_configuration_data_that19fcf690
        DataInfo_DID_E103_Car_Configuration_Parameter_Faults_DID_E103_16_8th_parameter_number_of_the_car_configuration_data_that19fcf690 (DcmDspDataInfo): DcmDspDataFixedLength=true
        DID_E103_Car_Configuration_Parameter_Faults_DID_E103_17_8th_parameter_invalid_value (DcmDspData):
          DcmDspDataSize = 8
          DcmDspDataType = UINT8
          DcmDspDataInfoRef = DataInfo_DID_E103_Car_Configuration_Parameter_Faults_DID_E103_17_8th_parameter_invalid_value
        DataInfo_DID_E103_Car_Configuration_Parameter_Faults_DID_E103_17_8th_parameter_invalid_value (DcmDspDataInfo): DcmDspDataFixedLength=true
        DID_E103_Car_Configuration_Parameter_Faults_DID_E103_18_9th_parameter_number_of_the_car_configuration_data_that_is_invalid (DcmDspData):
          DcmDspDataSize = 16
          DcmDspDataType = UINT16
          DcmDspDataInfoRef = DataInfo_DID_E103_Car_Configuration_Parameter_Faults_DID_E103_18_9th_parameter_number_of_the_car_configuration_data_that4ae7c090
        DataInfo_DID_E103_Car_Configuration_Parameter_Faults_DID_E103_18_9th_parameter_number_of_the_car_configuration_data_that4ae7c090 (DcmDspDataInfo): DcmDspDataFixedLength=true
        DID_E103_Car_Configuration_Parameter_Faults_DID_E103_19_9th_parameter_invalid_value (DcmDspData):
          DcmDspDataSize = 8
          DcmDspDataType = UINT8
          DcmDspDataInfoRef = DataInfo_DID_E103_Car_Configuration_Parameter_Faults_DID_E103_19_9th_parameter_invalid_value
        DataInfo_DID_E103_Car_Configuration_Parameter_Faults_DID_E103_19_9th_parameter_invalid_value (DcmDspDataInfo): DcmDspDataFixedLength=true
        DID_E103_Car_Configuration_Parameter_Faults_DID_E103_20_10th_parameter_number_of_the_car_configuration_data_that_is_invalid (DcmDspData):
          DcmDspDataSize = 16
          DcmDspDataType = UINT16
          DcmDspDataInfoRef = DataInfo_DID_E103_Car_Configuration_Parameter_Faults_DID_E103_20_10th_parameter_number_of_the_car_configuration_data_thace4964ec
        DataInfo_DID_E103_Car_Configuration_Parameter_Faults_DID_E103_20_10th_parameter_number_of_the_car_configuration_data_thace4964ec (DcmDspDataInfo): DcmDspDataFixedLength=true
        DID_E103_Car_Configuration_Parameter_Faults_DID_E103_21_10th_parameter_invalid_value (DcmDspData):
          DcmDspDataSize = 8
          DcmDspDataType = UINT8
          DcmDspDataInfoRef = DataInfo_DID_E103_Car_Configuration_Parameter_Faults_DID_E103_21_10th_parameter_invalid_value
        DataInfo_DID_E103_Car_Configuration_Parameter_Faults_DID_E103_21_10th_parameter_invalid_value (DcmDspDataInfo): DcmDspDataFixedLength=true
        DID_E300_HVDC_Voltage_DID_E300_HVDC_Voltage (DcmDspData): DcmDspDataSize=16, DcmDspDataType=UINT16, DcmDspDataInfoRef=DataInfo_DID_E300_HVDC_Voltage_DID_E300_HVDC_Voltage
        DataInfo_DID_E300_HVDC_Voltage_DID_E300_HVDC_Voltage (DcmDspDataInfo): DcmDspDataFixedLength=true
        DID_E301_HVDC_Current_DID_E301_HVDC_Current_ (DcmDspData): DcmDspDataSize=16, DcmDspDataType=UINT16, DcmDspDataInfoRef=DataInfo_DID_E301_HVDC_Current_DID_E301_HVDC_Current_
        DataInfo_DID_E301_HVDC_Current_DID_E301_HVDC_Current_ (DcmDspDataInfo): DcmDspDataFixedLength=true
        DID_E303_Motor_Speed_DID_E303_Motor_Speed_ (DcmDspData): DcmDspDataSize=16, DcmDspDataType=UINT16, DcmDspDataInfoRef=DataInfo_DID_E303_Motor_Speed_DID_E303_Motor_Speed_
        DataInfo_DID_E303_Motor_Speed_DID_E303_Motor_Speed_ (DcmDspDataInfo): DcmDspDataFixedLength=true
        DID_E304_Actual_Torque_DID_E304_Actual_Torque (DcmDspData): DcmDspDataSize=16, DcmDspDataType=UINT16, DcmDspDataInfoRef=DataInfo_DID_E304_Actual_Torque_DID_E304_Actual_Torque
        DataInfo_DID_E304_Actual_Torque_DID_E304_Actual_Torque (DcmDspDataInfo): DcmDspDataFixedLength=true
        DID_E305_Inverter_IGBT_Junction_Temp_DID_E305_Inverter_IGBT_Junction_Temp (DcmDspData): DcmDspDataSize=8, DcmDspDataType=UINT8, DcmDspDataInfoRef=DataInfo_DID_E305_Inverter_IGBT_Junction_Temp_DID_E305_Inverter_IGBT_Junction_Temp
        DataInfo_DID_E305_Inverter_IGBT_Junction_Temp_DID_E305_Inverter_IGBT_Junction_Temp (DcmDspDataInfo): DcmDspDataFixedLength=true
        DID_E306_Motor_Temperature_DID_E306_Motor_Temperature (DcmDspData): DcmDspDataSize=8, DcmDspDataType=UINT8, DcmDspDataInfoRef=DataInfo_DID_E306_Motor_Temperature_DID_E306_Motor_Temperature
        DataInfo_DID_E306_Motor_Temperature_DID_E306_Motor_Temperature (DcmDspDataInfo): DcmDspDataFixedLength=true
        DID_E307_System_Mode_DID_E307_System_Mode (DcmDspData): DcmDspDataSize=8, DcmDspDataType=UINT8, DcmDspDataInfoRef=DataInfo_DID_E307_System_Mode_DID_E307_System_Mode
        DataInfo_DID_E307_System_Mode_DID_E307_System_Mode (DcmDspDataInfo): DcmDspDataFixedLength=true
        DID_E308_ECM_Torque_Request_DID_E308_ECM_Torque_Request (DcmDspData): DcmDspDataSize=16, DcmDspDataType=UINT16, DcmDspDataInfoRef=DataInfo_DID_E308_ECM_Torque_Request_DID_E308_ECM_Torque_Request
        DataInfo_DID_E308_ECM_Torque_Request_DID_E308_ECM_Torque_Request (DcmDspDataInfo): DcmDspDataFixedLength=true
        DID_E309_ECM_Mode_Request_DID_E309_ECM_Mode_Request (DcmDspData): DcmDspDataSize=8, DcmDspDataType=UINT8, DcmDspDataInfoRef=DataInfo_DID_E309_ECM_Mode_Request_DID_E309_ECM_Mode_Request
        DataInfo_DID_E309_ECM_Mode_Request_DID_E309_ECM_Mode_Request (DcmDspDataInfo): DcmDspDataFixedLength=true
        DID_E310_IEM_MGM_Derating_Status_DID_E310_IEMMGM_Derating_Status (DcmDspData): DcmDspDataSize=8, DcmDspDataType=UINT8, DcmDspDataInfoRef=DataInfo_DID_E310_IEM_MGM_Derating_Status_DID_E310_IEMMGM_Derating_Status
        DataInfo_DID_E310_IEM_MGM_Derating_Status_DID_E310_IEMMGM_Derating_Status (DcmDspDataInfo): DcmDspDataFixedLength=true
        DID_E311_Crash_Status_DID_E311_Crash_Status (DcmDspData): DcmDspDataSize=8, DcmDspDataType=UINT8, DcmDspDataInfoRef=DataInfo_DID_E311_Crash_Status_DID_E311_Crash_Status
        DataInfo_DID_E311_Crash_Status_DID_E311_Crash_Status (DcmDspDataInfo): DcmDspDataFixedLength=true
        DID_E312_Wheel_Speed_DID_E312_Wheel_Speed (DcmDspData): DcmDspDataSize=16, DcmDspDataType=UINT16, DcmDspDataInfoRef=DataInfo_DID_E312_Wheel_Speed_DID_E312_Wheel_Speed
        DataInfo_DID_E312_Wheel_Speed_DID_E312_Wheel_Speed (DcmDspDataInfo): DcmDspDataFixedLength=true
        DID_E313_Active_discharge_status_DID_E313_Active_discharge_status (DcmDspData): DcmDspDataSize=8, DcmDspDataType=UINT8, DcmDspDataInfoRef=DataInfo_DID_E313_Active_discharge_status_DID_E313_Active_discharge_status
        DataInfo_DID_E313_Active_discharge_status_DID_E313_Active_discharge_status (DcmDspDataInfo): DcmDspDataFixedLength=true
        DID_E314_Available_Torque_maximum_DID_E314_Available_Torque_maximum (DcmDspData): DcmDspDataSize=16, DcmDspDataType=UINT16, DcmDspDataInfoRef=DataInfo_DID_E314_Available_Torque_maximum_DID_E314_Available_Torque_maximum
        DataInfo_DID_E314_Available_Torque_maximum_DID_E314_Available_Torque_maximum (DcmDspDataInfo): DcmDspDataFixedLength=true
        DID_E315_Available_Torque_minimum_DID_E315_Available_Torque_minimum (DcmDspData): DcmDspDataSize=16, DcmDspDataType=UINT16, DcmDspDataInfoRef=DataInfo_DID_E315_Available_Torque_minimum_DID_E315_Available_Torque_minimum
        DataInfo_DID_E315_Available_Torque_minimum_DID_E315_Available_Torque_minimum (DcmDspDataInfo): DcmDspDataFixedLength=true
        DID_E319_Torque_Direction_DID_E319_Torque_Direction (DcmDspData): DcmDspDataSize=8, DcmDspDataType=UINT8, DcmDspDataInfoRef=DataInfo_DID_E319_Torque_Direction_DID_E319_Torque_Direction
        DataInfo_DID_E319_Torque_Direction_DID_E319_Torque_Direction (DcmDspDataInfo): DcmDspDataFixedLength=true
        DID_E320_System_Mode_Mismatch_DID_E320_System_Mode_Mismatch (DcmDspData): DcmDspDataSize=8, DcmDspDataType=UINT8, DcmDspDataInfoRef=DataInfo_DID_E320_System_Mode_Mismatch_DID_E320_System_Mode_Mismatch
        DataInfo_DID_E320_System_Mode_Mismatch_DID_E320_System_Mode_Mismatch (DcmDspDataInfo): DcmDspDataFixedLength=true
        DID_E324_Motor_Derating_reason_of_IEM_MGM_DID_E324_Motor_Derating_reason_of_IEMMGM (DcmDspData):
          DcmDspDataSize = 8
          DcmDspDataType = UINT8
          DcmDspDataInfoRef = DataInfo_DID_E324_Motor_Derating_reason_of_IEM_MGM_DID_E324_Motor_Derating_reason_of_IEMMGM
        DataInfo_DID_E324_Motor_Derating_reason_of_IEM_MGM_DID_E324_Motor_Derating_reason_of_IEMMGM (DcmDspDataInfo): DcmDspDataFixedLength=true
        DID_E331_Software_Version_DID_E331_1_ASW_Software_Version (DcmDspData): DcmDspDataSize=64, DcmDspDataType=UINT8_N, DcmDspDataInfoRef=DataInfo_DID_E331_Software_Version_DID_E331_1_ASW_Software_Version
        DataInfo_DID_E331_Software_Version_DID_E331_1_ASW_Software_Version (DcmDspDataInfo): DcmDspDataFixedLength=true
        DID_E331_Software_Version_DID_E331_2_BSW_Software_Version (DcmDspData): DcmDspDataSize=64, DcmDspDataType=UINT8_N, DcmDspDataInfoRef=DataInfo_DID_E331_Software_Version_DID_E331_2_BSW_Software_Version
        DataInfo_DID_E331_Software_Version_DID_E331_2_BSW_Software_Version (DcmDspDataInfo): DcmDspDataFixedLength=true
        DID_E331_Software_Version_DID_E331_3_Calibration_Data_Software_Version (DcmDspData): DcmDspDataSize=64, DcmDspDataType=UINT8_N, DcmDspDataInfoRef=DataInfo_DID_E331_Software_Version_DID_E331_3_Calibration_Data_Software_Version
        DataInfo_DID_E331_Software_Version_DID_E331_3_Calibration_Data_Software_Version (DcmDspDataInfo): DcmDspDataFixedLength=true
        DID_E333_2002_State_2002_Hu (DcmDspData): DcmDspDataSize=8, DcmDspDataType=UINT8_N, DcmDspDataInfoRef=DataInfo_DID_E333_2002_State_2002_Hu
        DataInfo_DID_E333_2002_State_2002_Hu (DcmDspDataInfo): DcmDspDataFixedLength=true
        DID_E333_2002_State_2002_Hv (DcmDspData): DcmDspDataSize=8, DcmDspDataType=UINT8_N, DcmDspDataInfoRef=DataInfo_DID_E333_2002_State_2002_Hv
        DataInfo_DID_E333_2002_State_2002_Hv (DcmDspDataInfo): DcmDspDataFixedLength=true
        DID_E333_2002_State_2002_Hw (DcmDspData): DcmDspDataSize=8, DcmDspDataType=UINT8_N, DcmDspDataInfoRef=DataInfo_DID_E333_2002_State_2002_Hw
        DataInfo_DID_E333_2002_State_2002_Hw (DcmDspDataInfo): DcmDspDataFixedLength=true
        DID_E333_2002_State_2002_Lu (DcmDspData): DcmDspDataSize=8, DcmDspDataType=UINT8_N, DcmDspDataInfoRef=DataInfo_DID_E333_2002_State_2002_Lu
        DataInfo_DID_E333_2002_State_2002_Lu (DcmDspDataInfo): DcmDspDataFixedLength=true
        DID_E333_2002_State_2002_Lv (DcmDspData): DcmDspDataSize=8, DcmDspDataType=UINT8_N, DcmDspDataInfoRef=DataInfo_DID_E333_2002_State_2002_Lv
        DataInfo_DID_E333_2002_State_2002_Lv (DcmDspDataInfo): DcmDspDataFixedLength=true
        DID_E333_2002_State_2002_Lw (DcmDspData): DcmDspDataSize=8, DcmDspDataType=UINT8_N, DcmDspDataInfoRef=DataInfo_DID_E333_2002_State_2002_Lw
        DataInfo_DID_E333_2002_State_2002_Lw (DcmDspDataInfo): DcmDspDataFixedLength=true
        DID_E333_2002_State_2002_H_Ser (DcmDspData): DcmDspDataSize=8, DcmDspDataType=UINT8, DcmDspDataInfoRef=DataInfo_DID_E333_2002_State_2002_H_Ser
        DataInfo_DID_E333_2002_State_2002_H_Ser (DcmDspDataInfo): DcmDspDataFixedLength=true
        DID_E333_2002_State_2002_L_Ser (DcmDspData): DcmDspDataSize=8, DcmDspDataType=UINT8, DcmDspDataInfoRef=DataInfo_DID_E333_2002_State_2002_L_Ser
        DataInfo_DID_E333_2002_State_2002_L_Ser (DcmDspDataInfo): DcmDspDataFixedLength=true
        DID_E335_d_axis_current_setpoint_DID_E335_d_axis_current_setpoint (DcmDspData): DcmDspDataSize=16, DcmDspDataType=UINT16, DcmDspDataInfoRef=DataInfo_DID_E335_d_axis_current_setpoint_DID_E335_d_axis_current_setpoint
        DataInfo_DID_E335_d_axis_current_setpoint_DID_E335_d_axis_current_setpoint (DcmDspDataInfo): DcmDspDataFixedLength=true
        DID_E336_d_axis_current_feedback_DID_E336_d_axis_current_feedback (DcmDspData): DcmDspDataSize=16, DcmDspDataType=UINT16, DcmDspDataInfoRef=DataInfo_DID_E336_d_axis_current_feedback_DID_E336_d_axis_current_feedback
        DataInfo_DID_E336_d_axis_current_feedback_DID_E336_d_axis_current_feedback (DcmDspDataInfo): DcmDspDataFixedLength=true
        DID_E337_q_axis_current_setpoint_DID_E337_q_axis_current_setpoint (DcmDspData): DcmDspDataSize=16, DcmDspDataType=UINT16, DcmDspDataInfoRef=DataInfo_DID_E337_q_axis_current_setpoint_DID_E337_q_axis_current_setpoint
        DataInfo_DID_E337_q_axis_current_setpoint_DID_E337_q_axis_current_setpoint (DcmDspDataInfo): DcmDspDataFixedLength=true
        DID_E338_q_axis_current_feedback_DID_E338_q_axis_current_feedback (DcmDspData): DcmDspDataSize=16, DcmDspDataType=UINT16, DcmDspDataInfoRef=DataInfo_DID_E338_q_axis_current_feedback_DID_E338_q_axis_current_feedback
        DataInfo_DID_E338_q_axis_current_feedback_DID_E338_q_axis_current_feedback (DcmDspDataInfo): DcmDspDataFixedLength=true
        DID_E339_d_axis_voltage_DID_E339_d_axis_voltage (DcmDspData): DcmDspDataSize=16, DcmDspDataType=UINT16, DcmDspDataInfoRef=DataInfo_DID_E339_d_axis_voltage_DID_E339_d_axis_voltage
        DataInfo_DID_E339_d_axis_voltage_DID_E339_d_axis_voltage (DcmDspDataInfo): DcmDspDataFixedLength=true
        DID_E341_q_axis_voltage_DID_E341_q_axis_voltage (DcmDspData): DcmDspDataSize=16, DcmDspDataType=UINT16, DcmDspDataInfoRef=DataInfo_DID_E341_q_axis_voltage_DID_E341_q_axis_voltage
        DataInfo_DID_E341_q_axis_voltage_DID_E341_q_axis_voltage (DcmDspDataInfo): DcmDspDataFixedLength=true
        DID_E346_ECM_Torque_Allowed_Status_DID_E346_ECM_Torque_Allowed_Status (DcmDspData): DcmDspDataSize=8, DcmDspDataType=UINT8, DcmDspDataInfoRef=DataInfo_DID_E346_ECM_Torque_Allowed_Status_DID_E346_ECM_Torque_Allowed_Status
        DataInfo_DID_E346_ECM_Torque_Allowed_Status_DID_E346_ECM_Torque_Allowed_Status (DcmDspDataInfo): DcmDspDataFixedLength=true
        DID_E347_IGBT_Max_Temperature_DID_E347_IGBT_Max_Temperature (DcmDspData): DcmDspDataSize=8, DcmDspDataType=UINT8, DcmDspDataInfoRef=DataInfo_DID_E347_IGBT_Max_Temperature_DID_E347_IGBT_Max_Temperature
        DataInfo_DID_E347_IGBT_Max_Temperature_DID_E347_IGBT_Max_Temperature (DcmDspDataInfo): DcmDspDataFixedLength=true
        DID_E348_Phase_U_PWM_duty_DID_E348_Phase_U_PWM_duty (DcmDspData): DcmDspDataSize=8, DcmDspDataType=UINT8, DcmDspDataInfoRef=DataInfo_DID_E348_Phase_U_PWM_duty_DID_E348_Phase_U_PWM_duty
        DataInfo_DID_E348_Phase_U_PWM_duty_DID_E348_Phase_U_PWM_duty (DcmDspDataInfo): DcmDspDataFixedLength=true
        DID_E349_Phase_V_PWM_duty_DID_E349_Phase_V_PWM_duty (DcmDspData): DcmDspDataSize=8, DcmDspDataType=UINT8, DcmDspDataInfoRef=DataInfo_DID_E349_Phase_V_PWM_duty_DID_E349_Phase_V_PWM_duty
        DataInfo_DID_E349_Phase_V_PWM_duty_DID_E349_Phase_V_PWM_duty (DcmDspDataInfo): DcmDspDataFixedLength=true
        DID_E350_Phase_W_PWM_duty_DID_E350_Phase_W_PWM_duty (DcmDspData): DcmDspDataSize=8, DcmDspDataType=UINT8, DcmDspDataInfoRef=DataInfo_DID_E350_Phase_W_PWM_duty_DID_E350_Phase_W_PWM_duty
        DataInfo_DID_E350_Phase_W_PWM_duty_DID_E350_Phase_W_PWM_duty (DcmDspDataInfo): DcmDspDataFixedLength=true
        DID_E353_Flux_weakening_correction_factor_DID_E353_Flux_weakening_correction_factor (DcmDspData):
          DcmDspDataSize = 16
          DcmDspDataType = UINT16
          DcmDspDataInfoRef = DataInfo_DID_E353_Flux_weakening_correction_factor_DID_E353_Flux_weakening_correction_factor
        DataInfo_DID_E353_Flux_weakening_correction_factor_DID_E353_Flux_weakening_correction_factor (DcmDspDataInfo): DcmDspDataFixedLength=true
        DID_E357_Resolve_compensated_angle_DID_E357_Resolve_compensated_angle (DcmDspData): DcmDspDataSize=8, DcmDspDataType=UINT8, DcmDspDataInfoRef=DataInfo_DID_E357_Resolve_compensated_angle_DID_E357_Resolve_compensated_angle
        DataInfo_DID_E357_Resolve_compensated_angle_DID_E357_Resolve_compensated_angle (DcmDspDataInfo): DcmDspDataFixedLength=true
        DID_E358_Resolve_angle_DID_E358_Resolve_angle (DcmDspData): DcmDspDataSize=16, DcmDspDataType=UINT16, DcmDspDataInfoRef=DataInfo_DID_E358_Resolve_angle_DID_E358_Resolve_angle
        DataInfo_DID_E358_Resolve_angle_DID_E358_Resolve_angle (DcmDspDataInfo): DcmDspDataFixedLength=true
        DID_E363_Modulation_index_DID_E363_Modulation_index (DcmDspData): DcmDspDataSize=8, DcmDspDataType=UINT8, DcmDspDataInfoRef=DataInfo_DID_E363_Modulation_index_DID_E363_Modulation_index
        DataInfo_DID_E363_Modulation_index_DID_E363_Modulation_index (DcmDspDataInfo): DcmDspDataFixedLength=true
        DID_E364_AURIX_Fault_Indication_DID_E364_AURIX_Fault_Indication (DcmDspData): DcmDspDataSize=8, DcmDspDataType=UINT8_N, DcmDspDataInfoRef=DataInfo_DID_E364_AURIX_Fault_Indication_DID_E364_AURIX_Fault_Indication
        DataInfo_DID_E364_AURIX_Fault_Indication_DID_E364_AURIX_Fault_Indication (DcmDspDataInfo): DcmDspDataFixedLength=true
        DID_ED20_Complete_set_of_ECU_part_serial_numbers_Geely_BCD_part (DcmDspData): DcmDspDataSize=40, DcmDspDataType=UINT8_N, DcmDspDataInfoRef=DataInfo_DID_ED20_Complete_set_of_ECU_part_serial_numbers_Geely_BCD_part
        DataInfo_DID_ED20_Complete_set_of_ECU_part_serial_numbers_Geely_BCD_part (DcmDspDataInfo): DcmDspDataFixedLength=true
        DID_ED20_Complete_set_of_ECU_part_serial_numbers_Geely_ASCII_part (DcmDspData): DcmDspDataSize=24, DcmDspDataType=UINT8_N, DcmDspDataInfoRef=DataInfo_DID_ED20_Complete_set_of_ECU_part_serial_numbers_Geely_ASCII_part
        DataInfo_DID_ED20_Complete_set_of_ECU_part_serial_numbers_Geely_ASCII_part (DcmDspDataInfo): DcmDspDataFixedLength=true
        DID_ED20_Complete_set_of_ECU_part_serial_numbers_Geely_BCD_part_001 (DcmDspData): DcmDspDataSize=40, DcmDspDataType=UINT8_N, DcmDspDataInfoRef=DataInfo_DID_ED20_Complete_set_of_ECU_part_serial_numbers_Geely_BCD_part_001
        DataInfo_DID_ED20_Complete_set_of_ECU_part_serial_numbers_Geely_BCD_part_001 (DcmDspDataInfo): DcmDspDataFixedLength=true
        DID_ED20_Complete_set_of_ECU_part_serial_numbers_Geely_ASCII_part_001 (DcmDspData): DcmDspDataSize=24, DcmDspDataType=UINT8_N, DcmDspDataInfoRef=DataInfo_DID_ED20_Complete_set_of_ECU_part_serial_numbers_Geely_ASCII_part_001
        DataInfo_DID_ED20_Complete_set_of_ECU_part_serial_numbers_Geely_ASCII_part_001 (DcmDspDataInfo): DcmDspDataFixedLength=true
        DID_ED20_Complete_set_of_ECU_part_serial_numbers_Geely_BCD_part_002 (DcmDspData): DcmDspDataSize=40, DcmDspDataType=UINT8_N, DcmDspDataInfoRef=DataInfo_DID_ED20_Complete_set_of_ECU_part_serial_numbers_Geely_BCD_part_002
        DataInfo_DID_ED20_Complete_set_of_ECU_part_serial_numbers_Geely_BCD_part_002 (DcmDspDataInfo): DcmDspDataFixedLength=true
        DID_ED20_Complete_set_of_ECU_part_serial_numbers_Geely_ASCII_part_002 (DcmDspData): DcmDspDataSize=24, DcmDspDataType=UINT8_N, DcmDspDataInfoRef=DataInfo_DID_ED20_Complete_set_of_ECU_part_serial_numbers_Geely_ASCII_part_002
        DataInfo_DID_ED20_Complete_set_of_ECU_part_serial_numbers_Geely_ASCII_part_002 (DcmDspDataInfo): DcmDspDataFixedLength=true
        DID_ED20_Complete_set_of_ECU_part_serial_numbers_Geely_DID_F18C_ECU_Serial_Number (DcmDspData):
          DcmDspDataSize = 32
          DcmDspDataType = UINT32
          DcmDspDataInfoRef = DataInfo_DID_ED20_Complete_set_of_ECU_part_serial_numbers_Geely_DID_F18C_ECU_Serial_Number
        DataInfo_DID_ED20_Complete_set_of_ECU_part_serial_numbers_Geely_DID_F18C_ECU_Serial_Number (DcmDspDataInfo): DcmDspDataFixedLength=true
        DID_ED20_Complete_set_of_ECU_part_serial_numbers_Geely_DID_F1AE_1_Total_number_of_ECU_Software_Part_Numbers (DcmDspData):
          DcmDspDataSize = 8
          DcmDspDataType = UINT8
          DcmDspDataInfoRef = DataInfo_DID_ED20_Complete_set_of_ECU_part_serial_numbers_Geely_DID_F1AE_1_Total_number_of_ECU_Software_Part_Numbers
        DataInfo_DID_ED20_Complete_set_of_ECU_part_serial_numbers_Geely_DID_F1AE_1_Total_number_of_ECU_Software_Part_Numbers (DcmDspDataInfo): DcmDspDataFixedLength=true
        DID_ED20_Complete_set_of_ECU_part_serial_numbers_Geely_BCD_part_003 (DcmDspData): DcmDspDataSize=40, DcmDspDataType=UINT8_N, DcmDspDataInfoRef=DataInfo_DID_ED20_Complete_set_of_ECU_part_serial_numbers_Geely_BCD_part_003
        DataInfo_DID_ED20_Complete_set_of_ECU_part_serial_numbers_Geely_BCD_part_003 (DcmDspDataInfo): DcmDspDataFixedLength=true
        DID_ED20_Complete_set_of_ECU_part_serial_numbers_Geely_ASCII_part_003 (DcmDspData): DcmDspDataSize=24, DcmDspDataType=UINT8_N, DcmDspDataInfoRef=DataInfo_DID_ED20_Complete_set_of_ECU_part_serial_numbers_Geely_ASCII_part_003
        DataInfo_DID_ED20_Complete_set_of_ECU_part_serial_numbers_Geely_ASCII_part_003 (DcmDspDataInfo): DcmDspDataFixedLength=true
        DID_ED20_Complete_set_of_ECU_part_serial_numbers_Geely_Reserved (DcmDspData): DcmDspDataSize=80, DcmDspDataType=UINT8_N, DcmDspDataInfoRef=DataInfo_DID_ED20_Complete_set_of_ECU_part_serial_numbers_Geely_Reserved
        DataInfo_DID_ED20_Complete_set_of_ECU_part_serial_numbers_Geely_Reserved (DcmDspDataInfo): DcmDspDataFixedLength=true
        DID_EDA0_Complete_ECU_Part_Serial_Number_s_F120_Application_Diagnostic_Database_Part_Number (DcmDspData):
          DcmDspDataSize = 32
          DcmDspDataType = UINT32
          DcmDspDataInfoRef = DataInfo_DID_EDA0_Complete_ECU_Part_Serial_Number_s_F120_Application_Diagnostic_Database_Part_Number
        DataInfo_DID_EDA0_Complete_ECU_Part_Serial_Number_s_F120_Application_Diagnostic_Database_Part_Number (DcmDspDataInfo): DcmDspDataFixedLength=true
        DID_EDA0_Complete_ECU_Part_Serial_Number_s_F120_Application_Diagnostic_Database_Part_Number1 (DcmDspData):
          DcmDspDataSize = 24
          DcmDspDataType = UINT8_N
          DcmDspDataInfoRef = DataInfo_DID_EDA0_Complete_ECU_Part_Serial_Number_s_F120_Application_Diagnostic_Database_Part_Number1
        DataInfo_DID_EDA0_Complete_ECU_Part_Serial_Number_s_F120_Application_Diagnostic_Database_Part_Number1 (DcmDspDataInfo): DcmDspDataFixedLength=true
        DID_EDA0_Complete_ECU_Part_Serial_Number_s_DID_F12A_ECU_Delivery_Assembly_Part_Number_1 (DcmDspData):
          DcmDspDataSize = 32
          DcmDspDataType = UINT32
          DcmDspDataInfoRef = DataInfo_DID_EDA0_Complete_ECU_Part_Serial_Number_s_DID_F12A_ECU_Delivery_Assembly_Part_Number_1
        DataInfo_DID_EDA0_Complete_ECU_Part_Serial_Number_s_DID_F12A_ECU_Delivery_Assembly_Part_Number_1 (DcmDspDataInfo): DcmDspDataFixedLength=true
        DID_EDA0_Complete_ECU_Part_Serial_Number_s_DID_F12A_ECU_Delivery_Assembly_Part_Number1_1 (DcmDspData):
          DcmDspDataSize = 24
          DcmDspDataType = UINT8_N
          DcmDspDataInfoRef = DataInfo_DID_EDA0_Complete_ECU_Part_Serial_Number_s_DID_F12A_ECU_Delivery_Assembly_Part_Number1_1
        DataInfo_DID_EDA0_Complete_ECU_Part_Serial_Number_s_DID_F12A_ECU_Delivery_Assembly_Part_Number1_1 (DcmDspDataInfo): DcmDspDataFixedLength=true
        DID_EDA0_Complete_ECU_Part_Serial_Number_s_DID_F12B_ECU_Delivery_Assembly_Part_Number (DcmDspData):
          DcmDspDataSize = 32
          DcmDspDataType = UINT32
          DcmDspDataInfoRef = DataInfo_DID_EDA0_Complete_ECU_Part_Serial_Number_s_DID_F12B_ECU_Delivery_Assembly_Part_Number
        DataInfo_DID_EDA0_Complete_ECU_Part_Serial_Number_s_DID_F12B_ECU_Delivery_Assembly_Part_Number (DcmDspDataInfo): DcmDspDataFixedLength=true
        DID_EDA0_Complete_ECU_Part_Serial_Number_s_DID_F12B_ECU_Delivery_Assembly_Part_Number1 (DcmDspData):
          DcmDspDataSize = 24
          DcmDspDataType = UINT8_N
          DcmDspDataInfoRef = DataInfo_DID_EDA0_Complete_ECU_Part_Serial_Number_s_DID_F12B_ECU_Delivery_Assembly_Part_Number1
        DataInfo_DID_EDA0_Complete_ECU_Part_Serial_Number_s_DID_F12B_ECU_Delivery_Assembly_Part_Number1 (DcmDspDataInfo): DcmDspDataFixedLength=true
        DID_EDA0_Complete_ECU_Part_Serial_Number_s_DID_F18C_ECU_Serial_Number (DcmDspData): DcmDspDataSize=32, DcmDspDataType=UINT32, DcmDspDataInfoRef=DataInfo_DID_EDA0_Complete_ECU_Part_Serial_Number_s_DID_F18C_ECU_Serial_Number
        DataInfo_DID_EDA0_Complete_ECU_Part_Serial_Number_s_DID_F18C_ECU_Serial_Number (DcmDspDataInfo): DcmDspDataFixedLength=true
        DID_EDA0_Complete_ECU_Part_Serial_Number_s_DID_F12E_1_Total_number_of_ECU_Software_Part_Numbers (DcmDspData):
          DcmDspDataSize = 8
          DcmDspDataType = UINT8
          DcmDspDataInfoRef = DataInfo_DID_EDA0_Complete_ECU_Part_Serial_Number_s_DID_F12E_1_Total_number_of_ECU_Software_Part_Numbers
        DataInfo_DID_EDA0_Complete_ECU_Part_Serial_Number_s_DID_F12E_1_Total_number_of_ECU_Software_Part_Numbers (DcmDspDataInfo): DcmDspDataFixedLength=true
        DID_EDA0_Complete_ECU_Part_Serial_Number_s_BCD_part (DcmDspData): DcmDspDataSize=32, DcmDspDataType=UINT32, DcmDspDataInfoRef=DataInfo_DID_EDA0_Complete_ECU_Part_Serial_Number_s_BCD_part
        DataInfo_DID_EDA0_Complete_ECU_Part_Serial_Number_s_BCD_part (DcmDspDataInfo): DcmDspDataFixedLength=true
        DID_EDA0_Complete_ECU_Part_Serial_Number_s_ASCII_part (DcmDspData): DcmDspDataSize=24, DcmDspDataType=UINT8_N, DcmDspDataInfoRef=DataInfo_DID_EDA0_Complete_ECU_Part_Serial_Number_s_ASCII_part
        DataInfo_DID_EDA0_Complete_ECU_Part_Serial_Number_s_ASCII_part (DcmDspDataInfo): DcmDspDataFixedLength=true
        DID_EDA0_Complete_ECU_Part_Serial_Number_s_Reserved (DcmDspData): DcmDspDataSize=80, DcmDspDataType=UINT8_N, DcmDspDataInfoRef=DataInfo_DID_EDA0_Complete_ECU_Part_Serial_Number_s_Reserved
        DataInfo_DID_EDA0_Complete_ECU_Part_Serial_Number_s_Reserved (DcmDspDataInfo): DcmDspDataFixedLength=true
        DID_EE9A_Inverter_Coolant_Temperature_DID_EE9A_Inverter_Coolant_Temperature (DcmDspData): DcmDspDataSize=8, DcmDspDataType=UINT8, DcmDspDataInfoRef=DataInfo_DID_EE9A_Inverter_Coolant_Temperature_DID_EE9A_Inverter_Coolant_Temperature
        DataInfo_DID_EE9A_Inverter_Coolant_Temperature_DID_EE9A_Inverter_Coolant_Temperature (DcmDspDataInfo): DcmDspDataFixedLength=true
        DID_EE9C_Transient_Phase_Current_A_DID_EE9C_Transient_Phase_Current_A (DcmDspData): DcmDspDataSize=16, DcmDspDataType=UINT16, DcmDspDataInfoRef=DataInfo_DID_EE9C_Transient_Phase_Current_A_DID_EE9C_Transient_Phase_Current_A
        DataInfo_DID_EE9C_Transient_Phase_Current_A_DID_EE9C_Transient_Phase_Current_A (DcmDspDataInfo): DcmDspDataFixedLength=true
        DID_EE9D_Transient_Phase_Current_B_DID_EE9D_Transient_Phase_Current_B (DcmDspData): DcmDspDataSize=16, DcmDspDataType=UINT16, DcmDspDataInfoRef=DataInfo_DID_EE9D_Transient_Phase_Current_B_DID_EE9D_Transient_Phase_Current_B
        DataInfo_DID_EE9D_Transient_Phase_Current_B_DID_EE9D_Transient_Phase_Current_B (DcmDspDataInfo): DcmDspDataFixedLength=true
        DID_EE9E_Transient_Phase_Current_C_DID_EE9E_Transient_Phase_Current_C (DcmDspData): DcmDspDataSize=16, DcmDspDataType=UINT16, DcmDspDataInfoRef=DataInfo_DID_EE9E_Transient_Phase_Current_C_DID_EE9E_Transient_Phase_Current_C
        DataInfo_DID_EE9E_Transient_Phase_Current_C_DID_EE9E_Transient_Phase_Current_C (DcmDspDataInfo): DcmDspDataFixedLength=true
        DID_EE9F_Gate_Status_DID_EE9F_Gate_Status (DcmDspData): DcmDspDataSize=8, DcmDspDataType=UINT8, DcmDspDataInfoRef=DataInfo_DID_EE9F_Gate_Status_DID_EE9F_Gate_Status
        DataInfo_DID_EE9F_Gate_Status_DID_EE9F_Gate_Status (DcmDspDataInfo): DcmDspDataFixedLength=true
        DID_EEB2_Three_Phase_Motor_Current_RMS_Current_DID_EEB2_Three_Phase_Motor_Current_RMS_Current (DcmDspData):
          DcmDspDataSize = 16
          DcmDspDataType = UINT16
          DcmDspDataInfoRef = DataInfo_DID_EEB2_Three_Phase_Motor_Current_RMS_Current_DID_EEB2_Three_Phase_Motor_Current_RMS_Current
        DataInfo_DID_EEB2_Three_Phase_Motor_Current_RMS_Current_DID_EEB2_Three_Phase_Motor_Current_RMS_Current (DcmDspDataInfo): DcmDspDataFixedLength=true
        DID_EEB5_IEM_MGM_current_torque_DID_EEB5_IEMMGM_current_torque (DcmDspData): DcmDspDataSize=16, DcmDspDataType=UINT16, DcmDspDataInfoRef=DataInfo_DID_EEB5_IEM_MGM_current_torque_DID_EEB5_IEMMGM_current_torque
        DataInfo_DID_EEB5_IEM_MGM_current_torque_DID_EEB5_IEMMGM_current_torque (DcmDspDataInfo): DcmDspDataFixedLength=true
        DID_EEB6_ECM_Power_Limitation_maximum_DID_EEB6_ECM_Power_Limitation_maximum (DcmDspData): DcmDspDataSize=16, DcmDspDataType=UINT16, DcmDspDataInfoRef=DataInfo_DID_EEB6_ECM_Power_Limitation_maximum_DID_EEB6_ECM_Power_Limitation_maximum
        DataInfo_DID_EEB6_ECM_Power_Limitation_maximum_DID_EEB6_ECM_Power_Limitation_maximum (DcmDspDataInfo): DcmDspDataFixedLength=true
        DID_EEB7_ECM_Power_Limitation_minimum_DID_EEB7_ECM_Power_Limitation_minimum (DcmDspData): DcmDspDataSize=16, DcmDspDataType=UINT16, DcmDspDataInfoRef=DataInfo_DID_EEB7_ECM_Power_Limitation_minimum_DID_EEB7_ECM_Power_Limitation_minimum
        DataInfo_DID_EEB7_ECM_Power_Limitation_minimum_DID_EEB7_ECM_Power_Limitation_minimum (DcmDspDataInfo): DcmDspDataFixedLength=true
        DID_EEB8_HV_voltage_received_from_BECM_DID_EEB8_HV_voltage_received_from_BECM (DcmDspData):
          DcmDspDataSize = 16
          DcmDspDataType = UINT16
          DcmDspDataInfoRef = DataInfo_DID_EEB8_HV_voltage_received_from_BECM_DID_EEB8_HV_voltage_received_from_BECM
        DataInfo_DID_EEB8_HV_voltage_received_from_BECM_DID_EEB8_HV_voltage_received_from_BECM (DcmDspDataInfo): DcmDspDataFixedLength=true
        DID_EEBD_IEM_MGM_rotor_offset_angle_DID_EEBD_IEMMGM_rotor_offset_angle (DcmDspData): DcmDspDataSize=32, DcmDspDataType=UINT32, DcmDspDataInfoRef=DataInfo_DID_EEBD_IEM_MGM_rotor_offset_angle_DID_EEBD_IEMMGM_rotor_offset_angle
        DataInfo_DID_EEBD_IEM_MGM_rotor_offset_angle_DID_EEBD_IEMMGM_rotor_offset_angle (DcmDspDataInfo): DcmDspDataFixedLength=true
        DID_EEBE_Offset_angle_status_DID_EEBE_Offset_angle_status (DcmDspData): DcmDspDataSize=8, DcmDspDataType=UINT8, DcmDspDataInfoRef=DataInfo_DID_EEBE_Offset_angle_status_DID_EEBE_Offset_angle_status
        DataInfo_DID_EEBE_Offset_angle_status_DID_EEBE_Offset_angle_status (DcmDspDataInfo): DcmDspDataFixedLength=true
        DID_EEBF_HV_Main_Relay_Status_DID_EEBF_HV_Main_Relay_Status (DcmDspData): DcmDspDataSize=8, DcmDspDataType=UINT8, DcmDspDataInfoRef=DataInfo_DID_EEBF_HV_Main_Relay_Status_DID_EEBF_HV_Main_Relay_Status
        DataInfo_DID_EEBF_HV_Main_Relay_Status_DID_EEBF_HV_Main_Relay_Status (DcmDspDataInfo): DcmDspDataFixedLength=true
        DID_EEC3_ECU_power_supply_Voltage_DID_EEC3_ECU_power_supply_Voltage (DcmDspData): DcmDspDataSize=8, DcmDspDataType=UINT8, DcmDspDataInfoRef=DataInfo_DID_EEC3_ECU_power_supply_Voltage_DID_EEC3_ECU_power_supply_Voltage
        DataInfo_DID_EEC3_ECU_power_supply_Voltage_DID_EEC3_ECU_power_supply_Voltage (DcmDspDataInfo): DcmDspDataFixedLength=true
        DID_EEC4_Charging_Power_Sustain_Relay_CPSR_Voltage_DID_EEC4_Charging_Power_Sustain_RelayCPSR_Voltage (DcmDspData):
          DcmDspDataSize = 8
          DcmDspDataType = UINT8
          DcmDspDataInfoRef = DataInfo_DID_EEC4_Charging_Power_Sustain_Relay_CPSR_Voltage_DID_EEC4_Charging_Power_Sustain_RelayCPSR_Voltage
        DataInfo_DID_EEC4_Charging_Power_Sustain_Relay_CPSR_Voltage_DID_EEC4_Charging_Power_Sustain_RelayCPSR_Voltage (DcmDspDataInfo): DcmDspDataFixedLength=true
        DID_EEC5_ImobEng2_node_status_DID_EEC5_ImobEng2_node_status (DcmDspData): DcmDspDataSize=8, DcmDspDataType=UINT8, DcmDspDataInfoRef=DataInfo_DID_EEC5_ImobEng2_node_status_DID_EEC5_ImobEng2_node_status
        DataInfo_DID_EEC5_ImobEng2_node_status_DID_EEC5_ImobEng2_node_status (DcmDspDataInfo): DcmDspDataFixedLength=true
        DID_EED1_Safty_monitor_Fault_Indication_EED1_0 (DcmDspData): DcmDspDataSize=8, DcmDspDataType=UINT8, DcmDspDataInfoRef=DataInfo_DID_EED1_Safty_monitor_Fault_Indication_EED1_0
        DataInfo_DID_EED1_Safty_monitor_Fault_Indication_EED1_0 (DcmDspDataInfo): DcmDspDataFixedLength=true
        DID_EED1_Safty_monitor_Fault_Indication_EED1_1 (DcmDspData): DcmDspDataSize=8, DcmDspDataType=UINT8, DcmDspDataInfoRef=DataInfo_DID_EED1_Safty_monitor_Fault_Indication_EED1_1
        DataInfo_DID_EED1_Safty_monitor_Fault_Indication_EED1_1 (DcmDspDataInfo): DcmDspDataFixedLength=true
        DID_EED1_Safty_monitor_Fault_Indication_EED1_2 (DcmDspData): DcmDspDataSize=8, DcmDspDataType=UINT8, DcmDspDataInfoRef=DataInfo_DID_EED1_Safty_monitor_Fault_Indication_EED1_2
        DataInfo_DID_EED1_Safty_monitor_Fault_Indication_EED1_2 (DcmDspDataInfo): DcmDspDataFixedLength=true
        DID_EED1_Safty_monitor_Fault_Indication_EED1_3 (DcmDspData): DcmDspDataSize=8, DcmDspDataType=UINT8, DcmDspDataInfoRef=DataInfo_DID_EED1_Safty_monitor_Fault_Indication_EED1_3
        DataInfo_DID_EED1_Safty_monitor_Fault_Indication_EED1_3 (DcmDspDataInfo): DcmDspDataFixedLength=true
        DID_0xEEC7_1_DID_EED2_SaftyTorque (DcmDspData): DcmDspDataSize=16, DcmDspDataType=UINT16, DcmDspDataInfoRef=DataInfo_DID_0xEEC7_1_DID_EED2_SaftyTorque
        DataInfo_DID_0xEEC7_1_DID_EED2_SaftyTorque (DcmDspDataInfo): DcmDspDataFixedLength=true
        DID_EED3_Safety_speed_DID_EED3_Safety_speed (DcmDspData): DcmDspDataSize=16, DcmDspDataType=UINT16, DcmDspDataInfoRef=DataInfo_DID_EED3_Safety_speed_DID_EED3_Safety_speed
        DataInfo_DID_EED3_Safety_speed_DID_EED3_Safety_speed (DcmDspDataInfo): DcmDspDataFixedLength=true
        DID_EED4_Safty_Function_Mode_DID_EED4_Safty_Function_Mode (DcmDspData): DcmDspDataSize=8, DcmDspDataType=UINT8_N, DcmDspDataInfoRef=DataInfo_DID_EED4_Safty_Function_Mode_DID_EED4_Safty_Function_Mode
        DataInfo_DID_EED4_Safty_Function_Mode_DID_EED4_Safty_Function_Mode (DcmDspDataInfo): DcmDspDataFixedLength=true
        DID_EED5_Safety_Torque_QF_factor_EED5_Safety_Torque_Quality_factor (DcmDspData): DcmDspDataSize=8, DcmDspDataType=UINT8_N, DcmDspDataInfoRef=DataInfo_DID_EED5_Safety_Torque_QF_factor_EED5_Safety_Torque_Quality_factor
        DataInfo_DID_EED5_Safety_Torque_QF_factor_EED5_Safety_Torque_Quality_factor (DcmDspDataInfo): DcmDspDataFixedLength=true
        DID_EEFD_Sofware_Project_Version_DID_EEFD_Clutch_Control_Fault_Indication (DcmDspData): DcmDspDataSize=192, DcmDspDataType=UINT8_N, DcmDspDataInfoRef=DataInfo_DID_EEFD_Sofware_Project_Version_DID_EEFD_Clutch_Control_Fault_Indication
        DataInfo_DID_EEFD_Sofware_Project_Version_DID_EEFD_Clutch_Control_Fault_Indication (DcmDspDataInfo): DcmDspDataFixedLength=true
        DID_EF0A_Active_Discharge_Time_DID_EF0A_Active_Discharge_Time (DcmDspData): DcmDspDataSize=8, DcmDspDataType=UINT8, DcmDspDataInfoRef=DataInfo_DID_EF0A_Active_Discharge_Time_DID_EF0A_Active_Discharge_Time
        DataInfo_DID_EF0A_Active_Discharge_Time_DID_EF0A_Active_Discharge_Time (DcmDspDataInfo): DcmDspDataFixedLength=true
        DID_EF1B_EOL_config_word_A_DID_EF1B_EOL_config_word_A (DcmDspData): DcmDspDataSize=16, DcmDspDataType=UINT16, DcmDspDataInfoRef=DataInfo_DID_EF1B_EOL_config_word_A_DID_EF1B_EOL_config_word_A
        DataInfo_DID_EF1B_EOL_config_word_A_DID_EF1B_EOL_config_word_A (DcmDspDataInfo): DcmDspDataFixedLength=true
        DID_EF1C_EOL_config_word_B_DID_EF1C_EOL_config_word_B (DcmDspData): DcmDspDataSize=320, DcmDspDataType=UINT8_N, DcmDspDataInfoRef=DataInfo_DID_EF1C_EOL_config_word_B_DID_EF1C_EOL_config_word_B
        DataInfo_DID_EF1C_EOL_config_word_B_DID_EF1C_EOL_config_word_B (DcmDspDataInfo): DcmDspDataFixedLength=true
        DID_EF1D_EOL_config_word_C_DID_EF1D_EOL_config_word_C (DcmDspData): DcmDspDataSize=16, DcmDspDataType=UINT16, DcmDspDataInfoRef=DataInfo_DID_EF1D_EOL_config_word_C_DID_EF1D_EOL_config_word_C
        DataInfo_DID_EF1D_EOL_config_word_C_DID_EF1D_EOL_config_word_C (DcmDspDataInfo): DcmDspDataFixedLength=true
        Application_Diagnostic_Database_Part_Number_Partnumber_Main (DcmDspData): DcmDspDataSize=32, DcmDspDataType=UINT32, DcmDspDataInfoRef=DataInfo_Application_Diagnostic_Database_Part_Number_Partnumber_Main
        DataInfo_Application_Diagnostic_Database_Part_Number_Partnumber_Main (DcmDspDataInfo): DcmDspDataFixedLength=true
        Application_Diagnostic_Database_Part_Number_Partnumber_Variant (DcmDspData): DcmDspDataSize=24, DcmDspDataType=UINT8_N, DcmDspDataInfoRef=DataInfo_Application_Diagnostic_Database_Part_Number_Partnumber_Variant
        DataInfo_Application_Diagnostic_Database_Part_Number_Partnumber_Variant (DcmDspDataInfo): DcmDspDataFixedLength=true
        DID_F121_Primary_Bootloader_Diagnostic_Database_Part_Number_BCD_part (DcmDspData): DcmDspDataSize=32, DcmDspDataType=UINT32, DcmDspDataInfoRef=DataInfo_DID_F121_Primary_Bootloader_Diagnostic_Database_Part_Number_BCD_part
        DataInfo_DID_F121_Primary_Bootloader_Diagnostic_Database_Part_Number_BCD_part (DcmDspDataInfo): DcmDspDataFixedLength=true
        DID_F121_Primary_Bootloader_Diagnostic_Database_Part_Number_ASCII_part (DcmDspData): DcmDspDataSize=24, DcmDspDataType=UINT8_N, DcmDspDataInfoRef=DataInfo_DID_F121_Primary_Bootloader_Diagnostic_Database_Part_Number_ASCII_part
        DataInfo_DID_F121_Primary_Bootloader_Diagnostic_Database_Part_Number_ASCII_part (DcmDspDataInfo): DcmDspDataFixedLength=true
        DID_F125_Primary_Bootloader_Software_Part_Number_BCD_part (DcmDspData): DcmDspDataSize=32, DcmDspDataType=UINT32, DcmDspDataInfoRef=DataInfo_DID_F125_Primary_Bootloader_Software_Part_Number_BCD_part
        DataInfo_DID_F125_Primary_Bootloader_Software_Part_Number_BCD_part (DcmDspDataInfo): DcmDspDataFixedLength=true
        DID_F125_Primary_Bootloader_Software_Part_Number_ASCII_part (DcmDspData): DcmDspDataSize=24, DcmDspDataType=UINT8_N, DcmDspDataInfoRef=DataInfo_DID_F125_Primary_Bootloader_Software_Part_Number_ASCII_part
        DataInfo_DID_F125_Primary_Bootloader_Software_Part_Number_ASCII_part (DcmDspDataInfo): DcmDspDataFixedLength=true
        DID_F126_Autosar_BSW_Cluster_Versions_DID_F126_1_DIAG_CLUSTER_VENDOR_ID (DcmDspData): DcmDspDataSize=16, DcmDspDataType=UINT16, DcmDspDataInfoRef=DataInfo_DID_F126_Autosar_BSW_Cluster_Versions_DID_F126_1_DIAG_CLUSTER_VENDOR_ID
        DataInfo_DID_F126_Autosar_BSW_Cluster_Versions_DID_F126_1_DIAG_CLUSTER_VENDOR_ID (DcmDspDataInfo): DcmDspDataFixedLength=true
        DID_F126_Autosar_BSW_Cluster_Versions_DID_F126_2_DIAG_CLUSTER_SW_MAJOR_VERSION (DcmDspData):
          DcmDspDataSize = 8
          DcmDspDataType = UINT8
          DcmDspDataInfoRef = DataInfo_DID_F126_Autosar_BSW_Cluster_Versions_DID_F126_2_DIAG_CLUSTER_SW_MAJOR_VERSION
        DataInfo_DID_F126_Autosar_BSW_Cluster_Versions_DID_F126_2_DIAG_CLUSTER_SW_MAJOR_VERSION (DcmDspDataInfo): DcmDspDataFixedLength=true
        DID_F126_Autosar_BSW_Cluster_Versions_DID_F126_3_DIAG_CLUSTER_SW_MINOR_VERSION (DcmDspData):
          DcmDspDataSize = 8
          DcmDspDataType = UINT8
          DcmDspDataInfoRef = DataInfo_DID_F126_Autosar_BSW_Cluster_Versions_DID_F126_3_DIAG_CLUSTER_SW_MINOR_VERSION
        DataInfo_DID_F126_Autosar_BSW_Cluster_Versions_DID_F126_3_DIAG_CLUSTER_SW_MINOR_VERSION (DcmDspDataInfo): DcmDspDataFixedLength=true
        DID_F126_Autosar_BSW_Cluster_Versions_DID_F126_4_DIAG_CLUSTER_SW_PATCH_VERSION (DcmDspData):
          DcmDspDataSize = 8
          DcmDspDataType = UINT8
          DcmDspDataInfoRef = DataInfo_DID_F126_Autosar_BSW_Cluster_Versions_DID_F126_4_DIAG_CLUSTER_SW_PATCH_VERSION
        DataInfo_DID_F126_Autosar_BSW_Cluster_Versions_DID_F126_4_DIAG_CLUSTER_SW_PATCH_VERSION (DcmDspDataInfo): DcmDspDataFixedLength=true
        DID_F126_Autosar_BSW_Cluster_Versions_DID_F126_5_DIAG_CLUSTER_AR_RELEASE_MAJOR_VERSION (DcmDspData):
          DcmDspDataSize = 8
          DcmDspDataType = UINT8
          DcmDspDataInfoRef = DataInfo_DID_F126_Autosar_BSW_Cluster_Versions_DID_F126_5_DIAG_CLUSTER_AR_RELEASE_MAJOR_VERSION
        DataInfo_DID_F126_Autosar_BSW_Cluster_Versions_DID_F126_5_DIAG_CLUSTER_AR_RELEASE_MAJOR_VERSION (DcmDspDataInfo): DcmDspDataFixedLength=true
        DID_F126_Autosar_BSW_Cluster_Versions_DID_F126_6_DIAG_CLUSTER_AR_RELEASE_MINOR_VERSION (DcmDspData):
          DcmDspDataSize = 8
          DcmDspDataType = UINT8
          DcmDspDataInfoRef = DataInfo_DID_F126_Autosar_BSW_Cluster_Versions_DID_F126_6_DIAG_CLUSTER_AR_RELEASE_MINOR_VERSION
        DataInfo_DID_F126_Autosar_BSW_Cluster_Versions_DID_F126_6_DIAG_CLUSTER_AR_RELEASE_MINOR_VERSION (DcmDspDataInfo): DcmDspDataFixedLength=true
        DID_F126_Autosar_BSW_Cluster_Versions_DID_F126_7_DIAG_CLUSTER_AR_RELEASE_REVISION_VERSION (DcmDspData):
          DcmDspDataSize = 8
          DcmDspDataType = UINT8
          DcmDspDataInfoRef = DataInfo_DID_F126_Autosar_BSW_Cluster_Versions_DID_F126_7_DIAG_CLUSTER_AR_RELEASE_REVISION_VERSION
        DataInfo_DID_F126_Autosar_BSW_Cluster_Versions_DID_F126_7_DIAG_CLUSTER_AR_RELEASE_REVISION_VERSION (DcmDspDataInfo): DcmDspDataFixedLength=true
        DID_F126_Autosar_BSW_Cluster_Versions_DID_F126_8_DIAG_CLUSTER_VCC_DEM_VERSION (DcmDspData): DcmDspDataSize=8, DcmDspDataType=UINT8, DcmDspDataInfoRef=DataInfo_DID_F126_Autosar_BSW_Cluster_Versions_DID_F126_8_DIAG_CLUSTER_VCC_DEM_VERSION
        DataInfo_DID_F126_Autosar_BSW_Cluster_Versions_DID_F126_8_DIAG_CLUSTER_VCC_DEM_VERSION (DcmDspDataInfo): DcmDspDataFixedLength=true
        DID_F126_Autosar_BSW_Cluster_Versions_DID_F126_9_DIAG_CLUSTER_VCC_DCM_VERSION (DcmDspData): DcmDspDataSize=8, DcmDspDataType=UINT8, DcmDspDataInfoRef=DataInfo_DID_F126_Autosar_BSW_Cluster_Versions_DID_F126_9_DIAG_CLUSTER_VCC_DCM_VERSION
        DataInfo_DID_F126_Autosar_BSW_Cluster_Versions_DID_F126_9_DIAG_CLUSTER_VCC_DCM_VERSION (DcmDspDataInfo): DcmDspDataFixedLength=true
        DID_F126_Autosar_BSW_Cluster_Versions_DID_F126_10_DIAG_CLUSTER_VCC_FIM_VERSION (DcmDspData):
          DcmDspDataSize = 8
          DcmDspDataType = UINT8
          DcmDspDataInfoRef = DataInfo_DID_F126_Autosar_BSW_Cluster_Versions_DID_F126_10_DIAG_CLUSTER_VCC_FIM_VERSION
        DataInfo_DID_F126_Autosar_BSW_Cluster_Versions_DID_F126_10_DIAG_CLUSTER_VCC_FIM_VERSION (DcmDspDataInfo): DcmDspDataFixedLength=true
        DID_F126_Autosar_BSW_Cluster_Versions_DID_F126_11_MODEMGMT_CLUSTER_VENDOR_ID (DcmDspData):
          DcmDspDataSize = 16
          DcmDspDataType = UINT16
          DcmDspDataInfoRef = DataInfo_DID_F126_Autosar_BSW_Cluster_Versions_DID_F126_11_MODEMGMT_CLUSTER_VENDOR_ID
        DataInfo_DID_F126_Autosar_BSW_Cluster_Versions_DID_F126_11_MODEMGMT_CLUSTER_VENDOR_ID (DcmDspDataInfo): DcmDspDataFixedLength=true
        DID_F126_Autosar_BSW_Cluster_Versions_DID_F126_12_MODEMGMT_CLUSTER_SW_MAJOR_VERSION (DcmDspData):
          DcmDspDataSize = 8
          DcmDspDataType = UINT8
          DcmDspDataInfoRef = DataInfo_DID_F126_Autosar_BSW_Cluster_Versions_DID_F126_12_MODEMGMT_CLUSTER_SW_MAJOR_VERSION
        DataInfo_DID_F126_Autosar_BSW_Cluster_Versions_DID_F126_12_MODEMGMT_CLUSTER_SW_MAJOR_VERSION (DcmDspDataInfo): DcmDspDataFixedLength=true
        DID_F126_Autosar_BSW_Cluster_Versions_DID_F126_13_MODEMGMT_CLUSTER_SW_MINOR_VERSION (DcmDspData):
          DcmDspDataSize = 8
          DcmDspDataType = UINT8
          DcmDspDataInfoRef = DataInfo_DID_F126_Autosar_BSW_Cluster_Versions_DID_F126_13_MODEMGMT_CLUSTER_SW_MINOR_VERSION
        DataInfo_DID_F126_Autosar_BSW_Cluster_Versions_DID_F126_13_MODEMGMT_CLUSTER_SW_MINOR_VERSION (DcmDspDataInfo): DcmDspDataFixedLength=true
        DID_F126_Autosar_BSW_Cluster_Versions_DID_F126_14_MODEMGMT_CLUSTER_SW_PATCH_VERSION (DcmDspData):
          DcmDspDataSize = 8
          DcmDspDataType = UINT8
          DcmDspDataInfoRef = DataInfo_DID_F126_Autosar_BSW_Cluster_Versions_DID_F126_14_MODEMGMT_CLUSTER_SW_PATCH_VERSION
        DataInfo_DID_F126_Autosar_BSW_Cluster_Versions_DID_F126_14_MODEMGMT_CLUSTER_SW_PATCH_VERSION (DcmDspDataInfo): DcmDspDataFixedLength=true
        DID_F126_Autosar_BSW_Cluster_Versions_DID_F126_15_MODEMGMT_CLUSTER_AR_RELEASE_MAJOR_VERSION (DcmDspData):
          DcmDspDataSize = 8
          DcmDspDataType = UINT8
          DcmDspDataInfoRef = DataInfo_DID_F126_Autosar_BSW_Cluster_Versions_DID_F126_15_MODEMGMT_CLUSTER_AR_RELEASE_MAJOR_VERSION
        DataInfo_DID_F126_Autosar_BSW_Cluster_Versions_DID_F126_15_MODEMGMT_CLUSTER_AR_RELEASE_MAJOR_VERSION (DcmDspDataInfo): DcmDspDataFixedLength=true
        DID_F126_Autosar_BSW_Cluster_Versions_DID_F126_16_MODEMGMT_CLUSTER_AR_RELEASE_MINOR_VERSION (DcmDspData):
          DcmDspDataSize = 8
          DcmDspDataType = UINT8
          DcmDspDataInfoRef = DataInfo_DID_F126_Autosar_BSW_Cluster_Versions_DID_F126_16_MODEMGMT_CLUSTER_AR_RELEASE_MINOR_VERSION
        DataInfo_DID_F126_Autosar_BSW_Cluster_Versions_DID_F126_16_MODEMGMT_CLUSTER_AR_RELEASE_MINOR_VERSION (DcmDspDataInfo): DcmDspDataFixedLength=true
        DID_F126_Autosar_BSW_Cluster_Versions_DID_F126_17_MODEMGMT_CLUSTER_AR_RELEASE_REVISION_VERSION (DcmDspData):
          DcmDspDataSize = 8
          DcmDspDataType = UINT8
          DcmDspDataInfoRef = DataInfo_DID_F126_Autosar_BSW_Cluster_Versions_DID_F126_17_MODEMGMT_CLUSTER_AR_RELEASE_REVISION_VERSION
        DataInfo_DID_F126_Autosar_BSW_Cluster_Versions_DID_F126_17_MODEMGMT_CLUSTER_AR_RELEASE_REVISION_VERSION (DcmDspDataInfo): DcmDspDataFixedLength=true
        DID_F126_Autosar_BSW_Cluster_Versions_DID_F126_18_COM_CLUSTER_VENDOR_ID (DcmDspData): DcmDspDataSize=16, DcmDspDataType=UINT16, DcmDspDataInfoRef=DataInfo_DID_F126_Autosar_BSW_Cluster_Versions_DID_F126_18_COM_CLUSTER_VENDOR_ID
        DataInfo_DID_F126_Autosar_BSW_Cluster_Versions_DID_F126_18_COM_CLUSTER_VENDOR_ID (DcmDspDataInfo): DcmDspDataFixedLength=true
        DID_F126_Autosar_BSW_Cluster_Versions_DID_F126_19_COM_CLUSTER_SW_MAJOR_VERSION (DcmDspData):
          DcmDspDataSize = 8
          DcmDspDataType = UINT8
          DcmDspDataInfoRef = DataInfo_DID_F126_Autosar_BSW_Cluster_Versions_DID_F126_19_COM_CLUSTER_SW_MAJOR_VERSION
        DataInfo_DID_F126_Autosar_BSW_Cluster_Versions_DID_F126_19_COM_CLUSTER_SW_MAJOR_VERSION (DcmDspDataInfo): DcmDspDataFixedLength=true
        DID_F126_Autosar_BSW_Cluster_Versions_DID_F126_20_COM_CLUSTER_SW_MINOR_VERSION (DcmDspData):
          DcmDspDataSize = 8
          DcmDspDataType = UINT8
          DcmDspDataInfoRef = DataInfo_DID_F126_Autosar_BSW_Cluster_Versions_DID_F126_20_COM_CLUSTER_SW_MINOR_VERSION
        DataInfo_DID_F126_Autosar_BSW_Cluster_Versions_DID_F126_20_COM_CLUSTER_SW_MINOR_VERSION (DcmDspDataInfo): DcmDspDataFixedLength=true
        DID_F126_Autosar_BSW_Cluster_Versions_DID_F126_21_COM_CLUSTER_SW_PATCH_VERSION (DcmDspData):
          DcmDspDataSize = 8
          DcmDspDataType = UINT8
          DcmDspDataInfoRef = DataInfo_DID_F126_Autosar_BSW_Cluster_Versions_DID_F126_21_COM_CLUSTER_SW_PATCH_VERSION
        DataInfo_DID_F126_Autosar_BSW_Cluster_Versions_DID_F126_21_COM_CLUSTER_SW_PATCH_VERSION (DcmDspDataInfo): DcmDspDataFixedLength=true
        DID_F126_Autosar_BSW_Cluster_Versions_DID_F126_22_COM_CLUSTER_AR_RELEASE_MAJOR_VERSION (DcmDspData):
          DcmDspDataSize = 8
          DcmDspDataType = UINT8
          DcmDspDataInfoRef = DataInfo_DID_F126_Autosar_BSW_Cluster_Versions_DID_F126_22_COM_CLUSTER_AR_RELEASE_MAJOR_VERSION
        DataInfo_DID_F126_Autosar_BSW_Cluster_Versions_DID_F126_22_COM_CLUSTER_AR_RELEASE_MAJOR_VERSION (DcmDspDataInfo): DcmDspDataFixedLength=true
        DID_F126_Autosar_BSW_Cluster_Versions_DID_F126_23_COM_CLUSTER_AR_RELEASE_MINOR_VERSION (DcmDspData):
          DcmDspDataSize = 8
          DcmDspDataType = UINT8
          DcmDspDataInfoRef = DataInfo_DID_F126_Autosar_BSW_Cluster_Versions_DID_F126_23_COM_CLUSTER_AR_RELEASE_MINOR_VERSION
        DataInfo_DID_F126_Autosar_BSW_Cluster_Versions_DID_F126_23_COM_CLUSTER_AR_RELEASE_MINOR_VERSION (DcmDspDataInfo): DcmDspDataFixedLength=true
        DID_F126_Autosar_BSW_Cluster_Versions_DID_F126_24_COM_CLUSTER_AR_RELEASE_REVISION_VERSION (DcmDspData):
          DcmDspDataSize = 8
          DcmDspDataType = UINT8
          DcmDspDataInfoRef = DataInfo_DID_F126_Autosar_BSW_Cluster_Versions_DID_F126_24_COM_CLUSTER_AR_RELEASE_REVISION_VERSION
        DataInfo_DID_F126_Autosar_BSW_Cluster_Versions_DID_F126_24_COM_CLUSTER_AR_RELEASE_REVISION_VERSION (DcmDspDataInfo): DcmDspDataFixedLength=true
        DID_F126_Autosar_BSW_Cluster_Versions_DID_F126_25_CAN_CLUSTER_VENDOR_ID (DcmDspData): DcmDspDataSize=16, DcmDspDataType=UINT16, DcmDspDataInfoRef=DataInfo_DID_F126_Autosar_BSW_Cluster_Versions_DID_F126_25_CAN_CLUSTER_VENDOR_ID
        DataInfo_DID_F126_Autosar_BSW_Cluster_Versions_DID_F126_25_CAN_CLUSTER_VENDOR_ID (DcmDspDataInfo): DcmDspDataFixedLength=true
        DID_F126_Autosar_BSW_Cluster_Versions_DID_F126_26_CAN_CLUSTER_SW_MAJOR_VERSION (DcmDspData):
          DcmDspDataSize = 8
          DcmDspDataType = UINT8
          DcmDspDataInfoRef = DataInfo_DID_F126_Autosar_BSW_Cluster_Versions_DID_F126_26_CAN_CLUSTER_SW_MAJOR_VERSION
        DataInfo_DID_F126_Autosar_BSW_Cluster_Versions_DID_F126_26_CAN_CLUSTER_SW_MAJOR_VERSION (DcmDspDataInfo): DcmDspDataFixedLength=true
        DID_F126_Autosar_BSW_Cluster_Versions_DID_F126_27_CAN_CLUSTER_SW_MINOR_VERSION (DcmDspData):
          DcmDspDataSize = 8
          DcmDspDataType = UINT8
          DcmDspDataInfoRef = DataInfo_DID_F126_Autosar_BSW_Cluster_Versions_DID_F126_27_CAN_CLUSTER_SW_MINOR_VERSION
        DataInfo_DID_F126_Autosar_BSW_Cluster_Versions_DID_F126_27_CAN_CLUSTER_SW_MINOR_VERSION (DcmDspDataInfo): DcmDspDataFixedLength=true
        DID_F126_Autosar_BSW_Cluster_Versions_DID_F126_28_CAN_CLUSTER_SW_PATCH_VERSION (DcmDspData):
          DcmDspDataSize = 8
          DcmDspDataType = UINT8
          DcmDspDataInfoRef = DataInfo_DID_F126_Autosar_BSW_Cluster_Versions_DID_F126_28_CAN_CLUSTER_SW_PATCH_VERSION
        DataInfo_DID_F126_Autosar_BSW_Cluster_Versions_DID_F126_28_CAN_CLUSTER_SW_PATCH_VERSION (DcmDspDataInfo): DcmDspDataFixedLength=true
        DID_F126_Autosar_BSW_Cluster_Versions_DID_F126_29_CAN_CLUSTER_AR_RELEASE_MAJOR_VERSION (DcmDspData):
          DcmDspDataSize = 8
          DcmDspDataType = UINT8
          DcmDspDataInfoRef = DataInfo_DID_F126_Autosar_BSW_Cluster_Versions_DID_F126_29_CAN_CLUSTER_AR_RELEASE_MAJOR_VERSION
        DataInfo_DID_F126_Autosar_BSW_Cluster_Versions_DID_F126_29_CAN_CLUSTER_AR_RELEASE_MAJOR_VERSION (DcmDspDataInfo): DcmDspDataFixedLength=true
        DID_F126_Autosar_BSW_Cluster_Versions_DID_F126_30_CAN_CLUSTER_AR_RELEASE_MINOR_VERSION (DcmDspData):
          DcmDspDataSize = 8
          DcmDspDataType = UINT8
          DcmDspDataInfoRef = DataInfo_DID_F126_Autosar_BSW_Cluster_Versions_DID_F126_30_CAN_CLUSTER_AR_RELEASE_MINOR_VERSION
        DataInfo_DID_F126_Autosar_BSW_Cluster_Versions_DID_F126_30_CAN_CLUSTER_AR_RELEASE_MINOR_VERSION (DcmDspDataInfo): DcmDspDataFixedLength=true
        DID_F126_Autosar_BSW_Cluster_Versions_DID_F126_31_CAN_CLUSTER_AR_RELEASE_REVISION_VERSION (DcmDspData):
          DcmDspDataSize = 8
          DcmDspDataType = UINT8
          DcmDspDataInfoRef = DataInfo_DID_F126_Autosar_BSW_Cluster_Versions_DID_F126_31_CAN_CLUSTER_AR_RELEASE_REVISION_VERSION
        DataInfo_DID_F126_Autosar_BSW_Cluster_Versions_DID_F126_31_CAN_CLUSTER_AR_RELEASE_REVISION_VERSION (DcmDspDataInfo): DcmDspDataFixedLength=true
        DID_F126_Autosar_BSW_Cluster_Versions_DID_F126_32_FLEXRAY_CLUSTER_VENDOR_ID (DcmDspData): DcmDspDataSize=16, DcmDspDataType=UINT16, DcmDspDataInfoRef=DataInfo_DID_F126_Autosar_BSW_Cluster_Versions_DID_F126_32_FLEXRAY_CLUSTER_VENDOR_ID
        DataInfo_DID_F126_Autosar_BSW_Cluster_Versions_DID_F126_32_FLEXRAY_CLUSTER_VENDOR_ID (DcmDspDataInfo): DcmDspDataFixedLength=true
        DID_F126_Autosar_BSW_Cluster_Versions_DID_F126_33_FLEXRAY_CLUSTER_SW_MAJOR_VERSION (DcmDspData):
          DcmDspDataSize = 8
          DcmDspDataType = UINT8
          DcmDspDataInfoRef = DataInfo_DID_F126_Autosar_BSW_Cluster_Versions_DID_F126_33_FLEXRAY_CLUSTER_SW_MAJOR_VERSION
        DataInfo_DID_F126_Autosar_BSW_Cluster_Versions_DID_F126_33_FLEXRAY_CLUSTER_SW_MAJOR_VERSION (DcmDspDataInfo): DcmDspDataFixedLength=true
        DID_F126_Autosar_BSW_Cluster_Versions_DID_F126_34_FLEXRAY_CLUSTER_SW_MINOR_VERSION (DcmDspData):
          DcmDspDataSize = 8
          DcmDspDataType = UINT8
          DcmDspDataInfoRef = DataInfo_DID_F126_Autosar_BSW_Cluster_Versions_DID_F126_34_FLEXRAY_CLUSTER_SW_MINOR_VERSION
        DataInfo_DID_F126_Autosar_BSW_Cluster_Versions_DID_F126_34_FLEXRAY_CLUSTER_SW_MINOR_VERSION (DcmDspDataInfo): DcmDspDataFixedLength=true
        DID_F126_Autosar_BSW_Cluster_Versions_DID_F126_35_FLEXRAY_CLUSTER_SW_PATCH_VERSION (DcmDspData):
          DcmDspDataSize = 8
          DcmDspDataType = UINT8
          DcmDspDataInfoRef = DataInfo_DID_F126_Autosar_BSW_Cluster_Versions_DID_F126_35_FLEXRAY_CLUSTER_SW_PATCH_VERSION
        DataInfo_DID_F126_Autosar_BSW_Cluster_Versions_DID_F126_35_FLEXRAY_CLUSTER_SW_PATCH_VERSION (DcmDspDataInfo): DcmDspDataFixedLength=true
        DID_F126_Autosar_BSW_Cluster_Versions_DID_F126_36_FLEXRAY_CLUSTER_AR_RELEASE_MAJOR_VERSION (DcmDspData):
          DcmDspDataSize = 8
          DcmDspDataType = UINT8
          DcmDspDataInfoRef = DataInfo_DID_F126_Autosar_BSW_Cluster_Versions_DID_F126_36_FLEXRAY_CLUSTER_AR_RELEASE_MAJOR_VERSION
        DataInfo_DID_F126_Autosar_BSW_Cluster_Versions_DID_F126_36_FLEXRAY_CLUSTER_AR_RELEASE_MAJOR_VERSION (DcmDspDataInfo): DcmDspDataFixedLength=true
        DID_F126_Autosar_BSW_Cluster_Versions_DID_F126_37_FLEXRAY_CLUSTER_AR_RELEASE_MINOR_VERSION (DcmDspData):
          DcmDspDataSize = 8
          DcmDspDataType = UINT8
          DcmDspDataInfoRef = DataInfo_DID_F126_Autosar_BSW_Cluster_Versions_DID_F126_37_FLEXRAY_CLUSTER_AR_RELEASE_MINOR_VERSION
        DataInfo_DID_F126_Autosar_BSW_Cluster_Versions_DID_F126_37_FLEXRAY_CLUSTER_AR_RELEASE_MINOR_VERSION (DcmDspDataInfo): DcmDspDataFixedLength=true
        DID_F126_Autosar_BSW_Cluster_Versions_DID_F126_38_FLEXRAY_CLUSTER_AR_RELEASE_REVISION_VERSION (DcmDspData):
          DcmDspDataSize = 8
          DcmDspDataType = UINT8
          DcmDspDataInfoRef = DataInfo_DID_F126_Autosar_BSW_Cluster_Versions_DID_F126_38_FLEXRAY_CLUSTER_AR_RELEASE_REVISION_VERSION
        DataInfo_DID_F126_Autosar_BSW_Cluster_Versions_DID_F126_38_FLEXRAY_CLUSTER_AR_RELEASE_REVISION_VERSION (DcmDspDataInfo): DcmDspDataFixedLength=true
        DID_F126_Autosar_BSW_Cluster_Versions_DID_F126_39_LIN_CLUSTER_VENDOR_ID (DcmDspData): DcmDspDataSize=16, DcmDspDataType=UINT16, DcmDspDataInfoRef=DataInfo_DID_F126_Autosar_BSW_Cluster_Versions_DID_F126_39_LIN_CLUSTER_VENDOR_ID
        DataInfo_DID_F126_Autosar_BSW_Cluster_Versions_DID_F126_39_LIN_CLUSTER_VENDOR_ID (DcmDspDataInfo): DcmDspDataFixedLength=true
        DID_F126_Autosar_BSW_Cluster_Versions_DID_F126_40_LIN_CLUSTER_SW_MAJOR_VERSION (DcmDspData):
          DcmDspDataSize = 8
          DcmDspDataType = UINT8
          DcmDspDataInfoRef = DataInfo_DID_F126_Autosar_BSW_Cluster_Versions_DID_F126_40_LIN_CLUSTER_SW_MAJOR_VERSION
        DataInfo_DID_F126_Autosar_BSW_Cluster_Versions_DID_F126_40_LIN_CLUSTER_SW_MAJOR_VERSION (DcmDspDataInfo): DcmDspDataFixedLength=true
        DID_F126_Autosar_BSW_Cluster_Versions_DID_F126_41_LIN_CLUSTER_SW_MINOR_VERSION (DcmDspData):
          DcmDspDataSize = 8
          DcmDspDataType = UINT8
          DcmDspDataInfoRef = DataInfo_DID_F126_Autosar_BSW_Cluster_Versions_DID_F126_41_LIN_CLUSTER_SW_MINOR_VERSION
        DataInfo_DID_F126_Autosar_BSW_Cluster_Versions_DID_F126_41_LIN_CLUSTER_SW_MINOR_VERSION (DcmDspDataInfo): DcmDspDataFixedLength=true
        DID_F126_Autosar_BSW_Cluster_Versions_DID_F126_42_LIN_CLUSTER_SW_PATCH_VERSION (DcmDspData):
          DcmDspDataSize = 8
          DcmDspDataType = UINT8
          DcmDspDataInfoRef = DataInfo_DID_F126_Autosar_BSW_Cluster_Versions_DID_F126_42_LIN_CLUSTER_SW_PATCH_VERSION
        DataInfo_DID_F126_Autosar_BSW_Cluster_Versions_DID_F126_42_LIN_CLUSTER_SW_PATCH_VERSION (DcmDspDataInfo): DcmDspDataFixedLength=true
        DID_F126_Autosar_BSW_Cluster_Versions_DID_F126_43_LIN_CLUSTER_AR_RELEASE_MAJOR_VERSION (DcmDspData):
          DcmDspDataSize = 8
          DcmDspDataType = UINT8
          DcmDspDataInfoRef = DataInfo_DID_F126_Autosar_BSW_Cluster_Versions_DID_F126_43_LIN_CLUSTER_AR_RELEASE_MAJOR_VERSION
        DataInfo_DID_F126_Autosar_BSW_Cluster_Versions_DID_F126_43_LIN_CLUSTER_AR_RELEASE_MAJOR_VERSION (DcmDspDataInfo): DcmDspDataFixedLength=true
        DID_F126_Autosar_BSW_Cluster_Versions_DID_F126_44_LIN_CLUSTER_AR_RELEASE_MINOR_VERSION (DcmDspData):
          DcmDspDataSize = 8
          DcmDspDataType = UINT8
          DcmDspDataInfoRef = DataInfo_DID_F126_Autosar_BSW_Cluster_Versions_DID_F126_44_LIN_CLUSTER_AR_RELEASE_MINOR_VERSION
        DataInfo_DID_F126_Autosar_BSW_Cluster_Versions_DID_F126_44_LIN_CLUSTER_AR_RELEASE_MINOR_VERSION (DcmDspDataInfo): DcmDspDataFixedLength=true
        DID_F126_Autosar_BSW_Cluster_Versions_DID_F126_45_LIN_CLUSTER_AR_RELEASE_REVISION_VERSION (DcmDspData):
          DcmDspDataSize = 8
          DcmDspDataType = UINT8
          DcmDspDataInfoRef = DataInfo_DID_F126_Autosar_BSW_Cluster_Versions_DID_F126_45_LIN_CLUSTER_AR_RELEASE_REVISION_VERSION
        DataInfo_DID_F126_Autosar_BSW_Cluster_Versions_DID_F126_45_LIN_CLUSTER_AR_RELEASE_REVISION_VERSION (DcmDspDataInfo): DcmDspDataFixedLength=true
        DID_F12A_ECU_Core_Assembly_Part_Number_BCD_part (DcmDspData): DcmDspDataSize=32, DcmDspDataType=UINT32, DcmDspDataInfoRef=DataInfo_DID_F12A_ECU_Core_Assembly_Part_Number_BCD_part
        DataInfo_DID_F12A_ECU_Core_Assembly_Part_Number_BCD_part (DcmDspDataInfo): DcmDspDataFixedLength=true
        DID_F12A_ECU_Core_Assembly_Part_Number_ASCII_part (DcmDspData): DcmDspDataSize=24, DcmDspDataType=UINT8_N, DcmDspDataInfoRef=DataInfo_DID_F12A_ECU_Core_Assembly_Part_Number_ASCII_part
        DataInfo_DID_F12A_ECU_Core_Assembly_Part_Number_ASCII_part (DcmDspDataInfo): DcmDspDataFixedLength=true
        DID_F12B_ECU_Delivery_Assembly_Part_Number_BCD_part (DcmDspData): DcmDspDataSize=32, DcmDspDataType=UINT32, DcmDspDataInfoRef=DataInfo_DID_F12B_ECU_Delivery_Assembly_Part_Number_BCD_part
        DataInfo_DID_F12B_ECU_Delivery_Assembly_Part_Number_BCD_part (DcmDspDataInfo): DcmDspDataFixedLength=true
        DID_F12B_ECU_Delivery_Assembly_Part_Number_ASCII_part (DcmDspData): DcmDspDataSize=24, DcmDspDataType=UINT8_N, DcmDspDataInfoRef=DataInfo_DID_F12B_ECU_Delivery_Assembly_Part_Number_ASCII_part
        DataInfo_DID_F12B_ECU_Delivery_Assembly_Part_Number_ASCII_part (DcmDspDataInfo): DcmDspDataFixedLength=true
        DID_F12E_ECU_Software_Part_Numbers_DID_F12E_1_ECU_Software (DcmDspData): DcmDspDataSize=8, DcmDspDataType=UINT8, DcmDspDataInfoRef=DataInfo_DID_F12E_ECU_Software_Part_Numbers_DID_F12E_1_ECU_Software
        DataInfo_DID_F12E_ECU_Software_Part_Numbers_DID_F12E_1_ECU_Software (DcmDspDataInfo): DcmDspDataFixedLength=true
        DID_F12E_ECU_Software_Part_Numbers_BCD_part (DcmDspData): DcmDspDataSize=32, DcmDspDataType=UINT32, DcmDspDataInfoRef=DataInfo_DID_F12E_ECU_Software_Part_Numbers_BCD_part
        DataInfo_DID_F12E_ECU_Software_Part_Numbers_BCD_part (DcmDspDataInfo): DcmDspDataFixedLength=true
        DID_F12E_ECU_Software_Part_Numbers_ASCII_part (DcmDspData): DcmDspDataSize=24, DcmDspDataType=UINT8_N, DcmDspDataInfoRef=DataInfo_DID_F12E_ECU_Software_Part_Numbers_ASCII_part
        DataInfo_DID_F12E_ECU_Software_Part_Numbers_ASCII_part (DcmDspDataInfo): DcmDspDataFixedLength=true
        DID_F12F_ECU_Software_Extended_Part_Numbers_DID_F12F_1_Total_number_of_ECU_Software_Part_Numbers (DcmDspData):
          DcmDspDataSize = 8
          DcmDspDataType = UINT8
          DcmDspDataInfoRef = DataInfo_DID_F12F_ECU_Software_Extended_Part_Numbers_DID_F12F_1_Total_number_of_ECU_Software_Part_Numbers
        DataInfo_DID_F12F_ECU_Software_Extended_Part_Numbers_DID_F12F_1_Total_number_of_ECU_Software_Part_Numbers (DcmDspDataInfo): DcmDspDataFixedLength=true
        DID_F12F_ECU_Software_Extended_Part_Numbers_BCD_part (DcmDspData): DcmDspDataSize=32, DcmDspDataType=UINT32, DcmDspDataInfoRef=DataInfo_DID_F12F_ECU_Software_Extended_Part_Numbers_BCD_part
        DataInfo_DID_F12F_ECU_Software_Extended_Part_Numbers_BCD_part (DcmDspDataInfo): DcmDspDataFixedLength=true
        DID_F12F_ECU_Software_Extended_Part_Numbers_ASCII_part (DcmDspData): DcmDspDataSize=24, DcmDspDataType=UINT8_N, DcmDspDataInfoRef=DataInfo_DID_F12F_ECU_Software_Extended_Part_Numbers_ASCII_part
        DataInfo_DID_F12F_ECU_Software_Extended_Part_Numbers_ASCII_part (DcmDspDataInfo): DcmDspDataFixedLength=true
        DID_F12F_ECU_Software_Extended_Part_Numbers_BCD_part_001 (DcmDspData): DcmDspDataSize=32, DcmDspDataType=UINT32, DcmDspDataInfoRef=DataInfo_DID_F12F_ECU_Software_Extended_Part_Numbers_BCD_part_001
        DataInfo_DID_F12F_ECU_Software_Extended_Part_Numbers_BCD_part_001 (DcmDspDataInfo): DcmDspDataFixedLength=true
        DID_F12F_ECU_Software_Extended_Part_Numbers_ASCII_part_001 (DcmDspData): DcmDspDataSize=24, DcmDspDataType=UINT8_N, DcmDspDataInfoRef=DataInfo_DID_F12F_ECU_Software_Extended_Part_Numbers_ASCII_part_001
        DataInfo_DID_F12F_ECU_Software_Extended_Part_Numbers_ASCII_part_001 (DcmDspDataInfo): DcmDspDataFixedLength=true
        DID_F12F_ECU_Software_Extended_Part_Numbers_BCD_part_002 (DcmDspData): DcmDspDataSize=32, DcmDspDataType=UINT32, DcmDspDataInfoRef=DataInfo_DID_F12F_ECU_Software_Extended_Part_Numbers_BCD_part_002
        DataInfo_DID_F12F_ECU_Software_Extended_Part_Numbers_BCD_part_002 (DcmDspDataInfo): DcmDspDataFixedLength=true
        DID_F12F_ECU_Software_Extended_Part_Numbers_ASCII_part_002 (DcmDspData): DcmDspDataSize=24, DcmDspDataType=UINT8_N, DcmDspDataInfoRef=DataInfo_DID_F12F_ECU_Software_Extended_Part_Numbers_ASCII_part_002
        DataInfo_DID_F12F_ECU_Software_Extended_Part_Numbers_ASCII_part_002 (DcmDspDataInfo): DcmDspDataFixedLength=true
        DID_F12F_ECU_Software_Extended_Part_Numbers_BCD_part_003 (DcmDspData): DcmDspDataSize=32, DcmDspDataType=UINT32, DcmDspDataInfoRef=DataInfo_DID_F12F_ECU_Software_Extended_Part_Numbers_BCD_part_003
        DataInfo_DID_F12F_ECU_Software_Extended_Part_Numbers_BCD_part_003 (DcmDspDataInfo): DcmDspDataFixedLength=true
        DID_F12F_ECU_Software_Extended_Part_Numbers_ASCII_part_003 (DcmDspData): DcmDspDataSize=24, DcmDspDataType=UINT8_N, DcmDspDataInfoRef=DataInfo_DID_F12F_ECU_Software_Extended_Part_Numbers_ASCII_part_003
        DataInfo_DID_F12F_ECU_Software_Extended_Part_Numbers_ASCII_part_003 (DcmDspDataInfo): DcmDspDataFixedLength=true
        DID_F12F_ECU_Software_Extended_Part_Numbers_BCD_part_004 (DcmDspData): DcmDspDataSize=32, DcmDspDataType=UINT32, DcmDspDataInfoRef=DataInfo_DID_F12F_ECU_Software_Extended_Part_Numbers_BCD_part_004
        DataInfo_DID_F12F_ECU_Software_Extended_Part_Numbers_BCD_part_004 (DcmDspDataInfo): DcmDspDataFixedLength=true
        DID_F12F_ECU_Software_Extended_Part_Numbers_ASCII_part_004 (DcmDspData): DcmDspDataSize=24, DcmDspDataType=UINT8_N, DcmDspDataInfoRef=DataInfo_DID_F12F_ECU_Software_Extended_Part_Numbers_ASCII_part_004
        DataInfo_DID_F12F_ECU_Software_Extended_Part_Numbers_ASCII_part_004 (DcmDspDataInfo): DcmDspDataFixedLength=true
        DID_F12F_ECU_Software_Extended_Part_Numbers_BCD_part_005 (DcmDspData): DcmDspDataSize=32, DcmDspDataType=UINT32, DcmDspDataInfoRef=DataInfo_DID_F12F_ECU_Software_Extended_Part_Numbers_BCD_part_005
        DataInfo_DID_F12F_ECU_Software_Extended_Part_Numbers_BCD_part_005 (DcmDspDataInfo): DcmDspDataFixedLength=true
        DID_F12F_ECU_Software_Extended_Part_Numbers_ASCII_part_005 (DcmDspData): DcmDspDataSize=24, DcmDspDataType=UINT8_N, DcmDspDataInfoRef=DataInfo_DID_F12F_ECU_Software_Extended_Part_Numbers_ASCII_part_005
        DataInfo_DID_F12F_ECU_Software_Extended_Part_Numbers_ASCII_part_005 (DcmDspDataInfo): DcmDspDataFixedLength=true
        DID_F12F_ECU_Software_Extended_Part_Numbers_BCD_part_006 (DcmDspData): DcmDspDataSize=32, DcmDspDataType=UINT32, DcmDspDataInfoRef=DataInfo_DID_F12F_ECU_Software_Extended_Part_Numbers_BCD_part_006
        DataInfo_DID_F12F_ECU_Software_Extended_Part_Numbers_BCD_part_006 (DcmDspDataInfo): DcmDspDataFixedLength=true
        DID_F12F_ECU_Software_Extended_Part_Numbers_ASCII_part_006 (DcmDspData): DcmDspDataSize=24, DcmDspDataType=UINT8_N, DcmDspDataInfoRef=DataInfo_DID_F12F_ECU_Software_Extended_Part_Numbers_ASCII_part_006
        DataInfo_DID_F12F_ECU_Software_Extended_Part_Numbers_ASCII_part_006 (DcmDspDataInfo): DcmDspDataFixedLength=true
        DID_F12F_ECU_Software_Extended_Part_Numbers_BCD_part_007 (DcmDspData): DcmDspDataSize=32, DcmDspDataType=UINT32, DcmDspDataInfoRef=DataInfo_DID_F12F_ECU_Software_Extended_Part_Numbers_BCD_part_007
        DataInfo_DID_F12F_ECU_Software_Extended_Part_Numbers_BCD_part_007 (DcmDspDataInfo): DcmDspDataFixedLength=true
        DID_F12F_ECU_Software_Extended_Part_Numbers_ASCII_part_007 (DcmDspData): DcmDspDataSize=24, DcmDspDataType=UINT8_N, DcmDspDataInfoRef=DataInfo_DID_F12F_ECU_Software_Extended_Part_Numbers_ASCII_part_007
        DataInfo_DID_F12F_ECU_Software_Extended_Part_Numbers_ASCII_part_007 (DcmDspDataInfo): DcmDspDataFixedLength=true
        DID_F12F_ECU_Software_Extended_Part_Numbers_BCD_part_008 (DcmDspData): DcmDspDataSize=32, DcmDspDataType=UINT32, DcmDspDataInfoRef=DataInfo_DID_F12F_ECU_Software_Extended_Part_Numbers_BCD_part_008
        DataInfo_DID_F12F_ECU_Software_Extended_Part_Numbers_BCD_part_008 (DcmDspDataInfo): DcmDspDataFixedLength=true
        DID_F12F_ECU_Software_Extended_Part_Numbers_ASCII_part_008 (DcmDspData): DcmDspDataSize=24, DcmDspDataType=UINT8_N, DcmDspDataInfoRef=DataInfo_DID_F12F_ECU_Software_Extended_Part_Numbers_ASCII_part_008
        DataInfo_DID_F12F_ECU_Software_Extended_Part_Numbers_ASCII_part_008 (DcmDspDataInfo): DcmDspDataFixedLength=true
        DID_F12F_ECU_Software_Extended_Part_Numbers_BCD_part_009 (DcmDspData): DcmDspDataSize=32, DcmDspDataType=UINT32, DcmDspDataInfoRef=DataInfo_DID_F12F_ECU_Software_Extended_Part_Numbers_BCD_part_009
        DataInfo_DID_F12F_ECU_Software_Extended_Part_Numbers_BCD_part_009 (DcmDspDataInfo): DcmDspDataFixedLength=true
        DID_F12F_ECU_Software_Extended_Part_Numbers_ASCII_part_009 (DcmDspData): DcmDspDataSize=24, DcmDspDataType=UINT8_N, DcmDspDataInfoRef=DataInfo_DID_F12F_ECU_Software_Extended_Part_Numbers_ASCII_part_009
        DataInfo_DID_F12F_ECU_Software_Extended_Part_Numbers_ASCII_part_009 (DcmDspDataInfo): DcmDspDataFixedLength=true
        DID_F186_Active_Diagnostic_Session_DID_F186_Active_Diagnostic_Session (DcmDspData): DcmDspDataSize=8, DcmDspDataType=UINT8, DcmDspDataInfoRef=DataInfo_DID_F186_Active_Diagnostic_Session_DID_F186_Active_Diagnostic_Session
        DataInfo_DID_F186_Active_Diagnostic_Session_DID_F186_Active_Diagnostic_Session (DcmDspDataInfo): DcmDspDataFixedLength=true
        DID_F18C_ECU_Serial_Number_DID_F18C_ECU_Serial_Number (DcmDspData): DcmDspDataSize=32, DcmDspDataType=UINT32, DcmDspDataInfoRef=DataInfo_DID_F18C_ECU_Serial_Number_DID_F18C_ECU_Serial_Number
        DataInfo_DID_F18C_ECU_Serial_Number_DID_F18C_ECU_Serial_Number (DcmDspDataInfo): DcmDspDataFixedLength=true
        DID_F1A0_Application_Diagnostic_Database_Part_Number_Geely_BCD_part (DcmDspData): DcmDspDataSize=40, DcmDspDataType=UINT8_N, DcmDspDataInfoRef=DataInfo_DID_F1A0_Application_Diagnostic_Database_Part_Number_Geely_BCD_part
        DataInfo_DID_F1A0_Application_Diagnostic_Database_Part_Number_Geely_BCD_part (DcmDspDataInfo): DcmDspDataFixedLength=true
        DID_F1A0_Application_Diagnostic_Database_Part_Number_Geely_ASCII_part (DcmDspData): DcmDspDataSize=24, DcmDspDataType=UINT8_N, DcmDspDataInfoRef=DataInfo_DID_F1A0_Application_Diagnostic_Database_Part_Number_Geely_ASCII_part
        DataInfo_DID_F1A0_Application_Diagnostic_Database_Part_Number_Geely_ASCII_part (DcmDspDataInfo): DcmDspDataFixedLength=true
        DID_F1A1_Primary_Bootloader_Diagnostic_Database_Part_Number_Geely_BCD_part (DcmDspData): DcmDspDataSize=40, DcmDspDataType=UINT8_N, DcmDspDataInfoRef=DataInfo_DID_F1A1_Primary_Bootloader_Diagnostic_Database_Part_Number_Geely_BCD_part
        DataInfo_DID_F1A1_Primary_Bootloader_Diagnostic_Database_Part_Number_Geely_BCD_part (DcmDspDataInfo): DcmDspDataFixedLength=true
        DID_F1A1_Primary_Bootloader_Diagnostic_Database_Part_Number_Geely_ASCII_part (DcmDspData):
          DcmDspDataSize = 24
          DcmDspDataType = UINT8_N
          DcmDspDataInfoRef = DataInfo_DID_F1A1_Primary_Bootloader_Diagnostic_Database_Part_Number_Geely_ASCII_part
        DataInfo_DID_F1A1_Primary_Bootloader_Diagnostic_Database_Part_Number_Geely_ASCII_part (DcmDspDataInfo): DcmDspDataFixedLength=true
        DID_F1A5_Primary_Bootloader_Software_Part_Number_Geely_BCD_part (DcmDspData): DcmDspDataSize=40, DcmDspDataType=UINT8_N, DcmDspDataInfoRef=DataInfo_DID_F1A5_Primary_Bootloader_Software_Part_Number_Geely_BCD_part
        DataInfo_DID_F1A5_Primary_Bootloader_Software_Part_Number_Geely_BCD_part (DcmDspDataInfo): DcmDspDataFixedLength=true
        DID_F1A5_Primary_Bootloader_Software_Part_Number_Geely_ASCII_part (DcmDspData): DcmDspDataSize=24, DcmDspDataType=UINT8_N, DcmDspDataInfoRef=DataInfo_DID_F1A5_Primary_Bootloader_Software_Part_Number_Geely_ASCII_part
        DataInfo_DID_F1A5_Primary_Bootloader_Software_Part_Number_Geely_ASCII_part (DcmDspDataInfo): DcmDspDataFixedLength=true
        DID_F1AA_ECU_Core_Assembly_Part_Number_Geely_BCD_part (DcmDspData): DcmDspDataSize=40, DcmDspDataType=UINT8_N, DcmDspDataInfoRef=DataInfo_DID_F1AA_ECU_Core_Assembly_Part_Number_Geely_BCD_part
        DataInfo_DID_F1AA_ECU_Core_Assembly_Part_Number_Geely_BCD_part (DcmDspDataInfo): DcmDspDataFixedLength=true
        DID_F1AA_ECU_Core_Assembly_Part_Number_Geely_ASCII_part (DcmDspData): DcmDspDataSize=24, DcmDspDataType=UINT8_N, DcmDspDataInfoRef=DataInfo_DID_F1AA_ECU_Core_Assembly_Part_Number_Geely_ASCII_part
        DataInfo_DID_F1AA_ECU_Core_Assembly_Part_Number_Geely_ASCII_part (DcmDspDataInfo): DcmDspDataFixedLength=true
        DID_F1AB_ECU_Delivery_Assembly_Part_Number_Geely_BCD_part (DcmDspData): DcmDspDataSize=40, DcmDspDataType=UINT8_N, DcmDspDataInfoRef=DataInfo_DID_F1AB_ECU_Delivery_Assembly_Part_Number_Geely_BCD_part
        DataInfo_DID_F1AB_ECU_Delivery_Assembly_Part_Number_Geely_BCD_part (DcmDspDataInfo): DcmDspDataFixedLength=true
        DID_F1AB_ECU_Delivery_Assembly_Part_Number_Geely_ASCII_part (DcmDspData): DcmDspDataSize=24, DcmDspDataType=UINT8_N, DcmDspDataInfoRef=DataInfo_DID_F1AB_ECU_Delivery_Assembly_Part_Number_Geely_ASCII_part
        DataInfo_DID_F1AB_ECU_Delivery_Assembly_Part_Number_Geely_ASCII_part (DcmDspDataInfo): DcmDspDataFixedLength=true

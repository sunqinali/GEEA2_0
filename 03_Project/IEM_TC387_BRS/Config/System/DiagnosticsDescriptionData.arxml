[part 4 of 4: package /InitialEcuC]
AUTOSAR XML (schema 00045)
package /InitialEcuC  (continued)
  module config Dem: module-description=Dem_Impl  (continued)
    DemConfigSet  (continued)
      Ga_GADisengageFailure (DemEventParameter):
        DemEventKind = DEM_EVENT_KIND_SWC
        DemMaxNumberFreezeFrameRecords = 2
        DemDTCClassRef = DTCClass_Ga_GADisengageFailure
        DemExtendedDataClassRef = ExtendedDataClass_5ecd55b9
        DemFreezeFrameClassRef = FreezeFrameClass_dc4c3f47
        DemEventClass:
          DemAgingAllowed = true
          DemAgingCycleCounterThreshold = 40
          DemEventDestination = DEM_DTC_ORIGIN_PRIMARY_MEMORY
          DemEventPriority = 1
          DemEventFailureCycleCounterThreshold = 0
          DemAgingCycleRef = PowerCycle
          DemEnableConditionGroupRef = EnableConditionGroup_06a6aa19
          DemOperationCycleRef = PowerCycle
          DemDebounceAlgorithmClass
            DemDebounceCounterBased: DemDebounceCounterDecrementStepSize=128, DemDebounceCounterIncrementStepSize=127, DemDebounceCounterJumpDown=true, DemDebounceCounterJumpUp=true
          IndicatorAttribute_WarningIndicator (DemIndicatorAttribute): DemIndicatorFailureCycleSource=DEM_FAILURE_CYCLE_EVENT, DemIndicatorHealingCycleRef=PowerCycle, DemIndicatorRef=WarningIndicator
      DTCClass_Ga_FindEngleAngleFailed (DemDTCClass): DemDTCSeverity=DEM_DTC_SEV_IMMEDIATELY, DemUdsDTC=2672760
      Ga_FindEngleAngleFailed (DemEventParameter):
        DemEventKind = DEM_EVENT_KIND_SWC
        DemMaxNumberFreezeFrameRecords = 2
        DemDTCClassRef = DTCClass_Ga_FindEngleAngleFailed
        DemExtendedDataClassRef = ExtendedDataClass_5ecd55b9
        DemFreezeFrameClassRef = FreezeFrameClass_dc4c3f47
        DemEventClass:
          DemAgingAllowed = true
          DemAgingCycleCounterThreshold = 40
          DemEventDestination = DEM_DTC_ORIGIN_PRIMARY_MEMORY
          DemEventPriority = 1
          DemEventFailureCycleCounterThreshold = 0
          DemAgingCycleRef = PowerCycle
          DemEnableConditionGroupRef = EnableConditionGroup_06a6aa19
          DemOperationCycleRef = PowerCycle
          DemDebounceAlgorithmClass
            DemDebounceCounterBased: DemDebounceCounterDecrementStepSize=128, DemDebounceCounterIncrementStepSize=127, DemDebounceCounterJumpDown=true, DemDebounceCounterJumpUp=true
          IndicatorAttribute_WarningIndicator (DemIndicatorAttribute): DemIndicatorFailureCycleSource=DEM_FAILURE_CYCLE_EVENT, DemIndicatorHealingCycleRef=PowerCycle, DemIndicatorRef=WarningIndicator
      DTCClass_GA_BLDC_FLT (DemDTCClass): DemDTCSeverity=DEM_DTC_SEV_IMMEDIATELY, DemUdsDTC=2672787
      GA_BLDC_FLT (DemEventParameter):
        DemEventKind = DEM_EVENT_KIND_SWC
        DemMaxNumberFreezeFrameRecords = 2
        DemDTCClassRef = DTCClass_GA_BLDC_FLT
        DemExtendedDataClassRef = ExtendedDataClass_5ecd55b9
        DemFreezeFrameClassRef = FreezeFrameClass_dc4c3f47
        DemEventClass:
          DemAgingAllowed = true
          DemAgingCycleCounterThreshold = 40
          DemEventDestination = DEM_DTC_ORIGIN_PRIMARY_MEMORY
          DemEventPriority = 1
          DemEventFailureCycleCounterThreshold = 0
          DemAgingCycleRef = PowerCycle
          DemEnableConditionGroupRef = EnableConditionGroup_06a6aa19
          DemOperationCycleRef = PowerCycle
          DemDebounceAlgorithmClass
            DemDebounceCounterBased: DemDebounceCounterDecrementStepSize=128, DemDebounceCounterIncrementStepSize=127, DemDebounceCounterJumpDown=true, DemDebounceCounterJumpUp=true
          IndicatorAttribute_WarningIndicator (DemIndicatorAttribute): DemIndicatorFailureCycleSource=DEM_FAILURE_CYCLE_EVENT, DemIndicatorHealingCycleRef=PowerCycle, DemIndicatorRef=WarningIndicator
      DTCClass_GA_BLDC_POS_FLT (DemDTCClass): DemDTCSeverity=DEM_DTC_SEV_IMMEDIATELY, DemUdsDTC=2673665
      GA_BLDC_POS_FLT (DemEventParameter):
        DemEventKind = DEM_EVENT_KIND_SWC
        DemMaxNumberFreezeFrameRecords = 2
        DemDTCClassRef = DTCClass_GA_BLDC_POS_FLT
        DemExtendedDataClassRef = ExtendedDataClass_5ecd55b9
        DemFreezeFrameClassRef = FreezeFrameClass_dc4c3f47
        DemEventClass:
          DemAgingAllowed = true
          DemAgingCycleCounterThreshold = 40
          DemEventDestination = DEM_DTC_ORIGIN_PRIMARY_MEMORY
          DemEventPriority = 1
          DemEventFailureCycleCounterThreshold = 0
          DemAgingCycleRef = PowerCycle
          DemEnableConditionGroupRef = EnableConditionGroup_06a6aa19
          DemOperationCycleRef = PowerCycle
          DemDebounceAlgorithmClass
            DemDebounceCounterBased: DemDebounceCounterDecrementStepSize=128, DemDebounceCounterIncrementStepSize=127, DemDebounceCounterJumpDown=true, DemDebounceCounterJumpUp=true
          IndicatorAttribute_WarningIndicator (DemIndicatorAttribute): DemIndicatorFailureCycleSource=DEM_FAILURE_CYCLE_EVENT, DemIndicatorHealingCycleRef=PowerCycle, DemIndicatorRef=WarningIndicator
      DTCClass_INV_RSLVR_OFFS_DFT (DemDTCClass): DemDTCSeverity=DEM_DTC_SEV_IMMEDIATELY, DemUdsDTC=3147606
      INV_RSLVR_OFFS_DFT (DemEventParameter):
        DemEventKind = DEM_EVENT_KIND_SWC
        DemMaxNumberFreezeFrameRecords = 2
        DemDTCClassRef = DTCClass_INV_RSLVR_OFFS_DFT
        DemExtendedDataClassRef = ExtendedDataClass_5ecd55b9
        DemFreezeFrameClassRef = FreezeFrameClass_c3111450
        DemEventClass:
          DemAgingAllowed = true
          DemAgingCycleCounterThreshold = 40
          DemEventDestination = DEM_DTC_ORIGIN_PRIMARY_MEMORY
          DemEventPriority = 1
          DemEventFailureCycleCounterThreshold = 0
          DemAgingCycleRef = PowerCycle
          DemEnableConditionGroupRef = EnableConditionGroup_30df4d87
          DemOperationCycleRef = PowerCycle
          DemDebounceAlgorithmClass
            DemDebounceCounterBased: DemDebounceCounterDecrementStepSize=128, DemDebounceCounterIncrementStepSize=127, DemDebounceCounterJumpDown=true, DemDebounceCounterJumpUp=true
          IndicatorAttribute_WarningIndicator (DemIndicatorAttribute): DemIndicatorFailureCycleSource=DEM_FAILURE_CYCLE_EVENT, DemIndicatorHealingCycleRef=PowerCycle, DemIndicatorRef=WarningIndicator
      DTCClass_INV_RSLVR_OFFS_OUT_RANG (DemDTCClass): DemDTCSeverity=DEM_DTC_SEV_MAINTENANCE_ONLY, DemUdsDTC=3147653
      INV_RSLVR_OFFS_OUT_RANG (DemEventParameter):
        DemEventKind = DEM_EVENT_KIND_SWC
        DemMaxNumberFreezeFrameRecords = 2
        DemDTCClassRef = DTCClass_INV_RSLVR_OFFS_OUT_RANG
        DemExtendedDataClassRef = ExtendedDataClass_5ecd55b9
        DemFreezeFrameClassRef = FreezeFrameClass_c3111450
        DemEventClass:
          DemAgingAllowed = true
          DemAgingCycleCounterThreshold = 40
          DemEventDestination = DEM_DTC_ORIGIN_PRIMARY_MEMORY
          DemEventPriority = 1
          DemEventFailureCycleCounterThreshold = 0
          DemAgingCycleRef = PowerCycle
          DemEnableConditionGroupRef = EnableConditionGroup_830522f7
          DemOperationCycleRef = PowerCycle
          DemDebounceAlgorithmClass
            DemDebounceCounterBased: DemDebounceCounterDecrementStepSize=128, DemDebounceCounterIncrementStepSize=127, DemDebounceCounterJumpDown=true, DemDebounceCounterJumpUp=true
          IndicatorAttribute_WarningIndicator (DemIndicatorAttribute): DemIndicatorFailureCycleSource=DEM_FAILURE_CYCLE_EVENT, DemIndicatorHealingCycleRef=PowerCycle, DemIndicatorRef=WarningIndicator
      DTCClass_AURIX_RST_SNG (DemDTCClass): DemDTCSeverity=DEM_DTC_SEV_MAINTENANCE_ONLY, DemUdsDTC=5264788
      AURIX_RST_SNG (DemEventParameter):
        DemEventKind = DEM_EVENT_KIND_SWC
        DemMaxNumberFreezeFrameRecords = 2
        DemDTCClassRef = DTCClass_AURIX_RST_SNG
        DemExtendedDataClassRef = ExtendedDataClass_5ecd55b9
        DemFreezeFrameClassRef = FreezeFrameClass_c3111450
        DemEventClass:
          DemAgingAllowed = true
          DemAgingCycleCounterThreshold = 40
          DemEventDestination = DEM_DTC_ORIGIN_PRIMARY_MEMORY
          DemEventPriority = 1
          DemEventFailureCycleCounterThreshold = 0
          DemAgingCycleRef = PowerCycle
          DemEnableConditionGroupRef = EnableConditionGroup_830522f7
          DemOperationCycleRef = PowerCycle
          DemDebounceAlgorithmClass
            DemDebounceCounterBased: DemDebounceCounterDecrementStepSize=128, DemDebounceCounterIncrementStepSize=127, DemDebounceCounterJumpDown=true, DemDebounceCounterJumpUp=true
          IndicatorAttribute_WarningIndicator (DemIndicatorAttribute): DemIndicatorFailureCycleSource=DEM_FAILURE_CYCLE_EVENT, DemIndicatorHealingCycleRef=PowerCycle, DemIndicatorRef=WarningIndicator
      DTCClass_AURIX_RST_MPL (DemDTCClass): DemDTCSeverity=DEM_DTC_SEV_IMMEDIATELY, DemUdsDTC=5264790
      AURIX_RST_MPL (DemEventParameter):
        DemEventKind = DEM_EVENT_KIND_SWC
        DemMaxNumberFreezeFrameRecords = 2
        DemDTCClassRef = DTCClass_AURIX_RST_MPL
        DemExtendedDataClassRef = ExtendedDataClass_5ecd55b9
        DemFreezeFrameClassRef = FreezeFrameClass_c3111450
        DemEventClass:
          DemAgingAllowed = true
          DemAgingCycleCounterThreshold = 40
          DemEventDestination = DEM_DTC_ORIGIN_PRIMARY_MEMORY
          DemEventPriority = 1
          DemEventFailureCycleCounterThreshold = 0
          DemAgingCycleRef = PowerCycle
          DemEnableConditionGroupRef = EnableConditionGroup_0cc796ea
          DemOperationCycleRef = PowerCycle
          DemDebounceAlgorithmClass
            DemDebounceCounterBased: DemDebounceCounterDecrementStepSize=128, DemDebounceCounterIncrementStepSize=127, DemDebounceCounterJumpDown=true, DemDebounceCounterJumpUp=true
          IndicatorAttribute_WarningIndicator (DemIndicatorAttribute): DemIndicatorFailureCycleSource=DEM_FAILURE_CYCLE_EVENT, DemIndicatorHealingCycleRef=PowerCycle, DemIndicatorRef=WarningIndicator
      DTCClass_PS_P5_UC_FLT (DemDTCClass): DemDTCSeverity=DEM_DTC_SEV_IMMEDIATELY, DemUdsDTC=5281052
      PS_P5_UC_FLT (DemEventParameter):
        DemEventKind = DEM_EVENT_KIND_SWC
        DemMaxNumberFreezeFrameRecords = 2
        DemDTCClassRef = DTCClass_PS_P5_UC_FLT
        DemExtendedDataClassRef = ExtendedDataClass_5ecd55b9
        DemFreezeFrameClassRef = FreezeFrameClass_c3111450
        DemEventClass:
          DemAgingAllowed = true
          DemAgingCycleCounterThreshold = 40
          DemEventDestination = DEM_DTC_ORIGIN_PRIMARY_MEMORY
          DemEventPriority = 1
          DemEventFailureCycleCounterThreshold = 0
          DemAgingCycleRef = PowerCycle
          DemEnableConditionGroupRef = EnableConditionGroup_7ab46a93
          DemOperationCycleRef = PowerCycle
          DemDebounceAlgorithmClass
            DemDebounceCounterBased: DemDebounceCounterDecrementStepSize=128, DemDebounceCounterIncrementStepSize=127, DemDebounceCounterJumpDown=true, DemDebounceCounterJumpUp=true
          IndicatorAttribute_WarningIndicator (DemIndicatorAttribute): DemIndicatorFailureCycleSource=DEM_FAILURE_CYCLE_EVENT, DemIndicatorHealingCycleRef=PowerCycle, DemIndicatorRef=WarningIndicator
      DTCClass_PA_OpenCirc (DemDTCClass): DemDTCSeverity=DEM_DTC_SEV_IMMEDIATELY, DemUdsDTC=5282067
      PA_OpenCirc (DemEventParameter):
        DemEventKind = DEM_EVENT_KIND_SWC
        DemMaxNumberFreezeFrameRecords = 2
        DemDTCClassRef = DTCClass_PA_OpenCirc
        DemExtendedDataClassRef = ExtendedDataClass_5ecd55b9
        DemFreezeFrameClassRef = FreezeFrameClass_c3111450
        DemEventClass:
          DemAgingAllowed = true
          DemAgingCycleCounterThreshold = 40
          DemEventDestination = DEM_DTC_ORIGIN_PRIMARY_MEMORY
          DemEventPriority = 1
          DemEventFailureCycleCounterThreshold = 0
          DemAgingCycleRef = PowerCycle
          DemOperationCycleRef = PowerCycle
          DemDebounceAlgorithmClass
            DemDebounceCounterBased: DemDebounceCounterDecrementStepSize=128, DemDebounceCounterIncrementStepSize=127, DemDebounceCounterJumpDown=true, DemDebounceCounterJumpUp=true
      DTCClass_PA_ELE_FLT (DemDTCClass): DemDTCSeverity=DEM_DTC_SEV_IMMEDIATELY, DemUdsDTC=5282068
      PA_ELE_FLT (DemEventParameter):
        DemEventKind = DEM_EVENT_KIND_SWC
        DemMaxNumberFreezeFrameRecords = 2
        DemDTCClassRef = DTCClass_PA_ELE_FLT
        DemExtendedDataClassRef = ExtendedDataClass_5ecd55b9
        DemFreezeFrameClassRef = FreezeFrameClass_c3111450
        DemEventClass:
          DemAgingAllowed = true
          DemAgingCycleCounterThreshold = 40
          DemEventDestination = DEM_DTC_ORIGIN_PRIMARY_MEMORY
          DemEventPriority = 1
          DemEventFailureCycleCounterThreshold = 0
          DemAgingCycleRef = PowerCycle
          DemOperationCycleRef = PowerCycle
          DemDebounceAlgorithmClass
            DemDebounceCounterBased: DemDebounceCounterDecrementStepSize=128, DemDebounceCounterIncrementStepSize=127, DemDebounceCounterJumpDown=true, DemDebounceCounterJumpUp=true
      DTCClass_PA_OpenCirc_FLT (DemDTCClass): DemDTCSeverity=DEM_DTC_SEV_IMMEDIATELY, DemUdsDTC=5282069
      PA_OpenCirc_FLT (DemEventParameter):
        DemEventKind = DEM_EVENT_KIND_SWC
        DemMaxNumberFreezeFrameRecords = 2
        DemDTCClassRef = DTCClass_PA_OpenCirc_FLT
        DemExtendedDataClassRef = ExtendedDataClass_5ecd55b9
        DemFreezeFrameClassRef = FreezeFrameClass_c3111450
        DemEventClass:
          DemAgingAllowed = true
          DemAgingCycleCounterThreshold = 40
          DemEventDestination = DEM_DTC_ORIGIN_PRIMARY_MEMORY
          DemEventPriority = 1
          DemEventFailureCycleCounterThreshold = 0
          DemAgingCycleRef = PowerCycle
          DemOperationCycleRef = PowerCycle
          DemDebounceAlgorithmClass
            DemDebounceCounterBased: DemDebounceCounterDecrementStepSize=128, DemDebounceCounterIncrementStepSize=127, DemDebounceCounterJumpDown=true, DemDebounceCounterJumpUp=true
      DTCClass_PA_ACTION_FLT (DemDTCClass): DemDTCSeverity=DEM_DTC_SEV_IMMEDIATELY, DemUdsDTC=5283441
      PA_ACTION_FLT (DemEventParameter):
        DemEventKind = DEM_EVENT_KIND_SWC
        DemMaxNumberFreezeFrameRecords = 2
        DemDTCClassRef = DTCClass_PA_ACTION_FLT
        DemExtendedDataClassRef = ExtendedDataClass_5ecd55b9
        DemFreezeFrameClassRef = FreezeFrameClass_c3111450
        DemEventClass:
          DemAgingAllowed = true
          DemAgingCycleCounterThreshold = 40
          DemEventDestination = DEM_DTC_ORIGIN_PRIMARY_MEMORY
          DemEventPriority = 1
          DemEventFailureCycleCounterThreshold = 0
          DemAgingCycleRef = PowerCycle
          DemOperationCycleRef = PowerCycle
          DemDebounceAlgorithmClass
            DemDebounceCounterBased: DemDebounceCounterDecrementStepSize=128, DemDebounceCounterIncrementStepSize=127, DemDebounceCounterJumpDown=true, DemDebounceCounterJumpUp=true
      DTCClass_PSnsr_ELE_FLT (DemDTCClass): DemDTCSeverity=DEM_DTC_SEV_IMMEDIATELY, DemUdsDTC=5286913
      PSnsr_ELE_FLT (DemEventParameter):
        DemEventKind = DEM_EVENT_KIND_SWC
        DemMaxNumberFreezeFrameRecords = 2
        DemDTCClassRef = DTCClass_PSnsr_ELE_FLT
        DemExtendedDataClassRef = ExtendedDataClass_5ecd55b9
        DemFreezeFrameClassRef = FreezeFrameClass_c3111450
        DemEventClass:
          DemAgingAllowed = true
          DemAgingCycleCounterThreshold = 40
          DemEventDestination = DEM_DTC_ORIGIN_PRIMARY_MEMORY
          DemEventPriority = 1
          DemEventFailureCycleCounterThreshold = 0
          DemAgingCycleRef = PowerCycle
          DemOperationCycleRef = PowerCycle
          DemDebounceAlgorithmClass
            DemDebounceCounterBased: DemDebounceCounterDecrementStepSize=128, DemDebounceCounterIncrementStepSize=127, DemDebounceCounterJumpDown=true, DemDebounceCounterJumpUp=true
      DTCClass_PSnsr_RNG_NOK (DemDTCClass): DemDTCSeverity=DEM_DTC_SEV_IMMEDIATELY, DemUdsDTC=5286940
      PSnsr_RNG_NOK (DemEventParameter):
        DemEventKind = DEM_EVENT_KIND_SWC
        DemMaxNumberFreezeFrameRecords = 2
        DemDTCClassRef = DTCClass_PSnsr_RNG_NOK
        DemExtendedDataClassRef = ExtendedDataClass_5ecd55b9
        DemFreezeFrameClassRef = FreezeFrameClass_c3111450
        DemEventClass:
          DemAgingAllowed = true
          DemAgingCycleCounterThreshold = 40
          DemEventDestination = DEM_DTC_ORIGIN_PRIMARY_MEMORY
          DemEventPriority = 1
          DemEventFailureCycleCounterThreshold = 0
          DemAgingCycleRef = PowerCycle
          DemOperationCycleRef = PowerCycle
          DemDebounceAlgorithmClass
            DemDebounceCounterBased: DemDebounceCounterDecrementStepSize=128, DemDebounceCounterIncrementStepSize=127, DemDebounceCounterJumpDown=true, DemDebounceCounterJumpUp=true
      DTCClass_PSnsr_GRADT_Flt (DemDTCClass): DemDTCSeverity=DEM_DTC_SEV_IMMEDIATELY, DemUdsDTC=5286951
      PSnsr_GRADT_Flt (DemEventParameter):
        DemEventKind = DEM_EVENT_KIND_SWC
        DemMaxNumberFreezeFrameRecords = 2
        DemDTCClassRef = DTCClass_PSnsr_GRADT_Flt
        DemExtendedDataClassRef = ExtendedDataClass_5ecd55b9
        DemFreezeFrameClassRef = FreezeFrameClass_c3111450
        DemEventClass:
          DemAgingAllowed = true
          DemAgingCycleCounterThreshold = 40
          DemEventDestination = DEM_DTC_ORIGIN_PRIMARY_MEMORY
          DemEventPriority = 1
          DemEventFailureCycleCounterThreshold = 0
          DemAgingCycleRef = PowerCycle
          DemOperationCycleRef = PowerCycle
          DemDebounceAlgorithmClass
            DemDebounceCounterBased: DemDebounceCounterDecrementStepSize=128, DemDebounceCounterIncrementStepSize=127, DemDebounceCounterJumpDown=true, DemDebounceCounterJumpUp=true
      DTCClass_VCC_OverVoltage (DemDTCClass): DemDTCSeverity=DEM_DTC_SEV_IMMEDIATELY, DemUdsDTC=5290007
      VCC_OverVoltage (DemEventParameter):
        DemEventKind = DEM_EVENT_KIND_SWC
        DemMaxNumberFreezeFrameRecords = 2
        DemDTCClassRef = DTCClass_VCC_OverVoltage
        DemExtendedDataClassRef = ExtendedDataClass_5ecd55b9
        DemFreezeFrameClassRef = FreezeFrameClass_c3111450
        DemEventClass:
          DemAgingAllowed = true
          DemAgingCycleCounterThreshold = 40
          DemEventDestination = DEM_DTC_ORIGIN_PRIMARY_MEMORY
          DemEventPriority = 1
          DemEventFailureCycleCounterThreshold = 0
          DemAgingCycleRef = PowerCycle
          DemOperationCycleRef = PowerCycle
          DemDebounceAlgorithmClass
            DemDebounceCounterBased: DemDebounceCounterDecrementStepSize=128, DemDebounceCounterIncrementStepSize=127, DemDebounceCounterJumpDown=true, DemDebounceCounterJumpUp=true
      DTCClass_VCC_UnderVoltage (DemDTCClass): DemDTCSeverity=DEM_DTC_SEV_IMMEDIATELY, DemUdsDTC=5290008
      VCC_UnderVoltage (DemEventParameter):
        DemEventKind = DEM_EVENT_KIND_SWC
        DemMaxNumberFreezeFrameRecords = 2
        DemDTCClassRef = DTCClass_VCC_UnderVoltage
        DemExtendedDataClassRef = ExtendedDataClass_5ecd55b9
        DemFreezeFrameClassRef = FreezeFrameClass_c3111450
        DemEventClass:
          DemAgingAllowed = true
          DemAgingCycleCounterThreshold = 40
          DemEventDestination = DEM_DTC_ORIGIN_PRIMARY_MEMORY
          DemEventPriority = 1
          DemEventFailureCycleCounterThreshold = 0
          DemAgingCycleRef = PowerCycle
          DemOperationCycleRef = PowerCycle
          DemDebounceAlgorithmClass
            DemDebounceCounterBased: DemDebounceCounterDecrementStepSize=128, DemDebounceCounterIncrementStepSize=127, DemDebounceCounterJumpDown=true, DemDebounceCounterJumpUp=true
      DTCClass_PLOCK_Current_RNG_OUT (DemDTCClass): DemDTCSeverity=DEM_DTC_SEV_IMMEDIATELY, DemUdsDTC=5290009
      PLOCK_Current_RNG_OUT (DemEventParameter):
        DemEventKind = DEM_EVENT_KIND_SWC
        DemMaxNumberFreezeFrameRecords = 2
        DemDTCClassRef = DTCClass_PLOCK_Current_RNG_OUT
        DemExtendedDataClassRef = ExtendedDataClass_5ecd55b9
        DemFreezeFrameClassRef = FreezeFrameClass_c3111450
        DemEventClass:
          DemAgingAllowed = true
          DemAgingCycleCounterThreshold = 40
          DemEventDestination = DEM_DTC_ORIGIN_PRIMARY_MEMORY
          DemEventPriority = 1
          DemEventFailureCycleCounterThreshold = 0
          DemAgingCycleRef = PowerCycle
          DemOperationCycleRef = PowerCycle
          DemDebounceAlgorithmClass
            DemDebounceCounterBased: DemDebounceCounterDecrementStepSize=128, DemDebounceCounterIncrementStepSize=127, DemDebounceCounterJumpDown=true, DemDebounceCounterJumpUp=true
      DTCClass_PS_WhlSnsr_Vltg_FLT (DemDTCClass): DemDTCSeverity=DEM_DTC_SEV_IMMEDIATELY, DemUdsDTC=5935132
      PS_WhlSnsr_Vltg_FLT (DemEventParameter):
        DemEventKind = DEM_EVENT_KIND_SWC
        DemMaxNumberFreezeFrameRecords = 2
        DemDTCClassRef = DTCClass_PS_WhlSnsr_Vltg_FLT
        DemExtendedDataClassRef = ExtendedDataClass_5ecd55b9
        DemFreezeFrameClassRef = FreezeFrameClass_dc4c3f47
        DemEventClass:
          DemAgingAllowed = true
          DemAgingCycleCounterThreshold = 40
          DemEventDestination = DEM_DTC_ORIGIN_PRIMARY_MEMORY
          DemEventPriority = 1
          DemEventFailureCycleCounterThreshold = 0
          DemAgingCycleRef = PowerCycle
          DemEnableConditionGroupRef = EnableConditionGroup_06a6aa19
          DemOperationCycleRef = PowerCycle
          DemDebounceAlgorithmClass
            DemDebounceCounterBased: DemDebounceCounterDecrementStepSize=128, DemDebounceCounterIncrementStepSize=127, DemDebounceCounterJumpDown=true, DemDebounceCounterJumpUp=true
          IndicatorAttribute_WarningIndicator (DemIndicatorAttribute): DemIndicatorFailureCycleSource=DEM_FAILURE_CYCLE_EVENT, DemIndicatorHealingCycleRef=PowerCycle, DemIndicatorRef=WarningIndicator
      DTCClass_VcEvMonISAR (DemDTCClass): DemDTCSeverity=DEM_DTC_SEV_IMMEDIATELY, DemUdsDTC=9848320
      VcEvMonISAR (DemEventParameter):
        DemEventKind = DEM_EVENT_KIND_SWC
        DemMaxNumberFreezeFrameRecords = 2
        DemDTCClassRef = DTCClass_VcEvMonISAR
        DemExtendedDataClassRef = ExtendedDataClass_5ecd55b9
        DemFreezeFrameClassRef = FreezeFrameClass_c3111450
        DemEventClass:
          DemAgingAllowed = true
          DemAgingCycleCounterThreshold = 40
          DemEventDestination = DEM_DTC_ORIGIN_PRIMARY_MEMORY
          DemEventPriority = 1
          DemEventFailureCycleCounterThreshold = 0
          DemAgingCycleRef = PowerCycle
          DemOperationCycleRef = PowerCycle
          DemDebounceAlgorithmClass
            DemDebounceCounterBased: DemDebounceCounterDecrementStepSize=128, DemDebounceCounterIncrementStepSize=127, DemDebounceCounterJumpDown=true, DemDebounceCounterJumpUp=true
          IndicatorAttribute_WarningIndicator (DemIndicatorAttribute): DemIndicatorFailureCycleSource=DEM_FAILURE_CYCLE_EVENT, DemIndicatorHealingCycleRef=PowerCycle, DemIndicatorRef=WarningIndicator
      DTCClass_AURIX_EEPROM_FLT (DemDTCClass): DemDTCSeverity=DEM_DTC_SEV_IMMEDIATELY, DemUdsDTC=9849088
      AURIX_EEPROM_FLT (DemEventParameter):
        DemEventKind = DEM_EVENT_KIND_SWC
        DemMaxNumberFreezeFrameRecords = 2
        DemDTCClassRef = DTCClass_AURIX_EEPROM_FLT
        DemExtendedDataClassRef = ExtendedDataClass_5ecd55b9
        DemFreezeFrameClassRef = FreezeFrameClass_c3111450
        DemEventClass:
          DemAgingAllowed = true
          DemAgingCycleCounterThreshold = 40
          DemEventDestination = DEM_DTC_ORIGIN_PRIMARY_MEMORY
          DemEventPriority = 1
          DemEventFailureCycleCounterThreshold = 0
          DemAgingCycleRef = PowerCycle
          DemEnableConditionGroupRef = EnableConditionGroup_c56dc4a6
          DemOperationCycleRef = PowerCycle
          DemDebounceAlgorithmClass
            DemDebounceCounterBased: DemDebounceCounterDecrementStepSize=128, DemDebounceCounterIncrementStepSize=127, DemDebounceCounterJumpDown=true, DemDebounceCounterJumpUp=true
          IndicatorAttribute_WarningIndicator (DemIndicatorAttribute): DemIndicatorFailureCycleSource=DEM_FAILURE_CYCLE_EVENT, DemIndicatorHealingCycleRef=PowerCycle, DemIndicatorRef=WarningIndicator
      DTCClass_EXT_UC_SPI_FLT (DemDTCClass): DemDTCSeverity=DEM_DTC_SEV_IMMEDIATELY, DemUdsDTC=9849600
      EXT_UC_SPI_FLT (DemEventParameter):
        DemEventKind = DEM_EVENT_KIND_SWC
        DemMaxNumberFreezeFrameRecords = 2
        DemDTCClassRef = DTCClass_EXT_UC_SPI_FLT
        DemExtendedDataClassRef = ExtendedDataClass_5ecd55b9
        DemFreezeFrameClassRef = FreezeFrameClass_c3111450
        DemEventClass:
          DemAgingAllowed = true
          DemAgingCycleCounterThreshold = 40
          DemEventDestination = DEM_DTC_ORIGIN_PRIMARY_MEMORY
          DemEventPriority = 1
          DemEventFailureCycleCounterThreshold = 0
          DemAgingCycleRef = PowerCycle
          DemEnableConditionGroupRef = EnableConditionGroup_5ab64ab8
          DemOperationCycleRef = PowerCycle
          DemDebounceAlgorithmClass
            DemDebounceCounterBased: DemDebounceCounterDecrementStepSize=128, DemDebounceCounterIncrementStepSize=127, DemDebounceCounterJumpDown=true, DemDebounceCounterJumpUp=true
          IndicatorAttribute_WarningIndicator (DemIndicatorAttribute): DemIndicatorFailureCycleSource=DEM_FAILURE_CYCLE_EVENT, DemIndicatorHealingCycleRef=PowerCycle, DemIndicatorRef=WarningIndicator
      DTCClass_AURIX_HW_FLT (DemDTCClass): DemDTCSeverity=DEM_DTC_SEV_IMMEDIATELY, DemUdsDTC=9849856
      AURIX_HW_FLT (DemEventParameter):
        DemEventKind = DEM_EVENT_KIND_SWC
        DemMaxNumberFreezeFrameRecords = 2
        DemDTCClassRef = DTCClass_AURIX_HW_FLT
        DemExtendedDataClassRef = ExtendedDataClass_5ecd55b9
        DemFreezeFrameClassRef = FreezeFrameClass_c3111450
        DemEventClass:
          DemAgingAllowed = true
          DemAgingCycleCounterThreshold = 40
          DemEventDestination = DEM_DTC_ORIGIN_PRIMARY_MEMORY
          DemEventPriority = 1
          DemEventFailureCycleCounterThreshold = 0
          DemAgingCycleRef = PowerCycle
          DemEnableConditionGroupRef = EnableConditionGroup_f496e085
          DemOperationCycleRef = PowerCycle
          DemDebounceAlgorithmClass
            DemDebounceCounterBased: DemDebounceCounterDecrementStepSize=128, DemDebounceCounterIncrementStepSize=127, DemDebounceCounterJumpDown=true, DemDebounceCounterJumpUp=true
          IndicatorAttribute_WarningIndicator (DemIndicatorAttribute): DemIndicatorFailureCycleSource=DEM_FAILURE_CYCLE_EVENT, DemIndicatorHealingCycleRef=PowerCycle, DemIndicatorRef=WarningIndicator
      DTCClass_PS_5V_Fault (DemDTCClass): DemDTCSeverity=DEM_DTC_SEV_IMMEDIATELY, DemUdsDTC=9850368
      PS_5V_Fault (DemEventParameter):
        DemEventKind = DEM_EVENT_KIND_SWC
        DemMaxNumberFreezeFrameRecords = 2
        DemDTCClassRef = DTCClass_PS_5V_Fault
        DemExtendedDataClassRef = ExtendedDataClass_5ecd55b9
        DemFreezeFrameClassRef = FreezeFrameClass_c3111450
        DemCallbackInitMForE
        DemEventClass:
          DemAgingAllowed = true
          DemAgingCycleCounterThreshold = 40
          DemEventDestination = DEM_DTC_ORIGIN_PRIMARY_MEMORY
          DemEventPriority = 1
          DemEventFailureCycleCounterThreshold = 0
          DemAgingCycleRef = PowerCycle
          DemEnableConditionGroupRef = EnableConditionGroup_7ab46a93
          DemOperationCycleRef = PowerCycle
          DemDebounceAlgorithmClass
            DemDebounceCounterBased: DemDebounceCounterDecrementStepSize=128, DemDebounceCounterIncrementStepSize=127, DemDebounceCounterJumpDown=true, DemDebounceCounterJumpUp=true
          IndicatorAttribute_WarningIndicator (DemIndicatorAttribute): DemIndicatorFailureCycleSource=DEM_FAILURE_CYCLE_EVENT, DemIndicatorHealingCycleRef=PowerCycle, DemIndicatorRef=WarningIndicator
      DTCClass_CRASH_DTC (DemDTCClass): DemDTCSeverity=DEM_DTC_SEV_IMMEDIATELY, DemUdsDTC=9851392
      CRASH_DTC (DemEventParameter):
        DemEventKind = DEM_EVENT_KIND_SWC
        DemMaxNumberFreezeFrameRecords = 2
        DemDTCClassRef = DTCClass_CRASH_DTC
        DemExtendedDataClassRef = ExtendedDataClass_5ecd55b9
        DemFreezeFrameClassRef = FreezeFrameClass_c3111450
        DemEventClass:
          DemAgingAllowed = true
          DemAgingCycleCounterThreshold = 40
          DemEventDestination = DEM_DTC_ORIGIN_PRIMARY_MEMORY
          DemEventPriority = 1
          DemEventFailureCycleCounterThreshold = 0
          DemAgingCycleRef = PowerCycle
          DemEnableConditionGroupRef = EnableConditionGroup_7ab46a93
          DemOperationCycleRef = PowerCycle
          DemDebounceAlgorithmClass
            DemDebounceCounterBased: DemDebounceCounterDecrementStepSize=128, DemDebounceCounterIncrementStepSize=127, DemDebounceCounterJumpDown=true, DemDebounceCounterJumpUp=true
          IndicatorAttribute_WarningIndicator (DemIndicatorAttribute): DemIndicatorFailureCycleSource=DEM_FAILURE_CYCLE_EVENT, DemIndicatorHealingCycleRef=PowerCycle, DemIndicatorRef=WarningIndicator
      DTCClass_INV_INTERLOCK_FLT (DemDTCClass): DemDTCSeverity=DEM_DTC_SEV_MAINTENANCE_ONLY, DemUdsDTC=9867924
      INV_INTERLOCK_FLT (DemEventParameter):
        DemEventKind = DEM_EVENT_KIND_SWC
        DemMaxNumberFreezeFrameRecords = 2
        DemDTCClassRef = DTCClass_INV_INTERLOCK_FLT
        DemExtendedDataClassRef = ExtendedDataClass_5ecd55b9
        DemFreezeFrameClassRef = FreezeFrameClass_c3111450
        DemEventClass:
          DemAgingAllowed = true
          DemAgingCycleCounterThreshold = 40
          DemEventDestination = DEM_DTC_ORIGIN_PRIMARY_MEMORY
          DemEventPriority = 1
          DemEventFailureCycleCounterThreshold = 0
          DemAgingCycleRef = PowerCycle
          DemEnableConditionGroupRef = EnableConditionGroup_7ab46a93
          DemOperationCycleRef = PowerCycle
          DemDebounceAlgorithmClass
            DemDebounceCounterBased: DemDebounceCounterDecrementStepSize=128, DemDebounceCounterIncrementStepSize=127, DemDebounceCounterJumpDown=true, DemDebounceCounterJumpUp=true
          IndicatorAttribute_WarningIndicator (DemIndicatorAttribute): DemIndicatorFailureCycleSource=DEM_FAILURE_CYCLE_EVENT, DemIndicatorHealingCycleRef=PowerCycle, DemIndicatorRef=WarningIndicator
      DTCClass_Eg_HallVolWrong (DemDTCClass): DemDTCSeverity=DEM_DTC_SEV_IMMEDIATELY, DemUdsDTC=9876626
      Eg_HallVolWrong (DemEventParameter):
        DemEventKind = DEM_EVENT_KIND_SWC
        DemMaxNumberFreezeFrameRecords = 2
        DemDTCClassRef = DTCClass_Eg_HallVolWrong
        DemExtendedDataClassRef = ExtendedDataClass_5ecd55b9
        DemFreezeFrameClassRef = FreezeFrameClass_dc4c3f47
        DemEventClass:
          DemAgingAllowed = true
          DemAgingCycleCounterThreshold = 40
          DemEventDestination = DEM_DTC_ORIGIN_PRIMARY_MEMORY
          DemEventPriority = 1
          DemEventFailureCycleCounterThreshold = 0
          DemAgingCycleRef = PowerCycle
          DemEnableConditionGroupRef = EnableConditionGroup_06a6aa19
          DemOperationCycleRef = PowerCycle
          DemDebounceAlgorithmClass
            DemDebounceCounterBased: DemDebounceCounterDecrementStepSize=128, DemDebounceCounterIncrementStepSize=127, DemDebounceCounterJumpDown=true, DemDebounceCounterJumpUp=true
          IndicatorAttribute_WarningIndicator (DemIndicatorAttribute): DemIndicatorFailureCycleSource=DEM_FAILURE_CYCLE_EVENT, DemIndicatorHealingCycleRef=PowerCycle, DemIndicatorRef=WarningIndicator
      DTCClass_INV_SHUT_OFF_PAH_START_UP (DemDTCClass): DemDTCSeverity=DEM_DTC_SEV_IMMEDIATELY, DemUdsDTC=10491282
      INV_SHUT_OFF_PAH_START_UP (DemEventParameter):
        DemEventKind = DEM_EVENT_KIND_SWC
        DemMaxNumberFreezeFrameRecords = 2
        DemDTCClassRef = DTCClass_INV_SHUT_OFF_PAH_START_UP
        DemExtendedDataClassRef = ExtendedDataClass_5ecd55b9
        DemFreezeFrameClassRef = FreezeFrameClass_c3111450
        DemEventClass:
          DemAgingAllowed = true
          DemAgingCycleCounterThreshold = 40
          DemEventDestination = DEM_DTC_ORIGIN_PRIMARY_MEMORY
          DemEventPriority = 1
          DemEventFailureCycleCounterThreshold = 0
          DemAgingCycleRef = PowerCycle
          DemEnableConditionGroupRef = EnableConditionGroup_1027fc3a
          DemOperationCycleRef = PowerCycle
          DemDebounceAlgorithmClass
            DemDebounceCounterBased: DemDebounceCounterDecrementStepSize=128, DemDebounceCounterIncrementStepSize=127, DemDebounceCounterJumpDown=true, DemDebounceCounterJumpUp=true
          IndicatorAttribute_WarningIndicator (DemIndicatorAttribute): DemIndicatorFailureCycleSource=DEM_FAILURE_CYCLE_EVENT, DemIndicatorHealingCycleRef=PowerCycle, DemIndicatorRef=WarningIndicator
      DTCClass_PS_KL15_RNG_HI (DemDTCClass): DemDTCSeverity=DEM_DTC_SEV_MAINTENANCE_ONLY, DemUdsDTC=10491555
      PS_KL15_RNG_HI (DemEventParameter):
        DemEventKind = DEM_EVENT_KIND_SWC
        DemMaxNumberFreezeFrameRecords = 2
        DemDTCClassRef = DTCClass_PS_KL15_RNG_HI
        DemExtendedDataClassRef = ExtendedDataClass_5ecd55b9
        DemFreezeFrameClassRef = FreezeFrameClass_c3111450
        DemEventClass:
          DemAgingAllowed = true
          DemAgingCycleCounterThreshold = 40
          DemEventDestination = DEM_DTC_ORIGIN_PRIMARY_MEMORY
          DemEventPriority = 2
          DemEventFailureCycleCounterThreshold = 0
          DemAgingCycleRef = PowerCycle
          DemEnableConditionGroupRef = EnableConditionGroup_830522f7
          DemOperationCycleRef = PowerCycle
          DemDebounceAlgorithmClass
            DemDebounceCounterBased: DemDebounceCounterDecrementStepSize=128, DemDebounceCounterIncrementStepSize=127, DemDebounceCounterJumpDown=true, DemDebounceCounterJumpUp=true
          IndicatorAttribute_WarningIndicator (DemIndicatorAttribute): DemIndicatorFailureCycleSource=DEM_FAILURE_CYCLE_EVENT, DemIndicatorHealingCycleRef=PowerCycle, DemIndicatorRef=WarningIndicator
      DTCClass_VcEvNodeMisECM (DemDTCClass): DemDTCSeverity=DEM_DTC_SEV_IMMEDIATELY, DemUdsDTC=12648448
      VcEvNodeMisECM (DemEventParameter):
        DemEventKind = DEM_EVENT_KIND_SWC
        DemMaxNumberFreezeFrameRecords = 2
        DemDTCClassRef = DTCClass_VcEvNodeMisECM
        DemExtendedDataClassRef = ExtendedDataClass_5ecd55b9
        DemFreezeFrameClassRef = FreezeFrameClass_c3111450
        DemEventClass:
          DemAgingAllowed = true
          DemAgingCycleCounterThreshold = 40
          DemEventDestination = DEM_DTC_ORIGIN_PRIMARY_MEMORY
          DemEventPriority = 1
          DemEventFailureCycleCounterThreshold = 0
          DemAgingCycleRef = PowerCycle
          DemEnableConditionGroupRef = EnableConditionGroup_6f8868bd
          DemOperationCycleRef = PowerCycle
          DemDebounceAlgorithmClass
            DemDebounceCounterBased: DemDebounceCounterDecrementStepSize=128, DemDebounceCounterIncrementStepSize=127, DemDebounceCounterJumpDown=true, DemDebounceCounterJumpUp=true
          IndicatorAttribute_WarningIndicator (DemIndicatorAttribute): DemIndicatorFailureCycleSource=DEM_FAILURE_CYCLE_EVENT, DemIndicatorHealingCycleRef=PowerCycle, DemIndicatorRef=WarningIndicator
      DTCClass_VcEvNodeMisBECM (DemDTCClass): DemDTCSeverity=DEM_DTC_SEV_IMMEDIATELY, DemUdsDTC=12652800
      VcEvNodeMisBECM (DemEventParameter):
        DemEventKind = DEM_EVENT_KIND_SWC
        DemMaxNumberFreezeFrameRecords = 2
        DemDTCClassRef = DTCClass_VcEvNodeMisBECM
        DemExtendedDataClassRef = ExtendedDataClass_5ecd55b9
        DemFreezeFrameClassRef = FreezeFrameClass_c3111450
        DemEventClass:
          DemAgingAllowed = true
          DemAgingCycleCounterThreshold = 40
          DemEventDestination = DEM_DTC_ORIGIN_PRIMARY_MEMORY
          DemEventPriority = 1
          DemEventFailureCycleCounterThreshold = 0
          DemAgingCycleRef = PowerCycle
          DemEnableConditionGroupRef = EnableConditionGroup_6f8868bd
          DemOperationCycleRef = PowerCycle
          DemDebounceAlgorithmClass
            DemDebounceCounterBased: DemDebounceCounterDecrementStepSize=128, DemDebounceCounterIncrementStepSize=127, DemDebounceCounterJumpDown=true, DemDebounceCounterJumpUp=true
          IndicatorAttribute_WarningIndicator (DemIndicatorAttribute): DemIndicatorFailureCycleSource=DEM_FAILURE_CYCLE_EVENT, DemIndicatorHealingCycleRef=PowerCycle, DemIndicatorRef=WarningIndicator
      DTCClass_VcEvNodeMisVDDM (DemDTCClass): DemDTCSeverity=DEM_DTC_SEV_IMMEDIATELY, DemUdsDTC=12659200
      VcEvNodeMisVDDM (DemEventParameter):
        DemEventKind = DEM_EVENT_KIND_SWC
        DemMaxNumberFreezeFrameRecords = 2
        DemDTCClassRef = DTCClass_VcEvNodeMisVDDM
        DemExtendedDataClassRef = ExtendedDataClass_5ecd55b9
        DemFreezeFrameClassRef = FreezeFrameClass_c3111450
        DemEventClass:
          DemAgingAllowed = true
          DemAgingCycleCounterThreshold = 40
          DemEventDestination = DEM_DTC_ORIGIN_PRIMARY_MEMORY
          DemEventPriority = 1
          DemEventFailureCycleCounterThreshold = 0
          DemAgingCycleRef = PowerCycle
          DemEnableConditionGroupRef = EnableConditionGroup_6f8868bd
          DemOperationCycleRef = PowerCycle
          DemDebounceAlgorithmClass
            DemDebounceCounterBased: DemDebounceCounterDecrementStepSize=128, DemDebounceCounterIncrementStepSize=127, DemDebounceCounterJumpDown=true, DemDebounceCounterJumpUp=true
          IndicatorAttribute_WarningIndicator (DemIndicatorAttribute): DemIndicatorFailureCycleSource=DEM_FAILURE_CYCLE_EVENT, DemIndicatorHealingCycleRef=PowerCycle, DemIndicatorRef=WarningIndicator
      DTCClass_VCEvSrsPropFr02Tioutd (DemDTCClass): DemDTCSeverity=DEM_DTC_SEV_MAINTENANCE_ONLY, DemUdsDTC=12669184
      VCEvSrsPropFr02Tioutd (DemEventParameter):
        DemEventKind = DEM_EVENT_KIND_SWC
        DemMaxNumberFreezeFrameRecords = 2
        DemDTCClassRef = DTCClass_VCEvSrsPropFr02Tioutd
        DemExtendedDataClassRef = ExtendedDataClass_5ecd55b9
        DemFreezeFrameClassRef = FreezeFrameClass_c3111450
        DemEventClass:
          DemAgingAllowed = true
          DemAgingCycleCounterThreshold = 40
          DemEventDestination = DEM_DTC_ORIGIN_PRIMARY_MEMORY
          DemEventPriority = 1
          DemEventFailureCycleCounterThreshold = 0
          DemAgingCycleRef = PowerCycle
          DemEnableConditionGroupRef = EnableConditionGroup_6f8868bd
          DemOperationCycleRef = PowerCycle
          DemDebounceAlgorithmClass
            DemDebounceCounterBased: DemDebounceCounterDecrementStepSize=128, DemDebounceCounterIncrementStepSize=127, DemDebounceCounterJumpDown=true, DemDebounceCounterJumpUp=true
          IndicatorAttribute_WarningIndicator (DemIndicatorAttribute): DemIndicatorFailureCycleSource=DEM_FAILURE_CYCLE_EVENT, DemIndicatorHealingCycleRef=PowerCycle, DemIndicatorRef=WarningIndicator
      DTCClass_VcEvPropCANGlbTiOutd (DemDTCClass): DemDTCSeverity=DEM_DTC_SEV_IMMEDIATELY, DemUdsDTC=13633671
      VcEvPropCANGlbTiOutd (DemEventParameter):
        DemEventKind = DEM_EVENT_KIND_SWC
        DemMaxNumberFreezeFrameRecords = 2
        DemDTCClassRef = DTCClass_VcEvPropCANGlbTiOutd
        DemExtendedDataClassRef = ExtendedDataClass_5ecd55b9
        DemFreezeFrameClassRef = FreezeFrameClass_c3111450
        DemEventClass:
          DemAgingAllowed = true
          DemAgingCycleCounterThreshold = 40
          DemEventDestination = DEM_DTC_ORIGIN_PRIMARY_MEMORY
          DemEventPriority = 1
          DemEventFailureCycleCounterThreshold = 0
          DemAgingCycleRef = PowerCycle
          DemEnableConditionGroupRef = EnableConditionGroup_06a6aa19
          DemOperationCycleRef = PowerCycle
          DemDebounceAlgorithmClass
            DemDebounceCounterBased: DemDebounceCounterDecrementStepSize=128, DemDebounceCounterIncrementStepSize=127, DemDebounceCounterJumpDown=true, DemDebounceCounterJumpUp=true
          IndicatorAttribute_WarningIndicator (DemIndicatorAttribute): DemIndicatorFailureCycleSource=DEM_FAILURE_CYCLE_EVENT, DemIndicatorHealingCycleRef=PowerCycle, DemIndicatorRef=WarningIndicator
      DTCClass_INV_QUIESCENT_FLT (DemDTCClass): DemDTCSeverity=DEM_DTC_SEV_MAINTENANCE_ONLY, DemUdsDTC=13640296
      INV_QUIESCENT_FLT (DemEventParameter):
        DemEventKind = DEM_EVENT_KIND_SWC
        DemMaxNumberFreezeFrameRecords = 2
        DemDTCClassRef = DTCClass_INV_QUIESCENT_FLT
        DemExtendedDataClassRef = ExtendedDataClass_5ecd55b9
        DemFreezeFrameClassRef = FreezeFrameClass_c3111450
        DemEventClass:
          DemAgingAllowed = true
          DemAgingCycleCounterThreshold = 40
          DemEventDestination = DEM_DTC_ORIGIN_PRIMARY_MEMORY
          DemEventPriority = 2
          DemEventFailureCycleCounterThreshold = 0
          DemAgingCycleRef = PowerCycle
          DemEnableConditionGroupRef = EnableConditionGroup_f496e085
          DemOperationCycleRef = PowerCycle
          DemDebounceAlgorithmClass
            DemDebounceCounterBased: DemDebounceCounterDecrementStepSize=128, DemDebounceCounterIncrementStepSize=127, DemDebounceCounterJumpDown=true, DemDebounceCounterJumpUp=true
      DTCClass_INV_IMMO_NOKEY (DemDTCClass): DemDTCSeverity=DEM_DTC_SEV_MAINTENANCE_ONLY, DemUdsDTC=13676881
      INV_IMMO_NOKEY (DemEventParameter):
        DemEventKind = DEM_EVENT_KIND_SWC
        DemMaxNumberFreezeFrameRecords = 2
        DemDTCClassRef = DTCClass_INV_IMMO_NOKEY
        DemExtendedDataClassRef = ExtendedDataClass_5ecd55b9
        DemFreezeFrameClassRef = FreezeFrameClass_c3111450
        DemEventClass:
          DemAgingAllowed = true
          DemAgingCycleCounterThreshold = 40
          DemEventDestination = DEM_DTC_ORIGIN_PRIMARY_MEMORY
          DemEventPriority = 2
          DemEventFailureCycleCounterThreshold = 0
          DemAgingCycleRef = PowerCycle
          DemEnableConditionGroupRef = EnableConditionGroup_f496e085
          DemOperationCycleRef = PowerCycle
          DemDebounceAlgorithmClass
            DemDebounceCounterBased: DemDebounceCounterDecrementStepSize=128, DemDebounceCounterIncrementStepSize=127, DemDebounceCounterJumpDown=true, DemDebounceCounterJumpUp=true
          IndicatorAttribute_WarningIndicator (DemIndicatorAttribute): DemIndicatorFailureCycleSource=DEM_FAILURE_CYCLE_EVENT, DemIndicatorHealingCycleRef=PowerCycle, DemIndicatorRef=WarningIndicator
      DTCClass_VcEvCntr (DemDTCClass): DemDTCSeverity=DEM_DTC_SEV_MAINTENANCE_ONLY, DemUdsDTC=13916034
      VcEvCntr (DemEventParameter):
        DemEventKind = DEM_EVENT_KIND_SWC
        DemMaxNumberFreezeFrameRecords = 2
        DemDTCClassRef = DTCClass_VcEvCntr
        DemExtendedDataClassRef = ExtendedDataClass_5ecd55b9
        DemFreezeFrameClassRef = FreezeFrameClass_c3111450
        DemEventClass:
          DemAgingAllowed = true
          DemAgingCycleCounterThreshold = 40
          DemEventDestination = DEM_DTC_ORIGIN_PRIMARY_MEMORY
          DemEventPriority = 1
          DemEventFailureCycleCounterThreshold = 0
          DemAgingCycleRef = PowerCycle
          DemEnableConditionGroupRef = EnableConditionGroup_06a6aa19
          DemOperationCycleRef = PowerCycle
          DemDebounceAlgorithmClass
            DemDebounceCounterBased: DemDebounceCounterDecrementStepSize=128, DemDebounceCounterIncrementStepSize=127, DemDebounceCounterJumpDown=true, DemDebounceCounterJumpUp=true
          IndicatorAttribute_WarningIndicator (DemIndicatorAttribute): DemIndicatorFailureCycleSource=DEM_FAILURE_CYCLE_EVENT, DemIndicatorHealingCycleRef=PowerCycle, DemIndicatorRef=WarningIndicator
      DTCClass_VcEvChkSum (DemDTCClass): DemDTCSeverity=DEM_DTC_SEV_MAINTENANCE_ONLY, DemUdsDTC=13916035
      VcEvChkSum (DemEventParameter):
        DemEventKind = DEM_EVENT_KIND_SWC
        DemMaxNumberFreezeFrameRecords = 2
        DemDTCClassRef = DTCClass_VcEvChkSum
        DemExtendedDataClassRef = ExtendedDataClass_5ecd55b9
        DemFreezeFrameClassRef = FreezeFrameClass_c3111450
        DemEventClass:
          DemAgingAllowed = true
          DemAgingCycleCounterThreshold = 40
          DemEventDestination = DEM_DTC_ORIGIN_PRIMARY_MEMORY
          DemEventPriority = 1
          DemEventFailureCycleCounterThreshold = 0
          DemAgingCycleRef = PowerCycle
          DemEnableConditionGroupRef = EnableConditionGroup_06a6aa19
          DemOperationCycleRef = PowerCycle
          DemDebounceAlgorithmClass
            DemDebounceCounterBased: DemDebounceCounterDecrementStepSize=128, DemDebounceCounterIncrementStepSize=127, DemDebounceCounterJumpDown=true, DemDebounceCounterJumpUp=true
          IndicatorAttribute_WarningIndicator (DemIndicatorAttribute): DemIndicatorFailureCycleSource=DEM_FAILURE_CYCLE_EVENT, DemIndicatorHealingCycleRef=PowerCycle, DemIndicatorRef=WarningIndicator
      DTCClass_COM_Busoff (DemDTCClass): DemDTCSeverity=DEM_DTC_SEV_IMMEDIATELY, DemUdsDTC=14435720
      COM_Busoff (DemEventParameter):
        DemEventKind = DEM_EVENT_KIND_SWC
        DemMaxNumberFreezeFrameRecords = 2
        DemDTCClassRef = DTCClass_COM_Busoff
        DemExtendedDataClassRef = ExtendedDataClass_5ecd55b9
        DemFreezeFrameClassRef = FreezeFrameClass_c3111450
        DemEventClass:
          DemAgingAllowed = true
          DemAgingCycleCounterThreshold = 1
          DemEventDestination = DEM_DTC_ORIGIN_PRIMARY_MEMORY
          DemEventPriority = 1
          DemEventFailureCycleCounterThreshold = 0
          DemAgingCycleRef = PowerCycle
          DemEnableConditionGroupRef = EnableConditionGroup_377893c9
          DemOperationCycleRef = PowerCycle
          DemDebounceAlgorithmClass
            DemDebounceCounterBased: DemDebounceCounterDecrementStepSize=128, DemDebounceCounterIncrementStepSize=127, DemDebounceCounterJumpDown=true, DemDebounceCounterJumpUp=true
          IndicatorAttribute_WarningIndicator (DemIndicatorAttribute): DemIndicatorFailureCycleSource=DEM_FAILURE_CYCLE_EVENT, DemIndicatorHealingCycleRef=PowerCycle, DemIndicatorRef=WarningIndicator
      DTCClass_VcEvTsttrPlaus (DemDTCClass): DemDTCSeverity=DEM_DTC_SEV_MAINTENANCE_ONLY, DemUdsDTC=14680164
      VcEvTsttrPlaus (DemEventParameter):
        DemEventKind = DEM_EVENT_KIND_SWC
        DemMaxNumberFreezeFrameRecords = 2
        DemDTCClassRef = DTCClass_VcEvTsttrPlaus
        DemExtendedDataClassRef = ExtendedDataClass_5ecd55b9
        DemFreezeFrameClassRef = FreezeFrameClass_c3111450
        DemEventClass:
          DemAgingAllowed = true
          DemAgingCycleCounterThreshold = 40
          DemEventDestination = DEM_DTC_ORIGIN_PRIMARY_MEMORY
          DemEventPriority = 2
          DemEventFailureCycleCounterThreshold = 0
          DemAgingCycleRef = PowerCycle
          DemEnableConditionGroupRef = EnableConditionGroup_7ab46a93
          DemOperationCycleRef = PowerCycle
          DemDebounceAlgorithmClass
            DemDebounceCounterBased: DemDebounceCounterDecrementStepSize=128, DemDebounceCounterIncrementStepSize=127, DemDebounceCounterJumpDown=true, DemDebounceCounterJumpUp=true
          IndicatorAttribute_WarningIndicator (DemIndicatorAttribute): DemIndicatorFailureCycleSource=DEM_FAILURE_CYCLE_EVENT, DemIndicatorHealingCycleRef=PowerCycle, DemIndicatorRef=WarningIndicator
      DTCClass_COM_NotConfig (DemDTCClass): DemDTCSeverity=DEM_DTC_SEV_IMMEDIATELY, DemUdsDTC=14876757
      COM_NotConfig (DemEventParameter):
        DemEventKind = DEM_EVENT_KIND_SWC
        DemMaxNumberFreezeFrameRecords = 2
        DemDTCClassRef = DTCClass_COM_NotConfig
        DemExtendedDataClassRef = ExtendedDataClass_5ecd55b9
        DemFreezeFrameClassRef = FreezeFrameClass_c3111450
        DemEventClass:
          DemAgingAllowed = true
          DemAgingCycleCounterThreshold = 1
          DemEventDestination = DEM_DTC_ORIGIN_PRIMARY_MEMORY
          DemEventPriority = 2
          DemEventFailureCycleCounterThreshold = 0
          DemAgingCycleRef = PowerCycle
          DemEnableConditionGroupRef = EnableConditionGroup_b321d2d1
          DemOperationCycleRef = PowerCycle
          DemDebounceAlgorithmClass
            DemDebounceCounterBased: DemDebounceCounterDecrementStepSize=128, DemDebounceCounterIncrementStepSize=127, DemDebounceCounterJumpDown=true, DemDebounceCounterJumpUp=true
          IndicatorAttribute_WarningIndicator (DemIndicatorAttribute): DemIndicatorFailureCycleSource=DEM_FAILURE_CYCLE_EVENT, DemIndicatorHealingCycleRef=PowerCycle, DemIndicatorRef=WarningIndicator
      DTCClass_COM_CarConfigErr (DemDTCClass): DemDTCSeverity=DEM_DTC_SEV_IMMEDIATELY, DemUdsDTC=14876758
      COM_CarConfigErr (DemEventParameter):
        DemEventKind = DEM_EVENT_KIND_SWC
        DemMaxNumberFreezeFrameRecords = 2
        DemDTCClassRef = DTCClass_COM_CarConfigErr
        DemExtendedDataClassRef = ExtendedDataClass_5ecd55b9
        DemFreezeFrameClassRef = FreezeFrameClass_c3111450
        DemEventClass:
          DemAgingAllowed = true
          DemAgingCycleCounterThreshold = 1
          DemEventDestination = DEM_DTC_ORIGIN_PRIMARY_MEMORY
          DemEventPriority = 2
          DemEventFailureCycleCounterThreshold = 0
          DemAgingCycleRef = PowerCycle
          DemEnableConditionGroupRef = EnableConditionGroup_16bf7de5
          DemOperationCycleRef = PowerCycle
          DemDebounceAlgorithmClass
            DemDebounceCounterBased: DemDebounceCounterDecrementStepSize=128, DemDebounceCounterIncrementStepSize=127, DemDebounceCounterJumpDown=true, DemDebounceCounterJumpUp=true
          IndicatorAttribute_WarningIndicator (DemIndicatorAttribute): DemIndicatorFailureCycleSource=DEM_FAILURE_CYCLE_EVENT, DemIndicatorHealingCycleRef=PowerCycle, DemIndicatorRef=WarningIndicator
      DTCClass_PS_ECUSUPPLY_HIGH (DemDTCClass): DemDTCSeverity=DEM_DTC_SEV_IMMEDIATELY, DemUdsDTC=15598440
      PS_ECUSUPPLY_HIGH (DemEventParameter):
        DemEventKind = DEM_EVENT_KIND_SWC
        DemMaxNumberFreezeFrameRecords = 2
        DemDTCClassRef = DTCClass_PS_ECUSUPPLY_HIGH
        DemExtendedDataClassRef = ExtendedDataClass_5ecd55b9
        DemFreezeFrameClassRef = FreezeFrameClass_c3111450
        DemEventClass:
          DemAgingAllowed = true
          DemAgingCycleCounterThreshold = 40
          DemEventDestination = DEM_DTC_ORIGIN_PRIMARY_MEMORY
          DemEventPriority = 1
          DemEventFailureCycleCounterThreshold = 0
          DemAgingCycleRef = PowerCycle
          DemEnableConditionGroupRef = EnableConditionGroup_14eabb2c
          DemOperationCycleRef = PowerCycle
          DemDebounceAlgorithmClass
            DemDebounceCounterBased: DemDebounceCounterDecrementStepSize=128, DemDebounceCounterIncrementStepSize=127, DemDebounceCounterJumpDown=true, DemDebounceCounterJumpUp=true
          IndicatorAttribute_WarningIndicator (DemIndicatorAttribute): DemIndicatorFailureCycleSource=DEM_FAILURE_CYCLE_EVENT, DemIndicatorHealingCycleRef=PowerCycle, DemIndicatorRef=WarningIndicator
      DTCClass_PS_ECUSUPPLY_LOW (DemDTCClass): DemDTCSeverity=DEM_DTC_SEV_MAINTENANCE_ONLY, DemUdsDTC=15598696
      PS_ECUSUPPLY_LOW (DemEventParameter):
        DemEventKind = DEM_EVENT_KIND_SWC
        DemMaxNumberFreezeFrameRecords = 2
        DemDTCClassRef = DTCClass_PS_ECUSUPPLY_LOW
        DemExtendedDataClassRef = ExtendedDataClass_5ecd55b9
        DemFreezeFrameClassRef = FreezeFrameClass_c3111450
        DemEventClass:
          DemAgingAllowed = true
          DemAgingCycleCounterThreshold = 40
          DemEventDestination = DEM_DTC_ORIGIN_PRIMARY_MEMORY
          DemEventPriority = 1
          DemEventFailureCycleCounterThreshold = 0
          DemAgingCycleRef = PowerCycle
          DemEnableConditionGroupRef = EnableConditionGroup_14eabb2c
          DemOperationCycleRef = PowerCycle
          DemDebounceAlgorithmClass
            DemDebounceCounterBased: DemDebounceCounterDecrementStepSize=128, DemDebounceCounterIncrementStepSize=127, DemDebounceCounterJumpDown=true, DemDebounceCounterJumpUp=true
          IndicatorAttribute_WarningIndicator (DemIndicatorAttribute): DemIndicatorFailureCycleSource=DEM_FAILURE_CYCLE_EVENT, DemIndicatorHealingCycleRef=PowerCycle, DemIndicatorRef=WarningIndicator
      DTCClass_VCEvBecmPropFr02Tioutd (DemDTCClass): DemDTCSeverity=DEM_DTC_SEV_IMMEDIATELY, DemUdsDTC=15663360
      VCEvBecmPropFr02Tioutd (DemEventParameter):
        DemEventKind = DEM_EVENT_KIND_SWC
        DemMaxNumberFreezeFrameRecords = 2
        DemDTCClassRef = DTCClass_VCEvBecmPropFr02Tioutd
        DemExtendedDataClassRef = ExtendedDataClass_5ecd55b9
        DemFreezeFrameClassRef = FreezeFrameClass_c3111450
        DemEventClass:
          DemAgingAllowed = true
          DemAgingCycleCounterThreshold = 40
          DemEventDestination = DEM_DTC_ORIGIN_PRIMARY_MEMORY
          DemEventPriority = 1
          DemEventFailureCycleCounterThreshold = 0
          DemAgingCycleRef = PowerCycle
          DemEnableConditionGroupRef = EnableConditionGroup_6f8868bd
          DemOperationCycleRef = PowerCycle
          DemDebounceAlgorithmClass
            DemDebounceCounterBased: DemDebounceCounterDecrementStepSize=128, DemDebounceCounterIncrementStepSize=127, DemDebounceCounterJumpDown=true, DemDebounceCounterJumpUp=true
          IndicatorAttribute_WarningIndicator (DemIndicatorAttribute): DemIndicatorFailureCycleSource=DEM_FAILURE_CYCLE_EVENT, DemIndicatorHealingCycleRef=PowerCycle, DemIndicatorRef=WarningIndicator
      DTCClass_VCEvEcmPropFr05Tioutd (DemDTCClass): DemDTCSeverity=DEM_DTC_SEV_IMMEDIATELY, DemUdsDTC=15663616
      VCEvEcmPropFr05Tioutd (DemEventParameter):
        DemEventKind = DEM_EVENT_KIND_SWC
        DemMaxNumberFreezeFrameRecords = 2
        DemDTCClassRef = DTCClass_VCEvEcmPropFr05Tioutd
        DemExtendedDataClassRef = ExtendedDataClass_5ecd55b9
        DemFreezeFrameClassRef = FreezeFrameClass_c3111450
        DemEventClass:
          DemAgingAllowed = true
          DemAgingCycleCounterThreshold = 40
          DemEventDestination = DEM_DTC_ORIGIN_PRIMARY_MEMORY
          DemEventPriority = 1
          DemEventFailureCycleCounterThreshold = 0
          DemAgingCycleRef = PowerCycle
          DemEnableConditionGroupRef = EnableConditionGroup_6f8868bd
          DemOperationCycleRef = PowerCycle
          DemDebounceAlgorithmClass
            DemDebounceCounterBased: DemDebounceCounterDecrementStepSize=128, DemDebounceCounterIncrementStepSize=127, DemDebounceCounterJumpDown=true, DemDebounceCounterJumpUp=true
          IndicatorAttribute_WarningIndicator (DemIndicatorAttribute): DemIndicatorFailureCycleSource=DEM_FAILURE_CYCLE_EVENT, DemIndicatorHealingCycleRef=PowerCycle, DemIndicatorRef=WarningIndicator
      DTCClass_VCEvEcmPropXevFr06Tioutd (DemDTCClass): DemDTCSeverity=DEM_DTC_SEV_IMMEDIATELY, DemUdsDTC=15663872
      VCEvEcmPropXevFr06Tioutd (DemEventParameter):
        DemEventKind = DEM_EVENT_KIND_SWC
        DemMaxNumberFreezeFrameRecords = 2
        DemDTCClassRef = DTCClass_VCEvEcmPropXevFr06Tioutd
        DemExtendedDataClassRef = ExtendedDataClass_5ecd55b9
        DemFreezeFrameClassRef = FreezeFrameClass_c3111450
        DemEventClass:
          DemAgingAllowed = true
          DemAgingCycleCounterThreshold = 40
          DemEventDestination = DEM_DTC_ORIGIN_PRIMARY_MEMORY
          DemEventPriority = 1
          DemEventFailureCycleCounterThreshold = 0
          DemAgingCycleRef = PowerCycle
          DemEnableConditionGroupRef = EnableConditionGroup_6f8868bd
          DemOperationCycleRef = PowerCycle
          DemDebounceAlgorithmClass
            DemDebounceCounterBased: DemDebounceCounterDecrementStepSize=128, DemDebounceCounterIncrementStepSize=127, DemDebounceCounterJumpDown=true, DemDebounceCounterJumpUp=true
          IndicatorAttribute_WarningIndicator (DemIndicatorAttribute): DemIndicatorFailureCycleSource=DEM_FAILURE_CYCLE_EVENT, DemIndicatorHealingCycleRef=PowerCycle, DemIndicatorRef=WarningIndicator
      DTCClass_VCEvEcmPropFr08Tioutd (DemDTCClass): DemDTCSeverity=DEM_DTC_SEV_IMMEDIATELY, DemUdsDTC=15664128
      VCEvEcmPropFr08Tioutd (DemEventParameter):
        DemEventKind = DEM_EVENT_KIND_SWC
        DemMaxNumberFreezeFrameRecords = 2
        DemDTCClassRef = DTCClass_VCEvEcmPropFr08Tioutd
        DemExtendedDataClassRef = ExtendedDataClass_5ecd55b9
        DemFreezeFrameClassRef = FreezeFrameClass_c3111450
        DemEventClass:
          DemAgingAllowed = true
          DemAgingCycleCounterThreshold = 40
          DemEventDestination = DEM_DTC_ORIGIN_PRIMARY_MEMORY
          DemEventPriority = 1
          DemEventFailureCycleCounterThreshold = 0
          DemAgingCycleRef = PowerCycle
          DemEnableConditionGroupRef = EnableConditionGroup_6f8868bd
          DemOperationCycleRef = PowerCycle
          DemDebounceAlgorithmClass
            DemDebounceCounterBased: DemDebounceCounterDecrementStepSize=128, DemDebounceCounterIncrementStepSize=127, DemDebounceCounterJumpDown=true, DemDebounceCounterJumpUp=true
          IndicatorAttribute_WarningIndicator (DemIndicatorAttribute): DemIndicatorFailureCycleSource=DEM_FAILURE_CYCLE_EVENT, DemIndicatorHealingCycleRef=PowerCycle, DemIndicatorRef=WarningIndicator
      DTCClass_VCEvEcmPropFr11Tioutd (DemDTCClass): DemDTCSeverity=DEM_DTC_SEV_IMMEDIATELY, DemUdsDTC=15664384
      VCEvEcmPropFr11Tioutd (DemEventParameter):
        DemEventKind = DEM_EVENT_KIND_SWC
        DemMaxNumberFreezeFrameRecords = 2
        DemDTCClassRef = DTCClass_VCEvEcmPropFr11Tioutd
        DemExtendedDataClassRef = ExtendedDataClass_5ecd55b9
        DemFreezeFrameClassRef = FreezeFrameClass_c3111450
        DemEventClass:
          DemAgingAllowed = true
          DemAgingCycleCounterThreshold = 40
          DemEventDestination = DEM_DTC_ORIGIN_PRIMARY_MEMORY
          DemEventPriority = 1
          DemEventFailureCycleCounterThreshold = 0
          DemAgingCycleRef = PowerCycle
          DemEnableConditionGroupRef = EnableConditionGroup_6f8868bd
          DemOperationCycleRef = PowerCycle
          DemDebounceAlgorithmClass
            DemDebounceCounterBased: DemDebounceCounterDecrementStepSize=128, DemDebounceCounterIncrementStepSize=127, DemDebounceCounterJumpDown=true, DemDebounceCounterJumpUp=true
          IndicatorAttribute_WarningIndicator (DemIndicatorAttribute): DemIndicatorFailureCycleSource=DEM_FAILURE_CYCLE_EVENT, DemIndicatorHealingCycleRef=PowerCycle, DemIndicatorRef=WarningIndicator
      DTCClass_VCEvBecmPropFr01Tioutd (DemDTCClass): DemDTCSeverity=DEM_DTC_SEV_IMMEDIATELY, DemUdsDTC=15664640
      VCEvBecmPropFr01Tioutd (DemEventParameter):
        DemEventKind = DEM_EVENT_KIND_SWC
        DemMaxNumberFreezeFrameRecords = 2
        DemDTCClassRef = DTCClass_VCEvBecmPropFr01Tioutd
        DemExtendedDataClassRef = ExtendedDataClass_5ecd55b9
        DemFreezeFrameClassRef = FreezeFrameClass_c3111450
        DemEventClass:
          DemAgingAllowed = true
          DemAgingCycleCounterThreshold = 40
          DemEventDestination = DEM_DTC_ORIGIN_PRIMARY_MEMORY
          DemEventPriority = 1
          DemEventFailureCycleCounterThreshold = 0
          DemAgingCycleRef = PowerCycle
          DemEnableConditionGroupRef = EnableConditionGroup_6f8868bd
          DemOperationCycleRef = PowerCycle
          DemDebounceAlgorithmClass
            DemDebounceCounterBased: DemDebounceCounterDecrementStepSize=128, DemDebounceCounterIncrementStepSize=127, DemDebounceCounterJumpDown=true, DemDebounceCounterJumpUp=true
          IndicatorAttribute_WarningIndicator (DemIndicatorAttribute): DemIndicatorFailureCycleSource=DEM_FAILURE_CYCLE_EVENT, DemIndicatorHealingCycleRef=PowerCycle, DemIndicatorRef=WarningIndicator
      DTCClass_VCEvEcmPropFr04Tioutd (DemDTCClass): DemDTCSeverity=DEM_DTC_SEV_IMMEDIATELY, DemUdsDTC=15664896
      VCEvEcmPropFr04Tioutd (DemEventParameter):
        DemEventKind = DEM_EVENT_KIND_SWC
        DemMaxNumberFreezeFrameRecords = 2
        DemDTCClassRef = DTCClass_VCEvEcmPropFr04Tioutd
        DemExtendedDataClassRef = ExtendedDataClass_5ecd55b9
        DemFreezeFrameClassRef = FreezeFrameClass_c3111450
        DemEventClass:
          DemAgingAllowed = true
          DemAgingCycleCounterThreshold = 40
          DemEventDestination = DEM_DTC_ORIGIN_PRIMARY_MEMORY
          DemEventPriority = 1
          DemEventFailureCycleCounterThreshold = 0
          DemAgingCycleRef = PowerCycle
          DemOperationCycleRef = PowerCycle
          DemDebounceAlgorithmClass
            DemDebounceCounterBased: DemDebounceCounterDecrementStepSize=128, DemDebounceCounterIncrementStepSize=127, DemDebounceCounterJumpDown=true, DemDebounceCounterJumpUp=true
          IndicatorAttribute_WarningIndicator (DemIndicatorAttribute): DemIndicatorFailureCycleSource=DEM_FAILURE_CYCLE_EVENT, DemIndicatorHealingCycleRef=PowerCycle, DemIndicatorRef=WarningIndicator
      DTCClass_VCEvVddmPropFr05Tioutd (DemDTCClass): DemDTCSeverity=DEM_DTC_SEV_IMMEDIATELY, DemUdsDTC=15665152
      VCEvVddmPropFr05Tioutd (DemEventParameter):
        DemEventKind = DEM_EVENT_KIND_SWC
        DemMaxNumberFreezeFrameRecords = 2
        DemDTCClassRef = DTCClass_VCEvVddmPropFr05Tioutd
        DemExtendedDataClassRef = ExtendedDataClass_5ecd55b9
        DemFreezeFrameClassRef = FreezeFrameClass_c3111450
        DemEventClass:
          DemAgingAllowed = true
          DemAgingCycleCounterThreshold = 40
          DemEventDestination = DEM_DTC_ORIGIN_PRIMARY_MEMORY
          DemEventPriority = 1
          DemEventFailureCycleCounterThreshold = 0
          DemAgingCycleRef = PowerCycle
          DemEnableConditionGroupRef = EnableConditionGroup_6f8868bd
          DemOperationCycleRef = PowerCycle
          DemDebounceAlgorithmClass
            DemDebounceCounterBased: DemDebounceCounterDecrementStepSize=128, DemDebounceCounterIncrementStepSize=127, DemDebounceCounterJumpDown=true, DemDebounceCounterJumpUp=true
          IndicatorAttribute_WarningIndicator (DemIndicatorAttribute): DemIndicatorFailureCycleSource=DEM_FAILURE_CYCLE_EVENT, DemIndicatorHealingCycleRef=PowerCycle, DemIndicatorRef=WarningIndicator
      DTCClass_VCEvVddmPropFr17Tioutd (DemDTCClass): DemDTCSeverity=DEM_DTC_SEV_IMMEDIATELY, DemUdsDTC=15665408
      VCEvVddmPropFr17Tioutd (DemEventParameter):
        DemEventKind = DEM_EVENT_KIND_SWC
        DemMaxNumberFreezeFrameRecords = 2
        DemDTCClassRef = DTCClass_VCEvVddmPropFr17Tioutd
        DemExtendedDataClassRef = ExtendedDataClass_5ecd55b9
        DemFreezeFrameClassRef = FreezeFrameClass_c3111450
        DemEventClass:
          DemAgingAllowed = true
          DemAgingCycleCounterThreshold = 40
          DemEventDestination = DEM_DTC_ORIGIN_PRIMARY_MEMORY
          DemEventPriority = 1
          DemEventFailureCycleCounterThreshold = 0
          DemAgingCycleRef = PowerCycle
          DemEnableConditionGroupRef = EnableConditionGroup_6f8868bd
          DemOperationCycleRef = PowerCycle
          DemDebounceAlgorithmClass
            DemDebounceCounterBased: DemDebounceCounterDecrementStepSize=128, DemDebounceCounterIncrementStepSize=127, DemDebounceCounterJumpDown=true, DemDebounceCounterJumpUp=true
          IndicatorAttribute_WarningIndicator (DemIndicatorAttribute): DemIndicatorFailureCycleSource=DEM_FAILURE_CYCLE_EVENT, DemIndicatorHealingCycleRef=PowerCycle, DemIndicatorRef=WarningIndicator
      DTCClass_VCEvVddmPropFr18Tioutd (DemDTCClass): DemDTCSeverity=DEM_DTC_SEV_IMMEDIATELY, DemUdsDTC=15667200
      VCEvVddmPropFr18Tioutd (DemEventParameter):
        DemEventKind = DEM_EVENT_KIND_SWC
        DemMaxNumberFreezeFrameRecords = 2
        DemDTCClassRef = DTCClass_VCEvVddmPropFr18Tioutd
        DemExtendedDataClassRef = ExtendedDataClass_5ecd55b9
        DemFreezeFrameClassRef = FreezeFrameClass_c3111450
        DemEventClass:
          DemAgingAllowed = true
          DemAgingCycleCounterThreshold = 40
          DemEventDestination = DEM_DTC_ORIGIN_PRIMARY_MEMORY
          DemEventPriority = 1
          DemEventFailureCycleCounterThreshold = 0
          DemAgingCycleRef = PowerCycle
          DemEnableConditionGroupRef = EnableConditionGroup_6f8868bd
          DemOperationCycleRef = PowerCycle
          DemDebounceAlgorithmClass
            DemDebounceCounterBased: DemDebounceCounterDecrementStepSize=128, DemDebounceCounterIncrementStepSize=127, DemDebounceCounterJumpDown=true, DemDebounceCounterJumpUp=true
          IndicatorAttribute_WarningIndicator (DemIndicatorAttribute): DemIndicatorFailureCycleSource=DEM_FAILURE_CYCLE_EVENT, DemIndicatorHealingCycleRef=PowerCycle, DemIndicatorRef=WarningIndicator
      DTCClass_VCEvVddmPropFr19Tioutd (DemDTCClass): DemDTCSeverity=DEM_DTC_SEV_IMMEDIATELY, DemUdsDTC=15667456
      VCEvVddmPropFr19Tioutd (DemEventParameter):
        DemEventKind = DEM_EVENT_KIND_SWC
        DemMaxNumberFreezeFrameRecords = 2
        DemDTCClassRef = DTCClass_VCEvVddmPropFr19Tioutd
        DemExtendedDataClassRef = ExtendedDataClass_5ecd55b9
        DemFreezeFrameClassRef = FreezeFrameClass_c3111450
        DemEventClass:
          DemAgingAllowed = true
          DemAgingCycleCounterThreshold = 40
          DemEventDestination = DEM_DTC_ORIGIN_PRIMARY_MEMORY
          DemEventPriority = 1
          DemEventFailureCycleCounterThreshold = 0
          DemAgingCycleRef = PowerCycle
          DemEnableConditionGroupRef = EnableConditionGroup_6f8868bd
          DemOperationCycleRef = PowerCycle
          DemDebounceAlgorithmClass
            DemDebounceCounterBased: DemDebounceCounterDecrementStepSize=128, DemDebounceCounterIncrementStepSize=127, DemDebounceCounterJumpDown=true, DemDebounceCounterJumpUp=true
          IndicatorAttribute_WarningIndicator (DemIndicatorAttribute): DemIndicatorFailureCycleSource=DEM_FAILURE_CYCLE_EVENT, DemIndicatorHealingCycleRef=PowerCycle, DemIndicatorRef=WarningIndicator
      DTCClass_VCEvEcmPropFr24MgmFr01Tioutd (DemDTCClass): DemDTCSeverity=DEM_DTC_SEV_IMMEDIATELY, DemUdsDTC=15667712
      VCEvEcmPropFr24MgmFr01Tioutd (DemEventParameter):
        DemEventKind = DEM_EVENT_KIND_SWC
        DemMaxNumberFreezeFrameRecords = 2
        DemDTCClassRef = DTCClass_VCEvEcmPropFr24MgmFr01Tioutd
        DemExtendedDataClassRef = ExtendedDataClass_5ecd55b9
        DemFreezeFrameClassRef = FreezeFrameClass_c3111450
        DemEventClass:
          DemAgingAllowed = true
          DemAgingCycleCounterThreshold = 40
          DemEventDestination = DEM_DTC_ORIGIN_PRIMARY_MEMORY
          DemEventPriority = 1
          DemEventFailureCycleCounterThreshold = 0
          DemAgingCycleRef = PowerCycle
          DemOperationCycleRef = PowerCycle
          DemDebounceAlgorithmClass
            DemDebounceCounterBased: DemDebounceCounterDecrementStepSize=128, DemDebounceCounterIncrementStepSize=127, DemDebounceCounterJumpDown=true, DemDebounceCounterJumpUp=true
          IndicatorAttribute_WarningIndicator (DemIndicatorAttribute): DemIndicatorFailureCycleSource=DEM_FAILURE_CYCLE_EVENT, DemIndicatorHealingCycleRef=PowerCycle, DemIndicatorRef=WarningIndicator
      DTCClass_VCEvEcmPropFr25Tioutd (DemDTCClass): DemDTCSeverity=DEM_DTC_SEV_MAINTENANCE_ONLY, DemUdsDTC=15667968
      VCEvEcmPropFr25Tioutd (DemEventParameter):
        DemEventKind = DEM_EVENT_KIND_SWC
        DemMaxNumberFreezeFrameRecords = 2
        DemDTCClassRef = DTCClass_VCEvEcmPropFr25Tioutd
        DemExtendedDataClassRef = ExtendedDataClass_5ecd55b9
        DemFreezeFrameClassRef = FreezeFrameClass_c3111450
        DemEventClass:
          DemAgingAllowed = true
          DemAgingCycleCounterThreshold = 40
          DemEventDestination = DEM_DTC_ORIGIN_PRIMARY_MEMORY
          DemEventPriority = 1
          DemEventFailureCycleCounterThreshold = 0
          DemAgingCycleRef = PowerCycle
          DemEnableConditionGroupRef = EnableConditionGroup_6f8868bd
          DemOperationCycleRef = PowerCycle
          DemDebounceAlgorithmClass
            DemDebounceCounterBased: DemDebounceCounterDecrementStepSize=128, DemDebounceCounterIncrementStepSize=127, DemDebounceCounterJumpDown=true, DemDebounceCounterJumpUp=true
          IndicatorAttribute_WarningIndicator (DemIndicatorAttribute): DemIndicatorFailureCycleSource=DEM_FAILURE_CYCLE_EVENT, DemIndicatorHealingCycleRef=PowerCycle, DemIndicatorRef=WarningIndicator
      DTCClass_VCEvVddmPropFr08Tioutd (DemDTCClass): DemDTCSeverity=DEM_DTC_SEV_IMMEDIATELY, DemUdsDTC=15668224
      VCEvVddmPropFr08Tioutd (DemEventParameter):
        DemEventKind = DEM_EVENT_KIND_SWC
        DemMaxNumberFreezeFrameRecords = 2
        DemDTCClassRef = DTCClass_VCEvVddmPropFr08Tioutd
        DemExtendedDataClassRef = ExtendedDataClass_5ecd55b9
        DemFreezeFrameClassRef = FreezeFrameClass_c3111450
        DemEventClass:
          DemAgingAllowed = true
          DemAgingCycleCounterThreshold = 40
          DemEventDestination = DEM_DTC_ORIGIN_PRIMARY_MEMORY
          DemEventPriority = 1
          DemEventFailureCycleCounterThreshold = 0
          DemAgingCycleRef = PowerCycle
          DemOperationCycleRef = PowerCycle
          DemDebounceAlgorithmClass
            DemDebounceCounterBased: DemDebounceCounterDecrementStepSize=128, DemDebounceCounterIncrementStepSize=127, DemDebounceCounterJumpDown=true, DemDebounceCounterJumpUp=true
          IndicatorAttribute_WarningIndicator (DemIndicatorAttribute): DemIndicatorFailureCycleSource=DEM_FAILURE_CYCLE_EVENT, DemIndicatorHealingCycleRef=PowerCycle, DemIndicatorRef=WarningIndicator
      DTCClass_VCEvEcmPropFr02MgmFr00Tioutd (DemDTCClass): DemDTCSeverity=DEM_DTC_SEV_IMMEDIATELY, DemUdsDTC=15668480
      VCEvEcmPropFr02MgmFr00Tioutd (DemEventParameter):
        DemEventKind = DEM_EVENT_KIND_SWC
        DemMaxNumberFreezeFrameRecords = 2
        DemDTCClassRef = DTCClass_VCEvEcmPropFr02MgmFr00Tioutd
        DemExtendedDataClassRef = ExtendedDataClass_5ecd55b9
        DemFreezeFrameClassRef = FreezeFrameClass_c3111450
        DemEventClass:
          DemAgingAllowed = true
          DemAgingCycleCounterThreshold = 40
          DemEventDestination = DEM_DTC_ORIGIN_PRIMARY_MEMORY
          DemEventPriority = 1
          DemEventFailureCycleCounterThreshold = 0
          DemAgingCycleRef = PowerCycle
          DemOperationCycleRef = PowerCycle
          DemDebounceAlgorithmClass
            DemDebounceCounterBased: DemDebounceCounterDecrementStepSize=128, DemDebounceCounterIncrementStepSize=127, DemDebounceCounterJumpDown=true, DemDebounceCounterJumpUp=true
          IndicatorAttribute_WarningIndicator (DemIndicatorAttribute): DemIndicatorFailureCycleSource=DEM_FAILURE_CYCLE_EVENT, DemIndicatorHealingCycleRef=PowerCycle, DemIndicatorRef=WarningIndicator
      DTCClass_VCEvVddmPropFr15Tioutd (DemDTCClass): DemDTCSeverity=DEM_DTC_SEV_MAINTENANCE_ONLY, DemUdsDTC=15668992
      VCEvVddmPropFr15Tioutd (DemEventParameter):
        DemEventKind = DEM_EVENT_KIND_SWC
        DemMaxNumberFreezeFrameRecords = 2
        DemDTCClassRef = DTCClass_VCEvVddmPropFr15Tioutd
        DemExtendedDataClassRef = ExtendedDataClass_5ecd55b9
        DemFreezeFrameClassRef = FreezeFrameClass_c3111450
        DemEventClass:
          DemAgingAllowed = true
          DemAgingCycleCounterThreshold = 40
          DemEventDestination = DEM_DTC_ORIGIN_PRIMARY_MEMORY
          DemEventPriority = 1
          DemEventFailureCycleCounterThreshold = 0
          DemAgingCycleRef = PowerCycle
          DemEnableConditionGroupRef = EnableConditionGroup_6f8868bd
          DemOperationCycleRef = PowerCycle
          DemDebounceAlgorithmClass
            DemDebounceCounterBased: DemDebounceCounterDecrementStepSize=128, DemDebounceCounterIncrementStepSize=127, DemDebounceCounterJumpDown=true, DemDebounceCounterJumpUp=true
          IndicatorAttribute_WarningIndicator (DemIndicatorAttribute): DemIndicatorFailureCycleSource=DEM_FAILURE_CYCLE_EVENT, DemIndicatorHealingCycleRef=PowerCycle, DemIndicatorRef=WarningIndicator
      DTCClass_VCEvVddmPropFr08Tioutd_001 (DemDTCClass): DemDTCSeverity=DEM_DTC_SEV_MAINTENANCE_ONLY, DemUdsDTC=15669248
      VCEvVddmPropFr08Tioutd_001 (DemEventParameter):
        DemEventKind = DEM_EVENT_KIND_SWC
        DemMaxNumberFreezeFrameRecords = 2
        DemDTCClassRef = DTCClass_VCEvVddmPropFr08Tioutd_001
        DemExtendedDataClassRef = ExtendedDataClass_5ecd55b9
        DemFreezeFrameClassRef = FreezeFrameClass_c3111450
        DemEventClass:
          DemAgingAllowed = true
          DemAgingCycleCounterThreshold = 40
          DemEventDestination = DEM_DTC_ORIGIN_PRIMARY_MEMORY
          DemEventPriority = 1
          DemEventFailureCycleCounterThreshold = 0
          DemAgingCycleRef = PowerCycle
          DemEnableConditionGroupRef = EnableConditionGroup_6f8868bd
          DemOperationCycleRef = PowerCycle
          DemDebounceAlgorithmClass
            DemDebounceCounterBased: DemDebounceCounterDecrementStepSize=128, DemDebounceCounterIncrementStepSize=127, DemDebounceCounterJumpDown=true, DemDebounceCounterJumpUp=true
          IndicatorAttribute_WarningIndicator (DemIndicatorAttribute): DemIndicatorFailureCycleSource=DEM_FAILURE_CYCLE_EVENT, DemIndicatorHealingCycleRef=PowerCycle, DemIndicatorRef=WarningIndicator
      DTCClass_VCEvEcmPropFr02Tioutd (DemDTCClass): DemDTCSeverity=DEM_DTC_SEV_MAINTENANCE_ONLY, DemUdsDTC=15669504
      VCEvEcmPropFr02Tioutd (DemEventParameter):
        DemEventKind = DEM_EVENT_KIND_SWC
        DemMaxNumberFreezeFrameRecords = 2
        DemDTCClassRef = DTCClass_VCEvEcmPropFr02Tioutd
        DemExtendedDataClassRef = ExtendedDataClass_5ecd55b9
        DemFreezeFrameClassRef = FreezeFrameClass_c3111450
        DemEventClass:
          DemAgingAllowed = true
          DemAgingCycleCounterThreshold = 40
          DemEventDestination = DEM_DTC_ORIGIN_PRIMARY_MEMORY
          DemEventPriority = 1
          DemEventFailureCycleCounterThreshold = 0
          DemAgingCycleRef = PowerCycle
          DemEnableConditionGroupRef = EnableConditionGroup_6f8868bd
          DemOperationCycleRef = PowerCycle
          DemDebounceAlgorithmClass
            DemDebounceCounterBased: DemDebounceCounterDecrementStepSize=128, DemDebounceCounterIncrementStepSize=127, DemDebounceCounterJumpDown=true, DemDebounceCounterJumpUp=true
          IndicatorAttribute_WarningIndicator (DemIndicatorAttribute): DemIndicatorFailureCycleSource=DEM_FAILURE_CYCLE_EVENT, DemIndicatorHealingCycleRef=PowerCycle, DemIndicatorRef=WarningIndicator
      DTCClass_VcEvCntrWhlMotSysTqAllwd (DemDTCClass): DemDTCSeverity=DEM_DTC_SEV_MAINTENANCE_ONLY, DemUdsDTC=15671682
      VcEvCntrWhlMotSysTqAllwd (DemEventParameter):
        DemEventKind = DEM_EVENT_KIND_SWC
        DemMaxNumberFreezeFrameRecords = 2
        DemDTCClassRef = DTCClass_VcEvCntrWhlMotSysTqAllwd
        DemExtendedDataClassRef = ExtendedDataClass_5ecd55b9
        DemFreezeFrameClassRef = FreezeFrameClass_c3111450
        DemEventClass:
          DemAgingAllowed = true
          DemAgingCycleCounterThreshold = 40
          DemEventDestination = DEM_DTC_ORIGIN_PRIMARY_MEMORY
          DemEventPriority = 1
          DemEventFailureCycleCounterThreshold = 0
          DemAgingCycleRef = PowerCycle
          DemEnableConditionGroupRef = EnableConditionGroup_06a6aa19
          DemOperationCycleRef = PowerCycle
          DemDebounceAlgorithmClass
            DemDebounceCounterBased: DemDebounceCounterDecrementStepSize=128, DemDebounceCounterIncrementStepSize=127, DemDebounceCounterJumpDown=true, DemDebounceCounterJumpUp=true
          IndicatorAttribute_WarningIndicator (DemIndicatorAttribute): DemIndicatorFailureCycleSource=DEM_FAILURE_CYCLE_EVENT, DemIndicatorHealingCycleRef=PowerCycle, DemIndicatorRef=WarningIndicator
      DTCClass_VcEvChkSumWhlMotSysTqAllwd (DemDTCClass): DemDTCSeverity=DEM_DTC_SEV_IMMEDIATELY, DemUdsDTC=15671683
      VcEvChkSumWhlMotSysTqAllwd (DemEventParameter):
        DemEventKind = DEM_EVENT_KIND_SWC
        DemMaxNumberFreezeFrameRecords = 2
        DemDTCClassRef = DTCClass_VcEvChkSumWhlMotSysTqAllwd
        DemExtendedDataClassRef = ExtendedDataClass_5ecd55b9
        DemFreezeFrameClassRef = FreezeFrameClass_c3111450
        DemEventClass:
          DemAgingAllowed = true
          DemAgingCycleCounterThreshold = 40
          DemEventDestination = DEM_DTC_ORIGIN_PRIMARY_MEMORY
          DemEventPriority = 1
          DemEventFailureCycleCounterThreshold = 0
          DemAgingCycleRef = PowerCycle
          DemEnableConditionGroupRef = EnableConditionGroup_06a6aa19
          DemOperationCycleRef = PowerCycle
          DemDebounceAlgorithmClass
            DemDebounceCounterBased: DemDebounceCounterDecrementStepSize=128, DemDebounceCounterIncrementStepSize=127, DemDebounceCounterJumpDown=true, DemDebounceCounterJumpUp=true
          IndicatorAttribute_WarningIndicator (DemIndicatorAttribute): DemIndicatorFailureCycleSource=DEM_FAILURE_CYCLE_EVENT, DemIndicatorHealingCycleRef=PowerCycle, DemIndicatorRef=WarningIndicator
      DTCClass_VcEvCntrCrashStsSafe (DemDTCClass): DemDTCSeverity=DEM_DTC_SEV_IMMEDIATELY, DemUdsDTC=15671938
      VcEvCntrCrashStsSafe (DemEventParameter):
        DemEventKind = DEM_EVENT_KIND_SWC
        DemMaxNumberFreezeFrameRecords = 2
        DemDTCClassRef = DTCClass_VcEvCntrCrashStsSafe
        DemExtendedDataClassRef = ExtendedDataClass_5ecd55b9
        DemFreezeFrameClassRef = FreezeFrameClass_c3111450
        DemEventClass:
          DemAgingAllowed = true
          DemAgingCycleCounterThreshold = 40
          DemEventDestination = DEM_DTC_ORIGIN_PRIMARY_MEMORY
          DemEventPriority = 1
          DemEventFailureCycleCounterThreshold = 0
          DemAgingCycleRef = PowerCycle
          DemEnableConditionGroupRef = EnableConditionGroup_06a6aa19
          DemOperationCycleRef = PowerCycle
          DemDebounceAlgorithmClass
            DemDebounceCounterBased: DemDebounceCounterDecrementStepSize=128, DemDebounceCounterIncrementStepSize=127, DemDebounceCounterJumpDown=true, DemDebounceCounterJumpUp=true
          IndicatorAttribute_WarningIndicator (DemIndicatorAttribute): DemIndicatorFailureCycleSource=DEM_FAILURE_CYCLE_EVENT, DemIndicatorHealingCycleRef=PowerCycle, DemIndicatorRef=WarningIndicator
      DTCClass_VcEvChkSumCrashStsSafe (DemDTCClass): DemDTCSeverity=DEM_DTC_SEV_IMMEDIATELY, DemUdsDTC=15671939
      VcEvChkSumCrashStsSafe (DemEventParameter):
        DemEventKind = DEM_EVENT_KIND_SWC
        DemMaxNumberFreezeFrameRecords = 2
        DemDTCClassRef = DTCClass_VcEvChkSumCrashStsSafe
        DemExtendedDataClassRef = ExtendedDataClass_5ecd55b9
        DemFreezeFrameClassRef = FreezeFrameClass_c3111450
        DemEventClass:
          DemAgingAllowed = true
          DemAgingCycleCounterThreshold = 40
          DemEventDestination = DEM_DTC_ORIGIN_PRIMARY_MEMORY
          DemEventPriority = 1
          DemEventFailureCycleCounterThreshold = 0
          DemAgingCycleRef = PowerCycle
          DemEnableConditionGroupRef = EnableConditionGroup_06a6aa19
          DemOperationCycleRef = PowerCycle
          DemDebounceAlgorithmClass
            DemDebounceCounterBased: DemDebounceCounterDecrementStepSize=128, DemDebounceCounterIncrementStepSize=127, DemDebounceCounterJumpDown=true, DemDebounceCounterJumpUp=true
          IndicatorAttribute_WarningIndicator (DemIndicatorAttribute): DemIndicatorFailureCycleSource=DEM_FAILURE_CYCLE_EVENT, DemIndicatorHealingCycleRef=PowerCycle, DemIndicatorRef=WarningIndicator
      DTCClass_VcEvCntrHvSysRlySts (DemDTCClass): DemDTCSeverity=DEM_DTC_SEV_MAINTENANCE_ONLY, DemUdsDTC=15672194
      VcEvCntrHvSysRlySts (DemEventParameter):
        DemEventKind = DEM_EVENT_KIND_SWC
        DemMaxNumberFreezeFrameRecords = 2
        DemDTCClassRef = DTCClass_VcEvCntrHvSysRlySts
        DemExtendedDataClassRef = ExtendedDataClass_5ecd55b9
        DemFreezeFrameClassRef = FreezeFrameClass_c3111450
        DemEventClass:
          DemAgingAllowed = true
          DemAgingCycleCounterThreshold = 40
          DemEventDestination = DEM_DTC_ORIGIN_PRIMARY_MEMORY
          DemEventPriority = 1
          DemEventFailureCycleCounterThreshold = 0
          DemAgingCycleRef = PowerCycle
          DemEnableConditionGroupRef = EnableConditionGroup_06a6aa19
          DemOperationCycleRef = PowerCycle
          DemDebounceAlgorithmClass
            DemDebounceCounterBased: DemDebounceCounterDecrementStepSize=128, DemDebounceCounterIncrementStepSize=127, DemDebounceCounterJumpDown=true, DemDebounceCounterJumpUp=true
          IndicatorAttribute_WarningIndicator (DemIndicatorAttribute): DemIndicatorFailureCycleSource=DEM_FAILURE_CYCLE_EVENT, DemIndicatorHealingCycleRef=PowerCycle, DemIndicatorRef=WarningIndicator
      DTCClass_VcEvChkSumHvSysRlySts (DemDTCClass): DemDTCSeverity=DEM_DTC_SEV_IMMEDIATELY, DemUdsDTC=15672195
      VcEvChkSumHvSysRlySts (DemEventParameter):
        DemEventKind = DEM_EVENT_KIND_SWC
        DemMaxNumberFreezeFrameRecords = 2
        DemDTCClassRef = DTCClass_VcEvChkSumHvSysRlySts
        DemExtendedDataClassRef = ExtendedDataClass_5ecd55b9
        DemFreezeFrameClassRef = FreezeFrameClass_c3111450
        DemEventClass:
          DemAgingAllowed = true
          DemAgingCycleCounterThreshold = 40
          DemEventDestination = DEM_DTC_ORIGIN_PRIMARY_MEMORY
          DemEventPriority = 1
          DemEventFailureCycleCounterThreshold = 0
          DemAgingCycleRef = PowerCycle
          DemEnableConditionGroupRef = EnableConditionGroup_06a6aa19
          DemOperationCycleRef = PowerCycle
          DemDebounceAlgorithmClass
            DemDebounceCounterBased: DemDebounceCounterDecrementStepSize=128, DemDebounceCounterIncrementStepSize=127, DemDebounceCounterJumpDown=true, DemDebounceCounterJumpUp=true
          IndicatorAttribute_WarningIndicator (DemIndicatorAttribute): DemIndicatorFailureCycleSource=DEM_FAILURE_CYCLE_EVENT, DemIndicatorHealingCycleRef=PowerCycle, DemIndicatorRef=WarningIndicator
      DTCClass_PS_KL30_PLAUS (DemDTCClass): DemDTCSeverity=DEM_DTC_SEV_MAINTENANCE_ONLY, DemUdsDTC=15729506
      PS_KL30_PLAUS (DemEventParameter):
        DemEventKind = DEM_EVENT_KIND_SWC
        DemMaxNumberFreezeFrameRecords = 2
        DemDTCClassRef = DTCClass_PS_KL30_PLAUS
        DemExtendedDataClassRef = ExtendedDataClass_5ecd55b9
        DemFreezeFrameClassRef = FreezeFrameClass_c3111450
        DemEventClass:
          DemAgingAllowed = true
          DemAgingCycleCounterThreshold = 255
          DemEventDestination = DEM_DTC_ORIGIN_PRIMARY_MEMORY
          DemEventPriority = 2
          DemEventFailureCycleCounterThreshold = 0
          DemAgingCycleRef = PowerCycle
          DemEnableConditionGroupRef = EnableConditionGroup_830522f7
          DemOperationCycleRef = PowerCycle
          DemDebounceAlgorithmClass
            DemDebounceCounterBased: DemDebounceCounterDecrementStepSize=128, DemDebounceCounterIncrementStepSize=127, DemDebounceCounterJumpDown=true, DemDebounceCounterJumpUp=true
          IndicatorAttribute_WarningIndicator (DemIndicatorAttribute): DemIndicatorFailureCycleSource=DEM_FAILURE_CYCLE_EVENT, DemIndicatorHealingCycleRef=PowerCycle, DemIndicatorRef=WarningIndicator
    DemGeneral:
      DemAgingCycleCounterProcessing = DEM_PROCESS_AGINGCTR_INTERN
      DemDebounceCounterBasedSupport = true
      DemDtcStatusAvailabilityMask = 255
      DemEnableConditionSupport = true
      DemMaxNumberEventEntryMirror = 0
      DemPTOSupport = false
      DemTypeOfFreezeFrameRecordNumeration = DEM_FF_RECNUM_CALCULATED
      60 x DemDidClass:
        DID_D003_Vehicle_Speed: DemDidIdentifier=53251, DemDidDataClassRef=DID_0xd003_DID_D003_Vehicle_Speed
        DID_DD00_Global_Real_Time: DemDidIdentifier=56576, DemDidDataClassRef=DID_0xdd00_DID_DD00_Global_Real_Time
        DID_DD01_Total_Distance: DemDidIdentifier=56577, DemDidDataClassRef=DID_0xdd01_DID_DD01_Total_Distance
        DID_DD02_Vehicle_Battery_Voltage: DemDidIdentifier=56578, DemDidDataClassRef=DID_0xdd02_DID_DD02_Vehicle_Battery_Voltage
        DID_DD0A_Usage_Mode: DemDidIdentifier=56586, DemDidDataClassRef=DID_0xdd0a_DID_DD0A_Usage_Mode
        DID_DD0C_Electric_Power_Level: DemDidIdentifier=56588, DemDidDataClassRef=DID_0xdd0c_DID_DD0C_Electric_Power_Level
        DID_E300_HVDC_Voltage: DemDidIdentifier=58112, DemDidDataClassRef=DID_0xe300_DID_E300_HVDC_Voltage
        DID_E301_HVDC_Current: DemDidIdentifier=58113, DemDidDataClassRef=DID_0xe301_DID_E301_HVDC_Current_
        DID_E303_Motor_Speed: DemDidIdentifier=58115, DemDidDataClassRef=DID_0xe303_DID_E303_Motor_Speed_
        DID_E304_Actual_Torque: DemDidIdentifier=58116, DemDidDataClassRef=DID_0xe304_DID_E304_Actual_Torque
        DID_E305_Inverter_IGBT_Junction_Temp: DemDidIdentifier=58117, DemDidDataClassRef=DID_0xe305_DID_E305_Inverter_IGBT_Junction_Temp
        DID_E306_Motor_Temperature: DemDidIdentifier=58118, DemDidDataClassRef=DID_0xe306_DID_E306_Motor_Temperature
        DID_E307_System_Mode: DemDidIdentifier=58119, DemDidDataClassRef=DID_0xe307_DID_E307_System_Mode
        DID_E308_ECM_Torque_Request: DemDidIdentifier=58120, DemDidDataClassRef=DID_0xe308_DID_E308_ECM_Torque_Request
        DID_E309_ECM_Mode_Request: DemDidIdentifier=58121, DemDidDataClassRef=DID_0xe309_DID_E309_ECM_Mode_Request
        DID_E310_IEM_MGM_Derating_Status: DemDidIdentifier=58128, DemDidDataClassRef=DID_0xe310_DID_E310_IEMMGM_Derating_Status
        DID_E311_Crash_Status: DemDidIdentifier=58129, DemDidDataClassRef=DID_0xe311_DID_E311_Crash_Status
        DID_E312_Wheel_Speed: DemDidIdentifier=58130, DemDidDataClassRef=DID_0xe312_DID_E312_Wheel_Speed
        DID_E313_Active_discharge_status: DemDidIdentifier=58131, DemDidDataClassRef=DID_0xe313_DID_E313_Active_discharge_status
        DID_E314_Available_Torque_maximum: DemDidIdentifier=58132, DemDidDataClassRef=DID_0xe314_DID_E314_Available_Torque_maximum
        DID_E315_Available_Torque_minimum: DemDidIdentifier=58133, DemDidDataClassRef=DID_0xe315_DID_E315_Available_Torque_minimum
        DID_E319_Torque_Direction: DemDidIdentifier=58137, DemDidDataClassRef=DID_0xe319_DID_E319_Torque_Direction
        DID_E320_System_Mode_Mismatch: DemDidIdentifier=58144, DemDidDataClassRef=DID_0xe320_DID_E320_System_Mode_Mismatch
        DID_E324_Motor_Derating_reason_of_IEM_MGM: DemDidIdentifier=58148, DemDidDataClassRef=DID_0xe324_DID_E324_Motor_Derating_reason_of_IEMMGM
        DID_E333_2002_State: DemDidIdentifier=58163, DemDidDataClassRef=DID_0xe333_2002_Hu, DemDidDataClassRef=DID_0xe333_2002_Hv, DemDidDataClassRef=DID_0xe333_2002_Hw, DemDidDataClassRef=DID_0xe333_2002_Lu, DemDidDataClassRef=DID_0xe333_2002_Lv, DemDidDataClassRef=DID_0xe333_2002_Lw, DemDidDataClassRef=DID_0xe333_2002_H_Ser, DemDidDataClassRef=DID_0xe333_2002_L_Ser
        DID_E335_d_axis_current_setpoint: DemDidIdentifier=58165, DemDidDataClassRef=DID_0xe335_DID_E335_d_axis_current_setpoint
        DID_E336_d_axis_current_feedback: DemDidIdentifier=58166, DemDidDataClassRef=DID_0xe336_DID_E336_d_axis_current_feedback
        DID_E337_q_axis_current_setpoint: DemDidIdentifier=58167, DemDidDataClassRef=DID_0xe337_DID_E337_q_axis_current_setpoint
        DID_E338_q_axis_current_feedback: DemDidIdentifier=58168, DemDidDataClassRef=DID_0xe338_DID_E338_q_axis_current_feedback
        DID_E339_d_axis_voltage: DemDidIdentifier=58169, DemDidDataClassRef=DID_0xe339_DID_E339_d_axis_voltage
        DID_E341_q_axis_voltage: DemDidIdentifier=58177, DemDidDataClassRef=DID_0xe341_DID_E341_q_axis_voltage
        DID_E346_ECM_Torque_Allowed_Status: DemDidIdentifier=58182, DemDidDataClassRef=DID_0xe346_DID_E346_ECM_Torque_Allowed_Status
        DID_E347_IGBT_Max_Temperature: DemDidIdentifier=58183, DemDidDataClassRef=DID_0xe347_DID_E347_IGBT_Max_Temperature
        DID_E348_Phase_U_PWM_duty: DemDidIdentifier=58184, DemDidDataClassRef=DID_0xe348_DID_E348_Phase_U_PWM_duty
        DID_E349_Phase_V_PWM_duty: DemDidIdentifier=58185, DemDidDataClassRef=DID_0xe349_DID_E349_Phase_V_PWM_duty
        DID_E350_Phase_W_PWM_duty: DemDidIdentifier=58192, DemDidDataClassRef=DID_0xe350_DID_E350_Phase_W_PWM_duty
        DID_E353_Flux_weakening_correction_factor: DemDidIdentifier=58195, DemDidDataClassRef=DID_0xe353_DID_E353_Flux_weakening_correction_factor
        DID_E357_Resolve_compensated_angle: DemDidIdentifier=58199, DemDidDataClassRef=DID_0xe357_DID_E357_Resolve_compensated_angle
        DID_E358_Resolve_angle: DemDidIdentifier=58200, DemDidDataClassRef=DID_0xe358_DID_E358_Resolve_angle
        DID_E363_Modulation_index: DemDidIdentifier=58211, DemDidDataClassRef=DID_0xe363_DID_E363_Modulation_index
        DID_E364_AURIX_Fault_Indication: DemDidIdentifier=58212, DemDidDataClassRef=DID_0xe364_DID_E364_AURIX_Fault_Indication
        DID_EE9A_Inverter_Coolant_Temperature: DemDidIdentifier=61082, DemDidDataClassRef=DID_0xee9a_DID_EE9A_Inverter_Coolant_Temperature
        DID_EE9C_Transient_Phase_Current_A: DemDidIdentifier=61084, DemDidDataClassRef=DID_0xee9c_DID_EE9C_Transient_Phase_Current_A
        DID_EE9D_Transient_Phase_Current_B: DemDidIdentifier=61085, DemDidDataClassRef=DID_0xee9d_DID_EE9D_Transient_Phase_Current_B
        DID_EE9E_Transient_Phase_Current_C: DemDidIdentifier=61086, DemDidDataClassRef=DID_0xee9e_DID_EE9E_Transient_Phase_Current_C
        DID_EE9F_Gate_Status: DemDidIdentifier=61087, DemDidDataClassRef=DID_0xee9f_DID_EE9F_Gate_Status
        DID_EEB2_Three_Phase_Motor_Current_RMS_Current: DemDidIdentifier=61106, DemDidDataClassRef=DID_0xeeb2_DID_EEB2_Three_Phase_Motor_Current_RMS_Current
        DID_EEB5_IEM_MGM_current_torque: DemDidIdentifier=61109, DemDidDataClassRef=DID_0xeeb5_DID_EEB5_IEMMGM_current_torque
        DID_EEB6_ECM_Power_Limitation_maximum: DemDidIdentifier=61110, DemDidDataClassRef=DID_0xeeb6_DID_EEB6_ECM_Power_Limitation_maximum
        DID_EEB7_ECM_Power_Limitation_minimum: DemDidIdentifier=61111, DemDidDataClassRef=DID_0xeeb7_DID_EEB7_ECM_Power_Limitation_minimum
        DID_EEB8_HV_voltage_received_from_BECM: DemDidIdentifier=61112, DemDidDataClassRef=DID_0xeeb8_DID_EEB8_HV_voltage_received_from_BECM
        DID_EEBE_Offset_angle_status: DemDidIdentifier=61118, DemDidDataClassRef=DID_0xeebe_DID_EEBE_Offset_angle_status
        DID_EEBF_HV_Main_Relay_Status: DemDidIdentifier=61119, DemDidDataClassRef=DID_0xeebf_DID_EEBF_HV_Main_Relay_Status
        DID_EEC3_ECU_power_supply_Voltage: DemDidIdentifier=61123, DemDidDataClassRef=DID_0xeec3_DID_EEC3_ECU_power_supply_Voltage
        DID_EEC4_Charging_Power_Sustain_Relay_CPSR_Voltage: DemDidIdentifier=61124, DemDidDataClassRef=DID_0xeec4_DID_EEC4_Charging_Power_Sustain_RelayCPSR_Voltage
        DID_EED1_Safty_monitor_Fault_Indication: DemDidIdentifier=61137, DemDidDataClassRef=DID_0xeed1_EED1_0, DemDidDataClassRef=DID_0xeed1_EED1_1, DemDidDataClassRef=DID_0xeed1_EED1_2, DemDidDataClassRef=DID_0xeed1_EED1_3
        DID_0xEEC7_1: DemDidIdentifier=61138, DemDidDataClassRef=DID_0xeed2_DID_EED2_SaftyTorque
        DID_EED3_Safety_speed: DemDidIdentifier=61139, DemDidDataClassRef=DID_0xeed3_DID_EED3_Safety_speed
        DID_EED4_Safty_Function_Mode: DemDidIdentifier=61140, DemDidDataClassRef=DID_0xeed4_DID_EED4_Safty_Function_Mode
        DID_EED5_Safety_Torque_QF_factor: DemDidIdentifier=61141, DemDidDataClassRef=DID_0xeed5_EED5_Safety_Torque_Quality_factor
      155 x DemEnableCondition:
        KL15
        active
        Inverter
        LV
        initliazation
        is
        done
        KL30
        Voltage9
        V
        No
        INV_EM_STATOR_TEMP_RNG_HI
        INV_EM_STATOR_TEMP_RNG_LO
        abs
        SpdAct
        rpm
        AND
        no_001
        offset
        error
        in
        any
        phase
        system
        torque
        control
        mode
        P5
        work
        normally
        normallye
        INV_IAC_U_ELEC_HI
        INV_IAC_U_ELEC_LO
        INV_IAC_V_ELEC_HI
        INV_IAC_V_ELEC_LO
        INV_IAC_W_ELEC_HI
        INV_IAC_W_ELEC_LO
        Ubat
        UsageMode
        Driving
        current
        sensor
        faults
        IGBT
        resolver
        Not
        ASC
        Request
        toruqe
        Nm
        not_001
        P15
        fault
        SPI
        E
        motor
        CU
        temp
        range
        high
        low
        CU_temp
        faulte
        PS
        for
        discharge
        NO_002
        HVAC
        operation
        init
        test
        Prop
        CAN
        BusOff
        When
        the
        ECU
        enters
        or
        exit
        bus
        off
        state
        The_001
        generic
        run
        criteria
        A
        below
        shall
        be
        fulfilled
        DTC
        tests
        all
        time
        that
        with
        exceptions
        according
        to
        inhibited
        when_001
        electrical
        power
        availability
        limited
        as
        indicated
        by
        ElPowerLevel
        All_001
        during
        seconds
        from
        transition
        one
        car
        another
        inhibition
        start
        at
        notational
        consumption
        of
        signal
        a_001
        change
        requested
        and_001
        s
        vehicle
        set
        modes
        Factory
        Transport
        Crash
        Enabled
        while
        Bulk
        Test_001
        runs
        each
        Car_001
        Configuration
        block
        received
        once
        passed
        Every
        global
        configuration_001
        parameter
        used
        until
      ExtendedDataClass_5ecd55b9 (DemExtendedDataClass):
        DemExtendedDataRecordClassRef = OperCycCnt{1..6}
        DemExtendedDataRecordClassRef = DTCfaultdetectioncounter
        DemExtendedDataRecordClassRef = MaxDTCDetCntThisCycle
        DemExtendedDataRecordClassRef = MaxDTCSinClear
        DemExtendedDataRecordClassRef = DTCTimeStamp20
        DemExtendedDataRecordClassRef = DTCTimeStamp21
        DemExtendedDataRecordClassRef = DTCStatusindicator30
      34 x DemEnableConditionGroup:
        EnableConditionGroup_02c4dcbd: DemEnableConditionRef=Inverter, DemEnableConditionRef=LV, DemEnableConditionRef=control, DemEnableConditionRef=done, DemEnableConditionRef=in, DemEnableConditionRef=initliazation, DemEnableConditionRef=is, DemEnableConditionRef=mode, DemEnableConditionRef=system, DemEnableConditionRef=torque
        EnableConditionGroup_06a6aa19: DemEnableConditionRef=KL15, DemEnableConditionRef=KL30, DemEnableConditionRef=V, DemEnableConditionRef=Voltage9, DemEnableConditionRef=active
        EnableConditionGroup_0cc796ea: DemEnableConditionRef=KL15, DemEnableConditionRef=active, DemEnableConditionRef=in, DemEnableConditionRef=mode, DemEnableConditionRef=mode, DemEnableConditionRef=operation
        EnableConditionGroup_0d30bf3f: DemEnableConditionRef=AND, DemEnableConditionRef=Inverter, DemEnableConditionRef=KL15, DemEnableConditionRef=LV, DemEnableConditionRef=SpdAct, DemEnableConditionRef=abs, DemEnableConditionRef=active, DemEnableConditionRef=any, DemEnableConditionRef=done, DemEnableConditionRef=error, DemEnableConditionRef=in, DemEnableConditionRef=initliazation, DemEnableConditionRef=is, DemEnableConditionRef=no_001, DemEnableConditionRef=offset, DemEnableConditionRef=phase, DemEnableConditionRef=rpm
        EnableConditionGroup_0e207db3: DemEnableConditionRef=ASC, DemEnableConditionRef=IGBT, DemEnableConditionRef=Inverter, DemEnableConditionRef=LV, DemEnableConditionRef=Nm, DemEnableConditionRef=No, DemEnableConditionRef=No, DemEnableConditionRef=Not, DemEnableConditionRef=Request, DemEnableConditionRef=control, DemEnableConditionRef=current, DemEnableConditionRef=done, DemEnableConditionRef=error, DemEnableConditionRef=faults, DemEnableConditionRef=faults, DemEnableConditionRef=in, DemEnableConditionRef=in, DemEnableConditionRef=initliazation, DemEnableConditionRef=is, DemEnableConditionRef=mode, DemEnableConditionRef=no_001, DemEnableConditionRef=not_001, DemEnableConditionRef=resolver, DemEnableConditionRef=sensor, DemEnableConditionRef=system, DemEnableConditionRef=torque, DemEnableConditionRef=toruqe
        EnableConditionGroup_1027fc3a: DemEnableConditionRef=Inverter, DemEnableConditionRef=KL15, DemEnableConditionRef=LV, DemEnableConditionRef=P15, DemEnableConditionRef=active, DemEnableConditionRef=done, DemEnableConditionRef=fault, DemEnableConditionRef=initliazation, DemEnableConditionRef=is, DemEnableConditionRef=no_001
        EnableConditionGroup_14eabb2c: DemEnableConditionRef=Inverter, DemEnableConditionRef=LV, DemEnableConditionRef=done, DemEnableConditionRef=initliazation, DemEnableConditionRef=is
        EnableConditionGroup_16bf7de5: DemEnableConditionRef=ECU, DemEnableConditionRef=Every, DemEnableConditionRef=a_001, DemEnableConditionRef=configuration_001, DemEnableConditionRef=configuration_001, DemEnableConditionRef=for, DemEnableConditionRef=global, DemEnableConditionRef=is, DemEnableConditionRef=of, DemEnableConditionRef=parameter, DemEnableConditionRef=passed, DemEnableConditionRef=received, DemEnableConditionRef=test, DemEnableConditionRef=the, DemEnableConditionRef=time, DemEnableConditionRef=until, DemEnableConditionRef=used
        EnableConditionGroup_2747052a: DemEnableConditionRef=Inverter, DemEnableConditionRef=KL15, DemEnableConditionRef=LV, DemEnableConditionRef=P5, DemEnableConditionRef=active, DemEnableConditionRef=done, DemEnableConditionRef=initliazation, DemEnableConditionRef=is, DemEnableConditionRef=normally, DemEnableConditionRef=work
        EnableConditionGroup_30df4d87: DemEnableConditionRef=Inverter, DemEnableConditionRef=KL15, DemEnableConditionRef=LV, DemEnableConditionRef=No, DemEnableConditionRef=active, DemEnableConditionRef=done, DemEnableConditionRef=fault, DemEnableConditionRef=initliazation, DemEnableConditionRef=is, DemEnableConditionRef=resolver
        EnableConditionGroup_361fad53: DemEnableConditionRef=IGBT, DemEnableConditionRef=Inverter, DemEnableConditionRef=LV, DemEnableConditionRef=No, DemEnableConditionRef=No, DemEnableConditionRef=control, DemEnableConditionRef=current, DemEnableConditionRef=done, DemEnableConditionRef=error, DemEnableConditionRef=faults, DemEnableConditionRef=faults, DemEnableConditionRef=in, DemEnableConditionRef=initliazation, DemEnableConditionRef=is, DemEnableConditionRef=mode, DemEnableConditionRef=no_001, DemEnableConditionRef=resolver, DemEnableConditionRef=sensor, DemEnableConditionRef=system, DemEnableConditionRef=torque
        EnableConditionGroup_377893c9: DemEnableConditionRef=A, DemEnableConditionRef=A, DemEnableConditionRef=All_001, DemEnableConditionRef=All_001, DemEnableConditionRef=Crash, DemEnableConditionRef=DTC, DemEnableConditionRef=DTC, DemEnableConditionRef=DTC, DemEnableConditionRef=DTC, DemEnableConditionRef=ECU, DemEnableConditionRef=ECU, DemEnableConditionRef=ElPowerLevel, DemEnableConditionRef=Factory, DemEnableConditionRef=The_001, DemEnableConditionRef=The_001, DemEnableConditionRef=The_001, DemEnableConditionRef=Transport, DemEnableConditionRef=When, DemEnableConditionRef=a_001, DemEnableConditionRef=according, DemEnableConditionRef=active, DemEnableConditionRef=all, DemEnableConditionRef=and_001, DemEnableConditionRef=another, DemEnableConditionRef=any, DemEnableConditionRef=any, DemEnableConditionRef=as, DemEnableConditionRef=at, DemEnableConditionRef=availability, DemEnableConditionRef=be, DemEnableConditionRef=be, DemEnableConditionRef=be, DemEnableConditionRef=be, DemEnableConditionRef=be, DemEnableConditionRef=below, DemEnableConditionRef=below, DemEnableConditionRef=bus, DemEnableConditionRef=by, DemEnableConditionRef=car, DemEnableConditionRef=car, DemEnableConditionRef=car, DemEnableConditionRef=car, DemEnableConditionRef=change, DemEnableConditionRef=consumption, DemEnableConditionRef=criteria, DemEnableConditionRef=during, DemEnableConditionRef=electrical, DemEnableConditionRef=enters, DemEnableConditionRef=exceptions, DemEnableConditionRef=exit, DemEnableConditionRef=for, DemEnableConditionRef=from, DemEnableConditionRef=from, DemEnableConditionRef=fulfilled, DemEnableConditionRef=generic, DemEnableConditionRef=in, DemEnableConditionRef=in, DemEnableConditionRef=indicated, DemEnableConditionRef=inhibited, DemEnableConditionRef=inhibited, DemEnableConditionRef=inhibited, DemEnableConditionRef=inhibition, DemEnableConditionRef=is, DemEnableConditionRef=is, DemEnableConditionRef=is, DemEnableConditionRef=is, DemEnableConditionRef=limited, DemEnableConditionRef=mode, DemEnableConditionRef=mode, DemEnableConditionRef=mode, DemEnableConditionRef=modes, DemEnableConditionRef=notational, DemEnableConditionRef=of, DemEnableConditionRef=of, DemEnableConditionRef=of, DemEnableConditionRef=off, DemEnableConditionRef=one, DemEnableConditionRef=operation, DemEnableConditionRef=or, DemEnableConditionRef=or, DemEnableConditionRef=power, DemEnableConditionRef=requested, DemEnableConditionRef=run, DemEnableConditionRef=run, DemEnableConditionRef=s, DemEnableConditionRef=s, DemEnableConditionRef=seconds, DemEnableConditionRef=set, DemEnableConditionRef=shall, DemEnableConditionRef=shall, DemEnableConditionRef=shall, DemEnableConditionRef=shall, DemEnableConditionRef=shall, DemEnableConditionRef=shall, DemEnableConditionRef=shall, DemEnableConditionRef=signal, DemEnableConditionRef=start, DemEnableConditionRef=state, DemEnableConditionRef=test, DemEnableConditionRef=tests, DemEnableConditionRef=tests, DemEnableConditionRef=tests, DemEnableConditionRef=tests, DemEnableConditionRef=that, DemEnableConditionRef=the, DemEnableConditionRef=the, DemEnableConditionRef=the, DemEnableConditionRef=the, DemEnableConditionRef=the, DemEnableConditionRef=the, DemEnableConditionRef=the, DemEnableConditionRef=time, DemEnableConditionRef=to, DemEnableConditionRef=to, DemEnableConditionRef=transition, DemEnableConditionRef=vehicle, DemEnableConditionRef=when_001, DemEnableConditionRef=when_001, DemEnableConditionRef=when_001, DemEnableConditionRef=with
        EnableConditionGroup_3b30fb61: DemEnableConditionRef=Request, DemEnableConditionRef=active, DemEnableConditionRef=active, DemEnableConditionRef=discharge, DemEnableConditionRef=for, DemEnableConditionRef=is
        EnableConditionGroup_4c1ef766: DemEnableConditionRef=Inverter, DemEnableConditionRef=KL15, DemEnableConditionRef=LV, DemEnableConditionRef=No, DemEnableConditionRef=P15, DemEnableConditionRef=P5, DemEnableConditionRef=active, DemEnableConditionRef=current, DemEnableConditionRef=done, DemEnableConditionRef=faults, DemEnableConditionRef=initliazation, DemEnableConditionRef=is, DemEnableConditionRef=normally, DemEnableConditionRef=sensor, DemEnableConditionRef=work
        EnableConditionGroup_500f9dc2: DemEnableConditionRef=Inverter, DemEnableConditionRef=KL15, DemEnableConditionRef=LV, DemEnableConditionRef=active, DemEnableConditionRef=control, DemEnableConditionRef=done, DemEnableConditionRef=in, DemEnableConditionRef=initliazation, DemEnableConditionRef=is, DemEnableConditionRef=mode, DemEnableConditionRef=system, DemEnableConditionRef=torque
        EnableConditionGroup_57b85250: DemEnableConditionRef=CU_temp, DemEnableConditionRef=Inverter, DemEnableConditionRef=KL15, DemEnableConditionRef=LV, DemEnableConditionRef=No, DemEnableConditionRef=active, DemEnableConditionRef=done, DemEnableConditionRef=fault, DemEnableConditionRef=initliazation, DemEnableConditionRef=is
        EnableConditionGroup_5ab64ab8: DemEnableConditionRef=Inverter, DemEnableConditionRef=KL15, DemEnableConditionRef=LV, DemEnableConditionRef=P5, DemEnableConditionRef=active, DemEnableConditionRef=done, DemEnableConditionRef=fault, DemEnableConditionRef=initliazation, DemEnableConditionRef=is, DemEnableConditionRef=no_001
        EnableConditionGroup_6698c395: DemEnableConditionRef=Inverter, DemEnableConditionRef=KL15, DemEnableConditionRef=LV, DemEnableConditionRef=active, DemEnableConditionRef=done, DemEnableConditionRef=error, DemEnableConditionRef=initliazation, DemEnableConditionRef=is, DemEnableConditionRef=no_001, DemEnableConditionRef=resolver
        EnableConditionGroup_6f8868bd: DemEnableConditionRef=BusOff, DemEnableConditionRef=CAN, DemEnableConditionRef=KL15, DemEnableConditionRef=KL30, DemEnableConditionRef=Prop, DemEnableConditionRef=V, DemEnableConditionRef=Voltage9, DemEnableConditionRef=active, DemEnableConditionRef=no_001
        EnableConditionGroup_7ab46a93: DemEnableConditionRef=Inverter, DemEnableConditionRef=KL15, DemEnableConditionRef=LV, DemEnableConditionRef=active, DemEnableConditionRef=done, DemEnableConditionRef=initliazation, DemEnableConditionRef=is
        EnableConditionGroup_7cfce1b1: DemEnableConditionRef=Inverter, DemEnableConditionRef=LV, DemEnableConditionRef=PS, DemEnableConditionRef=V, DemEnableConditionRef=done, DemEnableConditionRef=fault, DemEnableConditionRef=initliazation, DemEnableConditionRef=is, DemEnableConditionRef=no_001
        EnableConditionGroup_830522f7: DemEnableConditionRef=AND, DemEnableConditionRef=Driving, DemEnableConditionRef=Ubat, DemEnableConditionRef=UsageMode, DemEnableConditionRef=V
        EnableConditionGroup_87177a06: DemEnableConditionRef=CU, DemEnableConditionRef=Inverter, DemEnableConditionRef=KL15, DemEnableConditionRef=LV, DemEnableConditionRef=active, DemEnableConditionRef=done, DemEnableConditionRef=faulte, DemEnableConditionRef=initliazation, DemEnableConditionRef=is, DemEnableConditionRef=no_001, DemEnableConditionRef=sensor, DemEnableConditionRef=temp
        EnableConditionGroup_90577524: DemEnableConditionRef=DemGeneral/INV_EM_STATOR_TEMP_RNG_HI, DemEnableConditionRef=DemGeneral/INV_EM_STATOR_TEMP_RNG_LO, DemEnableConditionRef=Inverter, DemEnableConditionRef=KL15, DemEnableConditionRef=LV, DemEnableConditionRef=No, DemEnableConditionRef=No, DemEnableConditionRef=active, DemEnableConditionRef=done, DemEnableConditionRef=initliazation, DemEnableConditionRef=is
        EnableConditionGroup_9e78dd86: DemEnableConditionRef=Inverter, DemEnableConditionRef=KL15, DemEnableConditionRef=LV, DemEnableConditionRef=No, DemEnableConditionRef=P5, DemEnableConditionRef=active, DemEnableConditionRef=current, DemEnableConditionRef=done, DemEnableConditionRef=faults, DemEnableConditionRef=initliazation, DemEnableConditionRef=is, DemEnableConditionRef=normally, DemEnableConditionRef=sensor, DemEnableConditionRef=work
        EnableConditionGroup_b321d2d1: DemEnableConditionRef=Bulk, DemEnableConditionRef=Car_001, DemEnableConditionRef=Configuration, DemEnableConditionRef=ECU, DemEnableConditionRef=Enabled, DemEnableConditionRef=Test_001, DemEnableConditionRef=Test_001, DemEnableConditionRef=a_001, DemEnableConditionRef=block, DemEnableConditionRef=each, DemEnableConditionRef=in, DemEnableConditionRef=inhibited, DemEnableConditionRef=is, DemEnableConditionRef=is, DemEnableConditionRef=is, DemEnableConditionRef=once, DemEnableConditionRef=passed, DemEnableConditionRef=received, DemEnableConditionRef=runs, DemEnableConditionRef=state, DemEnableConditionRef=time, DemEnableConditionRef=while
        EnableConditionGroup_c56dc4a6: DemEnableConditionRef=KL15, DemEnableConditionRef=active, DemEnableConditionRef=init, DemEnableConditionRef=test
        EnableConditionGroup_d13c1487: DemEnableConditionRef=E, DemEnableConditionRef=Inverter, DemEnableConditionRef=KL15, DemEnableConditionRef=LV, DemEnableConditionRef=No, DemEnableConditionRef=active, DemEnableConditionRef=done, DemEnableConditionRef=faults, DemEnableConditionRef=initliazation, DemEnableConditionRef=is, DemEnableConditionRef=motor, DemEnableConditionRef=sensor
        EnableConditionGroup_d38dfb27: DemEnableConditionRef=Inverter, DemEnableConditionRef=KL15, DemEnableConditionRef=LV, DemEnableConditionRef=P5, DemEnableConditionRef=active, DemEnableConditionRef=done, DemEnableConditionRef=initliazation, DemEnableConditionRef=is, DemEnableConditionRef=normallye, DemEnableConditionRef=work
        EnableConditionGroup_d8c05f30: DemEnableConditionRef=HVAC, DemEnableConditionRef=Inverter, DemEnableConditionRef=KL15, DemEnableConditionRef=LV, DemEnableConditionRef=NO_002, DemEnableConditionRef=SpdAct, DemEnableConditionRef=abs, DemEnableConditionRef=active, DemEnableConditionRef=current, DemEnableConditionRef=done, DemEnableConditionRef=fault, DemEnableConditionRef=initliazation, DemEnableConditionRef=is, DemEnableConditionRef=rpm, DemEnableConditionRef=sensor
        EnableConditionGroup_e2fc0f3d: DemEnableConditionRef=DemGeneral/INV_IAC_U_ELEC_HI, DemEnableConditionRef=DemGeneral/INV_IAC_U_ELEC_LO, DemEnableConditionRef=DemGeneral/INV_IAC_V_ELEC_HI, DemEnableConditionRef=DemGeneral/INV_IAC_V_ELEC_LO, DemEnableConditionRef=DemGeneral/INV_IAC_W_ELEC_HI, DemEnableConditionRef=DemGeneral/INV_IAC_W_ELEC_LO, DemEnableConditionRef=Inverter, DemEnableConditionRef=LV, DemEnableConditionRef=No, DemEnableConditionRef=No, DemEnableConditionRef=No, DemEnableConditionRef=done, DemEnableConditionRef=initliazation, DemEnableConditionRef=is
        EnableConditionGroup_f2368ecb: DemEnableConditionRef=CU, DemEnableConditionRef=CU, DemEnableConditionRef=Inverter, DemEnableConditionRef=KL15, DemEnableConditionRef=LV, DemEnableConditionRef=No, DemEnableConditionRef=No, DemEnableConditionRef=active, DemEnableConditionRef=done, DemEnableConditionRef=fault, DemEnableConditionRef=fault, DemEnableConditionRef=high, DemEnableConditionRef=initliazation, DemEnableConditionRef=is, DemEnableConditionRef=low, DemEnableConditionRef=range, DemEnableConditionRef=range, DemEnableConditionRef=temp, DemEnableConditionRef=temp
        EnableConditionGroup_f496e085: DemEnableConditionRef=KL15, DemEnableConditionRef=active
        EnableConditionGroup_fecd1d5c: DemEnableConditionRef=KL15, DemEnableConditionRef=SPI, DemEnableConditionRef=active, DemEnableConditionRef=faults, DemEnableConditionRef=no_001
      12 x DemExtendedDataRecordClass:
        OperCycCnt{1..6}: DemExtendedDataRecordNumber={1..6}, DemDataClassRef=OperCycCnt{1..6}_OperCycCnt{1..6}
        DTCfaultdetectioncounter: DemExtendedDataRecordNumber=16, DemDataClassRef=DTCfaultdetectioncounter_DTCFltDetCnt
        MaxDTCDetCntThisCycle: DemExtendedDataRecordNumber=17, DemDataClassRef=MaxDTCDetCntThisCycle_MaxDTCDetCntThisCycle
        MaxDTCSinClear: DemExtendedDataRecordNumber=18, DemDataClassRef=MaxDTCSinClear_MaxDTCSinClear
        DTCTimeStamp20: DemExtendedDataRecordNumber=32, DemDataClassRef=DTCTimeStamp20_DTCTimeStamp20
        DTCTimeStamp21: DemExtendedDataRecordNumber=33, DemDataClassRef=DTCTimeStamp21_DTCTimeStamp21
        DTCStatusindicator30: DemExtendedDataRecordNumber=48, DemDataClassRef=DTCStatusindicator30_DTCStatusindicator30
      4 x DemFreezeFrameClass, all with DemDidClassRef=DemGeneral/DID_D003_Vehicle_Speed, DemDidClassRef=DemGeneral/DID_DD00_Global_Real_Time, DemDidClassRef=DemGeneral/DID_DD01_Total_Distance, DemDidClassRef=DemGeneral/DID_DD0A_Usage_Mode, DemDidClassRef=DemGeneral/DID_DD0C_Electric_Power_Level, DemDidClassRef=DemGeneral/DID_E303_Motor_Speed, DemDidClassRef=DemGeneral/DID_E304_Actual_Torque, DemDidClassRef=DemGeneral/DID_E307_System_Mode, DemDidClassRef=DemGeneral/DID_E308_ECM_Torque_Request, DemDidClassRef=DemGeneral/DID_E309_ECM_Mode_Request, DemDidClassRef=DemGeneral/DID_E310_IEM_MGM_Derating_Status, DemDidClassRef=DemGeneral/DID_E312_Wheel_Speed, DemDidClassRef=DemGeneral/DID_E314_Available_Torque_maximum, DemDidClassRef=DemGeneral/DID_E315_Available_Torque_minimum, DemDidClassRef=DemGeneral/DID_E333_2002_State, DemDidClassRef=DemGeneral/DID_E335_d_axis_current_setpoint, DemDidClassRef=DemGeneral/DID_E336_d_axis_current_feedback, DemDidClassRef=DemGeneral/DID_E337_q_axis_current_setpoint, DemDidClassRef=DemGeneral/DID_E338_q_axis_current_feedback, DemDidClassRef=DemGeneral/DID_E346_ECM_Torque_Allowed_Status, DemDidClassRef=DemGeneral/DID_EE9A_Inverter_Coolant_Temperature, DemDidClassRef=DemGeneral/DID_EEB2_Three_Phase_Motor_Current_RMS_Current:
        FreezeFrameClass_5b6f811c: DemDidClassRef=DemGeneral/DID_DD02_Vehicle_Battery_Voltage, DemDidClassRef=DemGeneral/DID_E300_HVDC_Voltage, DemDidClassRef=DemGeneral/DID_E301_HVDC_Current, DemDidClassRef=DemGeneral/DID_E305_Inverter_IGBT_Junction_Temp, DemDidClassRef=DemGeneral/DID_E306_Motor_Temperature, DemDidClassRef=DemGeneral/DID_E311_Crash_Status, DemDidClassRef=DemGeneral/DID_E313_Active_discharge_status, DemDidClassRef=DemGeneral/DID_E319_Torque_Direction, DemDidClassRef=DemGeneral/DID_E320_System_Mode_Mismatch, DemDidClassRef=DemGeneral/DID_E324_Motor_Derating_reason_of_IEM_MGM, DemDidClassRef=DemGeneral/DID_E339_d_axis_voltage, DemDidClassRef=DemGeneral/DID_E341_q_axis_voltage, DemDidClassRef=DemGeneral/DID_E347_IGBT_Max_Temperature, DemDidClassRef=DemGeneral/DID_E348_Phase_U_PWM_duty, DemDidClassRef=DemGeneral/DID_E349_Phase_V_PWM_duty, DemDidClassRef=DemGeneral/DID_E350_Phase_W_PWM_duty, DemDidClassRef=DemGeneral/DID_E353_Flux_weakening_correction_factor, DemDidClassRef=DemGeneral/DID_E357_Resolve_compensated_angle, DemDidClassRef=DemGeneral/DID_E358_Resolve_angle, DemDidClassRef=DemGeneral/DID_E363_Modulation_index, DemDidClassRef=DemGeneral/DID_E364_AURIX_Fault_Indication, DemDidClassRef=DemGeneral/DID_EE9C_Transient_Phase_Current_A, DemDidClassRef=DemGeneral/DID_EE9D_Transient_Phase_Current_B, DemDidClassRef=DemGeneral/DID_EE9E_Transient_Phase_Current_C, DemDidClassRef=DemGeneral/DID_EE9F_Gate_Status, DemDidClassRef=DemGeneral/DID_EEB5_IEM_MGM_current_torque, DemDidClassRef=DemGeneral/DID_EEB6_ECM_Power_Limitation_maximum, DemDidClassRef=DemGeneral/DID_EEB7_ECM_Power_Limitation_minimum, DemDidClassRef=DemGeneral/DID_EEB8_HV_voltage_received_from_BECM, DemDidClassRef=DemGeneral/DID_EEBE_Offset_angle_status, DemDidClassRef=DemGeneral/DID_EEBF_HV_Main_Relay_Status, DemDidClassRef=DemGeneral/DID_EEC3_ECU_power_supply_Voltage, DemDidClassRef=DemGeneral/DID_EEC4_Charging_Power_Sustain_Relay_CPSR_Voltage, DemDidClassRef=DemGeneral/DID_EED1_Safty_monitor_Fault_Indication, DemDidClassRef=DemGeneral/DID_0xEEC7_1, DemDidClassRef=DemGeneral/DID_EED3_Safety_speed, DemDidClassRef=DemGeneral/DID_EED4_Safty_Function_Mode, DemDidClassRef=DemGeneral/DID_EED5_Safety_Torque_QF_factor
        FreezeFrameClass_79980272: DemDidClassRef=DemGeneral/DID_DD02_Vehicle_Battery_Voltage, DemDidClassRef=DemGeneral/DID_E300_HVDC_Voltage, DemDidClassRef=DemGeneral/DID_E301_HVDC_Current, DemDidClassRef=DemGeneral/DID_E305_Inverter_IGBT_Junction_Temp, DemDidClassRef=DemGeneral/DID_E306_Motor_Temperature, DemDidClassRef=DemGeneral/DID_E311_Crash_Status, DemDidClassRef=DemGeneral/DID_E313_Active_discharge_status, DemDidClassRef=DemGeneral/DID_E319_Torque_Direction, DemDidClassRef=DemGeneral/DID_E320_System_Mode_Mismatch, DemDidClassRef=DemGeneral/DID_E324_Motor_Derating_reason_of_IEM_MGM, DemDidClassRef=DemGeneral/DID_E339_d_axis_voltage, DemDidClassRef=DemGeneral/DID_E341_q_axis_voltage, DemDidClassRef=DemGeneral/DID_E347_IGBT_Max_Temperature, DemDidClassRef=DemGeneral/DID_E348_Phase_U_PWM_duty, DemDidClassRef=DemGeneral/DID_E349_Phase_V_PWM_duty, DemDidClassRef=DemGeneral/DID_E350_Phase_W_PWM_duty, DemDidClassRef=DemGeneral/DID_E353_Flux_weakening_correction_factor, DemDidClassRef=DemGeneral/DID_E357_Resolve_compensated_angle, DemDidClassRef=DemGeneral/DID_E358_Resolve_angle, DemDidClassRef=DemGeneral/DID_E363_Modulation_index, DemDidClassRef=DemGeneral/DID_E364_AURIX_Fault_Indication, DemDidClassRef=DemGeneral/DID_EE9C_Transient_Phase_Current_A, DemDidClassRef=DemGeneral/DID_EE9D_Transient_Phase_Current_B, DemDidClassRef=DemGeneral/DID_EE9E_Transient_Phase_Current_C, DemDidClassRef=DemGeneral/DID_EE9F_Gate_Status, DemDidClassRef=DemGeneral/DID_EEB5_IEM_MGM_current_torque
        FreezeFrameClass_c3111450: DemDidClassRef=DemGeneral/DID_DD02_Vehicle_Battery_Voltage, DemDidClassRef=DemGeneral/DID_E300_HVDC_Voltage, DemDidClassRef=DemGeneral/DID_E301_HVDC_Current, DemDidClassRef=DemGeneral/DID_E305_Inverter_IGBT_Junction_Temp, DemDidClassRef=DemGeneral/DID_E306_Motor_Temperature, DemDidClassRef=DemGeneral/DID_E311_Crash_Status, DemDidClassRef=DemGeneral/DID_E313_Active_discharge_status, DemDidClassRef=DemGeneral/DID_E319_Torque_Direction, DemDidClassRef=DemGeneral/DID_E320_System_Mode_Mismatch, DemDidClassRef=DemGeneral/DID_E324_Motor_Derating_reason_of_IEM_MGM, DemDidClassRef=DemGeneral/DID_E339_d_axis_voltage, DemDidClassRef=DemGeneral/DID_E341_q_axis_voltage, DemDidClassRef=DemGeneral/DID_E347_IGBT_Max_Temperature, DemDidClassRef=DemGeneral/DID_E348_Phase_U_PWM_duty, DemDidClassRef=DemGeneral/DID_E349_Phase_V_PWM_duty, DemDidClassRef=DemGeneral/DID_E350_Phase_W_PWM_duty, DemDidClassRef=DemGeneral/DID_E353_Flux_weakening_correction_factor, DemDidClassRef=DemGeneral/DID_E357_Resolve_compensated_angle, DemDidClassRef=DemGeneral/DID_E358_Resolve_angle, DemDidClassRef=DemGeneral/DID_E363_Modulation_index, DemDidClassRef=DemGeneral/DID_E364_AURIX_Fault_Indication, DemDidClassRef=DemGeneral/DID_EE9C_Transient_Phase_Current_A, DemDidClassRef=DemGeneral/DID_EE9D_Transient_Phase_Current_B, DemDidClassRef=DemGeneral/DID_EE9E_Transient_Phase_Current_C, DemDidClassRef=DemGeneral/DID_EE9F_Gate_Status, DemDidClassRef=DemGeneral/DID_EEB5_IEM_MGM_current_torque, DemDidClassRef=DemGeneral/DID_EEB6_ECM_Power_Limitation_maximum, DemDidClassRef=DemGeneral/DID_EEB7_ECM_Power_Limitation_minimum, DemDidClassRef=DemGeneral/DID_EEB8_HV_voltage_received_from_BECM, DemDidClassRef=DemGeneral/DID_EEBE_Offset_angle_status, DemDidClassRef=DemGeneral/DID_EEBF_HV_Main_Relay_Status, DemDidClassRef=DemGeneral/DID_EEC3_ECU_power_supply_Voltage, DemDidClassRef=DemGeneral/DID_EEC4_Charging_Power_Sustain_Relay_CPSR_Voltage
        FreezeFrameClass_dc4c3f47: DemDidClassRef=DemGeneral/DID_EEB8_HV_voltage_received_from_BECM, DemDidClassRef=DemGeneral/DID_EEBF_HV_Main_Relay_Status, DemDidClassRef=DemGeneral/DID_EEC3_ECU_power_supply_Voltage, DemDidClassRef=DemGeneral/DID_EEC4_Charging_Power_Sustain_Relay_CPSR_Voltage
      WarningIndicator (DemIndicator)
      PowerCycle (DemOperationCycle): DemOperationCycleType=DEM_OPCYC_POWER
      IgnitionCycle (DemOperationCycle): DemOperationCycleType=DEM_OPCYC_IGNITION
      82 x DemDataClass:
        DID_0xdd02_DID_DD02_Vehicle_Battery_Voltage: DemDataElementDataSize=1, DemDataElementDataType=UINT8, DemDataElementUsePort=USE_DATA_CLIENT_SERVER_PORT, DemDataElementStoreNonVolatile=true
        DID_0xdd0a_DID_DD0A_Usage_Mode: DemDataElementDataSize=1, DemDataElementDataType=UINT8, DemDataElementUsePort=USE_DATA_CLIENT_SERVER_PORT, DemDataElementStoreNonVolatile=true
        DID_0xdd0c_DID_DD0C_Electric_Power_Level: DemDataElementDataSize=1, DemDataElementDataType=UINT8, DemDataElementUsePort=USE_DATA_CLIENT_SERVER_PORT, DemDataElementStoreNonVolatile=true
        DID_0xe305_DID_E305_Inverter_IGBT_Junction_Temp: DemDataElementDataSize=1, DemDataElementDataType=UINT8, DemDataElementUsePort=USE_DATA_CLIENT_SERVER_PORT, DemDataElementStoreNonVolatile=true
        DID_0xe306_DID_E306_Motor_Temperature: DemDataElementDataSize=1, DemDataElementDataType=UINT8, DemDataElementUsePort=USE_DATA_CLIENT_SERVER_PORT, DemDataElementStoreNonVolatile=true
        DID_0xe307_DID_E307_System_Mode: DemDataElementDataSize=1, DemDataElementDataType=UINT8, DemDataElementUsePort=USE_DATA_CLIENT_SERVER_PORT, DemDataElementStoreNonVolatile=true
        DID_0xe309_DID_E309_ECM_Mode_Request: DemDataElementDataSize=1, DemDataElementDataType=UINT8, DemDataElementUsePort=USE_DATA_CLIENT_SERVER_PORT, DemDataElementStoreNonVolatile=true
        DID_0xe310_DID_E310_IEMMGM_Derating_Status: DemDataElementDataSize=1, DemDataElementDataType=UINT8, DemDataElementUsePort=USE_DATA_CLIENT_SERVER_PORT, DemDataElementStoreNonVolatile=true
        DID_0xe311_DID_E311_Crash_Status: DemDataElementDataSize=1, DemDataElementDataType=UINT8, DemDataElementUsePort=USE_DATA_CLIENT_SERVER_PORT, DemDataElementStoreNonVolatile=true
        DID_0xe313_DID_E313_Active_discharge_status: DemDataElementDataSize=1, DemDataElementDataType=UINT8, DemDataElementUsePort=USE_DATA_CLIENT_SERVER_PORT, DemDataElementStoreNonVolatile=true
        DID_0xe319_DID_E319_Torque_Direction: DemDataElementDataSize=1, DemDataElementDataType=UINT8, DemDataElementUsePort=USE_DATA_CLIENT_SERVER_PORT, DemDataElementStoreNonVolatile=true
        DID_0xe320_DID_E320_System_Mode_Mismatch: DemDataElementDataSize=1, DemDataElementDataType=UINT8, DemDataElementUsePort=USE_DATA_CLIENT_SERVER_PORT, DemDataElementStoreNonVolatile=true
        DID_0xe324_DID_E324_Motor_Derating_reason_of_IEMMGM: DemDataElementDataSize=1, DemDataElementDataType=UINT8, DemDataElementUsePort=USE_DATA_CLIENT_SERVER_PORT, DemDataElementStoreNonVolatile=true
        DID_0xe346_DID_E346_ECM_Torque_Allowed_Status: DemDataElementDataSize=1, DemDataElementDataType=UINT8, DemDataElementUsePort=USE_DATA_CLIENT_SERVER_PORT, DemDataElementStoreNonVolatile=true
        DID_0xe347_DID_E347_IGBT_Max_Temperature: DemDataElementDataSize=1, DemDataElementDataType=UINT8, DemDataElementUsePort=USE_DATA_CLIENT_SERVER_PORT, DemDataElementStoreNonVolatile=true
        DID_0xe348_DID_E348_Phase_U_PWM_duty: DemDataElementDataSize=1, DemDataElementDataType=UINT8, DemDataElementUsePort=USE_DATA_CLIENT_SERVER_PORT, DemDataElementStoreNonVolatile=true
        DID_0xe349_DID_E349_Phase_V_PWM_duty: DemDataElementDataSize=1, DemDataElementDataType=UINT8, DemDataElementUsePort=USE_DATA_CLIENT_SERVER_PORT, DemDataElementStoreNonVolatile=true
        DID_0xe350_DID_E350_Phase_W_PWM_duty: DemDataElementDataSize=1, DemDataElementDataType=UINT8, DemDataElementUsePort=USE_DATA_CLIENT_SERVER_PORT, DemDataElementStoreNonVolatile=true
        DID_0xe357_DID_E357_Resolve_compensated_angle: DemDataElementDataSize=1, DemDataElementDataType=UINT8, DemDataElementUsePort=USE_DATA_CLIENT_SERVER_PORT, DemDataElementStoreNonVolatile=true
        DID_0xe363_DID_E363_Modulation_index: DemDataElementDataSize=1, DemDataElementDataType=UINT8, DemDataElementUsePort=USE_DATA_CLIENT_SERVER_PORT, DemDataElementStoreNonVolatile=true
        DID_0xee9a_DID_EE9A_Inverter_Coolant_Temperature: DemDataElementDataSize=1, DemDataElementDataType=UINT8, DemDataElementUsePort=USE_DATA_CLIENT_SERVER_PORT, DemDataElementStoreNonVolatile=true
        DID_0xee9f_DID_EE9F_Gate_Status: DemDataElementDataSize=1, DemDataElementDataType=UINT8, DemDataElementUsePort=USE_DATA_CLIENT_SERVER_PORT, DemDataElementStoreNonVolatile=true
        DID_0xeebe_DID_EEBE_Offset_angle_status: DemDataElementDataSize=1, DemDataElementDataType=UINT8, DemDataElementUsePort=USE_DATA_CLIENT_SERVER_PORT, DemDataElementStoreNonVolatile=true
        DID_0xeebf_DID_EEBF_HV_Main_Relay_Status: DemDataElementDataSize=1, DemDataElementDataType=UINT8, DemDataElementUsePort=USE_DATA_CLIENT_SERVER_PORT, DemDataElementStoreNonVolatile=true
        DID_0xeec3_DID_EEC3_ECU_power_supply_Voltage: DemDataElementDataSize=1, DemDataElementDataType=UINT8, DemDataElementUsePort=USE_DATA_CLIENT_SERVER_PORT, DemDataElementStoreNonVolatile=true
        DID_0xeec4_DID_EEC4_Charging_Power_Sustain_RelayCPSR_Voltage: DemDataElementDataSize=1, DemDataElementDataType=UINT8, DemDataElementUsePort=USE_DATA_CLIENT_SERVER_PORT, DemDataElementStoreNonVolatile=true
        DTCStatusindicator30_DTCStatusindicator30: DemDataElementDataSize=1, DemDataElementDataType=UINT8, DemDataElementUsePort=USE_DATA_CLIENT_SERVER_PORT, DemDataElementStoreNonVolatile=true
        DID_0xeed1_EED1_{0..3}: DemDataElementDataSize=1, DemDataElementDataType=UINT8, DemDataElementUsePort=USE_DATA_CLIENT_SERVER_PORT, DemDataElementStoreNonVolatile=true
        DID_0xe333_2002_H_Ser: DemDataElementDataSize=1, DemDataElementDataType=UINT8, DemDataElementUsePort=USE_DATA_CLIENT_SERVER_PORT, DemDataElementStoreNonVolatile=true
        DID_0xe333_2002_L_Ser: DemDataElementDataSize=1, DemDataElementDataType=UINT8, DemDataElementUsePort=USE_DATA_CLIENT_SERVER_PORT, DemDataElementStoreNonVolatile=true
        DID_0xd003_DID_D003_Vehicle_Speed: DemDataElementDataSize=2, DemDataElementDataType=UINT16, DemDataElementEndianness=BIG_ENDIAN, DemDataElementUsePort=USE_DATA_CLIENT_SERVER_PORT, DemDataElementStoreNonVolatile=true
        DID_0xe300_DID_E300_HVDC_Voltage: DemDataElementDataSize=2, DemDataElementDataType=UINT16, DemDataElementEndianness=BIG_ENDIAN, DemDataElementUsePort=USE_DATA_CLIENT_SERVER_PORT, DemDataElementStoreNonVolatile=true
        DID_0xe301_DID_E301_HVDC_Current_: DemDataElementDataSize=2, DemDataElementDataType=UINT16, DemDataElementEndianness=BIG_ENDIAN, DemDataElementUsePort=USE_DATA_CLIENT_SERVER_PORT, DemDataElementStoreNonVolatile=true
        DID_0xe303_DID_E303_Motor_Speed_: DemDataElementDataSize=2, DemDataElementDataType=UINT16, DemDataElementEndianness=BIG_ENDIAN, DemDataElementUsePort=USE_DATA_CLIENT_SERVER_PORT, DemDataElementStoreNonVolatile=true
        DID_0xe304_DID_E304_Actual_Torque: DemDataElementDataSize=2, DemDataElementDataType=UINT16, DemDataElementEndianness=BIG_ENDIAN, DemDataElementUsePort=USE_DATA_CLIENT_SERVER_PORT, DemDataElementStoreNonVolatile=true
        DID_0xe308_DID_E308_ECM_Torque_Request: DemDataElementDataSize=2, DemDataElementDataType=UINT16, DemDataElementEndianness=BIG_ENDIAN, DemDataElementUsePort=USE_DATA_CLIENT_SERVER_PORT, DemDataElementStoreNonVolatile=true
        DID_0xe312_DID_E312_Wheel_Speed: DemDataElementDataSize=2, DemDataElementDataType=UINT16, DemDataElementEndianness=BIG_ENDIAN, DemDataElementUsePort=USE_DATA_CLIENT_SERVER_PORT, DemDataElementStoreNonVolatile=true
        DID_0xe314_DID_E314_Available_Torque_maximum: DemDataElementDataSize=2, DemDataElementDataType=UINT16, DemDataElementEndianness=BIG_ENDIAN, DemDataElementUsePort=USE_DATA_CLIENT_SERVER_PORT, DemDataElementStoreNonVolatile=true
        DID_0xe315_DID_E315_Available_Torque_minimum: DemDataElementDataSize=2, DemDataElementDataType=UINT16, DemDataElementEndianness=BIG_ENDIAN, DemDataElementUsePort=USE_DATA_CLIENT_SERVER_PORT, DemDataElementStoreNonVolatile=true
        DID_0xe335_DID_E335_d_axis_current_setpoint: DemDataElementDataSize=2, DemDataElementDataType=UINT16, DemDataElementEndianness=BIG_ENDIAN, DemDataElementUsePort=USE_DATA_CLIENT_SERVER_PORT, DemDataElementStoreNonVolatile=true
        DID_0xe336_DID_E336_d_axis_current_feedback: DemDataElementDataSize=2, DemDataElementDataType=UINT16, DemDataElementEndianness=BIG_ENDIAN, DemDataElementUsePort=USE_DATA_CLIENT_SERVER_PORT, DemDataElementStoreNonVolatile=true
        DID_0xe337_DID_E337_q_axis_current_setpoint: DemDataElementDataSize=2, DemDataElementDataType=UINT16, DemDataElementEndianness=BIG_ENDIAN, DemDataElementUsePort=USE_DATA_CLIENT_SERVER_PORT, DemDataElementStoreNonVolatile=true
        DID_0xe338_DID_E338_q_axis_current_feedback: DemDataElementDataSize=2, DemDataElementDataType=UINT16, DemDataElementEndianness=BIG_ENDIAN, DemDataElementUsePort=USE_DATA_CLIENT_SERVER_PORT, DemDataElementStoreNonVolatile=true
        DID_0xe339_DID_E339_d_axis_voltage: DemDataElementDataSize=2, DemDataElementDataType=UINT16, DemDataElementEndianness=BIG_ENDIAN, DemDataElementUsePort=USE_DATA_CLIENT_SERVER_PORT, DemDataElementStoreNonVolatile=true
        DID_0xe341_DID_E341_q_axis_voltage: DemDataElementDataSize=2, DemDataElementDataType=UINT16, DemDataElementEndianness=BIG_ENDIAN, DemDataElementUsePort=USE_DATA_CLIENT_SERVER_PORT, DemDataElementStoreNonVolatile=true
        DID_0xe353_DID_E353_Flux_weakening_correction_factor: DemDataElementDataSize=2, DemDataElementDataType=UINT16, DemDataElementEndianness=BIG_ENDIAN, DemDataElementUsePort=USE_DATA_CLIENT_SERVER_PORT, DemDataElementStoreNonVolatile=true
        DID_0xe358_DID_E358_Resolve_angle: DemDataElementDataSize=2, DemDataElementDataType=UINT16, DemDataElementEndianness=BIG_ENDIAN, DemDataElementUsePort=USE_DATA_CLIENT_SERVER_PORT, DemDataElementStoreNonVolatile=true
        DID_0xee9c_DID_EE9C_Transient_Phase_Current_A: DemDataElementDataSize=2, DemDataElementDataType=UINT16, DemDataElementEndianness=BIG_ENDIAN, DemDataElementUsePort=USE_DATA_CLIENT_SERVER_PORT, DemDataElementStoreNonVolatile=true
        DID_0xee9d_DID_EE9D_Transient_Phase_Current_B: DemDataElementDataSize=2, DemDataElementDataType=UINT16, DemDataElementEndianness=BIG_ENDIAN, DemDataElementUsePort=USE_DATA_CLIENT_SERVER_PORT, DemDataElementStoreNonVolatile=true
        DID_0xee9e_DID_EE9E_Transient_Phase_Current_C: DemDataElementDataSize=2, DemDataElementDataType=UINT16, DemDataElementEndianness=BIG_ENDIAN, DemDataElementUsePort=USE_DATA_CLIENT_SERVER_PORT, DemDataElementStoreNonVolatile=true
        DID_0xeeb2_DID_EEB2_Three_Phase_Motor_Current_RMS_Current: DemDataElementDataSize=2, DemDataElementDataType=UINT16, DemDataElementEndianness=BIG_ENDIAN, DemDataElementUsePort=USE_DATA_CLIENT_SERVER_PORT, DemDataElementStoreNonVolatile=true
        DID_0xeeb5_DID_EEB5_IEMMGM_current_torque: DemDataElementDataSize=2, DemDataElementDataType=UINT16, DemDataElementEndianness=BIG_ENDIAN, DemDataElementUsePort=USE_DATA_CLIENT_SERVER_PORT, DemDataElementStoreNonVolatile=true
        DID_0xeeb6_DID_EEB6_ECM_Power_Limitation_maximum: DemDataElementDataSize=2, DemDataElementDataType=UINT16, DemDataElementEndianness=BIG_ENDIAN, DemDataElementUsePort=USE_DATA_CLIENT_SERVER_PORT, DemDataElementStoreNonVolatile=true
        DID_0xeeb7_DID_EEB7_ECM_Power_Limitation_minimum: DemDataElementDataSize=2, DemDataElementDataType=UINT16, DemDataElementEndianness=BIG_ENDIAN, DemDataElementUsePort=USE_DATA_CLIENT_SERVER_PORT, DemDataElementStoreNonVolatile=true
        DID_0xeeb8_DID_EEB8_HV_voltage_received_from_BECM: DemDataElementDataSize=2, DemDataElementDataType=UINT16, DemDataElementEndianness=BIG_ENDIAN, DemDataElementUsePort=USE_DATA_CLIENT_SERVER_PORT, DemDataElementStoreNonVolatile=true
        DID_0xeed2_DID_EED2_SaftyTorque: DemDataElementDataSize=2, DemDataElementDataType=UINT16, DemDataElementEndianness=BIG_ENDIAN, DemDataElementUsePort=USE_DATA_CLIENT_SERVER_PORT, DemDataElementStoreNonVolatile=true
        DID_0xeed3_DID_EED3_Safety_speed: DemDataElementDataSize=2, DemDataElementDataType=UINT16, DemDataElementEndianness=BIG_ENDIAN, DemDataElementUsePort=USE_DATA_CLIENT_SERVER_PORT, DemDataElementStoreNonVolatile=true
        DID_0xdd00_DID_DD00_Global_Real_Time: DemDataElementDataSize=4, DemDataElementDataType=UINT32, DemDataElementEndianness=BIG_ENDIAN, DemDataElementUsePort=USE_DATA_CLIENT_SERVER_PORT, DemDataElementStoreNonVolatile=true
        DTCTimeStamp20_DTCTimeStamp20: DemDataElementDataSize=4, DemDataElementDataType=UINT32, DemDataElementEndianness=BIG_ENDIAN, DemDataElementUsePort=USE_DATA_CLIENT_SERVER_PORT, DemDataElementStoreNonVolatile=true
        DTCTimeStamp21_DTCTimeStamp21: DemDataElementDataSize=4, DemDataElementDataType=UINT32, DemDataElementEndianness=BIG_ENDIAN, DemDataElementUsePort=USE_DATA_CLIENT_SERVER_PORT, DemDataElementStoreNonVolatile=true
        DID_0xdd01_DID_DD01_Total_Distance: DemDataElementDataSize=3, DemDataElementDataType=UINT8_N, DemDataElementEndianness=opaque, DemDataElementUsePort=USE_DATA_CLIENT_SERVER_PORT, DemDataElementStoreNonVolatile=true
        DID_0xe364_DID_E364_AURIX_Fault_Indication: DemDataElementDataSize=1, DemDataElementDataType=UINT8_N, DemDataElementEndianness=opaque, DemDataElementUsePort=USE_DATA_CLIENT_SERVER_PORT, DemDataElementStoreNonVolatile=true
        DID_0xeed4_DID_EED4_Safty_Function_Mode: DemDataElementDataSize=1, DemDataElementDataType=UINT8_N, DemDataElementEndianness=opaque, DemDataElementUsePort=USE_DATA_CLIENT_SERVER_PORT, DemDataElementStoreNonVolatile=true
        DID_0xeed5_EED5_Safety_Torque_Quality_factor: DemDataElementDataSize=1, DemDataElementDataType=UINT8_N, DemDataElementEndianness=opaque, DemDataElementUsePort=USE_DATA_CLIENT_SERVER_PORT, DemDataElementStoreNonVolatile=true
        DID_0xe333_2002_Hu: DemDataElementDataSize=1, DemDataElementDataType=UINT8_N, DemDataElementEndianness=opaque, DemDataElementUsePort=USE_DATA_CLIENT_SERVER_PORT, DemDataElementStoreNonVolatile=true
        DID_0xe333_2002_Hv: DemDataElementDataSize=1, DemDataElementDataType=UINT8_N, DemDataElementEndianness=opaque, DemDataElementUsePort=USE_DATA_CLIENT_SERVER_PORT, DemDataElementStoreNonVolatile=true
        DID_0xe333_2002_Hw: DemDataElementDataSize=1, DemDataElementDataType=UINT8_N, DemDataElementEndianness=opaque, DemDataElementUsePort=USE_DATA_CLIENT_SERVER_PORT, DemDataElementStoreNonVolatile=true
        DID_0xe333_2002_Lu: DemDataElementDataSize=1, DemDataElementDataType=UINT8_N, DemDataElementEndianness=opaque, DemDataElementUsePort=USE_DATA_CLIENT_SERVER_PORT, DemDataElementStoreNonVolatile=true
        DID_0xe333_2002_Lv: DemDataElementDataSize=1, DemDataElementDataType=UINT8_N, DemDataElementEndianness=opaque, DemDataElementUsePort=USE_DATA_CLIENT_SERVER_PORT, DemDataElementStoreNonVolatile=true
        DID_0xe333_2002_Lw: DemDataElementDataSize=1, DemDataElementDataType=UINT8_N, DemDataElementEndianness=opaque, DemDataElementUsePort=USE_DATA_CLIENT_SERVER_PORT, DemDataElementStoreNonVolatile=true
        OperCycCnt{1..6}_OperCycCnt{1..6}: DemDataElementDataSize=1, DemDataElementInternalData=DEM_OCCCTR, DemDataElementUsePort=USE_DATA_INTERNAL
        DTCfaultdetectioncounter_DTCFltDetCnt: DemDataElementDataSize=1, DemDataElementInternalData=DEM_CURRENT_FDC, DemDataElementUsePort=USE_DATA_INTERNAL
        MaxDTCDetCntThisCycle_MaxDTCDetCntThisCycle: DemDataElementDataSize=1, DemDataElementInternalData=DEM_MAX_FDC_DURING_CURRENT_CYCLE, DemDataElementUsePort=USE_DATA_INTERNAL
        MaxDTCSinClear_MaxDTCSinClear: DemDataElementDataSize=1, DemDataElementInternalData=DEM_MAX_FDC_SINCE_LAST_CLEAR, DemDataElementUsePort=USE_DATA_INTERNAL

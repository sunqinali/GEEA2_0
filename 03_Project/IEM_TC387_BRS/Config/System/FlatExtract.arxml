AUTOSAR XML (schema 00044)
package /COM/VECTOR/CFG/WORKFLOW/SYSDESC/SYNC
  system SYSTEM: category=ECU_EXTRACT
    system mapping MAPPINGS
      data-mappings:
        data-element=Appl_ComShell.COMPOSITIONTYPE.CarTiGlb.CarTiGlb, system-signal=CarTiGlb
        data-element=Appl_ComShell.COMPOSITIONTYPE.BkpOfDstTrvld.BkpOfDstTrvld, system-signal=BkpOfDstTrvld
        data-element=Appl_ComShell.COMPOSITIONTYPE.WhlMotSysModReq.WhlMotSysModReq, system-signal=WhlMotSysModReq
        data-element=Appl_ComShell.COMPOSITIONTYPE.WhlMotSysTqReq.WhlMotSysTqReq, system-signal=WhlMotSysTqReq
        data-element=Appl_ComShell.COMPOSITIONTYPE.CooltTSigForDtElec.CooltTSigForDtElec, system-signal=CooltTSigForDtElec
        data-element=Appl_ComShell.COMPOSITIONTYPE.CooltFlowForDtElec.CooltFlowForDtElec, system-signal=CooltFlowForDtElec
        data-element=Appl_ComShell.COMPOSITIONTYPE.SpdRotlForWhlsAtAxleRe.SpdRotlForWhlsAtAxleRe, system-signal=SpdRotlForWhlsAtAxleRe
        data-element=Appl_ComShell.COMPOSITIONTYPE.WhlMotSysPwrLimMax.WhlMotSysPwrLimMax, system-signal=WhlMotSysPwrLimMax
        data-element=Appl_ComShell.COMPOSITIONTYPE.WhlMotSysPwrLimMin.WhlMotSysPwrLimMin, system-signal=WhlMotSysPwrLimMin
        data-element=Appl_ComShell.COMPOSITIONTYPE.WhlMotSysModSts.WhlMotSysModSts, system-signal=WhlMotSysModSts
        data-element=Appl_ComShell.COMPOSITIONTYPE.WhlMotSysSpdAct.WhlMotSysSpdAct, system-signal=WhlMotSysSpdAct
        data-element=Appl_ComShell.COMPOSITIONTYPE.WhlMotSysUdc.WhlMotSysUdc, system-signal=WhlMotSysUdc
        data-element=Appl_ComShell.COMPOSITIONTYPE.WhlMotSysMotT.WhlMotSysMotT, system-signal=WhlMotSysMotT
        data-element=Appl_ComShell.COMPOSITIONTYPE.WhlMotSysInvrT.WhlMotSysInvrT, system-signal=WhlMotSysInvrT
        data-element=Appl_ComShell.COMPOSITIONTYPE.WhlMotSysCooltT.WhlMotSysCooltT, system-signal=WhlMotSysCooltT
        data-element=Appl_ComShell.COMPOSITIONTYPE.WhlMotSysIdc.WhlMotSysIdc, system-signal=WhlMotSysIdc
        data-element=Appl_ComShell.COMPOSITIONTYPE.WhlMotSysLimnIndcn.WhlMotSysLimnIndcn, system-signal=WhlMotSysLimnIndcn
        data-element=Appl_ComShell.COMPOSITIONTYPE.WhlMotSysCoolgReq.WhlMotSysCoolgReq, system-signal=WhlMotSysCoolgReq
        data-element=Appl_ComShell.COMPOSITIONTYPE.WhlMotSysErrIndcnReq.WhlMotSysErrIndcnReq, system-signal=WhlMotSysErrIndcnReq
        data-element=Appl_ComShell.COMPOSITIONTYPE.DCChrgnHndlSts.DCChrgnHndlSts, system-signal=DCChrgnHndlSts
        data-element=Appl_ComShell.COMPOSITIONTYPE.DrvgCyc.DrvgCyc, system-signal=DrvgCyc
        data-element=Appl_ComShell.COMPOSITIONTYPE.GearLvrIndcn.GearLvrIndcn, system-signal=GearLvrIndcn
        data-element=Appl_ComShell.COMPOSITIONTYPE.HvBattSoc.HvBattSoc, system-signal=HvBattSoc
        data-element=Appl_ComShell.COMPOSITIONTYPE.HvBattUDc.HvBattUDc, system-signal=HvBattUDc
        data-element=Appl_ComShell.COMPOSITIONTYPE.HvBattUDynMaxLim.HvBattUDynMaxLim, system-signal=HvBattUDynMaxLim
        data-element=Appl_ComShell.COMPOSITIONTYPE.HvBattUDynMinLim.HvBattUDynMinLim, system-signal=HvBattUDynMinLim
        data-element=Appl_ComShell.COMPOSITIONTYPE.ImobEngSts2.ImobEngSts2, system-signal=ImobEngSts2
        data-element=Appl_ComShell.COMPOSITIONTYPE.OnBdChrgrHndlSts1.OnBdChrgrHndlSts1, system-signal=OnBdChrgrHndlSts1
        data-element=Appl_ComShell.COMPOSITIONTYPE.PLockFltIndcRe.PLockFltIndcRe, system-signal=PLockFltIndcRe
        data-element=Appl_ComShell.COMPOSITIONTYPE.PLockFltLvlRe.PLockFltLvlRe, system-signal=PLockFltLvlRe
        data-element=Appl_ComShell.COMPOSITIONTYPE.PLockParkReq.PLockParkReq, system-signal=PLockParkReq
        data-element=Appl_ComShell.COMPOSITIONTYPE.PLockParkStsRe.PLockParkStsRe, system-signal=PLockParkStsRe
        data-element=Appl_ComShell.COMPOSITIONTYPE.PrpsnFbLimnIndcn.PrpsnFbLimnIndcn, system-signal=PrpsnFbLimnIndcn
        data-element=Appl_ComShell.COMPOSITIONTYPE.RearHeatModEnad.RearHeatModEnad, system-signal=RearHeatModEnad
        data-element=Appl_ComShell.COMPOSITIONTYPE.RearHeatPwrAllwd.RearHeatPwrAllwd, system-signal=RearHeatPwrAllwd
        data-element=Appl_ComShell.COMPOSITIONTYPE.WhlMotClrRdyReq.WhlMotClrRdyReq, system-signal=WhlMotClrRdyReq
        data-element=Appl_ComShell.COMPOSITIONTYPE.WhlMotCooltFlowMinReq.WhlMotCooltFlowMinReq, system-signal=WhlMotCooltFlowMinReq
        data-element=Appl_ComShell.COMPOSITIONTYPE.WhlMotSysActvDampgModReq.WhlMotSysActvDampgModReq, system-signal=WhlMotSysActvDampgModReq
        data-element=Appl_ComShell.COMPOSITIONTYPE.WhlMotSysHeatFdBck.WhlMotSysHeatFdBck, system-signal=WhlMotSysHeatFdBck
        data-element=Appl_ComShell.COMPOSITIONTYPE.WhlMotSysHeatPwrAct.WhlMotSysHeatPwrAct, system-signal=WhlMotSysHeatPwrAct
        data-element=Appl_ComShell.COMPOSITIONTYPE.WhlMotSysHeatPwrMax.WhlMotSysHeatPwrMax, system-signal=WhlMotSysHeatPwrMax
    root-software-compositions:
      root sw composition prototype COMPOSITIONTYPE: flat-map=FLATMAP, software-composition=COMPOSITIONTYPE
  composition sw component type COMPOSITIONTYPE  # UB:Derived from original system description
    11 x component:
      BswM: type=BswM
      ComM: type=ComM
      DemMaster_0: type=DemMaster_0
      DemSatellite_0: type=DemSatellite_0
      Det: type=Det
      Dcm: type=Dcm
      Os_OsCore0_swc: type=Os_OsCore0_swc
      Os_OsCore2_swc: type=Os_OsCore2_swc
      EcuM: type=EcuM
      Appl_ComShell: type=Appl_ComShell
      NvM: type=NvM
  end to end protection set E2EPROTECTIONSET
  port interface mapping set PORTINTERFACEMAPPINGSET

AUTOSAR XML (schema 00044)
package /COM/VECTOR/CFG/WORKFLOW/SYSDESC/SYNC
  system SYSTEM: category=ECU_EXTRACT
    system mapping MAPPINGS
      data-mappings:
        sender-receiver-to-signal-mapping={data-element=Appl_ComShell.COMPOSITIONTYPE.CarTiGlb.CarTiGlb, system-signal=CarTiGlb}
        sender-receiver-to-signal-mapping={data-element=Appl_ComShell.COMPOSITIONTYPE.BkpOfDstTrvld.BkpOfDstTrvld, system-signal=BkpOfDstTrvld}
        sender-receiver-to-signal-mapping={data-element=Appl_ComShell.COMPOSITIONTYPE.WhlMotSysModReq.WhlMotSysModReq, system-signal=WhlMotSysModReq}
        sender-receiver-to-signal-mapping={data-element=Appl_ComShell.COMPOSITIONTYPE.WhlMotSysTqReq.WhlMotSysTqReq, system-signal=WhlMotSysTqReq}
        sender-receiver-to-signal-mapping={data-element=Appl_ComShell.COMPOSITIONTYPE.CooltTSigForDtElec.CooltTSigForDtElec, system-signal=CooltTSigForDtElec}
        sender-receiver-to-signal-mapping={data-element=Appl_ComShell.COMPOSITIONTYPE.CooltFlowForDtElec.CooltFlowForDtElec, system-signal=CooltFlowForDtElec}
        sender-receiver-to-signal-mapping={data-element=Appl_ComShell.COMPOSITIONTYPE.SpdRotlForWhlsAtAxleRe.SpdRotlForWhlsAtAxleRe, system-signal=SpdRotlForWhlsAtAxleRe}
        sender-receiver-to-signal-mapping={data-element=Appl_ComShell.COMPOSITIONTYPE.WhlMotSysPwrLimMax.WhlMotSysPwrLimMax, system-signal=WhlMotSysPwrLimMax}
        sender-receiver-to-signal-mapping={data-element=Appl_ComShell.COMPOSITIONTYPE.WhlMotSysPwrLimMin.WhlMotSysPwrLimMin, system-signal=WhlMotSysPwrLimMin}
        sender-receiver-to-signal-mapping={data-element=Appl_ComShell.COMPOSITIONTYPE.WhlMotSysModSts.WhlMotSysModSts, system-signal=WhlMotSysModSts}
        sender-receiver-to-signal-mapping={data-element=Appl_ComShell.COMPOSITIONTYPE.WhlMotSysSpdAct.WhlMotSysSpdAct, system-signal=WhlMotSysSpdAct}
        sender-receiver-to-signal-mapping={data-element=Appl_ComShell.COMPOSITIONTYPE.WhlMotSysUdc.WhlMotSysUdc, system-signal=WhlMotSysUdc}
        sender-receiver-to-signal-mapping={data-element=Appl_ComShell.COMPOSITIONTYPE.WhlMotSysMotT.WhlMotSysMotT, system-signal=WhlMotSysMotT}
        sender-receiver-to-signal-mapping={data-element=Appl_ComShell.COMPOSITIONTYPE.WhlMotSysInvrT.WhlMotSysInvrT, system-signal=WhlMotSysInvrT}
        sender-receiver-to-signal-mapping={data-element=Appl_ComShell.COMPOSITIONTYPE.WhlMotSysCooltT.WhlMotSysCooltT, system-signal=WhlMotSysCooltT}
        sender-receiver-to-signal-mapping={data-element=Appl_ComShell.COMPOSITIONTYPE.WhlMotSysIdc.WhlMotSysIdc, system-signal=WhlMotSysIdc}
        sender-receiver-to-signal-mapping={data-element=Appl_ComShell.COMPOSITIONTYPE.WhlMotSysLimnIndcn.WhlMotSysLimnIndcn, system-signal=WhlMotSysLimnIndcn}
        sender-receiver-to-signal-mapping={data-element=Appl_ComShell.COMPOSITIONTYPE.WhlMotSysCoolgReq.WhlMotSysCoolgReq, system-signal=WhlMotSysCoolgReq}
        sender-receiver-to-signal-mapping={data-element=Appl_ComShell.COMPOSITIONTYPE.WhlMotSysErrIndcnReq.WhlMotSysErrIndcnReq, system-signal=WhlMotSysErrIndcnReq}
        sender-receiver-to-signal-mapping={data-element=Appl_ComShell.COMPOSITIONTYPE.DCChrgnHndlSts.DCChrgnHndlSts, system-signal=DCChrgnHndlSts}
        sender-receiver-to-signal-mapping={data-element=Appl_ComShell.COMPOSITIONTYPE.DrvgCyc.DrvgCyc, system-signal=DrvgCyc}
        sender-receiver-to-signal-mapping={data-element=Appl_ComShell.COMPOSITIONTYPE.GearLvrIndcn.GearLvrIndcn, system-signal=GearLvrIndcn}
        sender-receiver-to-signal-mapping={data-element=Appl_ComShell.COMPOSITIONTYPE.HvBattSoc.HvBattSoc, system-signal=HvBattSoc}
        sender-receiver-to-signal-mapping={data-element=Appl_ComShell.COMPOSITIONTYPE.HvBattUDc.HvBattUDc, system-signal=HvBattUDc}
        sender-receiver-to-signal-mapping={data-element=Appl_ComShell.COMPOSITIONTYPE.HvBattUDynMaxLim.HvBattUDynMaxLim, system-signal=HvBattUDynMaxLim}
        sender-receiver-to-signal-mapping={data-element=Appl_ComShell.COMPOSITIONTYPE.HvBattUDynMinLim.HvBattUDynMinLim, system-signal=HvBattUDynMinLim}
        sender-receiver-to-signal-mapping={data-element=Appl_ComShell.COMPOSITIONTYPE.ImobEngSts2.ImobEngSts2, system-signal=ImobEngSts2}
        sender-receiver-to-signal-mapping={data-element=Appl_ComShell.COMPOSITIONTYPE.OnBdChrgrHndlSts1.OnBdChrgrHndlSts1, system-signal=OnBdChrgrHndlSts1}
        sender-receiver-to-signal-mapping={data-element=Appl_ComShell.COMPOSITIONTYPE.PLockFltIndcRe.PLockFltIndcRe, system-signal=PLockFltIndcRe}
        sender-receiver-to-signal-mapping={data-element=Appl_ComShell.COMPOSITIONTYPE.PLockFltLvlRe.PLockFltLvlRe, system-signal=PLockFltLvlRe}
        sender-receiver-to-signal-mapping={data-element=Appl_ComShell.COMPOSITIONTYPE.PLockParkReq.PLockParkReq, system-signal=PLockParkReq}
        sender-receiver-to-signal-mapping={data-element=Appl_ComShell.COMPOSITIONTYPE.PLockParkStsRe.PLockParkStsRe, system-signal=PLockParkStsRe}
        sender-receiver-to-signal-mapping={data-element=Appl_ComShell.COMPOSITIONTYPE.PrpsnFbLimnIndcn.PrpsnFbLimnIndcn, system-signal=PrpsnFbLimnIndcn}
        sender-receiver-to-signal-mapping={data-element=Appl_ComShell.COMPOSITIONTYPE.RearHeatModEnad.RearHeatModEnad, system-signal=RearHeatModEnad}
        sender-receiver-to-signal-mapping={data-element=Appl_ComShell.COMPOSITIONTYPE.RearHeatPwrAllwd.RearHeatPwrAllwd, system-signal=RearHeatPwrAllwd}
        sender-receiver-to-signal-mapping={data-element=Appl_ComShell.COMPOSITIONTYPE.WhlMotClrRdyReq.WhlMotClrRdyReq, system-signal=WhlMotClrRdyReq}
        sender-receiver-to-signal-mapping={data-element=Appl_ComShell.COMPOSITIONTYPE.WhlMotCooltFlowMinReq.WhlMotCooltFlowMinReq, system-signal=WhlMotCooltFlowMinReq}
        sender-receiver-to-signal-mapping={data-element=Appl_ComShell.COMPOSITIONTYPE.WhlMotSysActvDampgModReq.WhlMotSysActvDampgModReq, system-signal=WhlMotSysActvDampgModReq}
        sender-receiver-to-signal-mapping={data-element=Appl_ComShell.COMPOSITIONTYPE.WhlMotSysHeatFdBck.WhlMotSysHeatFdBck, system-signal=WhlMotSysHeatFdBck}
        sender-receiver-to-signal-mapping={data-element=Appl_ComShell.COMPOSITIONTYPE.WhlMotSysHeatPwrAct.WhlMotSysHeatPwrAct, system-signal=WhlMotSysHeatPwrAct}
        sender-receiver-to-signal-mapping={data-element=Appl_ComShell.COMPOSITIONTYPE.WhlMotSysHeatPwrMax.WhlMotSysHeatPwrMax, system-signal=WhlMotSysHeatPwrMax}
        sender-receiver-to-signal-group-mapping={data-element=Appl_ComShell.COMPOSITIONTYPE.CrashStsSafe.CrashStsSafe, signal-group=CrashStsSafe, type-mapping=sender-rec-record-type-mapping=record-element-mappings=[{application-record-element=Sts, system-signal=CrashStsSafeSts}, {application-record-element=Chks, system-signal=CrashStsSafeChks}, {application-record-element=Cntr, system-signal=CrashStsSafeCntr}]}
        sender-receiver-to-signal-group-mapping={data-element=Appl_ComShell.COMPOSITIONTYPE.EngSt1WdSts.EngSt1WdSts, signal-group=EngSt1WdSts, type-mapping=sender-rec-record-type-mapping=record-element-mappings=[{application-record-element=EngSt1WdSts, system-signal=EngSt1WdStsEngSt1WdSts}, {application-record-element=Chks, system-signal=EngSt1WdStsChks}, {application-record-element=Cntr, system-signal=EngSt1WdStsCntr}]}
        sender-receiver-to-signal-group-mapping={data-element=Appl_ComShell.COMPOSITIONTYPE.EscVariantToDmc.EscVariantToDmc, signal-group=EscVariantToDmc, type-mapping=sender-rec-record-type-mapping=record-element-mappings=[{application-record-element=EscVariantToDmc, system-signal=EscVariantToDmcEscVariantToDmc}, {application-record-element=Chks, system-signal=EscVariantToDmcChks}, {application-record-element=Cntr, system-signal=EscVariantToDmcCntr}]}
        sender-receiver-to-signal-group-mapping={data-element=Appl_ComShell.COMPOSITIONTYPE.HvSysRlySts.HvSysRlySts, signal-group=HvSysRlySts, type-mapping=sender-rec-record-type-mapping=record-element-mappings=[{application-record-element=HvSysRlySts, system-signal=HvSysRlyStsHvSysRlySts}, {application-record-element=Cntr, system-signal=HvSysRlyStsCntr}, {application-record-element=Chks, system-signal=HvSysRlyStsChks}]}
        sender-receiver-to-signal-group-mapping={data-element=Appl_ComShell.COMPOSITIONTYPE.PtTqAtAxleMaxReq.PtTqAtAxleMaxReq, signal-group=PtTqAtAxleMaxReq, type-mapping=sender-rec-record-type-mapping=record-element-mappings=[{application-record-element=PtTqAtAxleFrntReq, system-signal=PtTqAtAxleMaxReqPtTqAtAxleFrntReq}, {application-record-element=PtTqAtAxleReReq, system-signal=PtTqAtAxleMaxReqPtTqAtAxleReReq}, {application-record-element=Chks, system-signal=PtTqAtAxleMaxReqChks}, {application-record-element=Cntr, system-signal=PtTqAtAxleMaxReqCntr}]}
        sender-receiver-to-signal-group-mapping={data-element=Appl_ComShell.COMPOSITIONTYPE.StcStsToDmc.StcStsToDmc, signal-group=StcStsToDmc, type-mapping=sender-rec-record-type-mapping=record-element-mappings=[{application-record-element=StcStsToDmcFrnt, system-signal=StcStsToDmcFrnt}, {application-record-element=StcStsToDmcRear, system-signal=StcStsToDmcRear}, {application-record-element=EngRotTarSpdDMCFrnt, system-signal=StcStsToDmcEngRotTarSpdDMCFrnt}, {application-record-element=EngRotTarSpdDMCRear, system-signal=StcStsToDmcEngRotTarSpdDMCRear}, {application-record-element=Chks, system-signal=StcStsToDmcChks}, {application-record-element=Cntr, system-signal=StcStsToDmcCntr}]}
        sender-receiver-to-signal-group-mapping={data-element=Appl_ComShell.COMPOSITIONTYPE.VehModMngtGlbSafe1.VehModMngtGlbSafe1, signal-group=VehModMngtGlbSafe1, type-mapping=sender-rec-record-type-mapping=record-element-mappings=[{application-record-element=UsgModSts, system-signal=VehModMngtGlbSafe1UsgModSts}, {application-record-element=CarModSts1, system-signal=VehModMngtGlbSafe1CarModSts1}, {application-record-element=CarModSubtypWdCarModSubtyp, system-signal=VehModMngtGlbSafe1CarModSubtypWdCarModSubtyp}, {application-record-element=EgyLvlElecMai, system-signal=VehModMngtGlbSafe1EgyLvlElecMai}, {application-record-element=EgyLvlElecSubtyp, system-signal=VehModMngtGlbSafe1EgyLvlElecSubtyp}, {application-record-element=PwrLvlElecMai, system-signal=VehModMngtGlbSafe1PwrLvlElecMai}, {application-record-element=PwrLvlElecSubtyp, system-signal=VehModMngtGlbSafe1PwrLvlElecSubtyp}, {application-record-element=FltEgyCnsWdSts, system-signal=VehModMngtGlbSafe1FltEgyCnsWdSts}, {application-record-element=Chks, system-signal=VehModMngtGlbSafe1Chks}, {application-record-element=Cntr, system-signal=VehModMngtGlbSafe1Cntr}]}
        sender-receiver-to-signal-group-mapping={data-element=Appl_ComShell.COMPOSITIONTYPE.VehMtnSt.VehMtnSt, signal-group=VehMtnSt, type-mapping=sender-rec-record-type-mapping=record-element-mappings=[{application-record-element=VehMtnSt, system-signal=VehMtnStVehMtnSt}, {application-record-element=VehMtnStChks, system-signal=VehMtnStChks}, {application-record-element=VehMtnStCntr, system-signal=VehMtnStCntr}]}
        sender-receiver-to-signal-group-mapping={data-element=Appl_ComShell.COMPOSITIONTYPE.VehSpdLgt.VehSpdLgt, signal-group=VehSpdLgt, type-mapping=sender-rec-record-type-mapping=record-element-mappings=[{application-record-element=VehSpdLgtA, system-signal=VehSpdLgtA}, {application-record-element=VehSpdLgtQf, system-signal=VehSpdLgtQf}, {application-record-element=VehSpdLgtCntr, system-signal=VehSpdLgtCntr}, {application-record-element=VehSpdLgtChks, system-signal=VehSpdLgtChks}]}
        sender-receiver-to-signal-group-mapping={data-element=Appl_ComShell.COMPOSITIONTYPE.WhlMotSysTqAllwd.WhlMotSysTqAllwd, signal-group=WhlMotSysTqAllwd, type-mapping=sender-rec-record-type-mapping=record-element-mappings=[{application-record-element=WhlMotSysTqAllwd, system-signal=WhlMotSysTqAllwdWhlMotSysTqAllwd}, {application-record-element=Chks, system-signal=WhlMotSysTqAllwdChks}, {application-record-element=Cntr, system-signal=WhlMotSysTqAllwdCntr}]}
        sender-receiver-to-signal-group-mapping={data-element=Appl_ComShell.COMPOSITIONTYPE.ImobEngMgrReq2.ImobEngMgrReq2, signal-group=ImobEngMgrReq2, type-mapping=sender-rec-record-type-mapping=record-element-mappings=[{application-record-element=ImobEngMgrCmdTar1, system-signal=ImobEngMgrReq2ImobEngMgrCmdTar1}, {application-record-element=ImobEngDataMgrReq0, system-signal=ImobEngMgrReq2ImobEngDataMgrReq0}, {application-record-element=ImobEngDataMgrReq1, system-signal=ImobEngMgrReq2ImobEngDataMgrReq1}, {application-record-element=ImobEngDataMgrReq2, system-signal=ImobEngMgrReq2ImobEngDataMgrReq2}, {application-record-element=ImobEngDataMgrReq3, system-signal=ImobEngMgrReq2ImobEngDataMgrReq3}, {application-record-element=ImobEngDataMgrReq4, system-signal=ImobEngMgrReq2ImobEngDataMgrReq4}, {application-record-element=ImobEngDataMgrReq5, system-signal=ImobEngMgrReq2ImobEngDataMgrReq5}, {application-record-element=ImobEngDataMgrReq6, system-signal=ImobEngMgrReq2ImobEngDataMgrReq6}]}
        sender-receiver-to-signal-group-mapping={data-element=Appl_ComShell.COMPOSITIONTYPE.VehBattU.VehBattU, signal-group=VehBattU, type-mapping=sender-rec-record-type-mapping=record-element-mappings=[{application-record-element=SysU, system-signal=VehBattUSysU}, {application-record-element=SysUQf, system-signal=VehBattUSysUQf}]}
        sender-receiver-to-signal-group-mapping={data-element=Appl_ComShell.COMPOSITIONTYPE.DmcStsRearToEsc.DmcStsRearToEsc, signal-group=DmcStsRearToEsc, type-mapping=sender-rec-record-type-mapping=record-element-mappings=[{application-record-element=DmcSts, system-signal=DmcStsRearToEscDmcSts}, {application-record-element=DmcActAppTarTq, system-signal=DmcStsRearToEscDmcActAppTarTq}, {application-record-element=Cntr, system-signal=DmcStsRearToEscCntr}, {application-record-element=Chks, system-signal=DmcStsRearToEscChks}, {application-record-element=DmcSWInfo, system-signal=DmcStsRearToEscDmcSWInfo}]}
        sender-receiver-to-signal-group-mapping={data-element=Appl_ComShell.COMPOSITIONTYPE.WhlMotSysSpdActSafe.WhlMotSysSpdActSafe, signal-group=WhlMotSysSpdActSafe, type-mapping=sender-rec-record-type-mapping=record-element-mappings=[{application-record-element=IsgSpdWSgnTyp, system-signal=WhlMotSysSpdActSafeIsgSpdWSgnTyp}, {application-record-element=Chks, system-signal=WhlMotSysSpdActSafeChks}, {application-record-element=Cntr, system-signal=WhlMotSysSpdActSafeCntr}, {application-record-element=Qf, system-signal=WhlMotSysSpdActSafeQf}]}
        sender-receiver-to-signal-group-mapping={data-element=Appl_ComShell.COMPOSITIONTYPE.WhlMotSysTqEst.WhlMotSysTqEst, signal-group=WhlMotSysTqEst, type-mapping=sender-rec-record-type-mapping=record-element-mappings=[{application-record-element=Cntr, system-signal=WhlMotSysTqEstCntr}, {application-record-element=Chks, system-signal=WhlMotSysTqEstChks}, {application-record-element=QualityFactor, system-signal=WhlMotSysTqEstQualityFactor}, {application-record-element=IsgTqAct, system-signal=WhlMotSysTqEstIsgTqAct}]}
        sender-receiver-to-signal-group-mapping={data-element=Appl_ComShell.COMPOSITIONTYPE.IEMTestFr{1..3}.IEMTestFr{1..3}, signal-group=IEMTestFr{1..3}, type-mapping=sender-rec-record-type-mapping=record-element-mappings=[{application-record-element=Byte0, system-signal=IEMTestFr{1..3}Byte0}, {application-record-element=Byte1, system-signal=IEMTestFr{1..3}Byte1}, {application-record-element=Byte2, system-signal=IEMTestFr{1..3}Byte2}, {application-record-element=Byte3, system-signal=IEMTestFr{1..3}Byte3}, {application-record-element=Byte4, system-signal=IEMTestFr{1..3}Byte4}, {application-record-element=Byte5, system-signal=IEMTestFr{1..3}Byte5}, {application-record-element=Byte6, system-signal=IEMTestFr{1..3}Byte6}, {application-record-element=Byte7, system-signal=IEMTestFr{1..3}Byte7}]}
        sender-receiver-to-signal-group-mapping={data-element=Appl_ComShell.COMPOSITIONTYPE.IemGeneric.IemGeneric, signal-group=IemGeneric, type-mapping=sender-rec-record-type-mapping=record-element-mappings=[{application-record-element=EMQnty, system-signal=IemGenericEMQnty}, {application-record-element=EMSeqNr, system-signal=IemGenericEMSeqNr}, {application-record-element=DTCSts, system-signal=IemGenericDTCSts}, {application-record-element=DTCLow, system-signal=IemGenericDTCLow}, {application-record-element=DTCMid, system-signal=IemGenericDTCMid}, {application-record-element=DTCHig, system-signal=IemGenericDTCHig}, {application-record-element=TypeInfo, system-signal=IemGenericTypeInfo}, {application-record-element=MotTAlrmSt, system-signal=IemGenericMotTAlrmSt}, {application-record-element=InvrtTAlrmSt, system-signal=IemGenericInvrtTAlrmSt}, {application-record-element=FltAlrmSt, system-signal=IemGenericFltAlrmSt}, {application-record-element=SpdAlrmSt, system-signal=IemGenericSpdAlrmSt}, {application-record-element=IacAlrmSt, system-signal=IemGenericIacAlrmSt}, {application-record-element=UDcAlrmSt, system-signal=IemGenericUDcAlrmSt}, {application-record-element=RslAlrmSt, system-signal=IemGenericRslAlrmSt}, {application-record-element=ADAlrmSt, system-signal=IemGenericADAlrmSt}, {application-record-element=ModStatusRms, system-signal=IemGenericModStatusRms}]}
        sender-receiver-to-signal-group-mapping={data-element=Appl_ComShell.COMPOSITIONTYPE.ImobEngChk2.ImobEngChk2, signal-group=ImobEngChk2, type-mapping=sender-rec-record-type-mapping=record-element-mappings=[{application-record-element=ImobEngChkSts, system-signal=ImobEngChk2ImobEngChkSts}, {application-record-element=ImobEngDataChk0, system-signal=ImobEngChk2ImobEngDataChk0}, {application-record-element=ImobEngDataChk1, system-signal=ImobEngChk2ImobEngDataChk1}, {application-record-element=ImobEngDataChk2, system-signal=ImobEngChk2ImobEngDataChk2}, {application-record-element=ImobEngDataChk3, system-signal=ImobEngChk2ImobEngDataChk3}, {application-record-element=ImobEngDataChk4, system-signal=ImobEngChk2ImobEngDataChk4}, {application-record-element=ImobEngDataChk5, system-signal=ImobEngChk2ImobEngDataChk5}, {application-record-element=ImobEngDataChk6, system-signal=ImobEngChk2ImobEngDataChk6}]}
        sender-receiver-to-signal-group-mapping={data-element=Appl_ComShell.COMPOSITIONTYPE.WhlMotSysTqAvl.WhlMotSysTqAvl, signal-group=WhlMotSysTqAvl, type-mapping=sender-rec-record-type-mapping=record-element-mappings=[{application-record-element=TqAvlMax, system-signal=WhlMotSysTqAvlTqAvlMax}, {application-record-element=TqAvlMin, system-signal=WhlMotSysTqAvlTqAvlMin}]}
    root-software-compositions:
      root sw composition prototype COMPOSITIONTYPE: flat-map=FLATMAP, software-composition=COMPOSITIONTYPE
  composition sw component type COMPOSITIONTYPE  # UB:Derived from original system description
    11 x component:
      BswM: type=BswM
      ComM: type=ComM
      DemMaster_0: type=DemMaster_0
      DemSatellite_0: type=DemSatellite_0
      Det: type=Det
      Dcm: type=Dcm
      Os_OsCore0_swc: type=Os_OsCore0_swc
      Os_OsCore2_swc: type=Os_OsCore2_swc
      EcuM: type=EcuM
      Appl_ComShell: type=Appl_ComShell
      NvM: type=NvM
  end to end protection set E2EPROTECTIONSET
  port interface mapping set PORTINTERFACEMAPPINGSET

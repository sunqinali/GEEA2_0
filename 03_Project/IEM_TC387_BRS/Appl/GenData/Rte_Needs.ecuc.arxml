AUTOSAR XML (schema 4-0-3)
package /DaVinci_Project
  module config Com
    ComConfig
      41 x ComSignal:
        isBkpOfDstTrvld_1c9ea633_Rx: ComSignalType=UINT32
        isCarTiGlb_7a3bdc75_Rx: ComSignalType=UINT32
        isCooltFlowForDtElec_89c7c93c_Rx: ComSignalType=UINT16
        isCooltTSigForDtElec_f43a3873_Rx: ComSignalType=UINT16
        isDCChrgnHndlSts_7439a8f3_Rx: ComSignalType=UINT8
        isDrvgCyc_edb7d721_Rx: ComSignalType=UINT8
        isGearLvrIndcn_bb4b951e_Rx: ComSignalType=UINT8
        isHvBattSoc_ce242c3f_Rx: ComSignalType=UINT16
        isHvBattUDc_bcd9ade4_Rx: ComSignalType=UINT16
        isHvBattUDynMaxLim_6d11df88_Rx: ComSignalType=UINT16
        isHvBattUDynMinLim_28139c0a_Rx: ComSignalType=UINT16
        isImobEngSts2_5f8745c8_Tx: ComSignalType=UINT8
        isOnBdChrgrHndlSts1_677311c9_Rx: ComSignalType=UINT8
        isPLockFltIndcRe_f756fd30_Tx: ComSignalType=UINT8
        isPLockFltLvlRe_167e1ed2_Tx: ComSignalType=UINT8
        isPLockParkReq_5b6f1b96_Rx: ComSignalType=UINT8
        isPLockParkStsRe_8fb3cac5_Tx: ComSignalType=UINT8
        isPrpsnFbLimnIndcn_5674da6b_Rx: ComSignalType=UINT8
        isRearHeatModEnad_a110df41_Rx: ComSignalType=UINT8
        isRearHeatPwrAllwd_c919804a_Rx: ComSignalType=UINT8
        isSpdRotlForWhlsAtAxleRe_cda9e459_Rx: ComSignalType=UINT16
        isWhlMotClrRdyReq_189c9369_Tx: ComSignalType=UINT8
        isWhlMotCooltFlowMinReq_102e8fa4_Tx: ComSignalType=UINT16
        isWhlMotSysActvDampgModReq_1c578291_Rx: ComSignalType=UINT8
        isWhlMotSysCoolgReq_32e8ee03_Tx: ComSignalType=UINT8
        isWhlMotSysCooltT_da703242_Tx: ComSignalType=UINT8
        isWhlMotSysErrIndcnReq_d5e6edc2_Tx: ComSignalType=UINT8
        isWhlMotSysHeatFdBck_516116c8_Tx: ComSignalType=UINT8
        isWhlMotSysHeatPwrAct_e1709dcf_Tx: ComSignalType=UINT8
        isWhlMotSysHeatPwrMax_d3ea4a02_Tx: ComSignalType=UINT8
        isWhlMotSysIdc_56101b54_Tx: ComSignalType=UINT16
        isWhlMotSysInvrT_11341a35_Tx: ComSignalType=UINT8
        isWhlMotSysLimnIndcn_9f88a06a_Tx: ComSignalType=UINT16
        isWhlMotSysModReq_0153ebfe_Rx: ComSignalType=UINT8
        isWhlMotSysModSts_bd46c3f5_Tx: ComSignalType=UINT8
        isWhlMotSysMotT_54e003b6_Tx: ComSignalType=UINT8
        isWhlMotSysPwrLimMax_45b5505a_Rx: ComSignalType=UINT16
        isWhlMotSysPwrLimMin_79b86f03_Rx: ComSignalType=UINT16
        isWhlMotSysSpdAct_e26fc666_Tx: ComSignalType=SINT16
        isWhlMotSysTqReq_f0fdb022_Rx: ComSignalType=UINT16
        isWhlMotSysUdc_432c4140_Tx: ComSignalType=UINT16
  module config Rte
    22 x RteBswModuleInstance:
      BswM
        BswM_MainFunctionTimingEvent0 (RteBswEventToTaskMapping)
      Can
        3 x RteBswEventToTaskMapping:
          Can_MainFunction_BusOffTimingEvent0
          Can_MainFunction_ModeTimingEvent0
          Can_MainFunction_WakeupTimingEvent0
      CanIf
      CanNm
        CanNm_MainFunctionTimingEvent0 (RteBswEventToTaskMapping)
      CanSM
        CanSM_MainFunctionTimingEvent0 (RteBswEventToTaskMapping)
      CanTp
        CanTp_MainFunctionTimingEvent0 (RteBswEventToTaskMapping)
      CanTrcv
        CanTrcv_30_Tja1145_MainFunctionTimingEvent0 (RteBswEventToTaskMapping)
      Com
        Com_MainFunctionRxTimingEvent0 (RteBswEventToTaskMapping)
        Com_MainFunctionTxTimingEvent0 (RteBswEventToTaskMapping)
      ComM
        ComM_MainFunction_0TimingEvent0 (RteBswEventToTaskMapping)
      Dcm
        Dcm_MainFunctionTimingEvent0 (RteBswEventToTaskMapping)
      Dem
        Dem_MasterMainFunctionTimingEvent0 (RteBswEventToTaskMapping)
        Dem_SatelliteMainFunctionTimingEvent0 (RteBswEventToTaskMapping)
      Det
      EcuM
        4 x RteBswEventToTaskMapping:
          EcuM_MainFunctionTimingEvent{0..3}
      Fee
        Fee_MainFunctionTimingEvent0 (RteBswEventToTaskMapping)
      Fls
        Fls_17_Dmu_MainFunctionTimingEvent0 (RteBswEventToTaskMapping)
      McalLib
      Mcu
      Nm
      NvM
        NvM_MainFunctionTimingEvent0 (RteBswEventToTaskMapping)
      PduR
      Port
      Spi
        Spi_MainFunction_HandlingTimingEvent0 (RteBswEventToTaskMapping)
    11 x RteSwComponentInstance:
      Appl_ComShell_EcuSwComposition
        RE_Appl_ComShell_Step (RteEventToTaskMapping)
      BswM_EcuSwComposition
        Timer_BswM_MainFunction (RteEventToTaskMapping)
      ComM_EcuSwComposition
        Timer_ComM_MainFunction_0 (RteEventToTaskMapping)
      Dcm_EcuSwComposition
        Timer_Dcm_MainFunction (RteEventToTaskMapping)
      DemMaster_0_EcuSwComposition
        Timer_Dem_MasterMainFunction (RteEventToTaskMapping)
      DemSatellite_0_EcuSwComposition
        Timer_Dem_SatelliteMainFunction (RteEventToTaskMapping)
      Det_EcuSwComposition
      EcuM_EcuSwComposition
        Timer_EcuM_MainFunction (RteEventToTaskMapping)
      NvM_EcuSwComposition
        Timer_NvM_MainFunction (RteEventToTaskMapping)
      Os_OsCore0_swc_EcuSwComposition
      Os_OsCore2_swc_EcuSwComposition
    RteOsInteraction
  module config NvM
  module config Os
    5 x OsTask, all with OsTaskActivation=1, OsTaskSchedule=FULL:
      Task_Appl_10ms: OsTaskPriority=15, OsTaskAccessingApplication=OsApplication, OsTaskAccessingApplication=OsApplication_Core1, OsTaskAccessingApplication=OsApplication_Core3
      Task_Bsw_10ms: OsTaskPriority=20, OsTaskAccessingApplication=OsApplication_Core1, OsTaskAccessingApplication=OsApplication_Core2, OsTaskAccessingApplication=OsApplication_Core3
      Task_Com_5ms: OsTaskPriority=40, OsTaskAccessingApplication=OsApplication_Core1, OsTaskAccessingApplication=OsApplication_Core2, OsTaskAccessingApplication=OsApplication_Core3
      Task_EcuM_Core1: OsTaskPriority=5, OsTaskAccessingApplication=OsApplication, OsTaskAccessingApplication=OsApplication_Core2, OsTaskAccessingApplication=OsApplication_Core3
      Task_EcuM_Core3: OsTaskPriority=5, OsTaskAccessingApplication=OsApplication, OsTaskAccessingApplication=OsApplication_Core1, OsTaskAccessingApplication=OsApplication_Core2
    6 x OsApplication, all with OsTrusted=true:
      OsApplication: OsAppTaskRef=Task_Bsw_10ms, OsAppTaskRef=Task_Com_5ms
      OsApplication_Core1: OsAppTaskRef=Task_EcuM_Core1
      OsApplication_Core2: OsAppTaskRef=Task_Appl_10ms
      OsApplication_Core3: OsAppTaskRef=Task_EcuM_Core3
      SystemApplication_OsCore0
      SystemApplication_OsCore2
  module config EcuC
  ecuc value collection DaVinci_Project: ecuc-values=[Com, Rte, Os, EcuC, NvM]

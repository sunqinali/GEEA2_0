AUTOSAR XML (schema 4-0-3)
package /DaVinci_Project
  module config Com
    ComConfig
      21 x ComSignalGroup:
        igCrashStsSafe_0a09c5f2_Rx
          3 x ComGroupSignal, all with ComSignalType=UINT8:
            isCrashStsSafeChks_42d0b327_Rx
            isCrashStsSafeCntr_fc00f19d_Rx
            isCrashStsSafeSts_847c5d07_Rx
        igDmcStsRearToEsc_5d8e0053_Tx
          5 x ComGroupSignal:
            isDmcStsRearToEscChks_0817ec86_Tx: ComSignalType=UINT8
            isDmcStsRearToEscCntr_b6c7ae3c_Tx: ComSignalType=UINT8
            isDmcStsRearToEscDmcActAppTarTq_eaa126f0_Tx: ComSignalType=SINT16
            isDmcStsRearToEscDmcSWInfo_6d930900_Tx: ComSignalType=UINT16
            isDmcStsRearToEscDmcSts_2fffc6c5_Tx: ComSignalType=UINT8
        igEngSt1WdSts_adcf75d2_Rx
          3 x ComGroupSignal, all with ComSignalType=UINT8:
            isEngSt1WdStsChks_75cf5b53_Rx
            isEngSt1WdStsCntr_cb1f19e9_Rx
            isEngSt1WdStsEngSt1WdSts_21868fa0_Rx
        igEscVariantToDmc_3c205019_Rx
          3 x ComGroupSignal, all with ComSignalType=UINT8:
            isEscVariantToDmcChks_9a33bac6_Rx
            isEscVariantToDmcCntr_24e3f87c_Rx
            isEscVariantToDmcEscVariantToDmc_daa2c955_Rx
        igHvSysRlySts_760c5326_Rx
          3 x ComGroupSignal, all with ComSignalType=UINT8:
            isHvSysRlyStsChks_b1dd6f20_Rx
            isHvSysRlyStsCntr_0f0d2d9a_Rx
            isHvSysRlyStsHvSysRlySts_5b219bea_Rx
        igIEMTestFr1_f9c0b06a_Tx
          8 x ComGroupSignal, all with ComSignalType=UINT8:
            isIEMTestFr1Byte0_eb2525b1_Tx
            isIEMTestFr1Byte1_9c221527_Tx
            isIEMTestFr1Byte2_052b449d_Tx
            isIEMTestFr1Byte3_722c740b_Tx
            isIEMTestFr1Byte4_ec48e1a8_Tx
            isIEMTestFr1Byte5_9b4fd13e_Tx
            isIEMTestFr1Byte6_02468084_Tx
            isIEMTestFr1Byte7_7541b012_Tx
        igIEMTestFr2_60c9e1d0_Tx
          8 x ComGroupSignal, all with ComSignalType=UINT8:
            isIEMTestFr2Byte0_6db1571f_Tx
            isIEMTestFr2Byte1_1ab66789_Tx
            isIEMTestFr2Byte2_83bf3633_Tx
            isIEMTestFr2Byte3_f4b806a5_Tx
            isIEMTestFr2Byte4_6adc9306_Tx
            isIEMTestFr2Byte5_1ddba390_Tx
            isIEMTestFr2Byte6_84d2f22a_Tx
            isIEMTestFr2Byte7_f3d5c2bc_Tx
        igIEMTestFr3_17ced146_Tx
          8 x ComGroupSignal, all with ComSignalType=UINT8:
            isIEMTestFr3Byte0_a6ed84ba_Tx
            isIEMTestFr3Byte1_d1eab42c_Tx
            isIEMTestFr3Byte2_48e3e596_Tx
            isIEMTestFr3Byte3_3fe4d500_Tx
            isIEMTestFr3Byte4_a18040a3_Tx
            isIEMTestFr3Byte5_d6877035_Tx
            isIEMTestFr3Byte6_4f8e218f_Tx
            isIEMTestFr3Byte7_38891119_Tx
        igIemGeneric_ab95030b_Tx
          16 x ComGroupSignal, all with ComSignalType=UINT8:
            isIemGenericADAlrmSt_2216fde0_Tx
            isIemGenericDTCHig_6365ed22_Tx
            isIemGenericDTCLow_2f81f21c_Tx
            isIemGenericDTCMid_fca77e73_Tx
            isIemGenericDTCSts_96a019d2_Tx
            isIemGenericEMQnty_067a3f4d_Tx
            isIemGenericEMSeqNr_5f6f0e31_Tx
            isIemGenericFltAlrmSt_094332cf_Tx
            isIemGenericIacAlrmSt_ef864a8f_Tx
            isIemGenericInvrtTAlrmSt_ad103698_Tx
            isIemGenericModStatusRms_527fb71c_Tx
            isIemGenericMotTAlrmSt_e29bb0dd_Tx
            isIemGenericRslAlrmSt_09c5d09c_Tx
            isIemGenericSpdAlrmSt_a3de8d5b_Tx
            isIemGenericTypeInfo_10f77ae7_Tx
            isIemGenericUDcAlrmSt_14e497d8_Tx
        igImobEngChk2_35eae3c1_Tx
          8 x ComGroupSignal, all with ComSignalType=UINT8:
            isImobEngChk2ImobEngChkSts_8e88c5e4_Tx
            isImobEngChk2ImobEngDataChk0_fba6858b_Tx
            isImobEngChk2ImobEngDataChk1_8ca1b51d_Tx
            isImobEngChk2ImobEngDataChk2_15a8e4a7_Tx
            isImobEngChk2ImobEngDataChk3_62afd431_Tx
            isImobEngChk2ImobEngDataChk4_fccb4192_Tx
            isImobEngChk2ImobEngDataChk5_8bcc7104_Tx
            isImobEngChk2ImobEngDataChk6_12c520be_Tx
        igImobEngMgrReq2_1df0559d_Rx
          8 x ComGroupSignal, all with ComSignalType=UINT8:
            isImobEngMgrReq2ImobEngDataMgrReq0_9c0677f3_Rx
            isImobEngMgrReq2ImobEngDataMgrReq1_eb014765_Rx
            isImobEngMgrReq2ImobEngDataMgrReq2_720816df_Rx
            isImobEngMgrReq2ImobEngDataMgrReq3_050f2649_Rx
            isImobEngMgrReq2ImobEngDataMgrReq4_9b6bb3ea_Rx
            isImobEngMgrReq2ImobEngDataMgrReq5_ec6c837c_Rx
            isImobEngMgrReq2ImobEngDataMgrReq6_7565d2c6_Rx
            isImobEngMgrReq2ImobEngMgrCmdTar1_817e486b_Rx
        igPtTqAtAxleMaxReq_e1a6f04e_Rx
          4 x ComGroupSignal:
            isPtTqAtAxleMaxReqChks_6ad4cf82_Rx: ComSignalType=UINT8
            isPtTqAtAxleMaxReqCntr_d4048d38_Rx: ComSignalType=UINT8
            isPtTqAtAxleMaxReqPtTqAtAxleFrntReq_8c330c00_Rx: ComSignalType=SINT16
            isPtTqAtAxleMaxReqPtTqAtAxleReReq_449843f2_Rx: ComSignalType=SINT16
        igStcStsToDmc_cb036148_Rx
          6 x ComGroupSignal:
            isStcStsToDmcChks_7f830d10_Rx: ComSignalType=UINT8
            isStcStsToDmcCntr_c1534faa_Rx: ComSignalType=UINT8
            isStcStsToDmcEngRotTarSpdDMCFrnt_46c9d05b_Rx: ComSignalType=UINT16
            isStcStsToDmcEngRotTarSpdDMCRear_ee201c9c_Rx: ComSignalType=UINT16
            isStcStsToDmcFrnt_baffba62_Rx: ComSignalType=UINT8
            isStcStsToDmcRear_121676a5_Rx: ComSignalType=UINT8
        igVehBattU_0a2a47a4_Rx
          isVehBattUSysUQf_f605b03a_Rx (ComGroupSignal): ComSignalType=UINT8
          isVehBattUSysU_9501cb8f_Rx (ComGroupSignal): ComSignalType=UINT8
        igVehModMngtGlbSafe1_d1f2be1a_Rx
          10 x ComGroupSignal, all with ComSignalType=UINT8:
            isVehModMngtGlbSafe1CarModSts1_a7324f03_Rx
            isVehModMngtGlbSafe1CarModSubtypWdCarModSubtyp_e21ae44e_Rx
            isVehModMngtGlbSafe1Chks_5333fc0b_Rx
            isVehModMngtGlbSafe1Cntr_ede3beb1_Rx
            isVehModMngtGlbSafe1EgyLvlElecMai_47690dfe_Rx
            isVehModMngtGlbSafe1EgyLvlElecSubtyp_47668699_Rx
            isVehModMngtGlbSafe1FltEgyCnsWdSts_c45a6bde_Rx
            isVehModMngtGlbSafe1PwrLvlElecMai_c178728f_Rx
            isVehModMngtGlbSafe1PwrLvlElecSubtyp_d042c1b3_Rx
            isVehModMngtGlbSafe1UsgModSts_8ea1ac37_Rx
        igVehMtnSt_68a0f345_Rx
          3 x ComGroupSignal, all with ComSignalType=UINT8:
            isVehMtnStChks_46ae48d7_Rx
            isVehMtnStCntr_f87e0a6d_Rx
            isVehMtnStVehMtnSt_e696b713_Rx
        igVehSpdLgt_56c0cfd4_Rx
          4 x ComGroupSignal:
            isVehSpdLgtA_668ad5e3_Rx: ComSignalType=UINT16
            isVehSpdLgtChks_060f2c10_Rx: ComSignalType=UINT8
            isVehSpdLgtCntr_b8df6eaa_Rx: ComSignalType=UINT8
            isVehSpdLgtQf_057400a6_Rx: ComSignalType=UINT8
        igWhlMotSysSpdActSafe_58c9c55b_Tx
          4 x ComGroupSignal:
            isWhlMotSysSpdActSafeChks_8eaaad7b_Tx: ComSignalType=UINT8
            isWhlMotSysSpdActSafeCntr_307aefc1_Tx: ComSignalType=UINT8
            isWhlMotSysSpdActSafeIsgSpdWSgnTyp_9d8822c6_Tx: ComSignalType=SINT16
            isWhlMotSysSpdActSafeQf_b9719ecc_Tx: ComSignalType=UINT8
        igWhlMotSysTqAllwd_20f5846f_Rx
          3 x ComGroupSignal, all with ComSignalType=UINT8:
            isWhlMotSysTqAllwdChks_5c573be4_Rx
            isWhlMotSysTqAllwdCntr_e287795e_Rx
            isWhlMotSysTqAllwdWhlMotSysTqAllwd_0ecd7abd_Rx
        igWhlMotSysTqAvl_6ba13f42_Tx
          isWhlMotSysTqAvlTqAvlMax_bb518dba_Tx (ComGroupSignal): ComSignalType=UINT16
          isWhlMotSysTqAvlTqAvlMin_875cb2e3_Tx (ComGroupSignal): ComSignalType=UINT16
        igWhlMotSysTqEst_02b3fb8d_Tx
          4 x ComGroupSignal:
            isWhlMotSysTqEstChks_cdf81842_Tx: ComSignalType=UINT8
            isWhlMotSysTqEstCntr_73285af8_Tx: ComSignalType=UINT8
            isWhlMotSysTqEstIsgTqAct_70852206_Tx: ComSignalType=UINT16
            isWhlMotSysTqEstQualityFactor_cb4e64ff_Tx: ComSignalType=UINT8
      41 x ComSignal:
        isBkpOfDstTrvld_1c9ea633_Rx: ComSignalType=UINT32
        isCarTiGlb_7a3bdc75_Rx: ComSignalType=UINT32
        isCooltFlowForDtElec_89c7c93c_Rx: ComSignalType=UINT16
        isCooltTSigForDtElec_f43a3873_Rx: ComSignalType=UINT16
        isDCChrgnHndlSts_7439a8f3_Rx: ComSignalType=UINT8
        isDrvgCyc_edb7d721_Rx: ComSignalType=UINT8
        isGearLvrIndcn_bb4b951e_Rx: ComSignalType=UINT8
        isHvBattSoc_ce242c3f_Rx: ComSignalType=UINT16
        isHvBattUDc_bcd9ade4_Rx: ComSignalType=UINT16
        isHvBattUDynMaxLim_6d11df88_Rx: ComSignalType=UINT16
        isHvBattUDynMinLim_28139c0a_Rx: ComSignalType=UINT16
        isImobEngSts2_5f8745c8_Tx: ComSignalType=UINT8
        isOnBdChrgrHndlSts1_677311c9_Rx: ComSignalType=UINT8
        isPLockFltIndcRe_f756fd30_Tx: ComSignalType=UINT8
        isPLockFltLvlRe_167e1ed2_Tx: ComSignalType=UINT8
        isPLockParkReq_5b6f1b96_Rx: ComSignalType=UINT8
        isPLockParkStsRe_8fb3cac5_Tx: ComSignalType=UINT8
        isPrpsnFbLimnIndcn_5674da6b_Rx: ComSignalType=UINT8
        isRearHeatModEnad_a110df41_Rx: ComSignalType=UINT8
        isRearHeatPwrAllwd_c919804a_Rx: ComSignalType=UINT8
        isSpdRotlForWhlsAtAxleRe_cda9e459_Rx: ComSignalType=UINT16
        isWhlMotClrRdyReq_189c9369_Tx: ComSignalType=UINT8
        isWhlMotCooltFlowMinReq_102e8fa4_Tx: ComSignalType=UINT16
        isWhlMotSysActvDampgModReq_1c578291_Rx: ComSignalType=UINT8
        isWhlMotSysCoolgReq_32e8ee03_Tx: ComSignalType=UINT8
        isWhlMotSysCooltT_da703242_Tx: ComSignalType=UINT8
        isWhlMotSysErrIndcnReq_d5e6edc2_Tx: ComSignalType=UINT8
        isWhlMotSysHeatFdBck_516116c8_Tx: ComSignalType=UINT8
        isWhlMotSysHeatPwrAct_e1709dcf_Tx: ComSignalType=UINT8
        isWhlMotSysHeatPwrMax_d3ea4a02_Tx: ComSignalType=UINT8
        isWhlMotSysIdc_56101b54_Tx: ComSignalType=UINT16
        isWhlMotSysInvrT_11341a35_Tx: ComSignalType=UINT8
        isWhlMotSysLimnIndcn_9f88a06a_Tx: ComSignalType=UINT16
        isWhlMotSysModReq_0153ebfe_Rx: ComSignalType=UINT8
        isWhlMotSysModSts_bd46c3f5_Tx: ComSignalType=UINT8
        isWhlMotSysMotT_54e003b6_Tx: ComSignalType=UINT8
        isWhlMotSysPwrLimMax_45b5505a_Rx: ComSignalType=UINT16
        isWhlMotSysPwrLimMin_79b86f03_Rx: ComSignalType=UINT16
        isWhlMotSysSpdAct_e26fc666_Tx: ComSignalType=SINT16
        isWhlMotSysTqReq_f0fdb022_Rx: ComSignalType=UINT16
        isWhlMotSysUdc_432c4140_Tx: ComSignalType=UINT16
  module config Rte
    22 x RteBswModuleInstance:
      BswM
        BswM_MainFunctionTimingEvent0 (RteBswEventToTaskMapping)
      Can
        3 x RteBswEventToTaskMapping:
          Can_MainFunction_BusOffTimingEvent0
          Can_MainFunction_ModeTimingEvent0
          Can_MainFunction_WakeupTimingEvent0
      CanIf
      CanNm
        CanNm_MainFunctionTimingEvent0 (RteBswEventToTaskMapping)
      CanSM
        CanSM_MainFunctionTimingEvent0 (RteBswEventToTaskMapping)
      CanTp
        CanTp_MainFunctionTimingEvent0 (RteBswEventToTaskMapping)
      CanTrcv
        CanTrcv_30_Tja1145_MainFunctionTimingEvent0 (RteBswEventToTaskMapping)
      Com
        Com_MainFunctionRxTimingEvent0 (RteBswEventToTaskMapping)
        Com_MainFunctionTxTimingEvent0 (RteBswEventToTaskMapping)
      ComM
        ComM_MainFunction_0TimingEvent0 (RteBswEventToTaskMapping)
      Dcm
        Dcm_MainFunctionTimingEvent0 (RteBswEventToTaskMapping)
      Dem
        Dem_MasterMainFunctionTimingEvent0 (RteBswEventToTaskMapping)
        Dem_SatelliteMainFunctionTimingEvent0 (RteBswEventToTaskMapping)
      Det
      EcuM
        4 x RteBswEventToTaskMapping:
          EcuM_MainFunctionTimingEvent{0..3}
      Fee
        Fee_MainFunctionTimingEvent0 (RteBswEventToTaskMapping)
      Fls
        Fls_17_Dmu_MainFunctionTimingEvent0 (RteBswEventToTaskMapping)
      McalLib
      Mcu
      Nm
      NvM
        NvM_MainFunctionTimingEvent0 (RteBswEventToTaskMapping)
      PduR
      Port
      Spi
        Spi_MainFunction_HandlingTimingEvent0 (RteBswEventToTaskMapping)
    11 x RteSwComponentInstance:
      Appl_ComShell_EcuSwComposition
        RE_Appl_ComShell_Step (RteEventToTaskMapping)
      BswM_EcuSwComposition
        Timer_BswM_MainFunction (RteEventToTaskMapping)
      ComM_EcuSwComposition
        Timer_ComM_MainFunction_0 (RteEventToTaskMapping)
      Dcm_EcuSwComposition
        Timer_Dcm_MainFunction (RteEventToTaskMapping)
      DemMaster_0_EcuSwComposition
        Timer_Dem_MasterMainFunction (RteEventToTaskMapping)
      DemSatellite_0_EcuSwComposition
        Timer_Dem_SatelliteMainFunction (RteEventToTaskMapping)
      Det_EcuSwComposition
      EcuM_EcuSwComposition
        Timer_EcuM_MainFunction (RteEventToTaskMapping)
      NvM_EcuSwComposition
        Timer_NvM_MainFunction (RteEventToTaskMapping)
      Os_OsCore0_swc_EcuSwComposition
      Os_OsCore2_swc_EcuSwComposition
    RteOsInteraction
  module config NvM
  module config Os
    5 x OsTask, all with OsTaskSchedule=FULL:
      Task_Appl_10ms: OsTaskActivation=1, OsTaskPriority=15, OsTaskAccessingApplication=OsApplication, OsTaskAccessingApplication=OsApplication_Core1, OsTaskAccessingApplication=OsApplication_Core3
      Task_Bsw_10ms: OsTaskActivation=5, OsTaskPriority=20, OsTaskAccessingApplication=OsApplication_Core1, OsTaskAccessingApplication=OsApplication_Core2, OsTaskAccessingApplication=OsApplication_Core3
      Task_Com_5ms: OsTaskActivation=5, OsTaskPriority=40, OsTaskAccessingApplication=OsApplication_Core1, OsTaskAccessingApplication=OsApplication_Core2, OsTaskAccessingApplication=OsApplication_Core3
      Task_EcuM_Core1: OsTaskActivation=1, OsTaskPriority=5, OsTaskAccessingApplication=OsApplication, OsTaskAccessingApplication=OsApplication_Core2, OsTaskAccessingApplication=OsApplication_Core3
      Task_EcuM_Core3: OsTaskActivation=1, OsTaskPriority=5, OsTaskAccessingApplication=OsApplication, OsTaskAccessingApplication=OsApplication_Core1, OsTaskAccessingApplication=OsApplication_Core2
    6 x OsApplication, all with OsTrusted=true:
      OsApplication: OsAppTaskRef=Task_Bsw_10ms, OsAppTaskRef=Task_Com_5ms
      OsApplication_Core1: OsAppTaskRef=Task_EcuM_Core1
      OsApplication_Core2: OsAppTaskRef=Task_Appl_10ms
      OsApplication_Core3: OsAppTaskRef=Task_EcuM_Core3
      SystemApplication_OsCore0
      SystemApplication_OsCore2
  module config EcuC
  ecuc value collection DaVinci_Project: ecuc-values=[Com, Rte, Os, EcuC, NvM]

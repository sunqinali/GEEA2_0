AUTOSAR XML (schema 4-0-3)
package /DaVinci_Project
  module config Rte
    22 x RteBswModuleInstance:
      BswM
        BswM_MainFunctionTimingEvent0 (RteBswEventToTaskMapping)
      Can
        3 x RteBswEventToTaskMapping:
          Can_MainFunction_BusOffTimingEvent0
          Can_MainFunction_ModeTimingEvent0
          Can_MainFunction_WakeupTimingEvent0
      CanIf
      CanNm
        CanNm_MainFunctionTimingEvent0 (RteBswEventToTaskMapping)
      CanSM
        CanSM_MainFunctionTimingEvent0 (RteBswEventToTaskMapping)
      CanTp
        CanTp_MainFunctionTimingEvent0 (RteBswEventToTaskMapping)
      CanTrcv
        CanTrcv_30_Tja1145_MainFunctionTimingEvent0 (RteBswEventToTaskMapping)
      Com
        Com_MainFunctionRxTimingEvent0 (RteBswEventToTaskMapping)
        Com_MainFunctionTxTimingEvent0 (RteBswEventToTaskMapping)
      ComM
        ComM_MainFunction_0TimingEvent0 (RteBswEventToTaskMapping)
      Dcm
        Dcm_MainFunctionTimingEvent0 (RteBswEventToTaskMapping)
      Dem
        Dem_MasterMainFunctionTimingEvent0 (RteBswEventToTaskMapping)
        Dem_SatelliteMainFunctionTimingEvent0 (RteBswEventToTaskMapping)
      Det
      EcuM
        4 x RteBswEventToTaskMapping:
          EcuM_MainFunctionTimingEvent{0..3}
      Fee
        Fee_MainFunctionTimingEvent0 (RteBswEventToTaskMapping)
      Fls
        Fls_17_Dmu_MainFunctionTimingEvent0 (RteBswEventToTaskMapping)
      McalLib
      Mcu
      Nm
      NvM
        NvM_MainFunctionTimingEvent0 (RteBswEventToTaskMapping)
      PduR
      Port
      Spi
        Spi_MainFunction_HandlingTimingEvent0 (RteBswEventToTaskMapping)
    10 x RteSwComponentInstance:
      BswM_EcuSwComposition
        Timer_BswM_MainFunction (RteEventToTaskMapping)
      ComM_EcuSwComposition
        Timer_ComM_MainFunction_0 (RteEventToTaskMapping)
      Dcm_EcuSwComposition
        Timer_Dcm_MainFunction (RteEventToTaskMapping)
      DemMaster_0_EcuSwComposition
        Timer_Dem_MasterMainFunction (RteEventToTaskMapping)
      DemSatellite_0_EcuSwComposition
        Timer_Dem_SatelliteMainFunction (RteEventToTaskMapping)
      Det_EcuSwComposition
      EcuM_EcuSwComposition
        Timer_EcuM_MainFunction (RteEventToTaskMapping)
      NvM_EcuSwComposition
        Timer_NvM_MainFunction (RteEventToTaskMapping)
      Os_OsCore0_swc_EcuSwComposition
      Os_OsCore2_swc_EcuSwComposition
    RteOsInteraction
  module config NvM
  module config Os
    5 x OsTask, all with OsTaskActivation=1, OsTaskSchedule=FULL:
      Task_Appl_10ms: OsTaskPriority=15, OsTaskAccessingApplication=OsApplication, OsTaskAccessingApplication=OsApplication_Core1, OsTaskAccessingApplication=OsApplication_Core3
      Task_Bsw_10ms: OsTaskPriority=20, OsTaskAccessingApplication=OsApplication_Core1, OsTaskAccessingApplication=OsApplication_Core2, OsTaskAccessingApplication=OsApplication_Core3
      Task_Com_5ms: OsTaskPriority=40, OsTaskAccessingApplication=OsApplication_Core1, OsTaskAccessingApplication=OsApplication_Core2, OsTaskAccessingApplication=OsApplication_Core3
      Task_EcuM_Core1: OsTaskPriority=5, OsTaskAccessingApplication=OsApplication, OsTaskAccessingApplication=OsApplication_Core2, OsTaskAccessingApplication=OsApplication_Core3
      Task_EcuM_Core3: OsTaskPriority=5, OsTaskAccessingApplication=OsApplication, OsTaskAccessingApplication=OsApplication_Core1, OsTaskAccessingApplication=OsApplication_Core2
    6 x OsApplication, all with OsTrusted=true:
      OsApplication: OsAppTaskRef=Task_Bsw_10ms, OsAppTaskRef=Task_Com_5ms
      OsApplication_Core1: OsAppTaskRef=Task_EcuM_Core1
      OsApplication_Core2: OsAppTaskRef=Task_Appl_10ms
      OsApplication_Core3: OsAppTaskRef=Task_EcuM_Core3
      SystemApplication_OsCore0
      SystemApplication_OsCore2
  module config EcuC
  ecuc value collection DaVinci_Project: ecuc-values=[Com, Rte, Os, EcuC, NvM]

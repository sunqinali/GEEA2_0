AUTOSAR XML (schema 4-2-2)
package /COM/VECTOR/CFG/WORKFLOW/SYSDESC/SYNC
  flat map FLATMAP
    128 x flat instance descriptor:
      DmcStsRearToEsc: upstream-reference=TopLevelComposition.DmcStsRearToEsc.DmcStsRearToEsc, ecu-extract-reference=COMPOSITIONTYPE.DmcStsRearToEsc.DmcStsRearToEsc
      DmcStsRearToEsc_001: upstream-reference=TopLevelComposition.DmcStsRearToEsc, ecu-extract-reference=COMPOSITIONTYPE.DmcStsRearToEsc
      IemGeneric: upstream-reference=TopLevelComposition.IemGeneric.IemGeneric, ecu-extract-reference=COMPOSITIONTYPE.IemGeneric.IemGeneric
      IemGeneric_001: upstream-reference=TopLevelComposition.IemGeneric, ecu-extract-reference=COMPOSITIONTYPE.IemGeneric
      IEMTestFr1: upstream-reference=TopLevelComposition.IEMTestFr1.IEMTestFr1, ecu-extract-reference=COMPOSITIONTYPE.IEMTestFr1.IEMTestFr1
      IEMTestFr1_001: upstream-reference=TopLevelComposition.IEMTestFr1, ecu-extract-reference=COMPOSITIONTYPE.IEMTestFr1
      IEMTestFr2: upstream-reference=TopLevelComposition.IEMTestFr2.IEMTestFr2, ecu-extract-reference=COMPOSITIONTYPE.IEMTestFr2.IEMTestFr2
      IEMTestFr2_001: upstream-reference=TopLevelComposition.IEMTestFr2, ecu-extract-reference=COMPOSITIONTYPE.IEMTestFr2
      IEMTestFr3: upstream-reference=TopLevelComposition.IEMTestFr3.IEMTestFr3, ecu-extract-reference=COMPOSITIONTYPE.IEMTestFr3.IEMTestFr3
      IEMTestFr3_001: upstream-reference=TopLevelComposition.IEMTestFr3, ecu-extract-reference=COMPOSITIONTYPE.IEMTestFr3
      ImobEngChk2: upstream-reference=TopLevelComposition.ImobEngChk2.ImobEngChk2, ecu-extract-reference=COMPOSITIONTYPE.ImobEngChk2.ImobEngChk2
      ImobEngChk2_001: upstream-reference=TopLevelComposition.ImobEngChk2, ecu-extract-reference=COMPOSITIONTYPE.ImobEngChk2
      ImobEngSts2: upstream-reference=TopLevelComposition.ImobEngSts2.ImobEngSts2, ecu-extract-reference=COMPOSITIONTYPE.ImobEngSts2.ImobEngSts2
      ImobEngSts2_001: upstream-reference=TopLevelComposition.ImobEngSts2, ecu-extract-reference=COMPOSITIONTYPE.ImobEngSts2
      PLockFltIndcRe: upstream-reference=TopLevelComposition.PLockFltIndcRe.PLockFltIndcRe, ecu-extract-reference=COMPOSITIONTYPE.PLockFltIndcRe.PLockFltIndcRe
      PLockFltIndcRe_001: upstream-reference=TopLevelComposition.PLockFltIndcRe, ecu-extract-reference=COMPOSITIONTYPE.PLockFltIndcRe
      PLockFltLvlRe: upstream-reference=TopLevelComposition.PLockFltLvlRe.PLockFltLvlRe, ecu-extract-reference=COMPOSITIONTYPE.PLockFltLvlRe.PLockFltLvlRe
      PLockFltLvlRe_001: upstream-reference=TopLevelComposition.PLockFltLvlRe, ecu-extract-reference=COMPOSITIONTYPE.PLockFltLvlRe
      PLockParkStsRe: upstream-reference=TopLevelComposition.PLockParkStsRe.PLockParkStsRe, ecu-extract-reference=COMPOSITIONTYPE.PLockParkStsRe.PLockParkStsRe
      PLockParkStsRe_001: upstream-reference=TopLevelComposition.PLockParkStsRe, ecu-extract-reference=COMPOSITIONTYPE.PLockParkStsRe
      WhlMotClrRdyReq: upstream-reference=TopLevelComposition.WhlMotClrRdyReq.WhlMotClrRdyReq, ecu-extract-reference=COMPOSITIONTYPE.WhlMotClrRdyReq.WhlMotClrRdyReq
      WhlMotClrRdyReq_001: upstream-reference=TopLevelComposition.WhlMotClrRdyReq, ecu-extract-reference=COMPOSITIONTYPE.WhlMotClrRdyReq
      WhlMotCooltFlowMinReq: upstream-reference=TopLevelComposition.WhlMotCooltFlowMinReq.WhlMotCooltFlowMinReq, ecu-extract-reference=COMPOSITIONTYPE.WhlMotCooltFlowMinReq.WhlMotCooltFlowMinReq
      WhlMotCooltFlowMinReq_001: upstream-reference=TopLevelComposition.WhlMotCooltFlowMinReq, ecu-extract-reference=COMPOSITIONTYPE.WhlMotCooltFlowMinReq
      WhlMotSysCoolgReq: upstream-reference=TopLevelComposition.WhlMotSysCoolgReq.WhlMotSysCoolgReq, ecu-extract-reference=COMPOSITIONTYPE.WhlMotSysCoolgReq.WhlMotSysCoolgReq
      WhlMotSysCoolgReq_001: upstream-reference=TopLevelComposition.WhlMotSysCoolgReq, ecu-extract-reference=COMPOSITIONTYPE.WhlMotSysCoolgReq
      WhlMotSysCooltT: upstream-reference=TopLevelComposition.WhlMotSysCooltT.WhlMotSysCooltT, ecu-extract-reference=COMPOSITIONTYPE.WhlMotSysCooltT.WhlMotSysCooltT
      WhlMotSysCooltT_001: upstream-reference=TopLevelComposition.WhlMotSysCooltT, ecu-extract-reference=COMPOSITIONTYPE.WhlMotSysCooltT
      WhlMotSysErrIndcnReq: upstream-reference=TopLevelComposition.WhlMotSysErrIndcnReq.WhlMotSysErrIndcnReq, ecu-extract-reference=COMPOSITIONTYPE.WhlMotSysErrIndcnReq.WhlMotSysErrIndcnReq
      WhlMotSysErrIndcnReq_001: upstream-reference=TopLevelComposition.WhlMotSysErrIndcnReq, ecu-extract-reference=COMPOSITIONTYPE.WhlMotSysErrIndcnReq
      WhlMotSysHeatFdBck: upstream-reference=TopLevelComposition.WhlMotSysHeatFdBck.WhlMotSysHeatFdBck, ecu-extract-reference=COMPOSITIONTYPE.WhlMotSysHeatFdBck.WhlMotSysHeatFdBck
      WhlMotSysHeatFdBck_001: upstream-reference=TopLevelComposition.WhlMotSysHeatFdBck, ecu-extract-reference=COMPOSITIONTYPE.WhlMotSysHeatFdBck
      WhlMotSysHeatPwrAct: upstream-reference=TopLevelComposition.WhlMotSysHeatPwrAct.WhlMotSysHeatPwrAct, ecu-extract-reference=COMPOSITIONTYPE.WhlMotSysHeatPwrAct.WhlMotSysHeatPwrAct
      WhlMotSysHeatPwrAct_001: upstream-reference=TopLevelComposition.WhlMotSysHeatPwrAct, ecu-extract-reference=COMPOSITIONTYPE.WhlMotSysHeatPwrAct
      WhlMotSysHeatPwrMax: upstream-reference=TopLevelComposition.WhlMotSysHeatPwrMax.WhlMotSysHeatPwrMax, ecu-extract-reference=COMPOSITIONTYPE.WhlMotSysHeatPwrMax.WhlMotSysHeatPwrMax
      WhlMotSysHeatPwrMax_001: upstream-reference=TopLevelComposition.WhlMotSysHeatPwrMax, ecu-extract-reference=COMPOSITIONTYPE.WhlMotSysHeatPwrMax
      WhlMotSysIdc: upstream-reference=TopLevelComposition.WhlMotSysIdc.WhlMotSysIdc, ecu-extract-reference=COMPOSITIONTYPE.WhlMotSysIdc.WhlMotSysIdc
      WhlMotSysIdc_001: upstream-reference=TopLevelComposition.WhlMotSysIdc, ecu-extract-reference=COMPOSITIONTYPE.WhlMotSysIdc
      WhlMotSysInvrT: upstream-reference=TopLevelComposition.WhlMotSysInvrT.WhlMotSysInvrT, ecu-extract-reference=COMPOSITIONTYPE.WhlMotSysInvrT.WhlMotSysInvrT
      WhlMotSysInvrT_001: upstream-reference=TopLevelComposition.WhlMotSysInvrT, ecu-extract-reference=COMPOSITIONTYPE.WhlMotSysInvrT
      WhlMotSysLimnIndcn: upstream-reference=TopLevelComposition.WhlMotSysLimnIndcn.WhlMotSysLimnIndcn, ecu-extract-reference=COMPOSITIONTYPE.WhlMotSysLimnIndcn.WhlMotSysLimnIndcn
      WhlMotSysLimnIndcn_001: upstream-reference=TopLevelComposition.WhlMotSysLimnIndcn, ecu-extract-reference=COMPOSITIONTYPE.WhlMotSysLimnIndcn
      WhlMotSysModSts: upstream-reference=TopLevelComposition.WhlMotSysModSts.WhlMotSysModSts, ecu-extract-reference=COMPOSITIONTYPE.WhlMotSysModSts.WhlMotSysModSts
      WhlMotSysModSts_001: upstream-reference=TopLevelComposition.WhlMotSysModSts, ecu-extract-reference=COMPOSITIONTYPE.WhlMotSysModSts
      WhlMotSysMotT: upstream-reference=TopLevelComposition.WhlMotSysMotT.WhlMotSysMotT, ecu-extract-reference=COMPOSITIONTYPE.WhlMotSysMotT.WhlMotSysMotT
      WhlMotSysMotT_001: upstream-reference=TopLevelComposition.WhlMotSysMotT, ecu-extract-reference=COMPOSITIONTYPE.WhlMotSysMotT
      WhlMotSysSpdAct: upstream-reference=TopLevelComposition.WhlMotSysSpdAct.WhlMotSysSpdAct, ecu-extract-reference=COMPOSITIONTYPE.WhlMotSysSpdAct.WhlMotSysSpdAct
      WhlMotSysSpdAct_001: upstream-reference=TopLevelComposition.WhlMotSysSpdAct, ecu-extract-reference=COMPOSITIONTYPE.WhlMotSysSpdAct
      WhlMotSysSpdActSafe: upstream-reference=TopLevelComposition.WhlMotSysSpdActSafe.WhlMotSysSpdActSafe, ecu-extract-reference=COMPOSITIONTYPE.WhlMotSysSpdActSafe.WhlMotSysSpdActSafe
      WhlMotSysSpdActSafe_001: upstream-reference=TopLevelComposition.WhlMotSysSpdActSafe, ecu-extract-reference=COMPOSITIONTYPE.WhlMotSysSpdActSafe
      WhlMotSysTqAvl: upstream-reference=TopLevelComposition.WhlMotSysTqAvl.WhlMotSysTqAvl, ecu-extract-reference=COMPOSITIONTYPE.WhlMotSysTqAvl.WhlMotSysTqAvl
      WhlMotSysTqAvl_001: upstream-reference=TopLevelComposition.WhlMotSysTqAvl, ecu-extract-reference=COMPOSITIONTYPE.WhlMotSysTqAvl
      WhlMotSysTqEst: upstream-reference=TopLevelComposition.WhlMotSysTqEst.WhlMotSysTqEst, ecu-extract-reference=COMPOSITIONTYPE.WhlMotSysTqEst.WhlMotSysTqEst
      WhlMotSysTqEst_001: upstream-reference=TopLevelComposition.WhlMotSysTqEst, ecu-extract-reference=COMPOSITIONTYPE.WhlMotSysTqEst
      WhlMotSysUdc: upstream-reference=TopLevelComposition.WhlMotSysUdc.WhlMotSysUdc, ecu-extract-reference=COMPOSITIONTYPE.WhlMotSysUdc.WhlMotSysUdc
      WhlMotSysUdc_001: upstream-reference=TopLevelComposition.WhlMotSysUdc, ecu-extract-reference=COMPOSITIONTYPE.WhlMotSysUdc
      BkpOfDstTrvld: upstream-reference=TopLevelComposition.BkpOfDstTrvld.BkpOfDstTrvld, ecu-extract-reference=COMPOSITIONTYPE.BkpOfDstTrvld.BkpOfDstTrvld
      BkpOfDstTrvld_001: upstream-reference=TopLevelComposition.BkpOfDstTrvld, ecu-extract-reference=COMPOSITIONTYPE.BkpOfDstTrvld
      CarTiGlb: upstream-reference=TopLevelComposition.CarTiGlb.CarTiGlb, ecu-extract-reference=COMPOSITIONTYPE.CarTiGlb.CarTiGlb
      CarTiGlb_001: upstream-reference=TopLevelComposition.CarTiGlb, ecu-extract-reference=COMPOSITIONTYPE.CarTiGlb
      CooltFlowForDtElec: upstream-reference=TopLevelComposition.CooltFlowForDtElec.CooltFlowForDtElec, ecu-extract-reference=COMPOSITIONTYPE.CooltFlowForDtElec.CooltFlowForDtElec
      CooltFlowForDtElec_001: upstream-reference=TopLevelComposition.CooltFlowForDtElec, ecu-extract-reference=COMPOSITIONTYPE.CooltFlowForDtElec
      CooltTSigForDtElec: upstream-reference=TopLevelComposition.CooltTSigForDtElec.CooltTSigForDtElec, ecu-extract-reference=COMPOSITIONTYPE.CooltTSigForDtElec.CooltTSigForDtElec
      CooltTSigForDtElec_001: upstream-reference=TopLevelComposition.CooltTSigForDtElec, ecu-extract-reference=COMPOSITIONTYPE.CooltTSigForDtElec
      CrashStsSafe: upstream-reference=TopLevelComposition.CrashStsSafe.CrashStsSafe, ecu-extract-reference=COMPOSITIONTYPE.CrashStsSafe.CrashStsSafe
      CrashStsSafe_001: upstream-reference=TopLevelComposition.CrashStsSafe, ecu-extract-reference=COMPOSITIONTYPE.CrashStsSafe
      DCChrgnHndlSts: upstream-reference=TopLevelComposition.DCChrgnHndlSts.DCChrgnHndlSts, ecu-extract-reference=COMPOSITIONTYPE.DCChrgnHndlSts.DCChrgnHndlSts
      DCChrgnHndlSts_001: upstream-reference=TopLevelComposition.DCChrgnHndlSts, ecu-extract-reference=COMPOSITIONTYPE.DCChrgnHndlSts
      DrvgCyc: upstream-reference=TopLevelComposition.DrvgCyc.DrvgCyc, ecu-extract-reference=COMPOSITIONTYPE.DrvgCyc.DrvgCyc
      DrvgCyc_001: upstream-reference=TopLevelComposition.DrvgCyc, ecu-extract-reference=COMPOSITIONTYPE.DrvgCyc
      EngSt1WdSts: upstream-reference=TopLevelComposition.EngSt1WdSts.EngSt1WdSts, ecu-extract-reference=COMPOSITIONTYPE.EngSt1WdSts.EngSt1WdSts
      EngSt1WdSts_001: upstream-reference=TopLevelComposition.EngSt1WdSts, ecu-extract-reference=COMPOSITIONTYPE.EngSt1WdSts
      EscVariantToDmc: upstream-reference=TopLevelComposition.EscVariantToDmc.EscVariantToDmc, ecu-extract-reference=COMPOSITIONTYPE.EscVariantToDmc.EscVariantToDmc
      EscVariantToDmc_001: upstream-reference=TopLevelComposition.EscVariantToDmc, ecu-extract-reference=COMPOSITIONTYPE.EscVariantToDmc
      GearLvrIndcn: upstream-reference=TopLevelComposition.GearLvrIndcn.GearLvrIndcn, ecu-extract-reference=COMPOSITIONTYPE.GearLvrIndcn.GearLvrIndcn
      GearLvrIndcn_001: upstream-reference=TopLevelComposition.GearLvrIndcn, ecu-extract-reference=COMPOSITIONTYPE.GearLvrIndcn
      HvBattSoc: upstream-reference=TopLevelComposition.HvBattSoc.HvBattSoc, ecu-extract-reference=COMPOSITIONTYPE.HvBattSoc.HvBattSoc
      HvBattSoc_001: upstream-reference=TopLevelComposition.HvBattSoc, ecu-extract-reference=COMPOSITIONTYPE.HvBattSoc
      HvBattUDc: upstream-reference=TopLevelComposition.HvBattUDc.HvBattUDc, ecu-extract-reference=COMPOSITIONTYPE.HvBattUDc.HvBattUDc
      HvBattUDc_001: upstream-reference=TopLevelComposition.HvBattUDc, ecu-extract-reference=COMPOSITIONTYPE.HvBattUDc
      HvBattUDynMaxLim: upstream-reference=TopLevelComposition.HvBattUDynMaxLim.HvBattUDynMaxLim, ecu-extract-reference=COMPOSITIONTYPE.HvBattUDynMaxLim.HvBattUDynMaxLim
      HvBattUDynMaxLim_001: upstream-reference=TopLevelComposition.HvBattUDynMaxLim, ecu-extract-reference=COMPOSITIONTYPE.HvBattUDynMaxLim
      HvBattUDynMinLim: upstream-reference=TopLevelComposition.HvBattUDynMinLim.HvBattUDynMinLim, ecu-extract-reference=COMPOSITIONTYPE.HvBattUDynMinLim.HvBattUDynMinLim
      HvBattUDynMinLim_001: upstream-reference=TopLevelComposition.HvBattUDynMinLim, ecu-extract-reference=COMPOSITIONTYPE.HvBattUDynMinLim
      HvSysRlySts: upstream-reference=TopLevelComposition.HvSysRlySts.HvSysRlySts, ecu-extract-reference=COMPOSITIONTYPE.HvSysRlySts.HvSysRlySts
      HvSysRlySts_001: upstream-reference=TopLevelComposition.HvSysRlySts, ecu-extract-reference=COMPOSITIONTYPE.HvSysRlySts
      ImobEngMgrReq2: upstream-reference=TopLevelComposition.ImobEngMgrReq2.ImobEngMgrReq2, ecu-extract-reference=COMPOSITIONTYPE.ImobEngMgrReq2.ImobEngMgrReq2
      ImobEngMgrReq2_001: upstream-reference=TopLevelComposition.ImobEngMgrReq2, ecu-extract-reference=COMPOSITIONTYPE.ImobEngMgrReq2
      OnBdChrgrHndlSts1: upstream-reference=TopLevelComposition.OnBdChrgrHndlSts1.OnBdChrgrHndlSts1, ecu-extract-reference=COMPOSITIONTYPE.OnBdChrgrHndlSts1.OnBdChrgrHndlSts1
      OnBdChrgrHndlSts1_001: upstream-reference=TopLevelComposition.OnBdChrgrHndlSts1, ecu-extract-reference=COMPOSITIONTYPE.OnBdChrgrHndlSts1
      PLockParkReq: upstream-reference=TopLevelComposition.PLockParkReq.PLockParkReq, ecu-extract-reference=COMPOSITIONTYPE.PLockParkReq.PLockParkReq
      PLockParkReq_001: upstream-reference=TopLevelComposition.PLockParkReq, ecu-extract-reference=COMPOSITIONTYPE.PLockParkReq
      PrpsnFbLimnIndcn: upstream-reference=TopLevelComposition.PrpsnFbLimnIndcn.PrpsnFbLimnIndcn, ecu-extract-reference=COMPOSITIONTYPE.PrpsnFbLimnIndcn.PrpsnFbLimnIndcn
      PrpsnFbLimnIndcn_001: upstream-reference=TopLevelComposition.PrpsnFbLimnIndcn, ecu-extract-reference=COMPOSITIONTYPE.PrpsnFbLimnIndcn
      PtTqAtAxleMaxReq: upstream-reference=TopLevelComposition.PtTqAtAxleMaxReq.PtTqAtAxleMaxReq, ecu-extract-reference=COMPOSITIONTYPE.PtTqAtAxleMaxReq.PtTqAtAxleMaxReq
      PtTqAtAxleMaxReq_001: upstream-reference=TopLevelComposition.PtTqAtAxleMaxReq, ecu-extract-reference=COMPOSITIONTYPE.PtTqAtAxleMaxReq
      RearHeatModEnad: upstream-reference=TopLevelComposition.RearHeatModEnad.RearHeatModEnad, ecu-extract-reference=COMPOSITIONTYPE.RearHeatModEnad.RearHeatModEnad
      RearHeatModEnad_001: upstream-reference=TopLevelComposition.RearHeatModEnad, ecu-extract-reference=COMPOSITIONTYPE.RearHeatModEnad
      RearHeatPwrAllwd: upstream-reference=TopLevelComposition.RearHeatPwrAllwd.RearHeatPwrAllwd, ecu-extract-reference=COMPOSITIONTYPE.RearHeatPwrAllwd.RearHeatPwrAllwd
      RearHeatPwrAllwd_001: upstream-reference=TopLevelComposition.RearHeatPwrAllwd, ecu-extract-reference=COMPOSITIONTYPE.RearHeatPwrAllwd
      SpdRotlForWhlsAtAxleRe: upstream-reference=TopLevelComposition.SpdRotlForWhlsAtAxleRe.SpdRotlForWhlsAtAxleRe, ecu-extract-reference=COMPOSITIONTYPE.SpdRotlForWhlsAtAxleRe.SpdRotlForWhlsAtAxleRe
      SpdRotlForWhlsAtAxleRe_001: upstream-reference=TopLevelComposition.SpdRotlForWhlsAtAxleRe, ecu-extract-reference=COMPOSITIONTYPE.SpdRotlForWhlsAtAxleRe
      StcStsToDmc: upstream-reference=TopLevelComposition.StcStsToDmc.StcStsToDmc, ecu-extract-reference=COMPOSITIONTYPE.StcStsToDmc.StcStsToDmc
      StcStsToDmc_001: upstream-reference=TopLevelComposition.StcStsToDmc, ecu-extract-reference=COMPOSITIONTYPE.StcStsToDmc
      VehBattU: upstream-reference=TopLevelComposition.VehBattU.VehBattU, ecu-extract-reference=COMPOSITIONTYPE.VehBattU.VehBattU
      VehBattU_001: upstream-reference=TopLevelComposition.VehBattU, ecu-extract-reference=COMPOSITIONTYPE.VehBattU
      VehCfgPrm: upstream-reference=TopLevelComposition.VehCfgPrm.VehCfgPrm, ecu-extract-reference=COMPOSITIONTYPE.VehCfgPrm.VehCfgPrm
      VehCfgPrm_001: upstream-reference=TopLevelComposition.VehCfgPrm, ecu-extract-reference=COMPOSITIONTYPE.VehCfgPrm
      VehCfgPrmExt: upstream-reference=TopLevelComposition.VehCfgPrmExt.VehCfgPrmExt, ecu-extract-reference=COMPOSITIONTYPE.VehCfgPrmExt.VehCfgPrmExt
      VehCfgPrmExt_001: upstream-reference=TopLevelComposition.VehCfgPrmExt, ecu-extract-reference=COMPOSITIONTYPE.VehCfgPrmExt
      VehModMngtGlbSafe1: upstream-reference=TopLevelComposition.VehModMngtGlbSafe1.VehModMngtGlbSafe1, ecu-extract-reference=COMPOSITIONTYPE.VehModMngtGlbSafe1.VehModMngtGlbSafe1
      VehModMngtGlbSafe1_001: upstream-reference=TopLevelComposition.VehModMngtGlbSafe1, ecu-extract-reference=COMPOSITIONTYPE.VehModMngtGlbSafe1
      VehMtnSt: upstream-reference=TopLevelComposition.VehMtnSt.VehMtnSt, ecu-extract-reference=COMPOSITIONTYPE.VehMtnSt.VehMtnSt
      VehMtnSt_001: upstream-reference=TopLevelComposition.VehMtnSt, ecu-extract-reference=COMPOSITIONTYPE.VehMtnSt
      VehSpdLgt: upstream-reference=TopLevelComposition.VehSpdLgt.VehSpdLgt, ecu-extract-reference=COMPOSITIONTYPE.VehSpdLgt.VehSpdLgt
      VehSpdLgt_001: upstream-reference=TopLevelComposition.VehSpdLgt, ecu-extract-reference=COMPOSITIONTYPE.VehSpdLgt
      WhlMotSysActvDampgModReq: upstream-reference=TopLevelComposition.WhlMotSysActvDampgModReq.WhlMotSysActvDampgModReq, ecu-extract-reference=COMPOSITIONTYPE.WhlMotSysActvDampgModReq.WhlMotSysActvDampgModReq
      WhlMotSysActvDampgModReq_001: upstream-reference=TopLevelComposition.WhlMotSysActvDampgModReq, ecu-extract-reference=COMPOSITIONTYPE.WhlMotSysActvDampgModReq
      WhlMotSysModReq: upstream-reference=TopLevelComposition.WhlMotSysModReq.WhlMotSysModReq, ecu-extract-reference=COMPOSITIONTYPE.WhlMotSysModReq.WhlMotSysModReq
      WhlMotSysModReq_001: upstream-reference=TopLevelComposition.WhlMotSysModReq, ecu-extract-reference=COMPOSITIONTYPE.WhlMotSysModReq
      WhlMotSysPwrLimMax: upstream-reference=TopLevelComposition.WhlMotSysPwrLimMax.WhlMotSysPwrLimMax, ecu-extract-reference=COMPOSITIONTYPE.WhlMotSysPwrLimMax.WhlMotSysPwrLimMax
      WhlMotSysPwrLimMax_001: upstream-reference=TopLevelComposition.WhlMotSysPwrLimMax, ecu-extract-reference=COMPOSITIONTYPE.WhlMotSysPwrLimMax
      WhlMotSysPwrLimMin: upstream-reference=TopLevelComposition.WhlMotSysPwrLimMin.WhlMotSysPwrLimMin, ecu-extract-reference=COMPOSITIONTYPE.WhlMotSysPwrLimMin.WhlMotSysPwrLimMin
      WhlMotSysPwrLimMin_001: upstream-reference=TopLevelComposition.WhlMotSysPwrLimMin, ecu-extract-reference=COMPOSITIONTYPE.WhlMotSysPwrLimMin
      WhlMotSysTqAllwd: upstream-reference=TopLevelComposition.WhlMotSysTqAllwd.WhlMotSysTqAllwd, ecu-extract-reference=COMPOSITIONTYPE.WhlMotSysTqAllwd.WhlMotSysTqAllwd
      WhlMotSysTqAllwd_001: upstream-reference=TopLevelComposition.WhlMotSysTqAllwd, ecu-extract-reference=COMPOSITIONTYPE.WhlMotSysTqAllwd
      WhlMotSysTqReq: upstream-reference=TopLevelComposition.WhlMotSysTqReq.WhlMotSysTqReq, ecu-extract-reference=COMPOSITIONTYPE.WhlMotSysTqReq.WhlMotSysTqReq
      WhlMotSysTqReq_001: upstream-reference=TopLevelComposition.WhlMotSysTqReq, ecu-extract-reference=COMPOSITIONTYPE.WhlMotSysTqReq

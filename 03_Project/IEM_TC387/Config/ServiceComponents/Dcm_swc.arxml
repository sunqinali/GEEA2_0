[part 3 of 4: packages /MICROSAR/Dcm_swc/ComponentTypes to /MICROSAR/Dcm_swc/Interfaces]
AUTOSAR XML (schema 4-2-2)
package /MICROSAR/Dcm_swc/ComponentTypes  (continued)
  swc implementation DcmImplementation: programming-language=C, behavior=DcmInternalBehavior
package /MICROSAR/Dcm_swc/DataTypes
  24 x impl type:
    Dcm_ConfirmationStatusType: compu {0=DCM_RES_POS_OK, 1=DCM_RES_POS_NOT_OK, 2=DCM_RES_NEG_OK, 3=DCM_RES_NEG_NOT_OK}, range raw 0..3, implementation-data-type=uint8
    Dcm_OpStatusType: compu {0=DCM_INITIAL, 1=DCM_PENDING, 2=DCM_CANCEL, 3=DCM_FORCE_RCRRP_OK, 64=DCM_FORCE_RCRRP_NOT_OK}, range raw 0..64, implementation-data-type=uint8
    Dcm_NegativeResponseCodeType:
      compu {0=DCM_E_POSITIVERESPONSE, 16=DCM_E_GENERALREJECT, 17=DCM_E_SERVICENOTSUPPORTED, 18=DCM_E_SUBFUNCTIONNOTSUPPORTED, 19=DCM_E_INCORRECTMESSAGELENGTHORINVALIDFORMAT, 20=DCM_E_RESPONSETOOLONG, 33=DCM_E_BUSYREPEATREQUEST, 34=DCM_E_CONDITIONSNOTCORRECT, 36=DCM_E_REQUESTSEQUENCEERROR, 37=DCM_E_NORESPONSEFROMSUBNETCOMPONENT, 38=DCM_E_FAILUREPREVENTSEXECUTIONOFREQUESTEDACTION, 49=DCM_E_REQUESTOUTOFRANGE, 51=DCM_E_SECURITYACCESSDENIED, 53=DCM_E_INVALIDKEY, 54=DCM_E_EXCEEDNUMBEROFATTEMPTS, 55=DCM_E_REQUIREDTIMEDELAYNOTEXPIRED, 112=DCM_E_UPLOADDOWNLOADNOTACCEPTED, 113=DCM_E_TRANSFERDATASUSPENDED, 114=DCM_E_GENERALPROGRAMMINGFAILURE, 115=DCM_E_WRONGBLOCKSEQUENCECOUNTER, 120=DCM_E_REQUESTCORRECTLYRECEIVEDRESPONSEPENDING, 126=DCM_E_SUBFUNCTIONNOTSUPPORTEDINACTIVESESSION, 127=DCM_E_SERVICENOTSUPPORTEDINACTIVESESSION, 129=DCM_E_RPMTOOHIGH, 130=DCM_E_RPMTOOLOW, 131=DCM_E_ENGINEISRUNNING, 132=DCM_E_ENGINEISNOTRUNNING, 133=DCM_E_ENGINERUNTIMETOOLOW, 134=DCM_E_TEMPERATURETOOHIGH, 135=DCM_E_TEMPERATURETOOLOW, 136=DCM_E_VEHICLESPEEDTOOHIGH, 137=DCM_E_VEHICLESPEEDTOOLOW, 138=DCM_E_THROTTLE_PEDALTOOHIGH, 139=DCM_E_THROTTLE_PEDALTOOLOW, 140=DCM_E_TRANSMISSIONRANGENOTINNEUTRAL, 141=DCM_E_TRANSMISSIONRANGENOTINGEAR, 143=DCM_E_BRAKESWITCH_NOTCLOSED, 144=DCM_E_SHIFTERLEVERNOTINPARK, 145=DCM_E_TORQUECONVERTERCLUTCHLOCKED, 146=DCM_E_VOLTAGETOOHIGH, 147=DCM_E_VOLTAGETOOLOW, 240..249=DCM_E_VMSCNC_0..DCM_E_VMSCNC_9, 250=DCM_E_VMSCNC_A, 251=DCM_E_VMSCNC_B, 252=DCM_E_VMSCNC_C, 253=DCM_E_VMSCNC_D, 254=DCM_E_VMSCNC_E}
      range raw 0..254
      implementation-data-type=uint8
    Dcm_ProtocolType: compu {0=DCM_OBD_ON_CAN, 1=DCM_OBD_ON_FLEXRAY, 2=DCM_OBD_ON_IP, 3=DCM_UDS_ON_CAN, 4=DCM_UDS_ON_FLEXRAY, 5=DCM_UDS_ON_IP, 12=DCM_NO_ACTIVE_PROTOCOL, 240..254=DCM_SUPPLIER_1..DCM_SUPPLIER_15}, range raw 0..254, implementation-data-type=uint8
    Dcm_RequestKindType: compu {0=DCM_REQ_KIND_NONE, 1=DCM_REQ_KIND_EXTERNAL, 2=DCM_REQ_KIND_ROE}, range raw 0..2, implementation-data-type=uint8
    Dcm_SecLevelType: compu {0=DCM_SEC_LEV_LOCKED, 3=DCM_SEC_LEV_L3, 9=DCM_SEC_LEV_L9}, range raw 0..9, implementation-data-type=uint8
    Dcm_SesCtrlType: compu {1=DCM_DEFAULT_SESSION, 2=DCM_PROGRAMMING_SESSION, 3=DCM_EXTENDED_DIAGNOSTIC_SESSION}, range raw 0..3, implementation-data-type=uint8
    Dem_DTCFormatType: compu {0=DEM_DTC_FORMAT_OBD, 1=DEM_DTC_FORMAT_UDS, 2=DEM_DTC_FORMAT_J1939}, range raw 0..255, implementation-data-type=uint8
    Dem_DTCOriginType: compu {1=DEM_DTC_ORIGIN_PRIMARY_MEMORY, 2=DEM_DTC_ORIGIN_MIRROR_MEMORY, 3=DEM_DTC_ORIGIN_PERMANENT_MEMORY, 4=DEM_DTC_ORIGIN_SECONDARY_MEMORY}, range raw 0..255, implementation-data-type=uint8
    Dcm_EcuResetType: compu {0=DCM_ENUM_NONE, 1=DCM_ENUM_HARD, 2=DCM_ENUM_KEYONOFF, 3=DCM_ENUM_SOFT, 4=DCM_ENUM_JUMPTOBOOTLOADER, 5=DCM_ENUM_JUMPTOSYSSUPPLIERBOOTLOADER, 6=DCM_ENUM_EXECUTE}, range raw 0..255, implementation-data-type=uint8
    Dcm_DiagnosticSessionControlType: compu {1=DCM_ENUM_DEFAULT_SESSION, 2=DCM_ENUM_PROGRAMMING_SESSION, 3=DCM_ENUM_EXTENDED_SESSION}, range raw 0..255, implementation-data-type=uint8
    Dcm_CommunicationModeType:
      compu {0=DCM_ENABLE_RX_TX_NORM, 1=DCM_ENABLE_RX_DISABLE_TX_NORM, 2=DCM_DISABLE_RX_ENABLE_TX_NORM, 3=DCM_DISABLE_RX_TX_NORMAL, 4=DCM_ENABLE_RX_TX_NM, 5=DCM_ENABLE_RX_DISABLE_TX_NM, 6=DCM_DISABLE_RX_ENABLE_TX_NM, 7=DCM_DISABLE_RX_TX_NM, 8=DCM_ENABLE_RX_TX_NORM_NM, 9=DCM_ENABLE_RX_DISABLE_TX_NORM_NM, 10=DCM_DISABLE_RX_ENABLE_TX_NORM_NM, 11=DCM_DISABLE_RX_TX_NORM_NM}
      range raw 0..255
      implementation-data-type=uint8
    Dcm_Data3ByteType: category=ARRAY, sw-calibration-access=READ-ONLY
      element Dcm_Data3ByteTypeElement: array-size=3, array-size-semantics=FIXED-SIZE, implementation-data-type=uint8
    Dcm_Data2ByteType: category=ARRAY, sw-calibration-access=READ-ONLY
      element Dcm_Data2ByteTypeElement: array-size=2, array-size-semantics=FIXED-SIZE, implementation-data-type=uint8
    Dcm_Data1ByteType: category=ARRAY, sw-calibration-access=READ-ONLY
      element Dcm_Data1ByteTypeElement: array-size=1, array-size-semantics=FIXED-SIZE, implementation-data-type=uint8
    Dcm_Data5ByteType: category=ARRAY, sw-calibration-access=READ-ONLY
      element Dcm_Data5ByteTypeElement: array-size=5, array-size-semantics=FIXED-SIZE, implementation-data-type=uint8
    Dcm_Data4ByteType: category=ARRAY, sw-calibration-access=READ-ONLY
      element Dcm_Data4ByteTypeElement: array-size=4, array-size-semantics=FIXED-SIZE, implementation-data-type=uint8
    Dcm_Data10ByteType: category=ARRAY, sw-calibration-access=READ-ONLY
      element Dcm_Data10ByteTypeElement: array-size=10, array-size-semantics=FIXED-SIZE, implementation-data-type=uint8
    Dcm_Data32ByteType: category=ARRAY, sw-calibration-access=READ-ONLY
      element Dcm_Data32ByteTypeElement: array-size=32, array-size-semantics=FIXED-SIZE, implementation-data-type=uint8
    Dcm_Data40ByteType: category=ARRAY, sw-calibration-access=READ-ONLY
      element Dcm_Data40ByteTypeElement: array-size=40, array-size-semantics=FIXED-SIZE, implementation-data-type=uint8
    Dcm_Data24ByteType: category=ARRAY, sw-calibration-access=READ-ONLY
      element Dcm_Data24ByteTypeElement: array-size=24, array-size-semantics=FIXED-SIZE, implementation-data-type=uint8
    Dcm_Data8ByteType: category=ARRAY, sw-calibration-access=READ-ONLY
      element Dcm_Data8ByteTypeElement: array-size=8, array-size-semantics=FIXED-SIZE, implementation-data-type=uint8
    Dcm_Data7ByteType: category=ARRAY, sw-calibration-access=READ-ONLY
      element Dcm_Data7ByteTypeElement: array-size=7, array-size-semantics=FIXED-SIZE, implementation-data-type=uint8
    Dcm_Data22ByteType: category=ARRAY, sw-calibration-access=READ-ONLY
      element Dcm_Data22ByteTypeElement: array-size=22, array-size-semantics=FIXED-SIZE, implementation-data-type=uint8
package /MICROSAR/Dcm_swc/Interfaces
  mode switch interface DcmEcuReset: is-service=true, service-kind=DIAGNOSTIC-COMMUNICATION-MANAGER
    mode group DcmEcuReset: type=DcmEcuReset
  mode switch interface DcmDiagnosticSessionControl: is-service=true, service-kind=DIAGNOSTIC-COMMUNICATION-MANAGER
    mode group DcmDiagnosticSessionControl: type=DcmDiagnosticSessionControl
  347 x client server interface, all with is-service=true, service-kind=DIAGNOSTIC-COMMUNICATION-MANAGER:
    DCMServices
      6 x operation:
        GetActiveProtocol: possible-error=E_OK
          arg ActiveProtocol: type=Dcm_ProtocolType, direction=OUT
        GetSesCtrlType: possible-error=E_OK
          arg SesCtrlType: type=Dcm_SesCtrlType, direction=OUT
        ResetToDefaultSession: possible-error=E_OK
        GetSecurityLevel: possible-error=E_OK
          arg SecLevel: type=Dcm_SecLevelType, direction=OUT
        SetActiveDiagnostic: possible-error=E_OK
          arg active: type=boolean, direction=IN
        GetRequestKind: possible-error=DCMServices/E_NOT_OK
          arg TesterSourceAddress: type=uint16, direction=IN
          arg RequestKind: type=Dcm_RequestKindType, direction=OUT
      error E_OK: error-code=0
      error E_NOT_OK: error-code=1
    SecurityAccess_CommonUnlock_Level_3
      operation GetSeed: possible-error=[SecurityAccess_CommonUnlock_Level_3/E_NOT_OK, SecurityAccess_CommonUnlock_Level_3/DCM_E_PENDING]
        arg OpStatus: type=Dcm_OpStatusType, direction=IN
        arg Seed: type=Dcm_Data3ByteType, direction=OUT
        arg ErrorCode: type=Dcm_NegativeResponseCodeType, direction=OUT
      operation CompareKey: possible-error=[SecurityAccess_CommonUnlock_Level_3/E_NOT_OK, SecurityAccess_CommonUnlock_Level_3/DCM_E_PENDING, SecurityAccess_CommonUnlock_Level_3/DCM_E_COMPARE_KEY_FAILED]
        arg Key: type=Dcm_Data3ByteType, direction=IN
        arg OpStatus: type=Dcm_OpStatusType, direction=IN
        arg ErrorCode: type=Dcm_NegativeResponseCodeType, direction=OUT
      error E_NOT_OK: error-code=1
      error DCM_E_PENDING: error-code=10
      error DCM_E_COMPARE_KEY_FAILED: error-code=11
    SecurityAccess_ImmoUnlocked_Level_4
      operation GetSeed: possible-error=[SecurityAccess_ImmoUnlocked_Level_4/E_NOT_OK, SecurityAccess_ImmoUnlocked_Level_4/DCM_E_PENDING]
        arg OpStatus: type=Dcm_OpStatusType, direction=IN
        arg Seed: type=Dcm_Data3ByteType, direction=OUT
        arg ErrorCode: type=Dcm_NegativeResponseCodeType, direction=OUT
      operation CompareKey: possible-error=[SecurityAccess_ImmoUnlocked_Level_4/E_NOT_OK, SecurityAccess_ImmoUnlocked_Level_4/DCM_E_PENDING, SecurityAccess_ImmoUnlocked_Level_4/DCM_E_COMPARE_KEY_FAILED]
        arg Key: type=Dcm_Data3ByteType, direction=IN
        arg OpStatus: type=Dcm_OpStatusType, direction=IN
        arg ErrorCode: type=Dcm_NegativeResponseCodeType, direction=OUT
      error E_NOT_OK: error-code=1
      error DCM_E_PENDING: error-code=10
      error DCM_E_COMPARE_KEY_FAILED: error-code=11
    RoutineServices_Check_programming_pre_conditions
      operation Start: possible-error=[RoutineServices_Check_programming_pre_conditions/E_NOT_OK, RoutineServices_Check_programming_pre_conditions/DCM_E_PENDING, RoutineServices_Check_programming_pre_conditions/DCM_E_FORCE_RCRRP]
        4 x arg:
          OpStatus: type=Dcm_OpStatusType, direction=IN
          Out_New_Bit_Field: type=uint8, direction=OUT
          Out_RID_0206_Start_Pr_3_Condition_Fullfilled_To_Enter_Programming_Session: type=uint8, direction=OUT
          ErrorCode: type=Dcm_NegativeResponseCodeType, direction=OUT
      error E_NOT_OK: error-code=1
      error DCM_E_PENDING: error-code=10
      error DCM_E_FORCE_RCRRP: error-code=12
    RoutineServices_P_Lock
      operation Start: possible-error=[RoutineServices_P_Lock/E_NOT_OK, RoutineServices_P_Lock/DCM_E_PENDING, RoutineServices_P_Lock/DCM_E_FORCE_RCRRP]
        4 x arg:
          In_P_Lock_State_Request: type=uint8, direction=IN
          OpStatus: type=Dcm_OpStatusType, direction=IN
          Out_New_Bit_Field: type=uint8, direction=OUT
          ErrorCode: type=Dcm_NegativeResponseCodeType, direction=OUT
      operation Stop: possible-error=[RoutineServices_P_Lock/E_NOT_OK, RoutineServices_P_Lock/DCM_E_PENDING, RoutineServices_P_Lock/DCM_E_FORCE_RCRRP]
        arg OpStatus: type=Dcm_OpStatusType, direction=IN
        arg Out_New_Bit_Field: type=uint8, direction=OUT
        arg ErrorCode: type=Dcm_NegativeResponseCodeType, direction=OUT
      operation RequestResults: possible-error=[RoutineServices_P_Lock/E_NOT_OK, RoutineServices_P_Lock/DCM_E_PENDING, RoutineServices_P_Lock/DCM_E_FORCE_RCRRP]
        4 x arg:
          OpStatus: type=Dcm_OpStatusType, direction=IN
          Out_New_Bit_Field: type=uint8, direction=OUT
          Out_P_Lock_Status: type=uint8, direction=OUT
          ErrorCode: type=Dcm_NegativeResponseCodeType, direction=OUT
      error E_NOT_OK: error-code=1
      error DCM_E_PENDING: error-code=10
      error DCM_E_FORCE_RCRRP: error-code=12
    RoutineServices_Starter_Generator_Position_Sensors_Calibration
      operation Start: possible-error=[RoutineServices_Starter_Generator_Position_Sensors_Calibration/E_NOT_OK, RoutineServices_Starter_Generator_Position_Sensors_Calibration/DCM_E_PENDING, RoutineServices_Starter_Generator_Position_Sensors_Calibration/DCM_E_FORCE_RCRRP]
        arg OpStatus: type=Dcm_OpStatusType, direction=IN
        arg Out_Bitfield: type=uint8, direction=OUT
        arg ErrorCode: type=Dcm_NegativeResponseCodeType, direction=OUT
      operation Stop: possible-error=[RoutineServices_Starter_Generator_Position_Sensors_Calibration/E_NOT_OK, RoutineServices_Starter_Generator_Position_Sensors_Calibration/DCM_E_PENDING, RoutineServices_Starter_Generator_Position_Sensors_Calibration/DCM_E_FORCE_RCRRP]
        arg OpStatus: type=Dcm_OpStatusType, direction=IN
        arg Out_Bitfield: type=uint8, direction=OUT
        arg ErrorCode: type=Dcm_NegativeResponseCodeType, direction=OUT
      operation RequestResults: possible-error=[RoutineServices_Starter_Generator_Position_Sensors_Calibration/E_NOT_OK, RoutineServices_Starter_Generator_Position_Sensors_Calibration/DCM_E_PENDING, RoutineServices_Starter_Generator_Position_Sensors_Calibration/DCM_E_FORCE_RCRRP]
        4 x arg:
          OpStatus: type=Dcm_OpStatusType, direction=IN
          Out_Bitfield: type=uint8, direction=OUT
          Out_RID_4001_RequestResult_Pr_3_Calibration_result: type=uint16, direction=OUT
          ErrorCode: type=Dcm_NegativeResponseCodeType, direction=OUT
      error E_NOT_OK: error-code=1
      error DCM_E_PENDING: error-code=10
      error DCM_E_FORCE_RCRRP: error-code=12
    RoutineServices_Routine_Reserved_1
      operation Start: possible-error=[RoutineServices_Routine_Reserved_1/E_NOT_OK, RoutineServices_Routine_Reserved_1/DCM_E_PENDING, RoutineServices_Routine_Reserved_1/DCM_E_FORCE_RCRRP]
        8 x arg:
          In_InputData{1..3}: type=uint8, direction=IN
          OpStatus: type=Dcm_OpStatusType, direction=IN
          Out_Data_01_{1..3}: type=uint8, direction=OUT
          ErrorCode: type=Dcm_NegativeResponseCodeType, direction=OUT
      operation Stop: possible-error=[RoutineServices_Routine_Reserved_1/E_NOT_OK, RoutineServices_Routine_Reserved_1/DCM_E_PENDING, RoutineServices_Routine_Reserved_1/DCM_E_FORCE_RCRRP]
        arg OpStatus: type=Dcm_OpStatusType, direction=IN
        arg Out_New_Bit_Field: type=uint8, direction=OUT
        arg ErrorCode: type=Dcm_NegativeResponseCodeType, direction=OUT
      operation RequestResults: possible-error=[RoutineServices_Routine_Reserved_1/E_NOT_OK, RoutineServices_Routine_Reserved_1/DCM_E_PENDING, RoutineServices_Routine_Reserved_1/DCM_E_FORCE_RCRRP]
        5 x arg:
          OpStatus: type=Dcm_OpStatusType, direction=IN
          Out_Data_03_{1..3}: type=uint8, direction=OUT
          ErrorCode: type=Dcm_NegativeResponseCodeType, direction=OUT
      error E_NOT_OK: error-code=1
      error DCM_E_PENDING: error-code=10
      error DCM_E_FORCE_RCRRP: error-code=12
    RoutineServices_Routine_Reserved_2
      operation Start: possible-error=[RoutineServices_Routine_Reserved_2/E_NOT_OK, RoutineServices_Routine_Reserved_2/DCM_E_PENDING, RoutineServices_Routine_Reserved_2/DCM_E_FORCE_RCRRP]
        8 x arg:
          In_InputData{1..3}: type=uint8, direction=IN
          OpStatus: type=Dcm_OpStatusType, direction=IN
          Out_Data_01_{1..3}: type=uint8, direction=OUT
          ErrorCode: type=Dcm_NegativeResponseCodeType, direction=OUT
      operation Stop: possible-error=[RoutineServices_Routine_Reserved_2/E_NOT_OK, RoutineServices_Routine_Reserved_2/DCM_E_PENDING, RoutineServices_Routine_Reserved_2/DCM_E_FORCE_RCRRP]
        arg OpStatus: type=Dcm_OpStatusType, direction=IN
        arg Out_New_Bit_Field: type=uint8, direction=OUT
        arg ErrorCode: type=Dcm_NegativeResponseCodeType, direction=OUT
      operation RequestResults: possible-error=[RoutineServices_Routine_Reserved_2/E_NOT_OK, RoutineServices_Routine_Reserved_2/DCM_E_PENDING, RoutineServices_Routine_Reserved_2/DCM_E_FORCE_RCRRP]
        5 x arg:
          OpStatus: type=Dcm_OpStatusType, direction=IN
          Out_Data_03_{1..3}: type=uint8, direction=OUT
          ErrorCode: type=Dcm_NegativeResponseCodeType, direction=OUT
      error E_NOT_OK: error-code=1
      error DCM_E_PENDING: error-code=10
      error DCM_E_FORCE_RCRRP: error-code=12
    RoutineServices_Routine_Reserved_3
      operation Start: possible-error=[RoutineServices_Routine_Reserved_3/E_NOT_OK, RoutineServices_Routine_Reserved_3/DCM_E_PENDING, RoutineServices_Routine_Reserved_3/DCM_E_FORCE_RCRRP]
        8 x arg:
          In_InputData{1..3}: type=uint8, direction=IN
          OpStatus: type=Dcm_OpStatusType, direction=IN
          Out_Data_01_{1..3}: type=uint8, direction=OUT
          ErrorCode: type=Dcm_NegativeResponseCodeType, direction=OUT
      operation Stop: possible-error=[RoutineServices_Routine_Reserved_3/E_NOT_OK, RoutineServices_Routine_Reserved_3/DCM_E_PENDING, RoutineServices_Routine_Reserved_3/DCM_E_FORCE_RCRRP]
        arg OpStatus: type=Dcm_OpStatusType, direction=IN
        arg Out_New_Bit_Field: type=uint8, direction=OUT
        arg ErrorCode: type=Dcm_NegativeResponseCodeType, direction=OUT
      operation RequestResults: possible-error=[RoutineServices_Routine_Reserved_3/E_NOT_OK, RoutineServices_Routine_Reserved_3/DCM_E_PENDING, RoutineServices_Routine_Reserved_3/DCM_E_FORCE_RCRRP]
        5 x arg:
          OpStatus: type=Dcm_OpStatusType, direction=IN
          Out_Data_03_{1..3}: type=uint8, direction=OUT
          ErrorCode: type=Dcm_NegativeResponseCodeType, direction=OUT
      error E_NOT_OK: error-code=1
      error DCM_E_PENDING: error-code=10
      error DCM_E_FORCE_RCRRP: error-code=12
    DataServices_DID_E300_HVDC_Voltage_DID_E300_HVDC_Voltage
      operation ReadData: possible-error=[DataServices_DID_E300_HVDC_Voltage_DID_E300_HVDC_Voltage/E_NOT_OK, DataServices_DID_E300_HVDC_Voltage_DID_E300_HVDC_Voltage/DCM_E_PENDING]
        arg OpStatus: type=Dcm_OpStatusType, direction=IN
        arg Data: type=Dcm_Data2ByteType, direction=OUT
      operation ConditionCheckRead: possible-error=[DataServices_DID_E300_HVDC_Voltage_DID_E300_HVDC_Voltage/E_NOT_OK, DataServices_DID_E300_HVDC_Voltage_DID_E300_HVDC_Voltage/DCM_E_PENDING]
        arg OpStatus: type=Dcm_OpStatusType, direction=IN
        arg ErrorCode: type=Dcm_NegativeResponseCodeType, direction=OUT
      error E_NOT_OK: error-code=1
      error DCM_E_PENDING: error-code=10
    DataServices_DID_EED5_Safety_Torque_QF_factor_EED5_Safety_Torque_Quality_factor
      operation ReadData: possible-error=[DataServices_DID_EED5_Safety_Torque_QF_factor_EED5_Safety_Torque_Quality_factor/E_NOT_OK, DataServices_DID_EED5_Safety_Torque_QF_factor_EED5_Safety_Torque_Quality_factor/DCM_E_PENDING]
        arg OpStatus: type=Dcm_OpStatusType, direction=IN
        arg Data: type=Dcm_Data1ByteType, direction=OUT
      operation ConditionCheckRead: possible-error=[DataServices_DID_EED5_Safety_Torque_QF_factor_EED5_Safety_Torque_Quality_factor/E_NOT_OK, DataServices_DID_EED5_Safety_Torque_QF_factor_EED5_Safety_Torque_Quality_factor/DCM_E_PENDING]
        arg OpStatus: type=Dcm_OpStatusType, direction=IN
        arg ErrorCode: type=Dcm_NegativeResponseCodeType, direction=OUT
      error E_NOT_OK: error-code=1
      error DCM_E_PENDING: error-code=10
    DataServices_DID_F1A1_Primary_Bootloader_Diagnostic_Database_Part_Number_Geely_ASCII_part
      operation ReadData: possible-error=[DataServices_DID_F1A1_Primary_Bootloader_Diagnostic_Database_Part_Number_Geely_ASCII_part/E_NOT_OK, DataServices_DID_F1A1_Primary_Bootloader_Diagnostic_Database_Part_Number_Geely_ASCII_part/DCM_E_PENDING]
        arg OpStatus: type=Dcm_OpStatusType, direction=IN
        arg Data: type=Dcm_Data3ByteType, direction=OUT
      operation ConditionCheckRead: possible-error=[DataServices_DID_F1A1_Primary_Bootloader_Diagnostic_Database_Part_Number_Geely_ASCII_part/E_NOT_OK, DataServices_DID_F1A1_Primary_Bootloader_Diagnostic_Database_Part_Number_Geely_ASCII_part/DCM_E_PENDING]
        arg OpStatus: type=Dcm_OpStatusType, direction=IN
        arg ErrorCode: type=Dcm_NegativeResponseCodeType, direction=OUT
      error E_NOT_OK: error-code=1
      error DCM_E_PENDING: error-code=10
    DataServices_DID_F1A1_Primary_Bootloader_Diagnostic_Database_Part_Number_Geely_BCD_part
      operation ReadData: possible-error=[DataServices_DID_F1A1_Primary_Bootloader_Diagnostic_Database_Part_Number_Geely_BCD_part/E_NOT_OK, DataServices_DID_F1A1_Primary_Bootloader_Diagnostic_Database_Part_Number_Geely_BCD_part/DCM_E_PENDING]
        arg OpStatus: type=Dcm_OpStatusType, direction=IN
        arg Data: type=Dcm_Data5ByteType, direction=OUT
      operation ConditionCheckRead: possible-error=[DataServices_DID_F1A1_Primary_Bootloader_Diagnostic_Database_Part_Number_Geely_BCD_part/E_NOT_OK, DataServices_DID_F1A1_Primary_Bootloader_Diagnostic_Database_Part_Number_Geely_BCD_part/DCM_E_PENDING]
        arg OpStatus: type=Dcm_OpStatusType, direction=IN
        arg ErrorCode: type=Dcm_NegativeResponseCodeType, direction=OUT
      error E_NOT_OK: error-code=1
      error DCM_E_PENDING: error-code=10
    DataServices_DID_E353_Flux_weakening_correction_factor_DID_E353_Flux_weakening_correction_factor
      operation ReadData: possible-error=[DataServices_DID_E353_Flux_weakening_correction_factor_DID_E353_Flux_weakening_correction_factor/E_NOT_OK, DataServices_DID_E353_Flux_weakening_correction_factor_DID_E353_Flux_weakening_correction_factor/DCM_E_PENDING]
        arg OpStatus: type=Dcm_OpStatusType, direction=IN
        arg Data: type=Dcm_Data2ByteType, direction=OUT
      operation ConditionCheckRead: possible-error=[DataServices_DID_E353_Flux_weakening_correction_factor_DID_E353_Flux_weakening_correction_factor/E_NOT_OK, DataServices_DID_E353_Flux_weakening_correction_factor_DID_E353_Flux_weakening_correction_factor/DCM_E_PENDING]
        arg OpStatus: type=Dcm_OpStatusType, direction=IN
        arg ErrorCode: type=Dcm_NegativeResponseCodeType, direction=OUT
      error E_NOT_OK: error-code=1
      error DCM_E_PENDING: error-code=10
    DataServices_DID_DD00_Global_Real_Time_DID_DD00_Global_Real_Time
      operation ReadData: possible-error=[DataServices_DID_DD00_Global_Real_Time_DID_DD00_Global_Real_Time/E_NOT_OK, DataServices_DID_DD00_Global_Real_Time_DID_DD00_Global_Real_Time/DCM_E_PENDING]
        arg OpStatus: type=Dcm_OpStatusType, direction=IN
        arg Data: type=Dcm_Data4ByteType, direction=OUT
      operation ConditionCheckRead: possible-error=[DataServices_DID_DD00_Global_Real_Time_DID_DD00_Global_Real_Time/E_NOT_OK, DataServices_DID_DD00_Global_Real_Time_DID_DD00_Global_Real_Time/DCM_E_PENDING]
        arg OpStatus: type=Dcm_OpStatusType, direction=IN
        arg ErrorCode: type=Dcm_NegativeResponseCodeType, direction=OUT
      error E_NOT_OK: error-code=1
      error DCM_E_PENDING: error-code=10
    DataServices_DID_F186_Active_Diagnostic_Session_DID_F186_Active_Diagnostic_Session
      operation ReadData: possible-error=[DataServices_DID_F186_Active_Diagnostic_Session_DID_F186_Active_Diagnostic_Session/E_NOT_OK, DataServices_DID_F186_Active_Diagnostic_Session_DID_F186_Active_Diagnostic_Session/DCM_E_PENDING]
        arg OpStatus: type=Dcm_OpStatusType, direction=IN
        arg Data: type=Dcm_Data1ByteType, direction=OUT
      operation ConditionCheckRead: possible-error=[DataServices_DID_F186_Active_Diagnostic_Session_DID_F186_Active_Diagnostic_Session/E_NOT_OK, DataServices_DID_F186_Active_Diagnostic_Session_DID_F186_Active_Diagnostic_Session/DCM_E_PENDING]
        arg OpStatus: type=Dcm_OpStatusType, direction=IN
        arg ErrorCode: type=Dcm_NegativeResponseCodeType, direction=OUT
      error E_NOT_OK: error-code=1
      error DCM_E_PENDING: error-code=10
    DataServices_DID_E319_Torque_Direction_DID_E319_Torque_Direction
      operation ReadData: possible-error=[DataServices_DID_E319_Torque_Direction_DID_E319_Torque_Direction/E_NOT_OK, DataServices_DID_E319_Torque_Direction_DID_E319_Torque_Direction/DCM_E_PENDING]
        arg OpStatus: type=Dcm_OpStatusType, direction=IN
        arg Data: type=Dcm_Data1ByteType, direction=OUT
      operation ConditionCheckRead: possible-error=[DataServices_DID_E319_Torque_Direction_DID_E319_Torque_Direction/E_NOT_OK, DataServices_DID_E319_Torque_Direction_DID_E319_Torque_Direction/DCM_E_PENDING]
        arg OpStatus: type=Dcm_OpStatusType, direction=IN
        arg ErrorCode: type=Dcm_NegativeResponseCodeType, direction=OUT
      error E_NOT_OK: error-code=1
      error DCM_E_PENDING: error-code=10
    DataServices_DID_E338_q_axis_current_feedback_DID_E338_q_axis_current_feedback
      operation ReadData: possible-error=[DataServices_DID_E338_q_axis_current_feedback_DID_E338_q_axis_current_feedback/E_NOT_OK, DataServices_DID_E338_q_axis_current_feedback_DID_E338_q_axis_current_feedback/DCM_E_PENDING]
        arg OpStatus: type=Dcm_OpStatusType, direction=IN
        arg Data: type=Dcm_Data2ByteType, direction=OUT
      operation ConditionCheckRead: possible-error=[DataServices_DID_E338_q_axis_current_feedback_DID_E338_q_axis_current_feedback/E_NOT_OK, DataServices_DID_E338_q_axis_current_feedback_DID_E338_q_axis_current_feedback/DCM_E_PENDING]
        arg OpStatus: type=Dcm_OpStatusType, direction=IN
        arg ErrorCode: type=Dcm_NegativeResponseCodeType, direction=OUT
      error E_NOT_OK: error-code=1
      error DCM_E_PENDING: error-code=10
    DataServices_DID_E308_ECM_Torque_Request_DID_E308_ECM_Torque_Request
      operation ReadData: possible-error=[DataServices_DID_E308_ECM_Torque_Request_DID_E308_ECM_Torque_Request/E_NOT_OK, DataServices_DID_E308_ECM_Torque_Request_DID_E308_ECM_Torque_Request/DCM_E_PENDING]
        arg OpStatus: type=Dcm_OpStatusType, direction=IN
        arg Data: type=Dcm_Data2ByteType, direction=OUT
      operation ConditionCheckRead: possible-error=[DataServices_DID_E308_ECM_Torque_Request_DID_E308_ECM_Torque_Request/E_NOT_OK, DataServices_DID_E308_ECM_Torque_Request_DID_E308_ECM_Torque_Request/DCM_E_PENDING]
        arg OpStatus: type=Dcm_OpStatusType, direction=IN
        arg ErrorCode: type=Dcm_NegativeResponseCodeType, direction=OUT
      error E_NOT_OK: error-code=1
      error DCM_E_PENDING: error-code=10
    DataServices_DID_F1A5_Primary_Bootloader_Software_Part_Number_Geely_ASCII_part
      operation ReadData: possible-error=[DataServices_DID_F1A5_Primary_Bootloader_Software_Part_Number_Geely_ASCII_part/E_NOT_OK, DataServices_DID_F1A5_Primary_Bootloader_Software_Part_Number_Geely_ASCII_part/DCM_E_PENDING]
        arg OpStatus: type=Dcm_OpStatusType, direction=IN
        arg Data: type=Dcm_Data3ByteType, direction=OUT
      operation ConditionCheckRead: possible-error=[DataServices_DID_F1A5_Primary_Bootloader_Software_Part_Number_Geely_ASCII_part/E_NOT_OK, DataServices_DID_F1A5_Primary_Bootloader_Software_Part_Number_Geely_ASCII_part/DCM_E_PENDING]
        arg OpStatus: type=Dcm_OpStatusType, direction=IN
        arg ErrorCode: type=Dcm_NegativeResponseCodeType, direction=OUT
      error E_NOT_OK: error-code=1
      error DCM_E_PENDING: error-code=10
    DataServices_DID_F1A5_Primary_Bootloader_Software_Part_Number_Geely_BCD_part
      operation ReadData: possible-error=[DataServices_DID_F1A5_Primary_Bootloader_Software_Part_Number_Geely_BCD_part/E_NOT_OK, DataServices_DID_F1A5_Primary_Bootloader_Software_Part_Number_Geely_BCD_part/DCM_E_PENDING]
        arg OpStatus: type=Dcm_OpStatusType, direction=IN
        arg Data: type=Dcm_Data5ByteType, direction=OUT
      operation ConditionCheckRead: possible-error=[DataServices_DID_F1A5_Primary_Bootloader_Software_Part_Number_Geely_BCD_part/E_NOT_OK, DataServices_DID_F1A5_Primary_Bootloader_Software_Part_Number_Geely_BCD_part/DCM_E_PENDING]
        arg OpStatus: type=Dcm_OpStatusType, direction=IN
        arg ErrorCode: type=Dcm_NegativeResponseCodeType, direction=OUT
      error E_NOT_OK: error-code=1
      error DCM_E_PENDING: error-code=10
    DataServices_DID_EF1D_EOL_config_word_C_DID_EF1D_EOL_config_word_C
      operation ReadData: possible-error=[DataServices_DID_EF1D_EOL_config_word_C_DID_EF1D_EOL_config_word_C/E_NOT_OK, DataServices_DID_EF1D_EOL_config_word_C_DID_EF1D_EOL_config_word_C/DCM_E_PENDING]
        arg OpStatus: type=Dcm_OpStatusType, direction=IN
        arg Data: type=Dcm_Data2ByteType, direction=OUT
      operation ConditionCheckRead: possible-error=[DataServices_DID_EF1D_EOL_config_word_C_DID_EF1D_EOL_config_word_C/E_NOT_OK, DataServices_DID_EF1D_EOL_config_word_C_DID_EF1D_EOL_config_word_C/DCM_E_PENDING]
        arg OpStatus: type=Dcm_OpStatusType, direction=IN
        arg ErrorCode: type=Dcm_NegativeResponseCodeType, direction=OUT
      operation WriteData: possible-error=[DataServices_DID_EF1D_EOL_config_word_C_DID_EF1D_EOL_config_word_C/E_NOT_OK, DataServices_DID_EF1D_EOL_config_word_C_DID_EF1D_EOL_config_word_C/DCM_E_PENDING]
        arg Data: type=Dcm_Data2ByteType, direction=IN
        arg OpStatus: type=Dcm_OpStatusType, direction=IN
        arg ErrorCode: type=Dcm_NegativeResponseCodeType, direction=OUT
      error E_NOT_OK: error-code=1
      error DCM_E_PENDING: error-code=10
    DataServices_DID_DD0A_Usage_Mode_DID_DD0A_Usage_Mode
      operation ReadData: possible-error=[DataServices_DID_DD0A_Usage_Mode_DID_DD0A_Usage_Mode/E_NOT_OK, DataServices_DID_DD0A_Usage_Mode_DID_DD0A_Usage_Mode/DCM_E_PENDING]
        arg OpStatus: type=Dcm_OpStatusType, direction=IN
        arg Data: type=Dcm_Data1ByteType, direction=OUT
      operation ConditionCheckRead: possible-error=[DataServices_DID_DD0A_Usage_Mode_DID_DD0A_Usage_Mode/E_NOT_OK, DataServices_DID_DD0A_Usage_Mode_DID_DD0A_Usage_Mode/DCM_E_PENDING]
        arg OpStatus: type=Dcm_OpStatusType, direction=IN
        arg ErrorCode: type=Dcm_NegativeResponseCodeType, direction=OUT
      error E_NOT_OK: error-code=1
      error DCM_E_PENDING: error-code=10
    DataServices_DID_D003_Vehicle_Speed_DID_D003_Vehicle_Speed
      operation ReadData: possible-error=[DataServices_DID_D003_Vehicle_Speed_DID_D003_Vehicle_Speed/E_NOT_OK, DataServices_DID_D003_Vehicle_Speed_DID_D003_Vehicle_Speed/DCM_E_PENDING]
        arg OpStatus: type=Dcm_OpStatusType, direction=IN
        arg Data: type=Dcm_Data2ByteType, direction=OUT
      operation ConditionCheckRead: possible-error=[DataServices_DID_D003_Vehicle_Speed_DID_D003_Vehicle_Speed/E_NOT_OK, DataServices_DID_D003_Vehicle_Speed_DID_D003_Vehicle_Speed/DCM_E_PENDING]
        arg OpStatus: type=Dcm_OpStatusType, direction=IN
        arg ErrorCode: type=Dcm_NegativeResponseCodeType, direction=OUT
      error E_NOT_OK: error-code=1
      error DCM_E_PENDING: error-code=10
    DataServices_DID_E364_AURIX_Fault_Indication_DID_E364_AURIX_Fault_Indication
      operation ReadData: possible-error=[DataServices_DID_E364_AURIX_Fault_Indication_DID_E364_AURIX_Fault_Indication/E_NOT_OK, DataServices_DID_E364_AURIX_Fault_Indication_DID_E364_AURIX_Fault_Indication/DCM_E_PENDING]
        arg OpStatus: type=Dcm_OpStatusType, direction=IN
        arg Data: type=Dcm_Data1ByteType, direction=OUT
      operation ConditionCheckRead: possible-error=[DataServices_DID_E364_AURIX_Fault_Indication_DID_E364_AURIX_Fault_Indication/E_NOT_OK, DataServices_DID_E364_AURIX_Fault_Indication_DID_E364_AURIX_Fault_Indication/DCM_E_PENDING]
        arg OpStatus: type=Dcm_OpStatusType, direction=IN
        arg ErrorCode: type=Dcm_NegativeResponseCodeType, direction=OUT
      error E_NOT_OK: error-code=1
      error DCM_E_PENDING: error-code=10
    DataServices_DID_F18C_ECU_Serial_Number_DID_F18C_ECU_Serial_Number
      operation ReadData: possible-error=[DataServices_DID_F18C_ECU_Serial_Number_DID_F18C_ECU_Serial_Number/E_NOT_OK, DataServices_DID_F18C_ECU_Serial_Number_DID_F18C_ECU_Serial_Number/DCM_E_PENDING]
        arg OpStatus: type=Dcm_OpStatusType, direction=IN
        arg Data: type=Dcm_Data4ByteType, direction=OUT
      operation ConditionCheckRead: possible-error=[DataServices_DID_F18C_ECU_Serial_Number_DID_F18C_ECU_Serial_Number/E_NOT_OK, DataServices_DID_F18C_ECU_Serial_Number_DID_F18C_ECU_Serial_Number/DCM_E_PENDING]
        arg OpStatus: type=Dcm_OpStatusType, direction=IN
        arg ErrorCode: type=Dcm_NegativeResponseCodeType, direction=OUT
      error E_NOT_OK: error-code=1
      error DCM_E_PENDING: error-code=10
    DataServices_DID_D09A_High_Quiescent_Current_Function_Activation_Deactivation_DID_D09A_High_Quiescent_Current_Function_CD3E51C5
      operation ReadData: possible-error=[DataServices_DID_D09A_High_Quiescent_Current_Function_Activation_Deactivation_DID_D09A_High_Quiescent_Current_Function_CD3E51C5/E_NOT_OK, DataServices_DID_D09A_High_Quiescent_Current_Function_Activation_Deactivation_DID_D09A_High_Quiescent_Current_Function_CD3E51C5/DCM_E_PENDING]
        arg OpStatus: type=Dcm_OpStatusType, direction=IN
        arg Data: type=Dcm_Data1ByteType, direction=OUT
      operation ConditionCheckRead: possible-error=[DataServices_DID_D09A_High_Quiescent_Current_Function_Activation_Deactivation_DID_D09A_High_Quiescent_Current_Function_CD3E51C5/E_NOT_OK, DataServices_DID_D09A_High_Quiescent_Current_Function_Activation_Deactivation_DID_D09A_High_Quiescent_Current_Function_CD3E51C5/DCM_E_PENDING]
        arg OpStatus: type=Dcm_OpStatusType, direction=IN
        arg ErrorCode: type=Dcm_NegativeResponseCodeType, direction=OUT
      operation WriteData: possible-error=[DataServices_DID_D09A_High_Quiescent_Current_Function_Activation_Deactivation_DID_D09A_High_Quiescent_Current_Function_CD3E51C5/E_NOT_OK, DataServices_DID_D09A_High_Quiescent_Current_Function_Activation_Deactivation_DID_D09A_High_Quiescent_Current_Function_CD3E51C5/DCM_E_PENDING]
        arg Data: type=Dcm_Data1ByteType, direction=IN
        arg OpStatus: type=Dcm_OpStatusType, direction=IN
        arg ErrorCode: type=Dcm_NegativeResponseCodeType, direction=OUT
      error E_NOT_OK: error-code=1
      error DCM_E_PENDING: error-code=10
    DataServices_DID_EE9C_Transient_Phase_Current_A_DID_EE9C_Transient_Phase_Current_A
      operation ReadData: possible-error=[DataServices_DID_EE9C_Transient_Phase_Current_A_DID_EE9C_Transient_Phase_Current_A/E_NOT_OK, DataServices_DID_EE9C_Transient_Phase_Current_A_DID_EE9C_Transient_Phase_Current_A/DCM_E_PENDING]
        arg OpStatus: type=Dcm_OpStatusType, direction=IN
        arg Data: type=Dcm_Data2ByteType, direction=OUT
      operation ConditionCheckRead: possible-error=[DataServices_DID_EE9C_Transient_Phase_Current_A_DID_EE9C_Transient_Phase_Current_A/E_NOT_OK, DataServices_DID_EE9C_Transient_Phase_Current_A_DID_EE9C_Transient_Phase_Current_A/DCM_E_PENDING]
        arg OpStatus: type=Dcm_OpStatusType, direction=IN
        arg ErrorCode: type=Dcm_NegativeResponseCodeType, direction=OUT
      error E_NOT_OK: error-code=1
      error DCM_E_PENDING: error-code=10
    DataServices_DID_E349_Phase_V_PWM_duty_DID_E349_Phase_V_PWM_duty
      operation ReadData: possible-error=[DataServices_DID_E349_Phase_V_PWM_duty_DID_E349_Phase_V_PWM_duty/E_NOT_OK, DataServices_DID_E349_Phase_V_PWM_duty_DID_E349_Phase_V_PWM_duty/DCM_E_PENDING]
        arg OpStatus: type=Dcm_OpStatusType, direction=IN
        arg Data: type=Dcm_Data1ByteType, direction=OUT
      operation ConditionCheckRead: possible-error=[DataServices_DID_E349_Phase_V_PWM_duty_DID_E349_Phase_V_PWM_duty/E_NOT_OK, DataServices_DID_E349_Phase_V_PWM_duty_DID_E349_Phase_V_PWM_duty/DCM_E_PENDING]
        arg OpStatus: type=Dcm_OpStatusType, direction=IN
        arg ErrorCode: type=Dcm_NegativeResponseCodeType, direction=OUT
      error E_NOT_OK: error-code=1
      error DCM_E_PENDING: error-code=10
    DataServices_DID_E315_Available_Torque_minimum_DID_E315_Available_Torque_minimum
      operation ReadData: possible-error=[DataServices_DID_E315_Available_Torque_minimum_DID_E315_Available_Torque_minimum/E_NOT_OK, DataServices_DID_E315_Available_Torque_minimum_DID_E315_Available_Torque_minimum/DCM_E_PENDING]
        arg OpStatus: type=Dcm_OpStatusType, direction=IN
        arg Data: type=Dcm_Data2ByteType, direction=OUT
      operation ConditionCheckRead: possible-error=[DataServices_DID_E315_Available_Torque_minimum_DID_E315_Available_Torque_minimum/E_NOT_OK, DataServices_DID_E315_Available_Torque_minimum_DID_E315_Available_Torque_minimum/DCM_E_PENDING]
        arg OpStatus: type=Dcm_OpStatusType, direction=IN
        arg ErrorCode: type=Dcm_NegativeResponseCodeType, direction=OUT
      error E_NOT_OK: error-code=1
      error DCM_E_PENDING: error-code=10
    DataServices_DID_E314_Available_Torque_maximum_DID_E314_Available_Torque_maximum
      operation ReadData: possible-error=[DataServices_DID_E314_Available_Torque_maximum_DID_E314_Available_Torque_maximum/E_NOT_OK, DataServices_DID_E314_Available_Torque_maximum_DID_E314_Available_Torque_maximum/DCM_E_PENDING]
        arg OpStatus: type=Dcm_OpStatusType, direction=IN
        arg Data: type=Dcm_Data2ByteType, direction=OUT
      operation ConditionCheckRead: possible-error=[DataServices_DID_E314_Available_Torque_maximum_DID_E314_Available_Torque_maximum/E_NOT_OK, DataServices_DID_E314_Available_Torque_maximum_DID_E314_Available_Torque_maximum/DCM_E_PENDING]
        arg OpStatus: type=Dcm_OpStatusType, direction=IN
        arg ErrorCode: type=Dcm_NegativeResponseCodeType, direction=OUT
      error E_NOT_OK: error-code=1
      error DCM_E_PENDING: error-code=10
    DataServices_DID_EDA0_Complete_ECU_Part_Serial_Number_s_DID_F12E_1_Total_number_of_ECU_Software_Part_Numbers
      operation ReadData: possible-error=[DataServices_DID_EDA0_Complete_ECU_Part_Serial_Number_s_DID_F12E_1_Total_number_of_ECU_Software_Part_Numbers/E_NOT_OK, DataServices_DID_EDA0_Complete_ECU_Part_Serial_Number_s_DID_F12E_1_Total_number_of_ECU_Software_Part_Numbers/DCM_E_PENDING]
        arg OpStatus: type=Dcm_OpStatusType, direction=IN
        arg Data: type=Dcm_Data1ByteType, direction=OUT
      operation ConditionCheckRead: possible-error=[DataServices_DID_EDA0_Complete_ECU_Part_Serial_Number_s_DID_F12E_1_Total_number_of_ECU_Software_Part_Numbers/E_NOT_OK, DataServices_DID_EDA0_Complete_ECU_Part_Serial_Number_s_DID_F12E_1_Total_number_of_ECU_Software_Part_Numbers/DCM_E_PENDING]
        arg OpStatus: type=Dcm_OpStatusType, direction=IN
        arg ErrorCode: type=Dcm_NegativeResponseCodeType, direction=OUT
      error E_NOT_OK: error-code=1
      error DCM_E_PENDING: error-code=10
    DataServices_DID_EDA0_Complete_ECU_Part_Serial_Number_s_DID_F12A_ECU_Delivery_Assembly_Part_Number1_1
      operation ReadData: possible-error=[DataServices_DID_EDA0_Complete_ECU_Part_Serial_Number_s_DID_F12A_ECU_Delivery_Assembly_Part_Number1_1/E_NOT_OK, DataServices_DID_EDA0_Complete_ECU_Part_Serial_Number_s_DID_F12A_ECU_Delivery_Assembly_Part_Number1_1/DCM_E_PENDING]
        arg OpStatus: type=Dcm_OpStatusType, direction=IN
        arg Data: type=Dcm_Data3ByteType, direction=OUT
      operation ConditionCheckRead: possible-error=[DataServices_DID_EDA0_Complete_ECU_Part_Serial_Number_s_DID_F12A_ECU_Delivery_Assembly_Part_Number1_1/E_NOT_OK, DataServices_DID_EDA0_Complete_ECU_Part_Serial_Number_s_DID_F12A_ECU_Delivery_Assembly_Part_Number1_1/DCM_E_PENDING]
        arg OpStatus: type=Dcm_OpStatusType, direction=IN
        arg ErrorCode: type=Dcm_NegativeResponseCodeType, direction=OUT
      error E_NOT_OK: error-code=1
      error DCM_E_PENDING: error-code=10
    DataServices_DID_EDA0_Complete_ECU_Part_Serial_Number_s_Reserved
      operation ReadData: possible-error=[DataServices_DID_EDA0_Complete_ECU_Part_Serial_Number_s_Reserved/E_NOT_OK, DataServices_DID_EDA0_Complete_ECU_Part_Serial_Number_s_Reserved/DCM_E_PENDING]
        arg OpStatus: type=Dcm_OpStatusType, direction=IN
        arg Data: type=Dcm_Data10ByteType, direction=OUT
      operation ConditionCheckRead: possible-error=[DataServices_DID_EDA0_Complete_ECU_Part_Serial_Number_s_Reserved/E_NOT_OK, DataServices_DID_EDA0_Complete_ECU_Part_Serial_Number_s_Reserved/DCM_E_PENDING]
        arg OpStatus: type=Dcm_OpStatusType, direction=IN
        arg ErrorCode: type=Dcm_NegativeResponseCodeType, direction=OUT
      error E_NOT_OK: error-code=1
      error DCM_E_PENDING: error-code=10
    DataServices_DID_EDA0_Complete_ECU_Part_Serial_Number_s_DID_F12B_ECU_Delivery_Assembly_Part_Number
      operation ReadData: possible-error=[DataServices_DID_EDA0_Complete_ECU_Part_Serial_Number_s_DID_F12B_ECU_Delivery_Assembly_Part_Number/E_NOT_OK, DataServices_DID_EDA0_Complete_ECU_Part_Serial_Number_s_DID_F12B_ECU_Delivery_Assembly_Part_Number/DCM_E_PENDING]
        arg OpStatus: type=Dcm_OpStatusType, direction=IN
        arg Data: type=Dcm_Data4ByteType, direction=OUT
      operation ConditionCheckRead: possible-error=[DataServices_DID_EDA0_Complete_ECU_Part_Serial_Number_s_DID_F12B_ECU_Delivery_Assembly_Part_Number/E_NOT_OK, DataServices_DID_EDA0_Complete_ECU_Part_Serial_Number_s_DID_F12B_ECU_Delivery_Assembly_Part_Number/DCM_E_PENDING]
        arg OpStatus: type=Dcm_OpStatusType, direction=IN
        arg ErrorCode: type=Dcm_NegativeResponseCodeType, direction=OUT
      error E_NOT_OK: error-code=1
      error DCM_E_PENDING: error-code=10
    DataServices_DID_EDA0_Complete_ECU_Part_Serial_Number_s_DID_F18C_ECU_Serial_Number
      operation ReadData: possible-error=[DataServices_DID_EDA0_Complete_ECU_Part_Serial_Number_s_DID_F18C_ECU_Serial_Number/E_NOT_OK, DataServices_DID_EDA0_Complete_ECU_Part_Serial_Number_s_DID_F18C_ECU_Serial_Number/DCM_E_PENDING]
        arg OpStatus: type=Dcm_OpStatusType, direction=IN
        arg Data: type=Dcm_Data4ByteType, direction=OUT
      operation ConditionCheckRead: possible-error=[DataServices_DID_EDA0_Complete_ECU_Part_Serial_Number_s_DID_F18C_ECU_Serial_Number/E_NOT_OK, DataServices_DID_EDA0_Complete_ECU_Part_Serial_Number_s_DID_F18C_ECU_Serial_Number/DCM_E_PENDING]
        arg OpStatus: type=Dcm_OpStatusType, direction=IN
        arg ErrorCode: type=Dcm_NegativeResponseCodeType, direction=OUT
      error E_NOT_OK: error-code=1
      error DCM_E_PENDING: error-code=10
    DataServices_DID_EDA0_Complete_ECU_Part_Serial_Number_s_ASCII_part
      operation ReadData: possible-error=[DataServices_DID_EDA0_Complete_ECU_Part_Serial_Number_s_ASCII_part/E_NOT_OK, DataServices_DID_EDA0_Complete_ECU_Part_Serial_Number_s_ASCII_part/DCM_E_PENDING]
        arg OpStatus: type=Dcm_OpStatusType, direction=IN
        arg Data: type=Dcm_Data3ByteType, direction=OUT
      operation ConditionCheckRead: possible-error=[DataServices_DID_EDA0_Complete_ECU_Part_Serial_Number_s_ASCII_part/E_NOT_OK, DataServices_DID_EDA0_Complete_ECU_Part_Serial_Number_s_ASCII_part/DCM_E_PENDING]
        arg OpStatus: type=Dcm_OpStatusType, direction=IN
        arg ErrorCode: type=Dcm_NegativeResponseCodeType, direction=OUT
      error E_NOT_OK: error-code=1
      error DCM_E_PENDING: error-code=10
    DataServices_DID_EDA0_Complete_ECU_Part_Serial_Number_s_DID_F12B_ECU_Delivery_Assembly_Part_Number1
      operation ReadData: possible-error=[DataServices_DID_EDA0_Complete_ECU_Part_Serial_Number_s_DID_F12B_ECU_Delivery_Assembly_Part_Number1/E_NOT_OK, DataServices_DID_EDA0_Complete_ECU_Part_Serial_Number_s_DID_F12B_ECU_Delivery_Assembly_Part_Number1/DCM_E_PENDING]
        arg OpStatus: type=Dcm_OpStatusType, direction=IN
        arg Data: type=Dcm_Data3ByteType, direction=OUT
      operation ConditionCheckRead: possible-error=[DataServices_DID_EDA0_Complete_ECU_Part_Serial_Number_s_DID_F12B_ECU_Delivery_Assembly_Part_Number1/E_NOT_OK, DataServices_DID_EDA0_Complete_ECU_Part_Serial_Number_s_DID_F12B_ECU_Delivery_Assembly_Part_Number1/DCM_E_PENDING]
        arg OpStatus: type=Dcm_OpStatusType, direction=IN
        arg ErrorCode: type=Dcm_NegativeResponseCodeType, direction=OUT
      error E_NOT_OK: error-code=1
      error DCM_E_PENDING: error-code=10
    DataServices_DID_EDA0_Complete_ECU_Part_Serial_Number_s_F120_Application_Diagnostic_Database_Part_Number1
      operation ReadData: possible-error=[DataServices_DID_EDA0_Complete_ECU_Part_Serial_Number_s_F120_Application_Diagnostic_Database_Part_Number1/E_NOT_OK, DataServices_DID_EDA0_Complete_ECU_Part_Serial_Number_s_F120_Application_Diagnostic_Database_Part_Number1/DCM_E_PENDING]
        arg OpStatus: type=Dcm_OpStatusType, direction=IN
        arg Data: type=Dcm_Data3ByteType, direction=OUT
      operation ConditionCheckRead: possible-error=[DataServices_DID_EDA0_Complete_ECU_Part_Serial_Number_s_F120_Application_Diagnostic_Database_Part_Number1/E_NOT_OK, DataServices_DID_EDA0_Complete_ECU_Part_Serial_Number_s_F120_Application_Diagnostic_Database_Part_Number1/DCM_E_PENDING]
        arg OpStatus: type=Dcm_OpStatusType, direction=IN
        arg ErrorCode: type=Dcm_NegativeResponseCodeType, direction=OUT
      error E_NOT_OK: error-code=1
      error DCM_E_PENDING: error-code=10
    DataServices_DID_EDA0_Complete_ECU_Part_Serial_Number_s_F120_Application_Diagnostic_Database_Part_Number
      operation ReadData: possible-error=[DataServices_DID_EDA0_Complete_ECU_Part_Serial_Number_s_F120_Application_Diagnostic_Database_Part_Number/E_NOT_OK, DataServices_DID_EDA0_Complete_ECU_Part_Serial_Number_s_F120_Application_Diagnostic_Database_Part_Number/DCM_E_PENDING]
        arg OpStatus: type=Dcm_OpStatusType, direction=IN
        arg Data: type=Dcm_Data4ByteType, direction=OUT
      operation ConditionCheckRead: possible-error=[DataServices_DID_EDA0_Complete_ECU_Part_Serial_Number_s_F120_Application_Diagnostic_Database_Part_Number/E_NOT_OK, DataServices_DID_EDA0_Complete_ECU_Part_Serial_Number_s_F120_Application_Diagnostic_Database_Part_Number/DCM_E_PENDING]
        arg OpStatus: type=Dcm_OpStatusType, direction=IN
        arg ErrorCode: type=Dcm_NegativeResponseCodeType, direction=OUT
      error E_NOT_OK: error-code=1
      error DCM_E_PENDING: error-code=10
    DataServices_DID_EDA0_Complete_ECU_Part_Serial_Number_s_BCD_part
      operation ReadData: possible-error=[DataServices_DID_EDA0_Complete_ECU_Part_Serial_Number_s_BCD_part/E_NOT_OK, DataServices_DID_EDA0_Complete_ECU_Part_Serial_Number_s_BCD_part/DCM_E_PENDING]
        arg OpStatus: type=Dcm_OpStatusType, direction=IN
        arg Data: type=Dcm_Data4ByteType, direction=OUT
      operation ConditionCheckRead: possible-error=[DataServices_DID_EDA0_Complete_ECU_Part_Serial_Number_s_BCD_part/E_NOT_OK, DataServices_DID_EDA0_Complete_ECU_Part_Serial_Number_s_BCD_part/DCM_E_PENDING]
        arg OpStatus: type=Dcm_OpStatusType, direction=IN
        arg ErrorCode: type=Dcm_NegativeResponseCodeType, direction=OUT
      error E_NOT_OK: error-code=1
      error DCM_E_PENDING: error-code=10
    DataServices_DID_EDA0_Complete_ECU_Part_Serial_Number_s_DID_F12A_ECU_Delivery_Assembly_Part_Number_1
      operation ReadData: possible-error=[DataServices_DID_EDA0_Complete_ECU_Part_Serial_Number_s_DID_F12A_ECU_Delivery_Assembly_Part_Number_1/E_NOT_OK, DataServices_DID_EDA0_Complete_ECU_Part_Serial_Number_s_DID_F12A_ECU_Delivery_Assembly_Part_Number_1/DCM_E_PENDING]
        arg OpStatus: type=Dcm_OpStatusType, direction=IN
        arg Data: type=Dcm_Data4ByteType, direction=OUT
      operation ConditionCheckRead: possible-error=[DataServices_DID_EDA0_Complete_ECU_Part_Serial_Number_s_DID_F12A_ECU_Delivery_Assembly_Part_Number_1/E_NOT_OK, DataServices_DID_EDA0_Complete_ECU_Part_Serial_Number_s_DID_F12A_ECU_Delivery_Assembly_Part_Number_1/DCM_E_PENDING]
        arg OpStatus: type=Dcm_OpStatusType, direction=IN
        arg ErrorCode: type=Dcm_NegativeResponseCodeType, direction=OUT
      error E_NOT_OK: error-code=1
      error DCM_E_PENDING: error-code=10
    DataServices_DID_EED4_Safty_Function_Mode_DID_EED4_Safty_Function_Mode
      operation ReadData: possible-error=[DataServices_DID_EED4_Safty_Function_Mode_DID_EED4_Safty_Function_Mode/E_NOT_OK, DataServices_DID_EED4_Safty_Function_Mode_DID_EED4_Safty_Function_Mode/DCM_E_PENDING]
        arg OpStatus: type=Dcm_OpStatusType, direction=IN
        arg Data: type=Dcm_Data1ByteType, direction=OUT
      operation ConditionCheckRead: possible-error=[DataServices_DID_EED4_Safty_Function_Mode_DID_EED4_Safty_Function_Mode/E_NOT_OK, DataServices_DID_EED4_Safty_Function_Mode_DID_EED4_Safty_Function_Mode/DCM_E_PENDING]
        arg OpStatus: type=Dcm_OpStatusType, direction=IN
        arg ErrorCode: type=Dcm_NegativeResponseCodeType, direction=OUT
      error E_NOT_OK: error-code=1
      error DCM_E_PENDING: error-code=10
    DataServices_DID_EEC3_ECU_power_supply_Voltage_DID_EEC3_ECU_power_supply_Voltage
      operation ReadData: possible-error=[DataServices_DID_EEC3_ECU_power_supply_Voltage_DID_EEC3_ECU_power_supply_Voltage/E_NOT_OK, DataServices_DID_EEC3_ECU_power_supply_Voltage_DID_EEC3_ECU_power_supply_Voltage/DCM_E_PENDING]
        arg OpStatus: type=Dcm_OpStatusType, direction=IN
        arg Data: type=Dcm_Data1ByteType, direction=OUT
      operation ConditionCheckRead: possible-error=[DataServices_DID_EEC3_ECU_power_supply_Voltage_DID_EEC3_ECU_power_supply_Voltage/E_NOT_OK, DataServices_DID_EEC3_ECU_power_supply_Voltage_DID_EEC3_ECU_power_supply_Voltage/DCM_E_PENDING]
        arg OpStatus: type=Dcm_OpStatusType, direction=IN
        arg ErrorCode: type=Dcm_NegativeResponseCodeType, direction=OUT
      error E_NOT_OK: error-code=1
      error DCM_E_PENDING: error-code=10
    DataServices_DID_EF1B_EOL_config_word_A_DID_EF1B_EOL_config_word_A
      operation ReadData: possible-error=[DataServices_DID_EF1B_EOL_config_word_A_DID_EF1B_EOL_config_word_A/E_NOT_OK, DataServices_DID_EF1B_EOL_config_word_A_DID_EF1B_EOL_config_word_A/DCM_E_PENDING]
        arg OpStatus: type=Dcm_OpStatusType, direction=IN
        arg Data: type=Dcm_Data2ByteType, direction=OUT
      operation ConditionCheckRead: possible-error=[DataServices_DID_EF1B_EOL_config_word_A_DID_EF1B_EOL_config_word_A/E_NOT_OK, DataServices_DID_EF1B_EOL_config_word_A_DID_EF1B_EOL_config_word_A/DCM_E_PENDING]
        arg OpStatus: type=Dcm_OpStatusType, direction=IN
        arg ErrorCode: type=Dcm_NegativeResponseCodeType, direction=OUT
      operation WriteData: possible-error=[DataServices_DID_EF1B_EOL_config_word_A_DID_EF1B_EOL_config_word_A/E_NOT_OK, DataServices_DID_EF1B_EOL_config_word_A_DID_EF1B_EOL_config_word_A/DCM_E_PENDING]
        arg Data: type=Dcm_Data2ByteType, direction=IN
        arg OpStatus: type=Dcm_OpStatusType, direction=IN
        arg ErrorCode: type=Dcm_NegativeResponseCodeType, direction=OUT
      error E_NOT_OK: error-code=1
      error DCM_E_PENDING: error-code=10
    DataServices_DID_EEBF_HV_Main_Relay_Status_DID_EEBF_HV_Main_Relay_Status
      operation ReadData: possible-error=[DataServices_DID_EEBF_HV_Main_Relay_Status_DID_EEBF_HV_Main_Relay_Status/E_NOT_OK, DataServices_DID_EEBF_HV_Main_Relay_Status_DID_EEBF_HV_Main_Relay_Status/DCM_E_PENDING]
        arg OpStatus: type=Dcm_OpStatusType, direction=IN
        arg Data: type=Dcm_Data1ByteType, direction=OUT
      operation ConditionCheckRead: possible-error=[DataServices_DID_EEBF_HV_Main_Relay_Status_DID_EEBF_HV_Main_Relay_Status/E_NOT_OK, DataServices_DID_EEBF_HV_Main_Relay_Status_DID_EEBF_HV_Main_Relay_Status/DCM_E_PENDING]
        arg OpStatus: type=Dcm_OpStatusType, direction=IN
        arg ErrorCode: type=Dcm_NegativeResponseCodeType, direction=OUT
      error E_NOT_OK: error-code=1
      error DCM_E_PENDING: error-code=10
    DataServices_DID_E350_Phase_W_PWM_duty_DID_E350_Phase_W_PWM_duty
      operation ReadData: possible-error=[DataServices_DID_E350_Phase_W_PWM_duty_DID_E350_Phase_W_PWM_duty/E_NOT_OK, DataServices_DID_E350_Phase_W_PWM_duty_DID_E350_Phase_W_PWM_duty/DCM_E_PENDING]
        arg OpStatus: type=Dcm_OpStatusType, direction=IN
        arg Data: type=Dcm_Data1ByteType, direction=OUT
      operation ConditionCheckRead: possible-error=[DataServices_DID_E350_Phase_W_PWM_duty_DID_E350_Phase_W_PWM_duty/E_NOT_OK, DataServices_DID_E350_Phase_W_PWM_duty_DID_E350_Phase_W_PWM_duty/DCM_E_PENDING]
        arg OpStatus: type=Dcm_OpStatusType, direction=IN
        arg ErrorCode: type=Dcm_NegativeResponseCodeType, direction=OUT
      error E_NOT_OK: error-code=1
      error DCM_E_PENDING: error-code=10
    DataServices_DID_F126_Autosar_BSW_Cluster_Versions_DID_F126_24_COM_CLUSTER_AR_RELEASE_REVISION_VERSION
      operation ReadData: possible-error=[DataServices_DID_F126_Autosar_BSW_Cluster_Versions_DID_F126_24_COM_CLUSTER_AR_RELEASE_REVISION_VERSION/E_NOT_OK, DataServices_DID_F126_Autosar_BSW_Cluster_Versions_DID_F126_24_COM_CLUSTER_AR_RELEASE_REVISION_VERSION/DCM_E_PENDING]
        arg OpStatus: type=Dcm_OpStatusType, direction=IN
        arg Data: type=Dcm_Data1ByteType, direction=OUT
      operation ConditionCheckRead: possible-error=[DataServices_DID_F126_Autosar_BSW_Cluster_Versions_DID_F126_24_COM_CLUSTER_AR_RELEASE_REVISION_VERSION/E_NOT_OK, DataServices_DID_F126_Autosar_BSW_Cluster_Versions_DID_F126_24_COM_CLUSTER_AR_RELEASE_REVISION_VERSION/DCM_E_PENDING]
        arg OpStatus: type=Dcm_OpStatusType, direction=IN
        arg ErrorCode: type=Dcm_NegativeResponseCodeType, direction=OUT
      error E_NOT_OK: error-code=1
      error DCM_E_PENDING: error-code=10
    DataServices_DID_F126_Autosar_BSW_Cluster_Versions_DID_F126_36_FLEXRAY_CLUSTER_AR_RELEASE_MAJOR_VERSION
      operation ReadData: possible-error=[DataServices_DID_F126_Autosar_BSW_Cluster_Versions_DID_F126_36_FLEXRAY_CLUSTER_AR_RELEASE_MAJOR_VERSION/E_NOT_OK, DataServices_DID_F126_Autosar_BSW_Cluster_Versions_DID_F126_36_FLEXRAY_CLUSTER_AR_RELEASE_MAJOR_VERSION/DCM_E_PENDING]
        arg OpStatus: type=Dcm_OpStatusType, direction=IN
        arg Data: type=Dcm_Data1ByteType, direction=OUT
      operation ConditionCheckRead: possible-error=[DataServices_DID_F126_Autosar_BSW_Cluster_Versions_DID_F126_36_FLEXRAY_CLUSTER_AR_RELEASE_MAJOR_VERSION/E_NOT_OK, DataServices_DID_F126_Autosar_BSW_Cluster_Versions_DID_F126_36_FLEXRAY_CLUSTER_AR_RELEASE_MAJOR_VERSION/DCM_E_PENDING]
        arg OpStatus: type=Dcm_OpStatusType, direction=IN
        arg ErrorCode: type=Dcm_NegativeResponseCodeType, direction=OUT
      error E_NOT_OK: error-code=1
      error DCM_E_PENDING: error-code=10
    DataServices_DID_F126_Autosar_BSW_Cluster_Versions_DID_F126_31_CAN_CLUSTER_AR_RELEASE_REVISION_VERSION
      operation ReadData: possible-error=[DataServices_DID_F126_Autosar_BSW_Cluster_Versions_DID_F126_31_CAN_CLUSTER_AR_RELEASE_REVISION_VERSION/E_NOT_OK, DataServices_DID_F126_Autosar_BSW_Cluster_Versions_DID_F126_31_CAN_CLUSTER_AR_RELEASE_REVISION_VERSION/DCM_E_PENDING]
        arg OpStatus: type=Dcm_OpStatusType, direction=IN
        arg Data: type=Dcm_Data1ByteType, direction=OUT
      operation ConditionCheckRead: possible-error=[DataServices_DID_F126_Autosar_BSW_Cluster_Versions_DID_F126_31_CAN_CLUSTER_AR_RELEASE_REVISION_VERSION/E_NOT_OK, DataServices_DID_F126_Autosar_BSW_Cluster_Versions_DID_F126_31_CAN_CLUSTER_AR_RELEASE_REVISION_VERSION/DCM_E_PENDING]
        arg OpStatus: type=Dcm_OpStatusType, direction=IN
        arg ErrorCode: type=Dcm_NegativeResponseCodeType, direction=OUT
      error E_NOT_OK: error-code=1
      error DCM_E_PENDING: error-code=10
    DataServices_DID_F126_Autosar_BSW_Cluster_Versions_DID_F126_26_CAN_CLUSTER_SW_MAJOR_VERSION
      operation ReadData: possible-error=[DataServices_DID_F126_Autosar_BSW_Cluster_Versions_DID_F126_26_CAN_CLUSTER_SW_MAJOR_VERSION/E_NOT_OK, DataServices_DID_F126_Autosar_BSW_Cluster_Versions_DID_F126_26_CAN_CLUSTER_SW_MAJOR_VERSION/DCM_E_PENDING]
        arg OpStatus: type=Dcm_OpStatusType, direction=IN
        arg Data: type=Dcm_Data1ByteType, direction=OUT
      operation ConditionCheckRead: possible-error=[DataServices_DID_F126_Autosar_BSW_Cluster_Versions_DID_F126_26_CAN_CLUSTER_SW_MAJOR_VERSION/E_NOT_OK, DataServices_DID_F126_Autosar_BSW_Cluster_Versions_DID_F126_26_CAN_CLUSTER_SW_MAJOR_VERSION/DCM_E_PENDING]
        arg OpStatus: type=Dcm_OpStatusType, direction=IN
        arg ErrorCode: type=Dcm_NegativeResponseCodeType, direction=OUT
      error E_NOT_OK: error-code=1
      error DCM_E_PENDING: error-code=10
    DataServices_DID_F126_Autosar_BSW_Cluster_Versions_DID_F126_9_DIAG_CLUSTER_VCC_DCM_VERSION
      operation ReadData: possible-error=[DataServices_DID_F126_Autosar_BSW_Cluster_Versions_DID_F126_9_DIAG_CLUSTER_VCC_DCM_VERSION/E_NOT_OK, DataServices_DID_F126_Autosar_BSW_Cluster_Versions_DID_F126_9_DIAG_CLUSTER_VCC_DCM_VERSION/DCM_E_PENDING]
        arg OpStatus: type=Dcm_OpStatusType, direction=IN
        arg Data: type=Dcm_Data1ByteType, direction=OUT
      operation ConditionCheckRead: possible-error=[DataServices_DID_F126_Autosar_BSW_Cluster_Versions_DID_F126_9_DIAG_CLUSTER_VCC_DCM_VERSION/E_NOT_OK, DataServices_DID_F126_Autosar_BSW_Cluster_Versions_DID_F126_9_DIAG_CLUSTER_VCC_DCM_VERSION/DCM_E_PENDING]
        arg OpStatus: type=Dcm_OpStatusType, direction=IN
        arg ErrorCode: type=Dcm_NegativeResponseCodeType, direction=OUT
      error E_NOT_OK: error-code=1
      error DCM_E_PENDING: error-code=10
    DataServices_DID_F126_Autosar_BSW_Cluster_Versions_DID_F126_40_LIN_CLUSTER_SW_MAJOR_VERSION
      operation ReadData: possible-error=[DataServices_DID_F126_Autosar_BSW_Cluster_Versions_DID_F126_40_LIN_CLUSTER_SW_MAJOR_VERSION/E_NOT_OK, DataServices_DID_F126_Autosar_BSW_Cluster_Versions_DID_F126_40_LIN_CLUSTER_SW_MAJOR_VERSION/DCM_E_PENDING]
        arg OpStatus: type=Dcm_OpStatusType, direction=IN
        arg Data: type=Dcm_Data1ByteType, direction=OUT
      operation ConditionCheckRead: possible-error=[DataServices_DID_F126_Autosar_BSW_Cluster_Versions_DID_F126_40_LIN_CLUSTER_SW_MAJOR_VERSION/E_NOT_OK, DataServices_DID_F126_Autosar_BSW_Cluster_Versions_DID_F126_40_LIN_CLUSTER_SW_MAJOR_VERSION/DCM_E_PENDING]
        arg OpStatus: type=Dcm_OpStatusType, direction=IN
        arg ErrorCode: type=Dcm_NegativeResponseCodeType, direction=OUT
      error E_NOT_OK: error-code=1
      error DCM_E_PENDING: error-code=10
    DataServices_DID_F126_Autosar_BSW_Cluster_Versions_DID_F126_15_MODEMGMT_CLUSTER_AR_RELEASE_MAJOR_VERSION
      operation ReadData: possible-error=[DataServices_DID_F126_Autosar_BSW_Cluster_Versions_DID_F126_15_MODEMGMT_CLUSTER_AR_RELEASE_MAJOR_VERSION/E_NOT_OK, DataServices_DID_F126_Autosar_BSW_Cluster_Versions_DID_F126_15_MODEMGMT_CLUSTER_AR_RELEASE_MAJOR_VERSION/DCM_E_PENDING]
        arg OpStatus: type=Dcm_OpStatusType, direction=IN
        arg Data: type=Dcm_Data1ByteType, direction=OUT
      operation ConditionCheckRead: possible-error=[DataServices_DID_F126_Autosar_BSW_Cluster_Versions_DID_F126_15_MODEMGMT_CLUSTER_AR_RELEASE_MAJOR_VERSION/E_NOT_OK, DataServices_DID_F126_Autosar_BSW_Cluster_Versions_DID_F126_15_MODEMGMT_CLUSTER_AR_RELEASE_MAJOR_VERSION/DCM_E_PENDING]
        arg OpStatus: type=Dcm_OpStatusType, direction=IN
        arg ErrorCode: type=Dcm_NegativeResponseCodeType, direction=OUT
      error E_NOT_OK: error-code=1
      error DCM_E_PENDING: error-code=10
    DataServices_DID_F126_Autosar_BSW_Cluster_Versions_DID_F126_6_DIAG_CLUSTER_AR_RELEASE_MINOR_VERSION
      operation ReadData: possible-error=[DataServices_DID_F126_Autosar_BSW_Cluster_Versions_DID_F126_6_DIAG_CLUSTER_AR_RELEASE_MINOR_VERSION/E_NOT_OK, DataServices_DID_F126_Autosar_BSW_Cluster_Versions_DID_F126_6_DIAG_CLUSTER_AR_RELEASE_MINOR_VERSION/DCM_E_PENDING]
        arg OpStatus: type=Dcm_OpStatusType, direction=IN
        arg Data: type=Dcm_Data1ByteType, direction=OUT
      operation ConditionCheckRead: possible-error=[DataServices_DID_F126_Autosar_BSW_Cluster_Versions_DID_F126_6_DIAG_CLUSTER_AR_RELEASE_MINOR_VERSION/E_NOT_OK, DataServices_DID_F126_Autosar_BSW_Cluster_Versions_DID_F126_6_DIAG_CLUSTER_AR_RELEASE_MINOR_VERSION/DCM_E_PENDING]
        arg OpStatus: type=Dcm_OpStatusType, direction=IN
        arg ErrorCode: type=Dcm_NegativeResponseCodeType, direction=OUT
      error E_NOT_OK: error-code=1
      error DCM_E_PENDING: error-code=10
    DataServices_DID_F126_Autosar_BSW_Cluster_Versions_DID_F126_3_DIAG_CLUSTER_SW_MINOR_VERSION
      operation ReadData: possible-error=[DataServices_DID_F126_Autosar_BSW_Cluster_Versions_DID_F126_3_DIAG_CLUSTER_SW_MINOR_VERSION/E_NOT_OK, DataServices_DID_F126_Autosar_BSW_Cluster_Versions_DID_F126_3_DIAG_CLUSTER_SW_MINOR_VERSION/DCM_E_PENDING]
        arg OpStatus: type=Dcm_OpStatusType, direction=IN
        arg Data: type=Dcm_Data1ByteType, direction=OUT
      operation ConditionCheckRead: possible-error=[DataServices_DID_F126_Autosar_BSW_Cluster_Versions_DID_F126_3_DIAG_CLUSTER_SW_MINOR_VERSION/E_NOT_OK, DataServices_DID_F126_Autosar_BSW_Cluster_Versions_DID_F126_3_DIAG_CLUSTER_SW_MINOR_VERSION/DCM_E_PENDING]
        arg OpStatus: type=Dcm_OpStatusType, direction=IN
        arg ErrorCode: type=Dcm_NegativeResponseCodeType, direction=OUT
      error E_NOT_OK: error-code=1
      error DCM_E_PENDING: error-code=10
    DataServices_DID_F126_Autosar_BSW_Cluster_Versions_DID_F126_8_DIAG_CLUSTER_VCC_DEM_VERSION
      operation ReadData: possible-error=[DataServices_DID_F126_Autosar_BSW_Cluster_Versions_DID_F126_8_DIAG_CLUSTER_VCC_DEM_VERSION/E_NOT_OK, DataServices_DID_F126_Autosar_BSW_Cluster_Versions_DID_F126_8_DIAG_CLUSTER_VCC_DEM_VERSION/DCM_E_PENDING]
        arg OpStatus: type=Dcm_OpStatusType, direction=IN
        arg Data: type=Dcm_Data1ByteType, direction=OUT
      operation ConditionCheckRead: possible-error=[DataServices_DID_F126_Autosar_BSW_Cluster_Versions_DID_F126_8_DIAG_CLUSTER_VCC_DEM_VERSION/E_NOT_OK, DataServices_DID_F126_Autosar_BSW_Cluster_Versions_DID_F126_8_DIAG_CLUSTER_VCC_DEM_VERSION/DCM_E_PENDING]
        arg OpStatus: type=Dcm_OpStatusType, direction=IN
        arg ErrorCode: type=Dcm_NegativeResponseCodeType, direction=OUT
      error E_NOT_OK: error-code=1
      error DCM_E_PENDING: error-code=10
    DataServices_DID_F126_Autosar_BSW_Cluster_Versions_DID_F126_39_LIN_CLUSTER_VENDOR_ID
      operation ReadData: possible-error=[DataServices_DID_F126_Autosar_BSW_Cluster_Versions_DID_F126_39_LIN_CLUSTER_VENDOR_ID/E_NOT_OK, DataServices_DID_F126_Autosar_BSW_Cluster_Versions_DID_F126_39_LIN_CLUSTER_VENDOR_ID/DCM_E_PENDING]
        arg OpStatus: type=Dcm_OpStatusType, direction=IN
        arg Data: type=Dcm_Data2ByteType, direction=OUT
      operation ConditionCheckRead: possible-error=[DataServices_DID_F126_Autosar_BSW_Cluster_Versions_DID_F126_39_LIN_CLUSTER_VENDOR_ID/E_NOT_OK, DataServices_DID_F126_Autosar_BSW_Cluster_Versions_DID_F126_39_LIN_CLUSTER_VENDOR_ID/DCM_E_PENDING]
        arg OpStatus: type=Dcm_OpStatusType, direction=IN
        arg ErrorCode: type=Dcm_NegativeResponseCodeType, direction=OUT
      error E_NOT_OK: error-code=1
      error DCM_E_PENDING: error-code=10
    DataServices_DID_F126_Autosar_BSW_Cluster_Versions_DID_F126_43_LIN_CLUSTER_AR_RELEASE_MAJOR_VERSION
      operation ReadData: possible-error=[DataServices_DID_F126_Autosar_BSW_Cluster_Versions_DID_F126_43_LIN_CLUSTER_AR_RELEASE_MAJOR_VERSION/E_NOT_OK, DataServices_DID_F126_Autosar_BSW_Cluster_Versions_DID_F126_43_LIN_CLUSTER_AR_RELEASE_MAJOR_VERSION/DCM_E_PENDING]
        arg OpStatus: type=Dcm_OpStatusType, direction=IN
        arg Data: type=Dcm_Data1ByteType, direction=OUT
      operation ConditionCheckRead: possible-error=[DataServices_DID_F126_Autosar_BSW_Cluster_Versions_DID_F126_43_LIN_CLUSTER_AR_RELEASE_MAJOR_VERSION/E_NOT_OK, DataServices_DID_F126_Autosar_BSW_Cluster_Versions_DID_F126_43_LIN_CLUSTER_AR_RELEASE_MAJOR_VERSION/DCM_E_PENDING]
        arg OpStatus: type=Dcm_OpStatusType, direction=IN
        arg ErrorCode: type=Dcm_NegativeResponseCodeType, direction=OUT
      error E_NOT_OK: error-code=1
      error DCM_E_PENDING: error-code=10
    DataServices_DID_F126_Autosar_BSW_Cluster_Versions_DID_F126_13_MODEMGMT_CLUSTER_SW_MINOR_VERSION
      operation ReadData: possible-error=[DataServices_DID_F126_Autosar_BSW_Cluster_Versions_DID_F126_13_MODEMGMT_CLUSTER_SW_MINOR_VERSION/E_NOT_OK, DataServices_DID_F126_Autosar_BSW_Cluster_Versions_DID_F126_13_MODEMGMT_CLUSTER_SW_MINOR_VERSION/DCM_E_PENDING]
        arg OpStatus: type=Dcm_OpStatusType, direction=IN
        arg Data: type=Dcm_Data1ByteType, direction=OUT
      operation ConditionCheckRead: possible-error=[DataServices_DID_F126_Autosar_BSW_Cluster_Versions_DID_F126_13_MODEMGMT_CLUSTER_SW_MINOR_VERSION/E_NOT_OK, DataServices_DID_F126_Autosar_BSW_Cluster_Versions_DID_F126_13_MODEMGMT_CLUSTER_SW_MINOR_VERSION/DCM_E_PENDING]
        arg OpStatus: type=Dcm_OpStatusType, direction=IN
        arg ErrorCode: type=Dcm_NegativeResponseCodeType, direction=OUT
      error E_NOT_OK: error-code=1
      error DCM_E_PENDING: error-code=10
    DataServices_DID_F126_Autosar_BSW_Cluster_Versions_DID_F126_23_COM_CLUSTER_AR_RELEASE_MINOR_VERSION
      operation ReadData: possible-error=[DataServices_DID_F126_Autosar_BSW_Cluster_Versions_DID_F126_23_COM_CLUSTER_AR_RELEASE_MINOR_VERSION/E_NOT_OK, DataServices_DID_F126_Autosar_BSW_Cluster_Versions_DID_F126_23_COM_CLUSTER_AR_RELEASE_MINOR_VERSION/DCM_E_PENDING]
        arg OpStatus: type=Dcm_OpStatusType, direction=IN
        arg Data: type=Dcm_Data1ByteType, direction=OUT
      operation ConditionCheckRead: possible-error=[DataServices_DID_F126_Autosar_BSW_Cluster_Versions_DID_F126_23_COM_CLUSTER_AR_RELEASE_MINOR_VERSION/E_NOT_OK, DataServices_DID_F126_Autosar_BSW_Cluster_Versions_DID_F126_23_COM_CLUSTER_AR_RELEASE_MINOR_VERSION/DCM_E_PENDING]
        arg OpStatus: type=Dcm_OpStatusType, direction=IN
        arg ErrorCode: type=Dcm_NegativeResponseCodeType, direction=OUT
      error E_NOT_OK: error-code=1
      error DCM_E_PENDING: error-code=10
    DataServices_DID_F126_Autosar_BSW_Cluster_Versions_DID_F126_20_COM_CLUSTER_SW_MINOR_VERSION
      operation ReadData: possible-error=[DataServices_DID_F126_Autosar_BSW_Cluster_Versions_DID_F126_20_COM_CLUSTER_SW_MINOR_VERSION/E_NOT_OK, DataServices_DID_F126_Autosar_BSW_Cluster_Versions_DID_F126_20_COM_CLUSTER_SW_MINOR_VERSION/DCM_E_PENDING]
        arg OpStatus: type=Dcm_OpStatusType, direction=IN
        arg Data: type=Dcm_Data1ByteType, direction=OUT
      operation ConditionCheckRead: possible-error=[DataServices_DID_F126_Autosar_BSW_Cluster_Versions_DID_F126_20_COM_CLUSTER_SW_MINOR_VERSION/E_NOT_OK, DataServices_DID_F126_Autosar_BSW_Cluster_Versions_DID_F126_20_COM_CLUSTER_SW_MINOR_VERSION/DCM_E_PENDING]
        arg OpStatus: type=Dcm_OpStatusType, direction=IN
        arg ErrorCode: type=Dcm_NegativeResponseCodeType, direction=OUT
      error E_NOT_OK: error-code=1
      error DCM_E_PENDING: error-code=10
    DataServices_DID_F126_Autosar_BSW_Cluster_Versions_DID_F126_16_MODEMGMT_CLUSTER_AR_RELEASE_MINOR_VERSION
      operation ReadData: possible-error=[DataServices_DID_F126_Autosar_BSW_Cluster_Versions_DID_F126_16_MODEMGMT_CLUSTER_AR_RELEASE_MINOR_VERSION/E_NOT_OK, DataServices_DID_F126_Autosar_BSW_Cluster_Versions_DID_F126_16_MODEMGMT_CLUSTER_AR_RELEASE_MINOR_VERSION/DCM_E_PENDING]
        arg OpStatus: type=Dcm_OpStatusType, direction=IN
        arg Data: type=Dcm_Data1ByteType, direction=OUT
      operation ConditionCheckRead: possible-error=[DataServices_DID_F126_Autosar_BSW_Cluster_Versions_DID_F126_16_MODEMGMT_CLUSTER_AR_RELEASE_MINOR_VERSION/E_NOT_OK, DataServices_DID_F126_Autosar_BSW_Cluster_Versions_DID_F126_16_MODEMGMT_CLUSTER_AR_RELEASE_MINOR_VERSION/DCM_E_PENDING]
        arg OpStatus: type=Dcm_OpStatusType, direction=IN
        arg ErrorCode: type=Dcm_NegativeResponseCodeType, direction=OUT
      error E_NOT_OK: error-code=1
      error DCM_E_PENDING: error-code=10
    DataServices_DID_F126_Autosar_BSW_Cluster_Versions_DID_F126_2_DIAG_CLUSTER_SW_MAJOR_VERSION
      operation ReadData: possible-error=[DataServices_DID_F126_Autosar_BSW_Cluster_Versions_DID_F126_2_DIAG_CLUSTER_SW_MAJOR_VERSION/E_NOT_OK, DataServices_DID_F126_Autosar_BSW_Cluster_Versions_DID_F126_2_DIAG_CLUSTER_SW_MAJOR_VERSION/DCM_E_PENDING]
        arg OpStatus: type=Dcm_OpStatusType, direction=IN
        arg Data: type=Dcm_Data1ByteType, direction=OUT
      operation ConditionCheckRead: possible-error=[DataServices_DID_F126_Autosar_BSW_Cluster_Versions_DID_F126_2_DIAG_CLUSTER_SW_MAJOR_VERSION/E_NOT_OK, DataServices_DID_F126_Autosar_BSW_Cluster_Versions_DID_F126_2_DIAG_CLUSTER_SW_MAJOR_VERSION/DCM_E_PENDING]
        arg OpStatus: type=Dcm_OpStatusType, direction=IN
        arg ErrorCode: type=Dcm_NegativeResponseCodeType, direction=OUT
      error E_NOT_OK: error-code=1
      error DCM_E_PENDING: error-code=10
    DataServices_DID_F126_Autosar_BSW_Cluster_Versions_DID_F126_35_FLEXRAY_CLUSTER_SW_PATCH_VERSION
      operation ReadData: possible-error=[DataServices_DID_F126_Autosar_BSW_Cluster_Versions_DID_F126_35_FLEXRAY_CLUSTER_SW_PATCH_VERSION/E_NOT_OK, DataServices_DID_F126_Autosar_BSW_Cluster_Versions_DID_F126_35_FLEXRAY_CLUSTER_SW_PATCH_VERSION/DCM_E_PENDING]
        arg OpStatus: type=Dcm_OpStatusType, direction=IN
        arg Data: type=Dcm_Data1ByteType, direction=OUT
      operation ConditionCheckRead: possible-error=[DataServices_DID_F126_Autosar_BSW_Cluster_Versions_DID_F126_35_FLEXRAY_CLUSTER_SW_PATCH_VERSION/E_NOT_OK, DataServices_DID_F126_Autosar_BSW_Cluster_Versions_DID_F126_35_FLEXRAY_CLUSTER_SW_PATCH_VERSION/DCM_E_PENDING]
        arg OpStatus: type=Dcm_OpStatusType, direction=IN
        arg ErrorCode: type=Dcm_NegativeResponseCodeType, direction=OUT
      error E_NOT_OK: error-code=1
      error DCM_E_PENDING: error-code=10
    DataServices_DID_F126_Autosar_BSW_Cluster_Versions_DID_F126_17_MODEMGMT_CLUSTER_AR_RELEASE_REVISION_VERSION
      operation ReadData: possible-error=[DataServices_DID_F126_Autosar_BSW_Cluster_Versions_DID_F126_17_MODEMGMT_CLUSTER_AR_RELEASE_REVISION_VERSION/E_NOT_OK, DataServices_DID_F126_Autosar_BSW_Cluster_Versions_DID_F126_17_MODEMGMT_CLUSTER_AR_RELEASE_REVISION_VERSION/DCM_E_PENDING]
        arg OpStatus: type=Dcm_OpStatusType, direction=IN
        arg Data: type=Dcm_Data1ByteType, direction=OUT
      operation ConditionCheckRead: possible-error=[DataServices_DID_F126_Autosar_BSW_Cluster_Versions_DID_F126_17_MODEMGMT_CLUSTER_AR_RELEASE_REVISION_VERSION/E_NOT_OK, DataServices_DID_F126_Autosar_BSW_Cluster_Versions_DID_F126_17_MODEMGMT_CLUSTER_AR_RELEASE_REVISION_VERSION/DCM_E_PENDING]
        arg OpStatus: type=Dcm_OpStatusType, direction=IN
        arg ErrorCode: type=Dcm_NegativeResponseCodeType, direction=OUT
      error E_NOT_OK: error-code=1
      error DCM_E_PENDING: error-code=10
    DataServices_DID_F126_Autosar_BSW_Cluster_Versions_DID_F126_4_DIAG_CLUSTER_SW_PATCH_VERSION
      operation ReadData: possible-error=[DataServices_DID_F126_Autosar_BSW_Cluster_Versions_DID_F126_4_DIAG_CLUSTER_SW_PATCH_VERSION/E_NOT_OK, DataServices_DID_F126_Autosar_BSW_Cluster_Versions_DID_F126_4_DIAG_CLUSTER_SW_PATCH_VERSION/DCM_E_PENDING]
        arg OpStatus: type=Dcm_OpStatusType, direction=IN
        arg Data: type=Dcm_Data1ByteType, direction=OUT
      operation ConditionCheckRead: possible-error=[DataServices_DID_F126_Autosar_BSW_Cluster_Versions_DID_F126_4_DIAG_CLUSTER_SW_PATCH_VERSION/E_NOT_OK, DataServices_DID_F126_Autosar_BSW_Cluster_Versions_DID_F126_4_DIAG_CLUSTER_SW_PATCH_VERSION/DCM_E_PENDING]
        arg OpStatus: type=Dcm_OpStatusType, direction=IN
        arg ErrorCode: type=Dcm_NegativeResponseCodeType, direction=OUT
      error E_NOT_OK: error-code=1
      error DCM_E_PENDING: error-code=10
    DataServices_DID_F126_Autosar_BSW_Cluster_Versions_DID_F126_27_CAN_CLUSTER_SW_MINOR_VERSION
      operation ReadData: possible-error=[DataServices_DID_F126_Autosar_BSW_Cluster_Versions_DID_F126_27_CAN_CLUSTER_SW_MINOR_VERSION/E_NOT_OK, DataServices_DID_F126_Autosar_BSW_Cluster_Versions_DID_F126_27_CAN_CLUSTER_SW_MINOR_VERSION/DCM_E_PENDING]
        arg OpStatus: type=Dcm_OpStatusType, direction=IN
        arg Data: type=Dcm_Data1ByteType, direction=OUT
      operation ConditionCheckRead: possible-error=[DataServices_DID_F126_Autosar_BSW_Cluster_Versions_DID_F126_27_CAN_CLUSTER_SW_MINOR_VERSION/E_NOT_OK, DataServices_DID_F126_Autosar_BSW_Cluster_Versions_DID_F126_27_CAN_CLUSTER_SW_MINOR_VERSION/DCM_E_PENDING]
        arg OpStatus: type=Dcm_OpStatusType, direction=IN
        arg ErrorCode: type=Dcm_NegativeResponseCodeType, direction=OUT
      error E_NOT_OK: error-code=1
      error DCM_E_PENDING: error-code=10
    DataServices_DID_F126_Autosar_BSW_Cluster_Versions_DID_F126_7_DIAG_CLUSTER_AR_RELEASE_REVISION_VERSION
      operation ReadData: possible-error=[DataServices_DID_F126_Autosar_BSW_Cluster_Versions_DID_F126_7_DIAG_CLUSTER_AR_RELEASE_REVISION_VERSION/E_NOT_OK, DataServices_DID_F126_Autosar_BSW_Cluster_Versions_DID_F126_7_DIAG_CLUSTER_AR_RELEASE_REVISION_VERSION/DCM_E_PENDING]
        arg OpStatus: type=Dcm_OpStatusType, direction=IN
        arg Data: type=Dcm_Data1ByteType, direction=OUT
      operation ConditionCheckRead: possible-error=[DataServices_DID_F126_Autosar_BSW_Cluster_Versions_DID_F126_7_DIAG_CLUSTER_AR_RELEASE_REVISION_VERSION/E_NOT_OK, DataServices_DID_F126_Autosar_BSW_Cluster_Versions_DID_F126_7_DIAG_CLUSTER_AR_RELEASE_REVISION_VERSION/DCM_E_PENDING]
        arg OpStatus: type=Dcm_OpStatusType, direction=IN
        arg ErrorCode: type=Dcm_NegativeResponseCodeType, direction=OUT
      error E_NOT_OK: error-code=1
      error DCM_E_PENDING: error-code=10
    DataServices_DID_F126_Autosar_BSW_Cluster_Versions_DID_F126_11_MODEMGMT_CLUSTER_VENDOR_ID
      operation ReadData: possible-error=[DataServices_DID_F126_Autosar_BSW_Cluster_Versions_DID_F126_11_MODEMGMT_CLUSTER_VENDOR_ID/E_NOT_OK, DataServices_DID_F126_Autosar_BSW_Cluster_Versions_DID_F126_11_MODEMGMT_CLUSTER_VENDOR_ID/DCM_E_PENDING]
        arg OpStatus: type=Dcm_OpStatusType, direction=IN
        arg Data: type=Dcm_Data2ByteType, direction=OUT
      operation ConditionCheckRead: possible-error=[DataServices_DID_F126_Autosar_BSW_Cluster_Versions_DID_F126_11_MODEMGMT_CLUSTER_VENDOR_ID/E_NOT_OK, DataServices_DID_F126_Autosar_BSW_Cluster_Versions_DID_F126_11_MODEMGMT_CLUSTER_VENDOR_ID/DCM_E_PENDING]
        arg OpStatus: type=Dcm_OpStatusType, direction=IN
        arg ErrorCode: type=Dcm_NegativeResponseCodeType, direction=OUT
      error E_NOT_OK: error-code=1
      error DCM_E_PENDING: error-code=10
    DataServices_DID_F126_Autosar_BSW_Cluster_Versions_DID_F126_34_FLEXRAY_CLUSTER_SW_MINOR_VERSION
      operation ReadData: possible-error=[DataServices_DID_F126_Autosar_BSW_Cluster_Versions_DID_F126_34_FLEXRAY_CLUSTER_SW_MINOR_VERSION/E_NOT_OK, DataServices_DID_F126_Autosar_BSW_Cluster_Versions_DID_F126_34_FLEXRAY_CLUSTER_SW_MINOR_VERSION/DCM_E_PENDING]
        arg OpStatus: type=Dcm_OpStatusType, direction=IN
        arg Data: type=Dcm_Data1ByteType, direction=OUT
      operation ConditionCheckRead: possible-error=[DataServices_DID_F126_Autosar_BSW_Cluster_Versions_DID_F126_34_FLEXRAY_CLUSTER_SW_MINOR_VERSION/E_NOT_OK, DataServices_DID_F126_Autosar_BSW_Cluster_Versions_DID_F126_34_FLEXRAY_CLUSTER_SW_MINOR_VERSION/DCM_E_PENDING]
        arg OpStatus: type=Dcm_OpStatusType, direction=IN
        arg ErrorCode: type=Dcm_NegativeResponseCodeType, direction=OUT
      error E_NOT_OK: error-code=1
      error DCM_E_PENDING: error-code=10
    DataServices_DID_F126_Autosar_BSW_Cluster_Versions_DID_F126_5_DIAG_CLUSTER_AR_RELEASE_MAJOR_VERSION
      operation ReadData: possible-error=[DataServices_DID_F126_Autosar_BSW_Cluster_Versions_DID_F126_5_DIAG_CLUSTER_AR_RELEASE_MAJOR_VERSION/E_NOT_OK, DataServices_DID_F126_Autosar_BSW_Cluster_Versions_DID_F126_5_DIAG_CLUSTER_AR_RELEASE_MAJOR_VERSION/DCM_E_PENDING]
        arg OpStatus: type=Dcm_OpStatusType, direction=IN
        arg Data: type=Dcm_Data1ByteType, direction=OUT
      operation ConditionCheckRead: possible-error=[DataServices_DID_F126_Autosar_BSW_Cluster_Versions_DID_F126_5_DIAG_CLUSTER_AR_RELEASE_MAJOR_VERSION/E_NOT_OK, DataServices_DID_F126_Autosar_BSW_Cluster_Versions_DID_F126_5_DIAG_CLUSTER_AR_RELEASE_MAJOR_VERSION/DCM_E_PENDING]
        arg OpStatus: type=Dcm_OpStatusType, direction=IN
        arg ErrorCode: type=Dcm_NegativeResponseCodeType, direction=OUT
      error E_NOT_OK: error-code=1
      error DCM_E_PENDING: error-code=10
    DataServices_DID_F126_Autosar_BSW_Cluster_Versions_DID_F126_28_CAN_CLUSTER_SW_PATCH_VERSION
      operation ReadData: possible-error=[DataServices_DID_F126_Autosar_BSW_Cluster_Versions_DID_F126_28_CAN_CLUSTER_SW_PATCH_VERSION/E_NOT_OK, DataServices_DID_F126_Autosar_BSW_Cluster_Versions_DID_F126_28_CAN_CLUSTER_SW_PATCH_VERSION/DCM_E_PENDING]
        arg OpStatus: type=Dcm_OpStatusType, direction=IN
        arg Data: type=Dcm_Data1ByteType, direction=OUT
      operation ConditionCheckRead: possible-error=[DataServices_DID_F126_Autosar_BSW_Cluster_Versions_DID_F126_28_CAN_CLUSTER_SW_PATCH_VERSION/E_NOT_OK, DataServices_DID_F126_Autosar_BSW_Cluster_Versions_DID_F126_28_CAN_CLUSTER_SW_PATCH_VERSION/DCM_E_PENDING]
        arg OpStatus: type=Dcm_OpStatusType, direction=IN
        arg ErrorCode: type=Dcm_NegativeResponseCodeType, direction=OUT
      error E_NOT_OK: error-code=1
      error DCM_E_PENDING: error-code=10
    DataServices_DID_F126_Autosar_BSW_Cluster_Versions_DID_F126_25_CAN_CLUSTER_VENDOR_ID
      operation ReadData: possible-error=[DataServices_DID_F126_Autosar_BSW_Cluster_Versions_DID_F126_25_CAN_CLUSTER_VENDOR_ID/E_NOT_OK, DataServices_DID_F126_Autosar_BSW_Cluster_Versions_DID_F126_25_CAN_CLUSTER_VENDOR_ID/DCM_E_PENDING]
        arg OpStatus: type=Dcm_OpStatusType, direction=IN
        arg Data: type=Dcm_Data2ByteType, direction=OUT
      operation ConditionCheckRead: possible-error=[DataServices_DID_F126_Autosar_BSW_Cluster_Versions_DID_F126_25_CAN_CLUSTER_VENDOR_ID/E_NOT_OK, DataServices_DID_F126_Autosar_BSW_Cluster_Versions_DID_F126_25_CAN_CLUSTER_VENDOR_ID/DCM_E_PENDING]
        arg OpStatus: type=Dcm_OpStatusType, direction=IN
        arg ErrorCode: type=Dcm_NegativeResponseCodeType, direction=OUT
      error E_NOT_OK: error-code=1
      error DCM_E_PENDING: error-code=10
    DataServices_DID_F126_Autosar_BSW_Cluster_Versions_DID_F126_42_LIN_CLUSTER_SW_PATCH_VERSION
      operation ReadData: possible-error=[DataServices_DID_F126_Autosar_BSW_Cluster_Versions_DID_F126_42_LIN_CLUSTER_SW_PATCH_VERSION/E_NOT_OK, DataServices_DID_F126_Autosar_BSW_Cluster_Versions_DID_F126_42_LIN_CLUSTER_SW_PATCH_VERSION/DCM_E_PENDING]
        arg OpStatus: type=Dcm_OpStatusType, direction=IN
        arg Data: type=Dcm_Data1ByteType, direction=OUT
      operation ConditionCheckRead: possible-error=[DataServices_DID_F126_Autosar_BSW_Cluster_Versions_DID_F126_42_LIN_CLUSTER_SW_PATCH_VERSION/E_NOT_OK, DataServices_DID_F126_Autosar_BSW_Cluster_Versions_DID_F126_42_LIN_CLUSTER_SW_PATCH_VERSION/DCM_E_PENDING]
        arg OpStatus: type=Dcm_OpStatusType, direction=IN
        arg ErrorCode: type=Dcm_NegativeResponseCodeType, direction=OUT
      error E_NOT_OK: error-code=1
      error DCM_E_PENDING: error-code=10
    DataServices_DID_F126_Autosar_BSW_Cluster_Versions_DID_F126_19_COM_CLUSTER_SW_MAJOR_VERSION
      operation ReadData: possible-error=[DataServices_DID_F126_Autosar_BSW_Cluster_Versions_DID_F126_19_COM_CLUSTER_SW_MAJOR_VERSION/E_NOT_OK, DataServices_DID_F126_Autosar_BSW_Cluster_Versions_DID_F126_19_COM_CLUSTER_SW_MAJOR_VERSION/DCM_E_PENDING]
        arg OpStatus: type=Dcm_OpStatusType, direction=IN
        arg Data: type=Dcm_Data1ByteType, direction=OUT
      operation ConditionCheckRead: possible-error=[DataServices_DID_F126_Autosar_BSW_Cluster_Versions_DID_F126_19_COM_CLUSTER_SW_MAJOR_VERSION/E_NOT_OK, DataServices_DID_F126_Autosar_BSW_Cluster_Versions_DID_F126_19_COM_CLUSTER_SW_MAJOR_VERSION/DCM_E_PENDING]
        arg OpStatus: type=Dcm_OpStatusType, direction=IN
        arg ErrorCode: type=Dcm_NegativeResponseCodeType, direction=OUT
      error E_NOT_OK: error-code=1
      error DCM_E_PENDING: error-code=10
    DataServices_DID_F126_Autosar_BSW_Cluster_Versions_DID_F126_30_CAN_CLUSTER_AR_RELEASE_MINOR_VERSION
      operation ReadData: possible-error=[DataServices_DID_F126_Autosar_BSW_Cluster_Versions_DID_F126_30_CAN_CLUSTER_AR_RELEASE_MINOR_VERSION/E_NOT_OK, DataServices_DID_F126_Autosar_BSW_Cluster_Versions_DID_F126_30_CAN_CLUSTER_AR_RELEASE_MINOR_VERSION/DCM_E_PENDING]
        arg OpStatus: type=Dcm_OpStatusType, direction=IN
        arg Data: type=Dcm_Data1ByteType, direction=OUT
      operation ConditionCheckRead: possible-error=[DataServices_DID_F126_Autosar_BSW_Cluster_Versions_DID_F126_30_CAN_CLUSTER_AR_RELEASE_MINOR_VERSION/E_NOT_OK, DataServices_DID_F126_Autosar_BSW_Cluster_Versions_DID_F126_30_CAN_CLUSTER_AR_RELEASE_MINOR_VERSION/DCM_E_PENDING]
        arg OpStatus: type=Dcm_OpStatusType, direction=IN
        arg ErrorCode: type=Dcm_NegativeResponseCodeType, direction=OUT
      error E_NOT_OK: error-code=1
      error DCM_E_PENDING: error-code=10
    DataServices_DID_F126_Autosar_BSW_Cluster_Versions_DID_F126_21_COM_CLUSTER_SW_PATCH_VERSION
      operation ReadData: possible-error=[DataServices_DID_F126_Autosar_BSW_Cluster_Versions_DID_F126_21_COM_CLUSTER_SW_PATCH_VERSION/E_NOT_OK, DataServices_DID_F126_Autosar_BSW_Cluster_Versions_DID_F126_21_COM_CLUSTER_SW_PATCH_VERSION/DCM_E_PENDING]
        arg OpStatus: type=Dcm_OpStatusType, direction=IN
        arg Data: type=Dcm_Data1ByteType, direction=OUT
      operation ConditionCheckRead: possible-error=[DataServices_DID_F126_Autosar_BSW_Cluster_Versions_DID_F126_21_COM_CLUSTER_SW_PATCH_VERSION/E_NOT_OK, DataServices_DID_F126_Autosar_BSW_Cluster_Versions_DID_F126_21_COM_CLUSTER_SW_PATCH_VERSION/DCM_E_PENDING]
        arg OpStatus: type=Dcm_OpStatusType, direction=IN
        arg ErrorCode: type=Dcm_NegativeResponseCodeType, direction=OUT
      error E_NOT_OK: error-code=1
      error DCM_E_PENDING: error-code=10
    DataServices_DID_F126_Autosar_BSW_Cluster_Versions_DID_F126_14_MODEMGMT_CLUSTER_SW_PATCH_VERSION
      operation ReadData: possible-error=[DataServices_DID_F126_Autosar_BSW_Cluster_Versions_DID_F126_14_MODEMGMT_CLUSTER_SW_PATCH_VERSION/E_NOT_OK, DataServices_DID_F126_Autosar_BSW_Cluster_Versions_DID_F126_14_MODEMGMT_CLUSTER_SW_PATCH_VERSION/DCM_E_PENDING]
        arg OpStatus: type=Dcm_OpStatusType, direction=IN
        arg Data: type=Dcm_Data1ByteType, direction=OUT
      operation ConditionCheckRead: possible-error=[DataServices_DID_F126_Autosar_BSW_Cluster_Versions_DID_F126_14_MODEMGMT_CLUSTER_SW_PATCH_VERSION/E_NOT_OK, DataServices_DID_F126_Autosar_BSW_Cluster_Versions_DID_F126_14_MODEMGMT_CLUSTER_SW_PATCH_VERSION/DCM_E_PENDING]
        arg OpStatus: type=Dcm_OpStatusType, direction=IN
        arg ErrorCode: type=Dcm_NegativeResponseCodeType, direction=OUT
      error E_NOT_OK: error-code=1
      error DCM_E_PENDING: error-code=10
    DataServices_DID_F126_Autosar_BSW_Cluster_Versions_DID_F126_1_DIAG_CLUSTER_VENDOR_ID
      operation ReadData: possible-error=[DataServices_DID_F126_Autosar_BSW_Cluster_Versions_DID_F126_1_DIAG_CLUSTER_VENDOR_ID/E_NOT_OK, DataServices_DID_F126_Autosar_BSW_Cluster_Versions_DID_F126_1_DIAG_CLUSTER_VENDOR_ID/DCM_E_PENDING]
        arg OpStatus: type=Dcm_OpStatusType, direction=IN
        arg Data: type=Dcm_Data2ByteType, direction=OUT
      operation ConditionCheckRead: possible-error=[DataServices_DID_F126_Autosar_BSW_Cluster_Versions_DID_F126_1_DIAG_CLUSTER_VENDOR_ID/E_NOT_OK, DataServices_DID_F126_Autosar_BSW_Cluster_Versions_DID_F126_1_DIAG_CLUSTER_VENDOR_ID/DCM_E_PENDING]
        arg OpStatus: type=Dcm_OpStatusType, direction=IN
        arg ErrorCode: type=Dcm_NegativeResponseCodeType, direction=OUT
      error E_NOT_OK: error-code=1
      error DCM_E_PENDING: error-code=10
    DataServices_DID_F126_Autosar_BSW_Cluster_Versions_DID_F126_41_LIN_CLUSTER_SW_MINOR_VERSION
      operation ReadData: possible-error=[DataServices_DID_F126_Autosar_BSW_Cluster_Versions_DID_F126_41_LIN_CLUSTER_SW_MINOR_VERSION/E_NOT_OK, DataServices_DID_F126_Autosar_BSW_Cluster_Versions_DID_F126_41_LIN_CLUSTER_SW_MINOR_VERSION/DCM_E_PENDING]
        arg OpStatus: type=Dcm_OpStatusType, direction=IN
        arg Data: type=Dcm_Data1ByteType, direction=OUT
      operation ConditionCheckRead: possible-error=[DataServices_DID_F126_Autosar_BSW_Cluster_Versions_DID_F126_41_LIN_CLUSTER_SW_MINOR_VERSION/E_NOT_OK, DataServices_DID_F126_Autosar_BSW_Cluster_Versions_DID_F126_41_LIN_CLUSTER_SW_MINOR_VERSION/DCM_E_PENDING]
        arg OpStatus: type=Dcm_OpStatusType, direction=IN
        arg ErrorCode: type=Dcm_NegativeResponseCodeType, direction=OUT
      error E_NOT_OK: error-code=1
      error DCM_E_PENDING: error-code=10
    DataServices_DID_F126_Autosar_BSW_Cluster_Versions_DID_F126_10_DIAG_CLUSTER_VCC_FIM_VERSION
      operation ReadData: possible-error=[DataServices_DID_F126_Autosar_BSW_Cluster_Versions_DID_F126_10_DIAG_CLUSTER_VCC_FIM_VERSION/E_NOT_OK, DataServices_DID_F126_Autosar_BSW_Cluster_Versions_DID_F126_10_DIAG_CLUSTER_VCC_FIM_VERSION/DCM_E_PENDING]
        arg OpStatus: type=Dcm_OpStatusType, direction=IN
        arg Data: type=Dcm_Data1ByteType, direction=OUT
      operation ConditionCheckRead: possible-error=[DataServices_DID_F126_Autosar_BSW_Cluster_Versions_DID_F126_10_DIAG_CLUSTER_VCC_FIM_VERSION/E_NOT_OK, DataServices_DID_F126_Autosar_BSW_Cluster_Versions_DID_F126_10_DIAG_CLUSTER_VCC_FIM_VERSION/DCM_E_PENDING]
        arg OpStatus: type=Dcm_OpStatusType, direction=IN
        arg ErrorCode: type=Dcm_NegativeResponseCodeType, direction=OUT
      error E_NOT_OK: error-code=1
      error DCM_E_PENDING: error-code=10
    DataServices_DID_F126_Autosar_BSW_Cluster_Versions_DID_F126_18_COM_CLUSTER_VENDOR_ID
      operation ReadData: possible-error=[DataServices_DID_F126_Autosar_BSW_Cluster_Versions_DID_F126_18_COM_CLUSTER_VENDOR_ID/E_NOT_OK, DataServices_DID_F126_Autosar_BSW_Cluster_Versions_DID_F126_18_COM_CLUSTER_VENDOR_ID/DCM_E_PENDING]
        arg OpStatus: type=Dcm_OpStatusType, direction=IN
        arg Data: type=Dcm_Data2ByteType, direction=OUT
      operation ConditionCheckRead: possible-error=[DataServices_DID_F126_Autosar_BSW_Cluster_Versions_DID_F126_18_COM_CLUSTER_VENDOR_ID/E_NOT_OK, DataServices_DID_F126_Autosar_BSW_Cluster_Versions_DID_F126_18_COM_CLUSTER_VENDOR_ID/DCM_E_PENDING]
        arg OpStatus: type=Dcm_OpStatusType, direction=IN
        arg ErrorCode: type=Dcm_NegativeResponseCodeType, direction=OUT
      error E_NOT_OK: error-code=1
      error DCM_E_PENDING: error-code=10
    DataServices_DID_F126_Autosar_BSW_Cluster_Versions_DID_F126_38_FLEXRAY_CLUSTER_AR_RELEASE_REVISION_VERSION
      operation ReadData: possible-error=[DataServices_DID_F126_Autosar_BSW_Cluster_Versions_DID_F126_38_FLEXRAY_CLUSTER_AR_RELEASE_REVISION_VERSION/E_NOT_OK, DataServices_DID_F126_Autosar_BSW_Cluster_Versions_DID_F126_38_FLEXRAY_CLUSTER_AR_RELEASE_REVISION_VERSION/DCM_E_PENDING]
        arg OpStatus: type=Dcm_OpStatusType, direction=IN
        arg Data: type=Dcm_Data1ByteType, direction=OUT
      operation ConditionCheckRead: possible-error=[DataServices_DID_F126_Autosar_BSW_Cluster_Versions_DID_F126_38_FLEXRAY_CLUSTER_AR_RELEASE_REVISION_VERSION/E_NOT_OK, DataServices_DID_F126_Autosar_BSW_Cluster_Versions_DID_F126_38_FLEXRAY_CLUSTER_AR_RELEASE_REVISION_VERSION/DCM_E_PENDING]
        arg OpStatus: type=Dcm_OpStatusType, direction=IN
        arg ErrorCode: type=Dcm_NegativeResponseCodeType, direction=OUT
      error E_NOT_OK: error-code=1
      error DCM_E_PENDING: error-code=10
    DataServices_DID_F126_Autosar_BSW_Cluster_Versions_DID_F126_32_FLEXRAY_CLUSTER_VENDOR_ID
      operation ReadData: possible-error=[DataServices_DID_F126_Autosar_BSW_Cluster_Versions_DID_F126_32_FLEXRAY_CLUSTER_VENDOR_ID/E_NOT_OK, DataServices_DID_F126_Autosar_BSW_Cluster_Versions_DID_F126_32_FLEXRAY_CLUSTER_VENDOR_ID/DCM_E_PENDING]
        arg OpStatus: type=Dcm_OpStatusType, direction=IN
        arg Data: type=Dcm_Data2ByteType, direction=OUT
      operation ConditionCheckRead: possible-error=[DataServices_DID_F126_Autosar_BSW_Cluster_Versions_DID_F126_32_FLEXRAY_CLUSTER_VENDOR_ID/E_NOT_OK, DataServices_DID_F126_Autosar_BSW_Cluster_Versions_DID_F126_32_FLEXRAY_CLUSTER_VENDOR_ID/DCM_E_PENDING]
        arg OpStatus: type=Dcm_OpStatusType, direction=IN
        arg ErrorCode: type=Dcm_NegativeResponseCodeType, direction=OUT
      error E_NOT_OK: error-code=1
      error DCM_E_PENDING: error-code=10
    DataServices_DID_F126_Autosar_BSW_Cluster_Versions_DID_F126_12_MODEMGMT_CLUSTER_SW_MAJOR_VERSION
      operation ReadData: possible-error=[DataServices_DID_F126_Autosar_BSW_Cluster_Versions_DID_F126_12_MODEMGMT_CLUSTER_SW_MAJOR_VERSION/E_NOT_OK, DataServices_DID_F126_Autosar_BSW_Cluster_Versions_DID_F126_12_MODEMGMT_CLUSTER_SW_MAJOR_VERSION/DCM_E_PENDING]
        arg OpStatus: type=Dcm_OpStatusType, direction=IN
        arg Data: type=Dcm_Data1ByteType, direction=OUT
      operation ConditionCheckRead: possible-error=[DataServices_DID_F126_Autosar_BSW_Cluster_Versions_DID_F126_12_MODEMGMT_CLUSTER_SW_MAJOR_VERSION/E_NOT_OK, DataServices_DID_F126_Autosar_BSW_Cluster_Versions_DID_F126_12_MODEMGMT_CLUSTER_SW_MAJOR_VERSION/DCM_E_PENDING]
        arg OpStatus: type=Dcm_OpStatusType, direction=IN
        arg ErrorCode: type=Dcm_NegativeResponseCodeType, direction=OUT
      error E_NOT_OK: error-code=1
      error DCM_E_PENDING: error-code=10
    DataServices_DID_F126_Autosar_BSW_Cluster_Versions_DID_F126_29_CAN_CLUSTER_AR_RELEASE_MAJOR_VERSION
      operation ReadData: possible-error=[DataServices_DID_F126_Autosar_BSW_Cluster_Versions_DID_F126_29_CAN_CLUSTER_AR_RELEASE_MAJOR_VERSION/E_NOT_OK, DataServices_DID_F126_Autosar_BSW_Cluster_Versions_DID_F126_29_CAN_CLUSTER_AR_RELEASE_MAJOR_VERSION/DCM_E_PENDING]
        arg OpStatus: type=Dcm_OpStatusType, direction=IN
        arg Data: type=Dcm_Data1ByteType, direction=OUT
      operation ConditionCheckRead: possible-error=[DataServices_DID_F126_Autosar_BSW_Cluster_Versions_DID_F126_29_CAN_CLUSTER_AR_RELEASE_MAJOR_VERSION/E_NOT_OK, DataServices_DID_F126_Autosar_BSW_Cluster_Versions_DID_F126_29_CAN_CLUSTER_AR_RELEASE_MAJOR_VERSION/DCM_E_PENDING]
        arg OpStatus: type=Dcm_OpStatusType, direction=IN
        arg ErrorCode: type=Dcm_NegativeResponseCodeType, direction=OUT
      error E_NOT_OK: error-code=1
      error DCM_E_PENDING: error-code=10
    DataServices_DID_F126_Autosar_BSW_Cluster_Versions_DID_F126_22_COM_CLUSTER_AR_RELEASE_MAJOR_VERSION
      operation ReadData: possible-error=[DataServices_DID_F126_Autosar_BSW_Cluster_Versions_DID_F126_22_COM_CLUSTER_AR_RELEASE_MAJOR_VERSION/E_NOT_OK, DataServices_DID_F126_Autosar_BSW_Cluster_Versions_DID_F126_22_COM_CLUSTER_AR_RELEASE_MAJOR_VERSION/DCM_E_PENDING]
        arg OpStatus: type=Dcm_OpStatusType, direction=IN
        arg Data: type=Dcm_Data1ByteType, direction=OUT
      operation ConditionCheckRead: possible-error=[DataServices_DID_F126_Autosar_BSW_Cluster_Versions_DID_F126_22_COM_CLUSTER_AR_RELEASE_MAJOR_VERSION/E_NOT_OK, DataServices_DID_F126_Autosar_BSW_Cluster_Versions_DID_F126_22_COM_CLUSTER_AR_RELEASE_MAJOR_VERSION/DCM_E_PENDING]
        arg OpStatus: type=Dcm_OpStatusType, direction=IN
        arg ErrorCode: type=Dcm_NegativeResponseCodeType, direction=OUT
      error E_NOT_OK: error-code=1
      error DCM_E_PENDING: error-code=10
    DataServices_DID_F126_Autosar_BSW_Cluster_Versions_DID_F126_44_LIN_CLUSTER_AR_RELEASE_MINOR_VERSION
      operation ReadData: possible-error=[DataServices_DID_F126_Autosar_BSW_Cluster_Versions_DID_F126_44_LIN_CLUSTER_AR_RELEASE_MINOR_VERSION/E_NOT_OK, DataServices_DID_F126_Autosar_BSW_Cluster_Versions_DID_F126_44_LIN_CLUSTER_AR_RELEASE_MINOR_VERSION/DCM_E_PENDING]
        arg OpStatus: type=Dcm_OpStatusType, direction=IN
        arg Data: type=Dcm_Data1ByteType, direction=OUT
      operation ConditionCheckRead: possible-error=[DataServices_DID_F126_Autosar_BSW_Cluster_Versions_DID_F126_44_LIN_CLUSTER_AR_RELEASE_MINOR_VERSION/E_NOT_OK, DataServices_DID_F126_Autosar_BSW_Cluster_Versions_DID_F126_44_LIN_CLUSTER_AR_RELEASE_MINOR_VERSION/DCM_E_PENDING]
        arg OpStatus: type=Dcm_OpStatusType, direction=IN
        arg ErrorCode: type=Dcm_NegativeResponseCodeType, direction=OUT
      error E_NOT_OK: error-code=1
      error DCM_E_PENDING: error-code=10
    DataServices_DID_F126_Autosar_BSW_Cluster_Versions_DID_F126_37_FLEXRAY_CLUSTER_AR_RELEASE_MINOR_VERSION
      operation ReadData: possible-error=[DataServices_DID_F126_Autosar_BSW_Cluster_Versions_DID_F126_37_FLEXRAY_CLUSTER_AR_RELEASE_MINOR_VERSION/E_NOT_OK, DataServices_DID_F126_Autosar_BSW_Cluster_Versions_DID_F126_37_FLEXRAY_CLUSTER_AR_RELEASE_MINOR_VERSION/DCM_E_PENDING]
        arg OpStatus: type=Dcm_OpStatusType, direction=IN
        arg Data: type=Dcm_Data1ByteType, direction=OUT
      operation ConditionCheckRead: possible-error=[DataServices_DID_F126_Autosar_BSW_Cluster_Versions_DID_F126_37_FLEXRAY_CLUSTER_AR_RELEASE_MINOR_VERSION/E_NOT_OK, DataServices_DID_F126_Autosar_BSW_Cluster_Versions_DID_F126_37_FLEXRAY_CLUSTER_AR_RELEASE_MINOR_VERSION/DCM_E_PENDING]
        arg OpStatus: type=Dcm_OpStatusType, direction=IN
        arg ErrorCode: type=Dcm_NegativeResponseCodeType, direction=OUT
      error E_NOT_OK: error-code=1
      error DCM_E_PENDING: error-code=10
    DataServices_DID_F126_Autosar_BSW_Cluster_Versions_DID_F126_45_LIN_CLUSTER_AR_RELEASE_REVISION_VERSION
      operation ReadData: possible-error=[DataServices_DID_F126_Autosar_BSW_Cluster_Versions_DID_F126_45_LIN_CLUSTER_AR_RELEASE_REVISION_VERSION/E_NOT_OK, DataServices_DID_F126_Autosar_BSW_Cluster_Versions_DID_F126_45_LIN_CLUSTER_AR_RELEASE_REVISION_VERSION/DCM_E_PENDING]
        arg OpStatus: type=Dcm_OpStatusType, direction=IN
        arg Data: type=Dcm_Data1ByteType, direction=OUT
      operation ConditionCheckRead: possible-error=[DataServices_DID_F126_Autosar_BSW_Cluster_Versions_DID_F126_45_LIN_CLUSTER_AR_RELEASE_REVISION_VERSION/E_NOT_OK, DataServices_DID_F126_Autosar_BSW_Cluster_Versions_DID_F126_45_LIN_CLUSTER_AR_RELEASE_REVISION_VERSION/DCM_E_PENDING]
        arg OpStatus: type=Dcm_OpStatusType, direction=IN
        arg ErrorCode: type=Dcm_NegativeResponseCodeType, direction=OUT
      error E_NOT_OK: error-code=1
      error DCM_E_PENDING: error-code=10
    DataServices_DID_F126_Autosar_BSW_Cluster_Versions_DID_F126_33_FLEXRAY_CLUSTER_SW_MAJOR_VERSION
      operation ReadData: possible-error=[DataServices_DID_F126_Autosar_BSW_Cluster_Versions_DID_F126_33_FLEXRAY_CLUSTER_SW_MAJOR_VERSION/E_NOT_OK, DataServices_DID_F126_Autosar_BSW_Cluster_Versions_DID_F126_33_FLEXRAY_CLUSTER_SW_MAJOR_VERSION/DCM_E_PENDING]
        arg OpStatus: type=Dcm_OpStatusType, direction=IN
        arg Data: type=Dcm_Data1ByteType, direction=OUT
      operation ConditionCheckRead: possible-error=[DataServices_DID_F126_Autosar_BSW_Cluster_Versions_DID_F126_33_FLEXRAY_CLUSTER_SW_MAJOR_VERSION/E_NOT_OK, DataServices_DID_F126_Autosar_BSW_Cluster_Versions_DID_F126_33_FLEXRAY_CLUSTER_SW_MAJOR_VERSION/DCM_E_PENDING]
        arg OpStatus: type=Dcm_OpStatusType, direction=IN
        arg ErrorCode: type=Dcm_NegativeResponseCodeType, direction=OUT
      error E_NOT_OK: error-code=1
      error DCM_E_PENDING: error-code=10
    DataServices_DID_E337_q_axis_current_setpoint_DID_E337_q_axis_current_setpoint
      operation ReadData: possible-error=[DataServices_DID_E337_q_axis_current_setpoint_DID_E337_q_axis_current_setpoint/E_NOT_OK, DataServices_DID_E337_q_axis_current_setpoint_DID_E337_q_axis_current_setpoint/DCM_E_PENDING]
        arg OpStatus: type=Dcm_OpStatusType, direction=IN
        arg Data: type=Dcm_Data2ByteType, direction=OUT
      operation ConditionCheckRead: possible-error=[DataServices_DID_E337_q_axis_current_setpoint_DID_E337_q_axis_current_setpoint/E_NOT_OK, DataServices_DID_E337_q_axis_current_setpoint_DID_E337_q_axis_current_setpoint/DCM_E_PENDING]
        arg OpStatus: type=Dcm_OpStatusType, direction=IN
        arg ErrorCode: type=Dcm_NegativeResponseCodeType, direction=OUT
      error E_NOT_OK: error-code=1
      error DCM_E_PENDING: error-code=10
    DataServices_DID_ED20_Complete_set_of_ECU_part_serial_numbers_Geely_BCD_part_003
      operation ReadData: possible-error=[DataServices_DID_ED20_Complete_set_of_ECU_part_serial_numbers_Geely_BCD_part_003/E_NOT_OK, DataServices_DID_ED20_Complete_set_of_ECU_part_serial_numbers_Geely_BCD_part_003/DCM_E_PENDING]
        arg OpStatus: type=Dcm_OpStatusType, direction=IN
        arg Data: type=Dcm_Data5ByteType, direction=OUT
      operation ConditionCheckRead: possible-error=[DataServices_DID_ED20_Complete_set_of_ECU_part_serial_numbers_Geely_BCD_part_003/E_NOT_OK, DataServices_DID_ED20_Complete_set_of_ECU_part_serial_numbers_Geely_BCD_part_003/DCM_E_PENDING]
        arg OpStatus: type=Dcm_OpStatusType, direction=IN
        arg ErrorCode: type=Dcm_NegativeResponseCodeType, direction=OUT
      error E_NOT_OK: error-code=1
      error DCM_E_PENDING: error-code=10
    DataServices_DID_ED20_Complete_set_of_ECU_part_serial_numbers_Geely_BCD_part_001
      operation ReadData: possible-error=[DataServices_DID_ED20_Complete_set_of_ECU_part_serial_numbers_Geely_BCD_part_001/E_NOT_OK, DataServices_DID_ED20_Complete_set_of_ECU_part_serial_numbers_Geely_BCD_part_001/DCM_E_PENDING]
        arg OpStatus: type=Dcm_OpStatusType, direction=IN
        arg Data: type=Dcm_Data5ByteType, direction=OUT
      operation ConditionCheckRead: possible-error=[DataServices_DID_ED20_Complete_set_of_ECU_part_serial_numbers_Geely_BCD_part_001/E_NOT_OK, DataServices_DID_ED20_Complete_set_of_ECU_part_serial_numbers_Geely_BCD_part_001/DCM_E_PENDING]
        arg OpStatus: type=Dcm_OpStatusType, direction=IN
        arg ErrorCode: type=Dcm_NegativeResponseCodeType, direction=OUT
      error E_NOT_OK: error-code=1
      error DCM_E_PENDING: error-code=10
    DataServices_DID_ED20_Complete_set_of_ECU_part_serial_numbers_Geely_BCD_part_002
      operation ReadData: possible-error=[DataServices_DID_ED20_Complete_set_of_ECU_part_serial_numbers_Geely_BCD_part_002/E_NOT_OK, DataServices_DID_ED20_Complete_set_of_ECU_part_serial_numbers_Geely_BCD_part_002/DCM_E_PENDING]
        arg OpStatus: type=Dcm_OpStatusType, direction=IN
        arg Data: type=Dcm_Data5ByteType, direction=OUT
      operation ConditionCheckRead: possible-error=[DataServices_DID_ED20_Complete_set_of_ECU_part_serial_numbers_Geely_BCD_part_002/E_NOT_OK, DataServices_DID_ED20_Complete_set_of_ECU_part_serial_numbers_Geely_BCD_part_002/DCM_E_PENDING]
        arg OpStatus: type=Dcm_OpStatusType, direction=IN
        arg ErrorCode: type=Dcm_NegativeResponseCodeType, direction=OUT
      error E_NOT_OK: error-code=1
      error DCM_E_PENDING: error-code=10
    DataServices_DID_ED20_Complete_set_of_ECU_part_serial_numbers_Geely_Reserved
      operation ReadData: possible-error=[DataServices_DID_ED20_Complete_set_of_ECU_part_serial_numbers_Geely_Reserved/E_NOT_OK, DataServices_DID_ED20_Complete_set_of_ECU_part_serial_numbers_Geely_Reserved/DCM_E_PENDING]
        arg OpStatus: type=Dcm_OpStatusType, direction=IN
        arg Data: type=Dcm_Data10ByteType, direction=OUT
      operation ConditionCheckRead: possible-error=[DataServices_DID_ED20_Complete_set_of_ECU_part_serial_numbers_Geely_Reserved/E_NOT_OK, DataServices_DID_ED20_Complete_set_of_ECU_part_serial_numbers_Geely_Reserved/DCM_E_PENDING]
        arg OpStatus: type=Dcm_OpStatusType, direction=IN
        arg ErrorCode: type=Dcm_NegativeResponseCodeType, direction=OUT
      error E_NOT_OK: error-code=1
      error DCM_E_PENDING: error-code=10
    DataServices_DID_ED20_Complete_set_of_ECU_part_serial_numbers_Geely_DID_F1AE_1_Total_number_of_ECU_Software_Part_Numbers
      operation ReadData: possible-error=[DataServices_DID_ED20_Complete_set_of_ECU_part_serial_numbers_Geely_DID_F1AE_1_Total_number_of_ECU_Software_Part_Numbers/E_NOT_OK, DataServices_DID_ED20_Complete_set_of_ECU_part_serial_numbers_Geely_DID_F1AE_1_Total_number_of_ECU_Software_Part_Numbers/DCM_E_PENDING]
        arg OpStatus: type=Dcm_OpStatusType, direction=IN
        arg Data: type=Dcm_Data1ByteType, direction=OUT
      operation ConditionCheckRead: possible-error=[DataServices_DID_ED20_Complete_set_of_ECU_part_serial_numbers_Geely_DID_F1AE_1_Total_number_of_ECU_Software_Part_Numbers/E_NOT_OK, DataServices_DID_ED20_Complete_set_of_ECU_part_serial_numbers_Geely_DID_F1AE_1_Total_number_of_ECU_Software_Part_Numbers/DCM_E_PENDING]
        arg OpStatus: type=Dcm_OpStatusType, direction=IN
        arg ErrorCode: type=Dcm_NegativeResponseCodeType, direction=OUT
      error E_NOT_OK: error-code=1
      error DCM_E_PENDING: error-code=10
    DataServices_DID_ED20_Complete_set_of_ECU_part_serial_numbers_Geely_DID_F18C_ECU_Serial_Number
      operation ReadData: possible-error=[DataServices_DID_ED20_Complete_set_of_ECU_part_serial_numbers_Geely_DID_F18C_ECU_Serial_Number/E_NOT_OK, DataServices_DID_ED20_Complete_set_of_ECU_part_serial_numbers_Geely_DID_F18C_ECU_Serial_Number/DCM_E_PENDING]
        arg OpStatus: type=Dcm_OpStatusType, direction=IN
        arg Data: type=Dcm_Data4ByteType, direction=OUT
      operation ConditionCheckRead: possible-error=[DataServices_DID_ED20_Complete_set_of_ECU_part_serial_numbers_Geely_DID_F18C_ECU_Serial_Number/E_NOT_OK, DataServices_DID_ED20_Complete_set_of_ECU_part_serial_numbers_Geely_DID_F18C_ECU_Serial_Number/DCM_E_PENDING]
        arg OpStatus: type=Dcm_OpStatusType, direction=IN
        arg ErrorCode: type=Dcm_NegativeResponseCodeType, direction=OUT
      error E_NOT_OK: error-code=1
      error DCM_E_PENDING: error-code=10
    DataServices_DID_ED20_Complete_set_of_ECU_part_serial_numbers_Geely_ASCII_part_001
      operation ReadData: possible-error=[DataServices_DID_ED20_Complete_set_of_ECU_part_serial_numbers_Geely_ASCII_part_001/E_NOT_OK, DataServices_DID_ED20_Complete_set_of_ECU_part_serial_numbers_Geely_ASCII_part_001/DCM_E_PENDING]
        arg OpStatus: type=Dcm_OpStatusType, direction=IN
        arg Data: type=Dcm_Data3ByteType, direction=OUT
      operation ConditionCheckRead: possible-error=[DataServices_DID_ED20_Complete_set_of_ECU_part_serial_numbers_Geely_ASCII_part_001/E_NOT_OK, DataServices_DID_ED20_Complete_set_of_ECU_part_serial_numbers_Geely_ASCII_part_001/DCM_E_PENDING]
        arg OpStatus: type=Dcm_OpStatusType, direction=IN
        arg ErrorCode: type=Dcm_NegativeResponseCodeType, direction=OUT
      error E_NOT_OK: error-code=1
      error DCM_E_PENDING: error-code=10
    DataServices_DID_ED20_Complete_set_of_ECU_part_serial_numbers_Geely_ASCII_part_002
      operation ReadData: possible-error=[DataServices_DID_ED20_Complete_set_of_ECU_part_serial_numbers_Geely_ASCII_part_002/E_NOT_OK, DataServices_DID_ED20_Complete_set_of_ECU_part_serial_numbers_Geely_ASCII_part_002/DCM_E_PENDING]
        arg OpStatus: type=Dcm_OpStatusType, direction=IN
        arg Data: type=Dcm_Data3ByteType, direction=OUT
      operation ConditionCheckRead: possible-error=[DataServices_DID_ED20_Complete_set_of_ECU_part_serial_numbers_Geely_ASCII_part_002/E_NOT_OK, DataServices_DID_ED20_Complete_set_of_ECU_part_serial_numbers_Geely_ASCII_part_002/DCM_E_PENDING]
        arg OpStatus: type=Dcm_OpStatusType, direction=IN
        arg ErrorCode: type=Dcm_NegativeResponseCodeType, direction=OUT
      error E_NOT_OK: error-code=1
      error DCM_E_PENDING: error-code=10
    DataServices_DID_ED20_Complete_set_of_ECU_part_serial_numbers_Geely_ASCII_part_003
      operation ReadData: possible-error=[DataServices_DID_ED20_Complete_set_of_ECU_part_serial_numbers_Geely_ASCII_part_003/E_NOT_OK, DataServices_DID_ED20_Complete_set_of_ECU_part_serial_numbers_Geely_ASCII_part_003/DCM_E_PENDING]
        arg OpStatus: type=Dcm_OpStatusType, direction=IN
        arg Data: type=Dcm_Data3ByteType, direction=OUT
      operation ConditionCheckRead: possible-error=[DataServices_DID_ED20_Complete_set_of_ECU_part_serial_numbers_Geely_ASCII_part_003/E_NOT_OK, DataServices_DID_ED20_Complete_set_of_ECU_part_serial_numbers_Geely_ASCII_part_003/DCM_E_PENDING]
        arg OpStatus: type=Dcm_OpStatusType, direction=IN
        arg ErrorCode: type=Dcm_NegativeResponseCodeType, direction=OUT
      error E_NOT_OK: error-code=1
      error DCM_E_PENDING: error-code=10
    DataServices_DID_ED20_Complete_set_of_ECU_part_serial_numbers_Geely_ASCII_part
      operation ReadData: possible-error=[DataServices_DID_ED20_Complete_set_of_ECU_part_serial_numbers_Geely_ASCII_part/E_NOT_OK, DataServices_DID_ED20_Complete_set_of_ECU_part_serial_numbers_Geely_ASCII_part/DCM_E_PENDING]
        arg OpStatus: type=Dcm_OpStatusType, direction=IN
        arg Data: type=Dcm_Data3ByteType, direction=OUT
      operation ConditionCheckRead: possible-error=[DataServices_DID_ED20_Complete_set_of_ECU_part_serial_numbers_Geely_ASCII_part/E_NOT_OK, DataServices_DID_ED20_Complete_set_of_ECU_part_serial_numbers_Geely_ASCII_part/DCM_E_PENDING]
        arg OpStatus: type=Dcm_OpStatusType, direction=IN
        arg ErrorCode: type=Dcm_NegativeResponseCodeType, direction=OUT
      error E_NOT_OK: error-code=1
      error DCM_E_PENDING: error-code=10
    DataServices_DID_ED20_Complete_set_of_ECU_part_serial_numbers_Geely_BCD_part
      operation ReadData: possible-error=[DataServices_DID_ED20_Complete_set_of_ECU_part_serial_numbers_Geely_BCD_part/E_NOT_OK, DataServices_DID_ED20_Complete_set_of_ECU_part_serial_numbers_Geely_BCD_part/DCM_E_PENDING]
        arg OpStatus: type=Dcm_OpStatusType, direction=IN
        arg Data: type=Dcm_Data5ByteType, direction=OUT
      operation ConditionCheckRead: possible-error=[DataServices_DID_ED20_Complete_set_of_ECU_part_serial_numbers_Geely_BCD_part/E_NOT_OK, DataServices_DID_ED20_Complete_set_of_ECU_part_serial_numbers_Geely_BCD_part/DCM_E_PENDING]
        arg OpStatus: type=Dcm_OpStatusType, direction=IN
        arg ErrorCode: type=Dcm_NegativeResponseCodeType, direction=OUT
      error E_NOT_OK: error-code=1
      error DCM_E_PENDING: error-code=10
    DataServices_DID_E339_d_axis_voltage_DID_E339_d_axis_voltage
      operation ReadData: possible-error=[DataServices_DID_E339_d_axis_voltage_DID_E339_d_axis_voltage/E_NOT_OK, DataServices_DID_E339_d_axis_voltage_DID_E339_d_axis_voltage/DCM_E_PENDING]
        arg OpStatus: type=Dcm_OpStatusType, direction=IN
        arg Data: type=Dcm_Data2ByteType, direction=OUT
      operation ConditionCheckRead: possible-error=[DataServices_DID_E339_d_axis_voltage_DID_E339_d_axis_voltage/E_NOT_OK, DataServices_DID_E339_d_axis_voltage_DID_E339_d_axis_voltage/DCM_E_PENDING]
        arg OpStatus: type=Dcm_OpStatusType, direction=IN
        arg ErrorCode: type=Dcm_NegativeResponseCodeType, direction=OUT
      error E_NOT_OK: error-code=1
      error DCM_E_PENDING: error-code=10
    DataServices_DID_EEB5_IEM_MGM_current_torque_DID_EEB5_IEMMGM_current_torque
      operation ReadData: possible-error=[DataServices_DID_EEB5_IEM_MGM_current_torque_DID_EEB5_IEMMGM_current_torque/E_NOT_OK, DataServices_DID_EEB5_IEM_MGM_current_torque_DID_EEB5_IEMMGM_current_torque/DCM_E_PENDING]
        arg OpStatus: type=Dcm_OpStatusType, direction=IN
        arg Data: type=Dcm_Data2ByteType, direction=OUT
      operation ConditionCheckRead: possible-error=[DataServices_DID_EEB5_IEM_MGM_current_torque_DID_EEB5_IEMMGM_current_torque/E_NOT_OK, DataServices_DID_EEB5_IEM_MGM_current_torque_DID_EEB5_IEMMGM_current_torque/DCM_E_PENDING]
        arg OpStatus: type=Dcm_OpStatusType, direction=IN
        arg ErrorCode: type=Dcm_NegativeResponseCodeType, direction=OUT
      error E_NOT_OK: error-code=1
      error DCM_E_PENDING: error-code=10
    DataServices_DID_F121_Primary_Bootloader_Diagnostic_Database_Part_Number_ASCII_part
      operation ReadData: possible-error=[DataServices_DID_F121_Primary_Bootloader_Diagnostic_Database_Part_Number_ASCII_part/E_NOT_OK, DataServices_DID_F121_Primary_Bootloader_Diagnostic_Database_Part_Number_ASCII_part/DCM_E_PENDING]
        arg OpStatus: type=Dcm_OpStatusType, direction=IN
        arg Data: type=Dcm_Data3ByteType, direction=OUT
      operation ConditionCheckRead: possible-error=[DataServices_DID_F121_Primary_Bootloader_Diagnostic_Database_Part_Number_ASCII_part/E_NOT_OK, DataServices_DID_F121_Primary_Bootloader_Diagnostic_Database_Part_Number_ASCII_part/DCM_E_PENDING]
        arg OpStatus: type=Dcm_OpStatusType, direction=IN
        arg ErrorCode: type=Dcm_NegativeResponseCodeType, direction=OUT
      error E_NOT_OK: error-code=1
      error DCM_E_PENDING: error-code=10
    DataServices_DID_F121_Primary_Bootloader_Diagnostic_Database_Part_Number_BCD_part
      operation ReadData: possible-error=[DataServices_DID_F121_Primary_Bootloader_Diagnostic_Database_Part_Number_BCD_part/E_NOT_OK, DataServices_DID_F121_Primary_Bootloader_Diagnostic_Database_Part_Number_BCD_part/DCM_E_PENDING]
        arg OpStatus: type=Dcm_OpStatusType, direction=IN
        arg Data: type=Dcm_Data4ByteType, direction=OUT
      operation ConditionCheckRead: possible-error=[DataServices_DID_F121_Primary_Bootloader_Diagnostic_Database_Part_Number_BCD_part/E_NOT_OK, DataServices_DID_F121_Primary_Bootloader_Diagnostic_Database_Part_Number_BCD_part/DCM_E_PENDING]
        arg OpStatus: type=Dcm_OpStatusType, direction=IN
        arg ErrorCode: type=Dcm_NegativeResponseCodeType, direction=OUT
      error E_NOT_OK: error-code=1
      error DCM_E_PENDING: error-code=10
    DataServices_DID_D0B5_SDB_version_SDB_version
      operation ReadData: possible-error=[DataServices_DID_D0B5_SDB_version_SDB_version/E_NOT_OK, DataServices_DID_D0B5_SDB_version_SDB_version/DCM_E_PENDING]
        arg OpStatus: type=Dcm_OpStatusType, direction=IN
        arg Data: type=Dcm_Data3ByteType, direction=OUT
      operation ConditionCheckRead: possible-error=[DataServices_DID_D0B5_SDB_version_SDB_version/E_NOT_OK, DataServices_DID_D0B5_SDB_version_SDB_version/DCM_E_PENDING]
        arg OpStatus: type=Dcm_OpStatusType, direction=IN
        arg ErrorCode: type=Dcm_NegativeResponseCodeType, direction=OUT
      error E_NOT_OK: error-code=1
      error DCM_E_PENDING: error-code=10
    DataServices_DID_D12F_Security_Constant_Level_11_12_DID_D12F_Security_Constant_Level_1112
      operation ReadData: possible-error=[DataServices_DID_D12F_Security_Constant_Level_11_12_DID_D12F_Security_Constant_Level_1112/E_NOT_OK, DataServices_DID_D12F_Security_Constant_Level_11_12_DID_D12F_Security_Constant_Level_1112/DCM_E_PENDING]
        arg OpStatus: type=Dcm_OpStatusType, direction=IN
        arg Data: type=Dcm_Data5ByteType, direction=OUT
      operation ConditionCheckRead: possible-error=[DataServices_DID_D12F_Security_Constant_Level_11_12_DID_D12F_Security_Constant_Level_1112/E_NOT_OK, DataServices_DID_D12F_Security_Constant_Level_11_12_DID_D12F_Security_Constant_Level_1112/DCM_E_PENDING]
        arg OpStatus: type=Dcm_OpStatusType, direction=IN
        arg ErrorCode: type=Dcm_NegativeResponseCodeType, direction=OUT
      operation WriteData: possible-error=[DataServices_DID_D12F_Security_Constant_Level_11_12_DID_D12F_Security_Constant_Level_1112/E_NOT_OK, DataServices_DID_D12F_Security_Constant_Level_11_12_DID_D12F_Security_Constant_Level_1112/DCM_E_PENDING]
        arg Data: type=Dcm_Data5ByteType, direction=IN
        arg OpStatus: type=Dcm_OpStatusType, direction=IN
        arg ErrorCode: type=Dcm_NegativeResponseCodeType, direction=OUT
      error E_NOT_OK: error-code=1
      error DCM_E_PENDING: error-code=10
    DataServices_DID_E313_Active_discharge_status_DID_E313_Active_discharge_status
      operation ReadData: possible-error=[DataServices_DID_E313_Active_discharge_status_DID_E313_Active_discharge_status/E_NOT_OK, DataServices_DID_E313_Active_discharge_status_DID_E313_Active_discharge_status/DCM_E_PENDING]
        arg OpStatus: type=Dcm_OpStatusType, direction=IN
        arg Data: type=Dcm_Data1ByteType, direction=OUT
      operation ConditionCheckRead: possible-error=[DataServices_DID_E313_Active_discharge_status_DID_E313_Active_discharge_status/E_NOT_OK, DataServices_DID_E313_Active_discharge_status_DID_E313_Active_discharge_status/DCM_E_PENDING]
        arg OpStatus: type=Dcm_OpStatusType, direction=IN
        arg ErrorCode: type=Dcm_NegativeResponseCodeType, direction=OUT
      error E_NOT_OK: error-code=1
      error DCM_E_PENDING: error-code=10
    DataServices_DID_DD02_Vehicle_Battery_Voltage_DID_DD02_Vehicle_Battery_Voltage
      operation ReadData: possible-error=[DataServices_DID_DD02_Vehicle_Battery_Voltage_DID_DD02_Vehicle_Battery_Voltage/E_NOT_OK, DataServices_DID_DD02_Vehicle_Battery_Voltage_DID_DD02_Vehicle_Battery_Voltage/DCM_E_PENDING]
        arg OpStatus: type=Dcm_OpStatusType, direction=IN
        arg Data: type=Dcm_Data1ByteType, direction=OUT
      operation ConditionCheckRead: possible-error=[DataServices_DID_DD02_Vehicle_Battery_Voltage_DID_DD02_Vehicle_Battery_Voltage/E_NOT_OK, DataServices_DID_DD02_Vehicle_Battery_Voltage_DID_DD02_Vehicle_Battery_Voltage/DCM_E_PENDING]
        arg OpStatus: type=Dcm_OpStatusType, direction=IN
        arg ErrorCode: type=Dcm_NegativeResponseCodeType, direction=OUT
      error E_NOT_OK: error-code=1
      error DCM_E_PENDING: error-code=10
    DataServices_DID_E312_Wheel_Speed_DID_E312_Wheel_Speed
      operation ReadData: possible-error=[DataServices_DID_E312_Wheel_Speed_DID_E312_Wheel_Speed/E_NOT_OK, DataServices_DID_E312_Wheel_Speed_DID_E312_Wheel_Speed/DCM_E_PENDING]
        arg OpStatus: type=Dcm_OpStatusType, direction=IN
        arg Data: type=Dcm_Data2ByteType, direction=OUT
      operation ConditionCheckRead: possible-error=[DataServices_DID_E312_Wheel_Speed_DID_E312_Wheel_Speed/E_NOT_OK, DataServices_DID_E312_Wheel_Speed_DID_E312_Wheel_Speed/DCM_E_PENDING]
        arg OpStatus: type=Dcm_OpStatusType, direction=IN
        arg ErrorCode: type=Dcm_NegativeResponseCodeType, direction=OUT
      error E_NOT_OK: error-code=1
      error DCM_E_PENDING: error-code=10
    DataServices_DID_E363_Modulation_index_DID_E363_Modulation_index
      operation ReadData: possible-error=[DataServices_DID_E363_Modulation_index_DID_E363_Modulation_index/E_NOT_OK, DataServices_DID_E363_Modulation_index_DID_E363_Modulation_index/DCM_E_PENDING]
        arg OpStatus: type=Dcm_OpStatusType, direction=IN
        arg Data: type=Dcm_Data1ByteType, direction=OUT
      operation ConditionCheckRead: possible-error=[DataServices_DID_E363_Modulation_index_DID_E363_Modulation_index/E_NOT_OK, DataServices_DID_E363_Modulation_index_DID_E363_Modulation_index/DCM_E_PENDING]
        arg OpStatus: type=Dcm_OpStatusType, direction=IN
        arg ErrorCode: type=Dcm_NegativeResponseCodeType, direction=OUT
      error E_NOT_OK: error-code=1
      error DCM_E_PENDING: error-code=10
    DataServices_DID_D03A_swAuth_Public_Key_CheckSum_DID_D03A_swAuth_Public_Key_CheckSum
      operation ReadData: possible-error=[DataServices_DID_D03A_swAuth_Public_Key_CheckSum_DID_D03A_swAuth_Public_Key_CheckSum/E_NOT_OK, DataServices_DID_D03A_swAuth_Public_Key_CheckSum_DID_D03A_swAuth_Public_Key_CheckSum/DCM_E_PENDING]
        arg OpStatus: type=Dcm_OpStatusType, direction=IN
        arg Data: type=Dcm_Data32ByteType, direction=OUT
      operation ConditionCheckRead: possible-error=[DataServices_DID_D03A_swAuth_Public_Key_CheckSum_DID_D03A_swAuth_Public_Key_CheckSum/E_NOT_OK, DataServices_DID_D03A_swAuth_Public_Key_CheckSum_DID_D03A_swAuth_Public_Key_CheckSum/DCM_E_PENDING]
        arg OpStatus: type=Dcm_OpStatusType, direction=IN
        arg ErrorCode: type=Dcm_NegativeResponseCodeType, direction=OUT
      error E_NOT_OK: error-code=1
      error DCM_E_PENDING: error-code=10
    DataServices_DID_E347_IGBT_Max_Temperature_DID_E347_IGBT_Max_Temperature
      operation ReadData: possible-error=[DataServices_DID_E347_IGBT_Max_Temperature_DID_E347_IGBT_Max_Temperature/E_NOT_OK, DataServices_DID_E347_IGBT_Max_Temperature_DID_E347_IGBT_Max_Temperature/DCM_E_PENDING]
        arg OpStatus: type=Dcm_OpStatusType, direction=IN
        arg Data: type=Dcm_Data1ByteType, direction=OUT
      operation ConditionCheckRead: possible-error=[DataServices_DID_E347_IGBT_Max_Temperature_DID_E347_IGBT_Max_Temperature/E_NOT_OK, DataServices_DID_E347_IGBT_Max_Temperature_DID_E347_IGBT_Max_Temperature/DCM_E_PENDING]
        arg OpStatus: type=Dcm_OpStatusType, direction=IN
        arg ErrorCode: type=Dcm_NegativeResponseCodeType, direction=OUT
      error E_NOT_OK: error-code=1
      error DCM_E_PENDING: error-code=10
    DataServices_DID_F1AB_ECU_Delivery_Assembly_Part_Number_Geely_ASCII_part
      operation ReadData: possible-error=[DataServices_DID_F1AB_ECU_Delivery_Assembly_Part_Number_Geely_ASCII_part/E_NOT_OK, DataServices_DID_F1AB_ECU_Delivery_Assembly_Part_Number_Geely_ASCII_part/DCM_E_PENDING]
        arg OpStatus: type=Dcm_OpStatusType, direction=IN
        arg Data: type=Dcm_Data3ByteType, direction=OUT
      operation ConditionCheckRead: possible-error=[DataServices_DID_F1AB_ECU_Delivery_Assembly_Part_Number_Geely_ASCII_part/E_NOT_OK, DataServices_DID_F1AB_ECU_Delivery_Assembly_Part_Number_Geely_ASCII_part/DCM_E_PENDING]
        arg OpStatus: type=Dcm_OpStatusType, direction=IN
        arg ErrorCode: type=Dcm_NegativeResponseCodeType, direction=OUT
      error E_NOT_OK: error-code=1
      error DCM_E_PENDING: error-code=10
    DataServices_DID_F1AB_ECU_Delivery_Assembly_Part_Number_Geely_BCD_part
      operation ReadData: possible-error=[DataServices_DID_F1AB_ECU_Delivery_Assembly_Part_Number_Geely_BCD_part/E_NOT_OK, DataServices_DID_F1AB_ECU_Delivery_Assembly_Part_Number_Geely_BCD_part/DCM_E_PENDING]
        arg OpStatus: type=Dcm_OpStatusType, direction=IN
        arg Data: type=Dcm_Data5ByteType, direction=OUT
      operation ConditionCheckRead: possible-error=[DataServices_DID_F1AB_ECU_Delivery_Assembly_Part_Number_Geely_BCD_part/E_NOT_OK, DataServices_DID_F1AB_ECU_Delivery_Assembly_Part_Number_Geely_BCD_part/DCM_E_PENDING]
        arg OpStatus: type=Dcm_OpStatusType, direction=IN
        arg ErrorCode: type=Dcm_NegativeResponseCodeType, direction=OUT
      error E_NOT_OK: error-code=1
      error DCM_E_PENDING: error-code=10
    DataServices_DID_E336_d_axis_current_feedback_DID_E336_d_axis_current_feedback
      operation ReadData: possible-error=[DataServices_DID_E336_d_axis_current_feedback_DID_E336_d_axis_current_feedback/E_NOT_OK, DataServices_DID_E336_d_axis_current_feedback_DID_E336_d_axis_current_feedback/DCM_E_PENDING]
        arg OpStatus: type=Dcm_OpStatusType, direction=IN
        arg Data: type=Dcm_Data2ByteType, direction=OUT
      operation ConditionCheckRead: possible-error=[DataServices_DID_E336_d_axis_current_feedback_DID_E336_d_axis_current_feedback/E_NOT_OK, DataServices_DID_E336_d_axis_current_feedback_DID_E336_d_axis_current_feedback/DCM_E_PENDING]
        arg OpStatus: type=Dcm_OpStatusType, direction=IN
        arg ErrorCode: type=Dcm_NegativeResponseCodeType, direction=OUT
      error E_NOT_OK: error-code=1
      error DCM_E_PENDING: error-code=10
    DataServices_DID_EE9D_Transient_Phase_Current_B_DID_EE9D_Transient_Phase_Current_B
      operation ReadData: possible-error=[DataServices_DID_EE9D_Transient_Phase_Current_B_DID_EE9D_Transient_Phase_Current_B/E_NOT_OK, DataServices_DID_EE9D_Transient_Phase_Current_B_DID_EE9D_Transient_Phase_Current_B/DCM_E_PENDING]
        arg OpStatus: type=Dcm_OpStatusType, direction=IN
        arg Data: type=Dcm_Data2ByteType, direction=OUT
      operation ConditionCheckRead: possible-error=[DataServices_DID_EE9D_Transient_Phase_Current_B_DID_EE9D_Transient_Phase_Current_B/E_NOT_OK, DataServices_DID_EE9D_Transient_Phase_Current_B_DID_EE9D_Transient_Phase_Current_B/DCM_E_PENDING]
        arg OpStatus: type=Dcm_OpStatusType, direction=IN
        arg ErrorCode: type=Dcm_NegativeResponseCodeType, direction=OUT
      error E_NOT_OK: error-code=1
      error DCM_E_PENDING: error-code=10
    DataServices_DID_EE9F_Gate_Status_DID_EE9F_Gate_Status
      operation ReadData: possible-error=[DataServices_DID_EE9F_Gate_Status_DID_EE9F_Gate_Status/E_NOT_OK, DataServices_DID_EE9F_Gate_Status_DID_EE9F_Gate_Status/DCM_E_PENDING]
        arg OpStatus: type=Dcm_OpStatusType, direction=IN
        arg Data: type=Dcm_Data1ByteType, direction=OUT
      operation ConditionCheckRead: possible-error=[DataServices_DID_EE9F_Gate_Status_DID_EE9F_Gate_Status/E_NOT_OK, DataServices_DID_EE9F_Gate_Status_DID_EE9F_Gate_Status/DCM_E_PENDING]
        arg OpStatus: type=Dcm_OpStatusType, direction=IN
        arg ErrorCode: type=Dcm_NegativeResponseCodeType, direction=OUT
      error E_NOT_OK: error-code=1
      error DCM_E_PENDING: error-code=10
    DataServices_DID_E333_2002_State_2002_H_Ser
      operation ReadData: possible-error=[DataServices_DID_E333_2002_State_2002_H_Ser/E_NOT_OK, DataServices_DID_E333_2002_State_2002_H_Ser/DCM_E_PENDING]
        arg OpStatus: type=Dcm_OpStatusType, direction=IN
        arg Data: type=Dcm_Data1ByteType, direction=OUT
      operation ConditionCheckRead: possible-error=[DataServices_DID_E333_2002_State_2002_H_Ser/E_NOT_OK, DataServices_DID_E333_2002_State_2002_H_Ser/DCM_E_PENDING]
        arg OpStatus: type=Dcm_OpStatusType, direction=IN
        arg ErrorCode: type=Dcm_NegativeResponseCodeType, direction=OUT
      operation WriteData: possible-error=[DataServices_DID_E333_2002_State_2002_H_Ser/E_NOT_OK, DataServices_DID_E333_2002_State_2002_H_Ser/DCM_E_PENDING]
        arg Data: type=Dcm_Data1ByteType, direction=IN
        arg OpStatus: type=Dcm_OpStatusType, direction=IN
        arg ErrorCode: type=Dcm_NegativeResponseCodeType, direction=OUT
      error E_NOT_OK: error-code=1
      error DCM_E_PENDING: error-code=10
    DataServices_DID_E333_2002_State_2002_Lu
      operation ReadData: possible-error=[DataServices_DID_E333_2002_State_2002_Lu/E_NOT_OK, DataServices_DID_E333_2002_State_2002_Lu/DCM_E_PENDING]
        arg OpStatus: type=Dcm_OpStatusType, direction=IN
        arg Data: type=Dcm_Data1ByteType, direction=OUT
      operation ConditionCheckRead: possible-error=[DataServices_DID_E333_2002_State_2002_Lu/E_NOT_OK, DataServices_DID_E333_2002_State_2002_Lu/DCM_E_PENDING]
        arg OpStatus: type=Dcm_OpStatusType, direction=IN
        arg ErrorCode: type=Dcm_NegativeResponseCodeType, direction=OUT
      operation WriteData: possible-error=[DataServices_DID_E333_2002_State_2002_Lu/E_NOT_OK, DataServices_DID_E333_2002_State_2002_Lu/DCM_E_PENDING]
        arg Data: type=Dcm_Data1ByteType, direction=IN
        arg OpStatus: type=Dcm_OpStatusType, direction=IN
        arg ErrorCode: type=Dcm_NegativeResponseCodeType, direction=OUT
      error E_NOT_OK: error-code=1
      error DCM_E_PENDING: error-code=10
    DataServices_DID_E333_2002_State_2002_L_Ser
      operation ReadData: possible-error=[DataServices_DID_E333_2002_State_2002_L_Ser/E_NOT_OK, DataServices_DID_E333_2002_State_2002_L_Ser/DCM_E_PENDING]
        arg OpStatus: type=Dcm_OpStatusType, direction=IN
        arg Data: type=Dcm_Data1ByteType, direction=OUT
      operation ConditionCheckRead: possible-error=[DataServices_DID_E333_2002_State_2002_L_Ser/E_NOT_OK, DataServices_DID_E333_2002_State_2002_L_Ser/DCM_E_PENDING]
        arg OpStatus: type=Dcm_OpStatusType, direction=IN
        arg ErrorCode: type=Dcm_NegativeResponseCodeType, direction=OUT
      operation WriteData: possible-error=[DataServices_DID_E333_2002_State_2002_L_Ser/E_NOT_OK, DataServices_DID_E333_2002_State_2002_L_Ser/DCM_E_PENDING]
        arg Data: type=Dcm_Data1ByteType, direction=IN
        arg OpStatus: type=Dcm_OpStatusType, direction=IN
        arg ErrorCode: type=Dcm_NegativeResponseCodeType, direction=OUT
      error E_NOT_OK: error-code=1
      error DCM_E_PENDING: error-code=10
    DataServices_DID_E333_2002_State_2002_Hu
      operation ReadData: possible-error=[DataServices_DID_E333_2002_State_2002_Hu/E_NOT_OK, DataServices_DID_E333_2002_State_2002_Hu/DCM_E_PENDING]
        arg OpStatus: type=Dcm_OpStatusType, direction=IN
        arg Data: type=Dcm_Data1ByteType, direction=OUT
      operation ConditionCheckRead: possible-error=[DataServices_DID_E333_2002_State_2002_Hu/E_NOT_OK, DataServices_DID_E333_2002_State_2002_Hu/DCM_E_PENDING]
        arg OpStatus: type=Dcm_OpStatusType, direction=IN
        arg ErrorCode: type=Dcm_NegativeResponseCodeType, direction=OUT
      operation WriteData: possible-error=[DataServices_DID_E333_2002_State_2002_Hu/E_NOT_OK, DataServices_DID_E333_2002_State_2002_Hu/DCM_E_PENDING]
        arg Data: type=Dcm_Data1ByteType, direction=IN
        arg OpStatus: type=Dcm_OpStatusType, direction=IN
        arg ErrorCode: type=Dcm_NegativeResponseCodeType, direction=OUT
      error E_NOT_OK: error-code=1
      error DCM_E_PENDING: error-code=10
    DataServices_DID_E333_2002_State_2002_Lv
      operation ReadData: possible-error=[DataServices_DID_E333_2002_State_2002_Lv/E_NOT_OK, DataServices_DID_E333_2002_State_2002_Lv/DCM_E_PENDING]
        arg OpStatus: type=Dcm_OpStatusType, direction=IN
        arg Data: type=Dcm_Data1ByteType, direction=OUT
      operation ConditionCheckRead: possible-error=[DataServices_DID_E333_2002_State_2002_Lv/E_NOT_OK, DataServices_DID_E333_2002_State_2002_Lv/DCM_E_PENDING]
        arg OpStatus: type=Dcm_OpStatusType, direction=IN
        arg ErrorCode: type=Dcm_NegativeResponseCodeType, direction=OUT
      operation WriteData: possible-error=[DataServices_DID_E333_2002_State_2002_Lv/E_NOT_OK, DataServices_DID_E333_2002_State_2002_Lv/DCM_E_PENDING]
        arg Data: type=Dcm_Data1ByteType, direction=IN
        arg OpStatus: type=Dcm_OpStatusType, direction=IN
        arg ErrorCode: type=Dcm_NegativeResponseCodeType, direction=OUT
      error E_NOT_OK: error-code=1
      error DCM_E_PENDING: error-code=10
    DataServices_DID_E333_2002_State_2002_Lw
      operation ReadData: possible-error=[DataServices_DID_E333_2002_State_2002_Lw/E_NOT_OK, DataServices_DID_E333_2002_State_2002_Lw/DCM_E_PENDING]
        arg OpStatus: type=Dcm_OpStatusType, direction=IN
        arg Data: type=Dcm_Data1ByteType, direction=OUT
      operation ConditionCheckRead: possible-error=[DataServices_DID_E333_2002_State_2002_Lw/E_NOT_OK, DataServices_DID_E333_2002_State_2002_Lw/DCM_E_PENDING]
        arg OpStatus: type=Dcm_OpStatusType, direction=IN
        arg ErrorCode: type=Dcm_NegativeResponseCodeType, direction=OUT
      operation WriteData: possible-error=[DataServices_DID_E333_2002_State_2002_Lw/E_NOT_OK, DataServices_DID_E333_2002_State_2002_Lw/DCM_E_PENDING]
        arg Data: type=Dcm_Data1ByteType, direction=IN
        arg OpStatus: type=Dcm_OpStatusType, direction=IN
        arg ErrorCode: type=Dcm_NegativeResponseCodeType, direction=OUT
      error E_NOT_OK: error-code=1
      error DCM_E_PENDING: error-code=10
    DataServices_DID_E333_2002_State_2002_Hv
      operation ReadData: possible-error=[DataServices_DID_E333_2002_State_2002_Hv/E_NOT_OK, DataServices_DID_E333_2002_State_2002_Hv/DCM_E_PENDING]
        arg OpStatus: type=Dcm_OpStatusType, direction=IN
        arg Data: type=Dcm_Data1ByteType, direction=OUT
      operation ConditionCheckRead: possible-error=[DataServices_DID_E333_2002_State_2002_Hv/E_NOT_OK, DataServices_DID_E333_2002_State_2002_Hv/DCM_E_PENDING]
        arg OpStatus: type=Dcm_OpStatusType, direction=IN
        arg ErrorCode: type=Dcm_NegativeResponseCodeType, direction=OUT
      operation WriteData: possible-error=[DataServices_DID_E333_2002_State_2002_Hv/E_NOT_OK, DataServices_DID_E333_2002_State_2002_Hv/DCM_E_PENDING]
        arg Data: type=Dcm_Data1ByteType, direction=IN
        arg OpStatus: type=Dcm_OpStatusType, direction=IN
        arg ErrorCode: type=Dcm_NegativeResponseCodeType, direction=OUT
      error E_NOT_OK: error-code=1
      error DCM_E_PENDING: error-code=10
    DataServices_DID_E333_2002_State_2002_Hw
      operation ReadData: possible-error=[DataServices_DID_E333_2002_State_2002_Hw/E_NOT_OK, DataServices_DID_E333_2002_State_2002_Hw/DCM_E_PENDING]
        arg OpStatus: type=Dcm_OpStatusType, direction=IN
        arg Data: type=Dcm_Data1ByteType, direction=OUT
      operation ConditionCheckRead: possible-error=[DataServices_DID_E333_2002_State_2002_Hw/E_NOT_OK, DataServices_DID_E333_2002_State_2002_Hw/DCM_E_PENDING]
        arg OpStatus: type=Dcm_OpStatusType, direction=IN
        arg ErrorCode: type=Dcm_NegativeResponseCodeType, direction=OUT
      operation WriteData: possible-error=[DataServices_DID_E333_2002_State_2002_Hw/E_NOT_OK, DataServices_DID_E333_2002_State_2002_Hw/DCM_E_PENDING]
        arg Data: type=Dcm_Data1ByteType, direction=IN
        arg OpStatus: type=Dcm_OpStatusType, direction=IN
        arg ErrorCode: type=Dcm_NegativeResponseCodeType, direction=OUT
      error E_NOT_OK: error-code=1
      error DCM_E_PENDING: error-code=10
    DataServices_DID_E310_IEM_MGM_Derating_Status_DID_E310_IEMMGM_Derating_Status
      operation ReadData: possible-error=[DataServices_DID_E310_IEM_MGM_Derating_Status_DID_E310_IEMMGM_Derating_Status/E_NOT_OK, DataServices_DID_E310_IEM_MGM_Derating_Status_DID_E310_IEMMGM_Derating_Status/DCM_E_PENDING]
        arg OpStatus: type=Dcm_OpStatusType, direction=IN
        arg Data: type=Dcm_Data1ByteType, direction=OUT
      operation ConditionCheckRead: possible-error=[DataServices_DID_E310_IEM_MGM_Derating_Status_DID_E310_IEMMGM_Derating_Status/E_NOT_OK, DataServices_DID_E310_IEM_MGM_Derating_Status_DID_E310_IEMMGM_Derating_Status/DCM_E_PENDING]
        arg OpStatus: type=Dcm_OpStatusType, direction=IN
        arg ErrorCode: type=Dcm_NegativeResponseCodeType, direction=OUT
      error E_NOT_OK: error-code=1
      error DCM_E_PENDING: error-code=10
    DataServices_DID_EEBE_Offset_angle_status_DID_EEBE_Offset_angle_status
      operation ReadData: possible-error=[DataServices_DID_EEBE_Offset_angle_status_DID_EEBE_Offset_angle_status/E_NOT_OK, DataServices_DID_EEBE_Offset_angle_status_DID_EEBE_Offset_angle_status/DCM_E_PENDING]
        arg OpStatus: type=Dcm_OpStatusType, direction=IN
        arg Data: type=Dcm_Data1ByteType, direction=OUT
      operation ConditionCheckRead: possible-error=[DataServices_DID_EEBE_Offset_angle_status_DID_EEBE_Offset_angle_status/E_NOT_OK, DataServices_DID_EEBE_Offset_angle_status_DID_EEBE_Offset_angle_status/DCM_E_PENDING]
        arg OpStatus: type=Dcm_OpStatusType, direction=IN
        arg ErrorCode: type=Dcm_NegativeResponseCodeType, direction=OUT
      error E_NOT_OK: error-code=1
      error DCM_E_PENDING: error-code=10
    DataServices_Application_Diagnostic_Database_Part_Number_Partnumber_Variant
      operation ReadData: possible-error=[DataServices_Application_Diagnostic_Database_Part_Number_Partnumber_Variant/E_NOT_OK, DataServices_Application_Diagnostic_Database_Part_Number_Partnumber_Variant/DCM_E_PENDING]
        arg OpStatus: type=Dcm_OpStatusType, direction=IN
        arg Data: type=Dcm_Data3ByteType, direction=OUT
      operation ConditionCheckRead: possible-error=[DataServices_Application_Diagnostic_Database_Part_Number_Partnumber_Variant/E_NOT_OK, DataServices_Application_Diagnostic_Database_Part_Number_Partnumber_Variant/DCM_E_PENDING]
        arg OpStatus: type=Dcm_OpStatusType, direction=IN
        arg ErrorCode: type=Dcm_NegativeResponseCodeType, direction=OUT
      error E_NOT_OK: error-code=1
      error DCM_E_PENDING: error-code=10
    DataServices_Application_Diagnostic_Database_Part_Number_Partnumber_Main
      operation ReadData: possible-error=[DataServices_Application_Diagnostic_Database_Part_Number_Partnumber_Main/E_NOT_OK, DataServices_Application_Diagnostic_Database_Part_Number_Partnumber_Main/DCM_E_PENDING]
        arg OpStatus: type=Dcm_OpStatusType, direction=IN
        arg Data: type=Dcm_Data4ByteType, direction=OUT
      operation ConditionCheckRead: possible-error=[DataServices_Application_Diagnostic_Database_Part_Number_Partnumber_Main/E_NOT_OK, DataServices_Application_Diagnostic_Database_Part_Number_Partnumber_Main/DCM_E_PENDING]
        arg OpStatus: type=Dcm_OpStatusType, direction=IN
        arg ErrorCode: type=Dcm_NegativeResponseCodeType, direction=OUT
      error E_NOT_OK: error-code=1
      error DCM_E_PENDING: error-code=10
    DataServices_DID_0xEEC7_1_DID_EED2_SaftyTorque
      operation ReadData: possible-error=[DataServices_DID_0xEEC7_1_DID_EED2_SaftyTorque/E_NOT_OK, DataServices_DID_0xEEC7_1_DID_EED2_SaftyTorque/DCM_E_PENDING]
        arg OpStatus: type=Dcm_OpStatusType, direction=IN
        arg Data: type=Dcm_Data2ByteType, direction=OUT
      operation ConditionCheckRead: possible-error=[DataServices_DID_0xEEC7_1_DID_EED2_SaftyTorque/E_NOT_OK, DataServices_DID_0xEEC7_1_DID_EED2_SaftyTorque/DCM_E_PENDING]
        arg OpStatus: type=Dcm_OpStatusType, direction=IN
        arg ErrorCode: type=Dcm_NegativeResponseCodeType, direction=OUT
      error E_NOT_OK: error-code=1
      error DCM_E_PENDING: error-code=10
    DataServices_DID_E358_Resolve_angle_DID_E358_Resolve_angle
      operation ReadData: possible-error=[DataServices_DID_E358_Resolve_angle_DID_E358_Resolve_angle/E_NOT_OK, DataServices_DID_E358_Resolve_angle_DID_E358_Resolve_angle/DCM_E_PENDING]
        arg OpStatus: type=Dcm_OpStatusType, direction=IN
        arg Data: type=Dcm_Data2ByteType, direction=OUT
      operation ConditionCheckRead: possible-error=[DataServices_DID_E358_Resolve_angle_DID_E358_Resolve_angle/E_NOT_OK, DataServices_DID_E358_Resolve_angle_DID_E358_Resolve_angle/DCM_E_PENDING]
        arg OpStatus: type=Dcm_OpStatusType, direction=IN
        arg ErrorCode: type=Dcm_NegativeResponseCodeType, direction=OUT
      error E_NOT_OK: error-code=1
      error DCM_E_PENDING: error-code=10
    DataServices_DID_E357_Resolve_compensated_angle_DID_E357_Resolve_compensated_angle
      operation ReadData: possible-error=[DataServices_DID_E357_Resolve_compensated_angle_DID_E357_Resolve_compensated_angle/E_NOT_OK, DataServices_DID_E357_Resolve_compensated_angle_DID_E357_Resolve_compensated_angle/DCM_E_PENDING]
        arg OpStatus: type=Dcm_OpStatusType, direction=IN
        arg Data: type=Dcm_Data1ByteType, direction=OUT
      operation ConditionCheckRead: possible-error=[DataServices_DID_E357_Resolve_compensated_angle_DID_E357_Resolve_compensated_angle/E_NOT_OK, DataServices_DID_E357_Resolve_compensated_angle_DID_E357_Resolve_compensated_angle/DCM_E_PENDING]
        arg OpStatus: type=Dcm_OpStatusType, direction=IN
        arg ErrorCode: type=Dcm_NegativeResponseCodeType, direction=OUT
      error E_NOT_OK: error-code=1
      error DCM_E_PENDING: error-code=10
    DataServices_DID_E307_System_Mode_DID_E307_System_Mode
      operation ReadData: possible-error=[DataServices_DID_E307_System_Mode_DID_E307_System_Mode/E_NOT_OK, DataServices_DID_E307_System_Mode_DID_E307_System_Mode/DCM_E_PENDING]
        arg OpStatus: type=Dcm_OpStatusType, direction=IN
        arg Data: type=Dcm_Data1ByteType, direction=OUT
      operation ConditionCheckRead: possible-error=[DataServices_DID_E307_System_Mode_DID_E307_System_Mode/E_NOT_OK, DataServices_DID_E307_System_Mode_DID_E307_System_Mode/DCM_E_PENDING]
        arg OpStatus: type=Dcm_OpStatusType, direction=IN
        arg ErrorCode: type=Dcm_NegativeResponseCodeType, direction=OUT
      error E_NOT_OK: error-code=1
      error DCM_E_PENDING: error-code=10
    DataServices_DID_E305_Inverter_IGBT_Junction_Temp_DID_E305_Inverter_IGBT_Junction_Temp
      operation ReadData: possible-error=[DataServices_DID_E305_Inverter_IGBT_Junction_Temp_DID_E305_Inverter_IGBT_Junction_Temp/E_NOT_OK, DataServices_DID_E305_Inverter_IGBT_Junction_Temp_DID_E305_Inverter_IGBT_Junction_Temp/DCM_E_PENDING]
        arg OpStatus: type=Dcm_OpStatusType, direction=IN
        arg Data: type=Dcm_Data1ByteType, direction=OUT
      operation ConditionCheckRead: possible-error=[DataServices_DID_E305_Inverter_IGBT_Junction_Temp_DID_E305_Inverter_IGBT_Junction_Temp/E_NOT_OK, DataServices_DID_E305_Inverter_IGBT_Junction_Temp_DID_E305_Inverter_IGBT_Junction_Temp/DCM_E_PENDING]
        arg OpStatus: type=Dcm_OpStatusType, direction=IN
        arg ErrorCode: type=Dcm_NegativeResponseCodeType, direction=OUT
      error E_NOT_OK: error-code=1
      error DCM_E_PENDING: error-code=10
    DataServices_DID_F1AA_ECU_Core_Assembly_Part_Number_Geely_ASCII_part
      operation ReadData: possible-error=[DataServices_DID_F1AA_ECU_Core_Assembly_Part_Number_Geely_ASCII_part/E_NOT_OK, DataServices_DID_F1AA_ECU_Core_Assembly_Part_Number_Geely_ASCII_part/DCM_E_PENDING]
        arg OpStatus: type=Dcm_OpStatusType, direction=IN
        arg Data: type=Dcm_Data3ByteType, direction=OUT
      operation ConditionCheckRead: possible-error=[DataServices_DID_F1AA_ECU_Core_Assembly_Part_Number_Geely_ASCII_part/E_NOT_OK, DataServices_DID_F1AA_ECU_Core_Assembly_Part_Number_Geely_ASCII_part/DCM_E_PENDING]
        arg OpStatus: type=Dcm_OpStatusType, direction=IN
        arg ErrorCode: type=Dcm_NegativeResponseCodeType, direction=OUT
      error E_NOT_OK: error-code=1
      error DCM_E_PENDING: error-code=10
    DataServices_DID_F1AA_ECU_Core_Assembly_Part_Number_Geely_BCD_part
      operation ReadData: possible-error=[DataServices_DID_F1AA_ECU_Core_Assembly_Part_Number_Geely_BCD_part/E_NOT_OK, DataServices_DID_F1AA_ECU_Core_Assembly_Part_Number_Geely_BCD_part/DCM_E_PENDING]
        arg OpStatus: type=Dcm_OpStatusType, direction=IN
        arg Data: type=Dcm_Data5ByteType, direction=OUT
      operation ConditionCheckRead: possible-error=[DataServices_DID_F1AA_ECU_Core_Assembly_Part_Number_Geely_BCD_part/E_NOT_OK, DataServices_DID_F1AA_ECU_Core_Assembly_Part_Number_Geely_BCD_part/DCM_E_PENDING]
        arg OpStatus: type=Dcm_OpStatusType, direction=IN
        arg ErrorCode: type=Dcm_NegativeResponseCodeType, direction=OUT
      error E_NOT_OK: error-code=1
      error DCM_E_PENDING: error-code=10
    DataServices_DID_E301_HVDC_Current_DID_E301_HVDC_Current_
      operation ReadData: possible-error=[DataServices_DID_E301_HVDC_Current_DID_E301_HVDC_Current_/E_NOT_OK, DataServices_DID_E301_HVDC_Current_DID_E301_HVDC_Current_/DCM_E_PENDING]
        arg OpStatus: type=Dcm_OpStatusType, direction=IN
        arg Data: type=Dcm_Data2ByteType, direction=OUT
      operation ConditionCheckRead: possible-error=[DataServices_DID_E301_HVDC_Current_DID_E301_HVDC_Current_/E_NOT_OK, DataServices_DID_E301_HVDC_Current_DID_E301_HVDC_Current_/DCM_E_PENDING]
        arg OpStatus: type=Dcm_OpStatusType, direction=IN
        arg ErrorCode: type=Dcm_NegativeResponseCodeType, direction=OUT
      error E_NOT_OK: error-code=1
      error DCM_E_PENDING: error-code=10
    DataServices_DID_EF1C_EOL_config_word_B_DID_EF1C_EOL_config_word_B
      operation ReadData: possible-error=[DataServices_DID_EF1C_EOL_config_word_B_DID_EF1C_EOL_config_word_B/E_NOT_OK, DataServices_DID_EF1C_EOL_config_word_B_DID_EF1C_EOL_config_word_B/DCM_E_PENDING]
        arg OpStatus: type=Dcm_OpStatusType, direction=IN
        arg Data: type=Dcm_Data40ByteType, direction=OUT
      operation ConditionCheckRead: possible-error=[DataServices_DID_EF1C_EOL_config_word_B_DID_EF1C_EOL_config_word_B/E_NOT_OK, DataServices_DID_EF1C_EOL_config_word_B_DID_EF1C_EOL_config_word_B/DCM_E_PENDING]
        arg OpStatus: type=Dcm_OpStatusType, direction=IN
        arg ErrorCode: type=Dcm_NegativeResponseCodeType, direction=OUT
      operation WriteData: possible-error=[DataServices_DID_EF1C_EOL_config_word_B_DID_EF1C_EOL_config_word_B/E_NOT_OK, DataServices_DID_EF1C_EOL_config_word_B_DID_EF1C_EOL_config_word_B/DCM_E_PENDING]
        arg Data: type=Dcm_Data40ByteType, direction=IN
        arg OpStatus: type=Dcm_OpStatusType, direction=IN
        arg ErrorCode: type=Dcm_NegativeResponseCodeType, direction=OUT
      error E_NOT_OK: error-code=1
      error DCM_E_PENDING: error-code=10
    DataServices_DID_EEBD_IEM_MGM_rotor_offset_angle_DID_EEBD_IEMMGM_rotor_offset_angle
      operation ReadData: possible-error=[DataServices_DID_EEBD_IEM_MGM_rotor_offset_angle_DID_EEBD_IEMMGM_rotor_offset_angle/E_NOT_OK, DataServices_DID_EEBD_IEM_MGM_rotor_offset_angle_DID_EEBD_IEMMGM_rotor_offset_angle/DCM_E_PENDING]
        arg OpStatus: type=Dcm_OpStatusType, direction=IN
        arg Data: type=Dcm_Data4ByteType, direction=OUT
      operation ConditionCheckRead: possible-error=[DataServices_DID_EEBD_IEM_MGM_rotor_offset_angle_DID_EEBD_IEMMGM_rotor_offset_angle/E_NOT_OK, DataServices_DID_EEBD_IEM_MGM_rotor_offset_angle_DID_EEBD_IEMMGM_rotor_offset_angle/DCM_E_PENDING]
        arg OpStatus: type=Dcm_OpStatusType, direction=IN
        arg ErrorCode: type=Dcm_NegativeResponseCodeType, direction=OUT
      operation WriteData: possible-error=[DataServices_DID_EEBD_IEM_MGM_rotor_offset_angle_DID_EEBD_IEMMGM_rotor_offset_angle/E_NOT_OK, DataServices_DID_EEBD_IEM_MGM_rotor_offset_angle_DID_EEBD_IEMMGM_rotor_offset_angle/DCM_E_PENDING]
        arg Data: type=Dcm_Data4ByteType, direction=IN
        arg OpStatus: type=Dcm_OpStatusType, direction=IN
        arg ErrorCode: type=Dcm_NegativeResponseCodeType, direction=OUT
      error E_NOT_OK: error-code=1
      error DCM_E_PENDING: error-code=10
    DataServices_DID_E306_Motor_Temperature_DID_E306_Motor_Temperature
      operation ReadData: possible-error=[DataServices_DID_E306_Motor_Temperature_DID_E306_Motor_Temperature/E_NOT_OK, DataServices_DID_E306_Motor_Temperature_DID_E306_Motor_Temperature/DCM_E_PENDING]
        arg OpStatus: type=Dcm_OpStatusType, direction=IN
        arg Data: type=Dcm_Data1ByteType, direction=OUT
      operation ConditionCheckRead: possible-error=[DataServices_DID_E306_Motor_Temperature_DID_E306_Motor_Temperature/E_NOT_OK, DataServices_DID_E306_Motor_Temperature_DID_E306_Motor_Temperature/DCM_E_PENDING]
        arg OpStatus: type=Dcm_OpStatusType, direction=IN
        arg ErrorCode: type=Dcm_NegativeResponseCodeType, direction=OUT
      error E_NOT_OK: error-code=1
      error DCM_E_PENDING: error-code=10
    DataServices_DID_EED1_Safty_monitor_Fault_Indication_EED1_1
      operation ReadData: possible-error=[DataServices_DID_EED1_Safty_monitor_Fault_Indication_EED1_1/E_NOT_OK, DataServices_DID_EED1_Safty_monitor_Fault_Indication_EED1_1/DCM_E_PENDING]
        arg OpStatus: type=Dcm_OpStatusType, direction=IN
        arg Data: type=Dcm_Data1ByteType, direction=OUT
      operation ConditionCheckRead: possible-error=[DataServices_DID_EED1_Safty_monitor_Fault_Indication_EED1_1/E_NOT_OK, DataServices_DID_EED1_Safty_monitor_Fault_Indication_EED1_1/DCM_E_PENDING]
        arg OpStatus: type=Dcm_OpStatusType, direction=IN
        arg ErrorCode: type=Dcm_NegativeResponseCodeType, direction=OUT
      error E_NOT_OK: error-code=1
      error DCM_E_PENDING: error-code=10
    DataServices_DID_EED1_Safty_monitor_Fault_Indication_EED1_2
      operation ReadData: possible-error=[DataServices_DID_EED1_Safty_monitor_Fault_Indication_EED1_2/E_NOT_OK, DataServices_DID_EED1_Safty_monitor_Fault_Indication_EED1_2/DCM_E_PENDING]
        arg OpStatus: type=Dcm_OpStatusType, direction=IN
        arg Data: type=Dcm_Data1ByteType, direction=OUT
      operation ConditionCheckRead: possible-error=[DataServices_DID_EED1_Safty_monitor_Fault_Indication_EED1_2/E_NOT_OK, DataServices_DID_EED1_Safty_monitor_Fault_Indication_EED1_2/DCM_E_PENDING]
        arg OpStatus: type=Dcm_OpStatusType, direction=IN
        arg ErrorCode: type=Dcm_NegativeResponseCodeType, direction=OUT
      error E_NOT_OK: error-code=1
      error DCM_E_PENDING: error-code=10
    DataServices_DID_EED1_Safty_monitor_Fault_Indication_EED1_3
      operation ReadData: possible-error=[DataServices_DID_EED1_Safty_monitor_Fault_Indication_EED1_3/E_NOT_OK, DataServices_DID_EED1_Safty_monitor_Fault_Indication_EED1_3/DCM_E_PENDING]
        arg OpStatus: type=Dcm_OpStatusType, direction=IN
        arg Data: type=Dcm_Data1ByteType, direction=OUT
      operation ConditionCheckRead: possible-error=[DataServices_DID_EED1_Safty_monitor_Fault_Indication_EED1_3/E_NOT_OK, DataServices_DID_EED1_Safty_monitor_Fault_Indication_EED1_3/DCM_E_PENDING]
        arg OpStatus: type=Dcm_OpStatusType, direction=IN
        arg ErrorCode: type=Dcm_NegativeResponseCodeType, direction=OUT
      error E_NOT_OK: error-code=1
      error DCM_E_PENDING: error-code=10
    DataServices_DID_EED1_Safty_monitor_Fault_Indication_EED1_0
      operation ReadData: possible-error=[DataServices_DID_EED1_Safty_monitor_Fault_Indication_EED1_0/E_NOT_OK, DataServices_DID_EED1_Safty_monitor_Fault_Indication_EED1_0/DCM_E_PENDING]
        arg OpStatus: type=Dcm_OpStatusType, direction=IN
        arg Data: type=Dcm_Data1ByteType, direction=OUT
      operation ConditionCheckRead: possible-error=[DataServices_DID_EED1_Safty_monitor_Fault_Indication_EED1_0/E_NOT_OK, DataServices_DID_EED1_Safty_monitor_Fault_Indication_EED1_0/DCM_E_PENDING]
        arg OpStatus: type=Dcm_OpStatusType, direction=IN
        arg ErrorCode: type=Dcm_NegativeResponseCodeType, direction=OUT
      error E_NOT_OK: error-code=1
      error DCM_E_PENDING: error-code=10
    DataServices_DID_EEB7_ECM_Power_Limitation_minimum_DID_EEB7_ECM_Power_Limitation_minimum
      operation ReadData: possible-error=[DataServices_DID_EEB7_ECM_Power_Limitation_minimum_DID_EEB7_ECM_Power_Limitation_minimum/E_NOT_OK, DataServices_DID_EEB7_ECM_Power_Limitation_minimum_DID_EEB7_ECM_Power_Limitation_minimum/DCM_E_PENDING]
        arg OpStatus: type=Dcm_OpStatusType, direction=IN
        arg Data: type=Dcm_Data2ByteType, direction=OUT
      operation ConditionCheckRead: possible-error=[DataServices_DID_EEB7_ECM_Power_Limitation_minimum_DID_EEB7_ECM_Power_Limitation_minimum/E_NOT_OK, DataServices_DID_EEB7_ECM_Power_Limitation_minimum_DID_EEB7_ECM_Power_Limitation_minimum/DCM_E_PENDING]
        arg OpStatus: type=Dcm_OpStatusType, direction=IN
        arg ErrorCode: type=Dcm_NegativeResponseCodeType, direction=OUT
      error E_NOT_OK: error-code=1
      error DCM_E_PENDING: error-code=10
    DataServices_DID_F12E_ECU_Software_Part_Numbers_ASCII_part
      operation ReadData: possible-error=[DataServices_DID_F12E_ECU_Software_Part_Numbers_ASCII_part/E_NOT_OK, DataServices_DID_F12E_ECU_Software_Part_Numbers_ASCII_part/DCM_E_PENDING]
        arg OpStatus: type=Dcm_OpStatusType, direction=IN
        arg Data: type=Dcm_Data3ByteType, direction=OUT
      operation ConditionCheckRead: possible-error=[DataServices_DID_F12E_ECU_Software_Part_Numbers_ASCII_part/E_NOT_OK, DataServices_DID_F12E_ECU_Software_Part_Numbers_ASCII_part/DCM_E_PENDING]
        arg OpStatus: type=Dcm_OpStatusType, direction=IN
        arg ErrorCode: type=Dcm_NegativeResponseCodeType, direction=OUT
      error E_NOT_OK: error-code=1
      error DCM_E_PENDING: error-code=10
    DataServices_DID_F12E_ECU_Software_Part_Numbers_DID_F12E_1_ECU_Software
      operation ReadData: possible-error=[DataServices_DID_F12E_ECU_Software_Part_Numbers_DID_F12E_1_ECU_Software/E_NOT_OK, DataServices_DID_F12E_ECU_Software_Part_Numbers_DID_F12E_1_ECU_Software/DCM_E_PENDING]
        arg OpStatus: type=Dcm_OpStatusType, direction=IN
        arg Data: type=Dcm_Data1ByteType, direction=OUT
      operation ConditionCheckRead: possible-error=[DataServices_DID_F12E_ECU_Software_Part_Numbers_DID_F12E_1_ECU_Software/E_NOT_OK, DataServices_DID_F12E_ECU_Software_Part_Numbers_DID_F12E_1_ECU_Software/DCM_E_PENDING]
        arg OpStatus: type=Dcm_OpStatusType, direction=IN
        arg ErrorCode: type=Dcm_NegativeResponseCodeType, direction=OUT
      error E_NOT_OK: error-code=1
      error DCM_E_PENDING: error-code=10
    DataServices_DID_F12E_ECU_Software_Part_Numbers_BCD_part
      operation ReadData: possible-error=[DataServices_DID_F12E_ECU_Software_Part_Numbers_BCD_part/E_NOT_OK, DataServices_DID_F12E_ECU_Software_Part_Numbers_BCD_part/DCM_E_PENDING]
        arg OpStatus: type=Dcm_OpStatusType, direction=IN
        arg Data: type=Dcm_Data4ByteType, direction=OUT
      operation ConditionCheckRead: possible-error=[DataServices_DID_F12E_ECU_Software_Part_Numbers_BCD_part/E_NOT_OK, DataServices_DID_F12E_ECU_Software_Part_Numbers_BCD_part/DCM_E_PENDING]
        arg OpStatus: type=Dcm_OpStatusType, direction=IN
        arg ErrorCode: type=Dcm_NegativeResponseCodeType, direction=OUT
      error E_NOT_OK: error-code=1
      error DCM_E_PENDING: error-code=10
    DataServices_DID_F1AE_ECU_Software_Part_Numbers_Geely_DID_F1AE_1_Total_number_of_ECU_Software_Part_Numbers
      operation ReadData: possible-error=[DataServices_DID_F1AE_ECU_Software_Part_Numbers_Geely_DID_F1AE_1_Total_number_of_ECU_Software_Part_Numbers/E_NOT_OK, DataServices_DID_F1AE_ECU_Software_Part_Numbers_Geely_DID_F1AE_1_Total_number_of_ECU_Software_Part_Numbers/DCM_E_PENDING]
        arg OpStatus: type=Dcm_OpStatusType, direction=IN
        arg Data: type=Dcm_Data1ByteType, direction=OUT
      operation ConditionCheckRead: possible-error=[DataServices_DID_F1AE_ECU_Software_Part_Numbers_Geely_DID_F1AE_1_Total_number_of_ECU_Software_Part_Numbers/E_NOT_OK, DataServices_DID_F1AE_ECU_Software_Part_Numbers_Geely_DID_F1AE_1_Total_number_of_ECU_Software_Part_Numbers/DCM_E_PENDING]
        arg OpStatus: type=Dcm_OpStatusType, direction=IN
        arg ErrorCode: type=Dcm_NegativeResponseCodeType, direction=OUT
      error E_NOT_OK: error-code=1
      error DCM_E_PENDING: error-code=10
    DataServices_DID_F1AE_ECU_Software_Part_Numbers_Geely_ASCII_part
      operation ReadData: possible-error=[DataServices_DID_F1AE_ECU_Software_Part_Numbers_Geely_ASCII_part/E_NOT_OK, DataServices_DID_F1AE_ECU_Software_Part_Numbers_Geely_ASCII_part/DCM_E_PENDING]
        arg OpStatus: type=Dcm_OpStatusType, direction=IN
        arg Data: type=Dcm_Data3ByteType, direction=OUT
      operation ConditionCheckRead: possible-error=[DataServices_DID_F1AE_ECU_Software_Part_Numbers_Geely_ASCII_part/E_NOT_OK, DataServices_DID_F1AE_ECU_Software_Part_Numbers_Geely_ASCII_part/DCM_E_PENDING]
        arg OpStatus: type=Dcm_OpStatusType, direction=IN
        arg ErrorCode: type=Dcm_NegativeResponseCodeType, direction=OUT
      error E_NOT_OK: error-code=1
      error DCM_E_PENDING: error-code=10
    DataServices_DID_F1AE_ECU_Software_Part_Numbers_Geely_BCD_part
      operation ReadData: possible-error=[DataServices_DID_F1AE_ECU_Software_Part_Numbers_Geely_BCD_part/E_NOT_OK, DataServices_DID_F1AE_ECU_Software_Part_Numbers_Geely_BCD_part/DCM_E_PENDING]
        arg OpStatus: type=Dcm_OpStatusType, direction=IN
        arg Data: type=Dcm_Data5ByteType, direction=OUT
      operation ConditionCheckRead: possible-error=[DataServices_DID_F1AE_ECU_Software_Part_Numbers_Geely_BCD_part/E_NOT_OK, DataServices_DID_F1AE_ECU_Software_Part_Numbers_Geely_BCD_part/DCM_E_PENDING]
        arg OpStatus: type=Dcm_OpStatusType, direction=IN
        arg ErrorCode: type=Dcm_NegativeResponseCodeType, direction=OUT
      error E_NOT_OK: error-code=1
      error DCM_E_PENDING: error-code=10
    DataServices_DID_F125_Primary_Bootloader_Software_Part_Number_ASCII_part
      operation ReadData: possible-error=[DataServices_DID_F125_Primary_Bootloader_Software_Part_Number_ASCII_part/E_NOT_OK, DataServices_DID_F125_Primary_Bootloader_Software_Part_Number_ASCII_part/DCM_E_PENDING]
        arg OpStatus: type=Dcm_OpStatusType, direction=IN
        arg Data: type=Dcm_Data3ByteType, direction=OUT
      operation ConditionCheckRead: possible-error=[DataServices_DID_F125_Primary_Bootloader_Software_Part_Number_ASCII_part/E_NOT_OK, DataServices_DID_F125_Primary_Bootloader_Software_Part_Number_ASCII_part/DCM_E_PENDING]
        arg OpStatus: type=Dcm_OpStatusType, direction=IN
        arg ErrorCode: type=Dcm_NegativeResponseCodeType, direction=OUT
      error E_NOT_OK: error-code=1
      error DCM_E_PENDING: error-code=10
    DataServices_DID_F125_Primary_Bootloader_Software_Part_Number_BCD_part
      operation ReadData: possible-error=[DataServices_DID_F125_Primary_Bootloader_Software_Part_Number_BCD_part/E_NOT_OK, DataServices_DID_F125_Primary_Bootloader_Software_Part_Number_BCD_part/DCM_E_PENDING]
        arg OpStatus: type=Dcm_OpStatusType, direction=IN
        arg Data: type=Dcm_Data4ByteType, direction=OUT
      operation ConditionCheckRead: possible-error=[DataServices_DID_F125_Primary_Bootloader_Software_Part_Number_BCD_part/E_NOT_OK, DataServices_DID_F125_Primary_Bootloader_Software_Part_Number_BCD_part/DCM_E_PENDING]
        arg OpStatus: type=Dcm_OpStatusType, direction=IN
        arg ErrorCode: type=Dcm_NegativeResponseCodeType, direction=OUT
      error E_NOT_OK: error-code=1
      error DCM_E_PENDING: error-code=10
    DataServices_DID_EEFD_Sofware_Project_Version_DID_EEFD_Clutch_Control_Fault_Indication
      operation ReadData: possible-error=[DataServices_DID_EEFD_Sofware_Project_Version_DID_EEFD_Clutch_Control_Fault_Indication/E_NOT_OK, DataServices_DID_EEFD_Sofware_Project_Version_DID_EEFD_Clutch_Control_Fault_Indication/DCM_E_PENDING]
        arg OpStatus: type=Dcm_OpStatusType, direction=IN
        arg Data: type=Dcm_Data24ByteType, direction=OUT
      operation ConditionCheckRead: possible-error=[DataServices_DID_EEFD_Sofware_Project_Version_DID_EEFD_Clutch_Control_Fault_Indication/E_NOT_OK, DataServices_DID_EEFD_Sofware_Project_Version_DID_EEFD_Clutch_Control_Fault_Indication/DCM_E_PENDING]
        arg OpStatus: type=Dcm_OpStatusType, direction=IN
        arg ErrorCode: type=Dcm_NegativeResponseCodeType, direction=OUT
      error E_NOT_OK: error-code=1
      error DCM_E_PENDING: error-code=10
    DataServices_DID_E304_Actual_Torque_DID_E304_Actual_Torque
      operation ReadData: possible-error=[DataServices_DID_E304_Actual_Torque_DID_E304_Actual_Torque/E_NOT_OK, DataServices_DID_E304_Actual_Torque_DID_E304_Actual_Torque/DCM_E_PENDING]
        arg OpStatus: type=Dcm_OpStatusType, direction=IN
        arg Data: type=Dcm_Data2ByteType, direction=OUT
      operation ConditionCheckRead: possible-error=[DataServices_DID_E304_Actual_Torque_DID_E304_Actual_Torque/E_NOT_OK, DataServices_DID_E304_Actual_Torque_DID_E304_Actual_Torque/DCM_E_PENDING]
        arg OpStatus: type=Dcm_OpStatusType, direction=IN
        arg ErrorCode: type=Dcm_NegativeResponseCodeType, direction=OUT
      error E_NOT_OK: error-code=1
      error DCM_E_PENDING: error-code=10
    DataServices_DID_D134_Car_Mode_DID_D134_Car_Mode
      operation ReadData: possible-error=[DataServices_DID_D134_Car_Mode_DID_D134_Car_Mode/E_NOT_OK, DataServices_DID_D134_Car_Mode_DID_D134_Car_Mode/DCM_E_PENDING]
        arg OpStatus: type=Dcm_OpStatusType, direction=IN
        arg Data: type=Dcm_Data1ByteType, direction=OUT
      operation ConditionCheckRead: possible-error=[DataServices_DID_D134_Car_Mode_DID_D134_Car_Mode/E_NOT_OK, DataServices_DID_D134_Car_Mode_DID_D134_Car_Mode/DCM_E_PENDING]
        arg OpStatus: type=Dcm_OpStatusType, direction=IN
        arg ErrorCode: type=Dcm_NegativeResponseCodeType, direction=OUT
      error E_NOT_OK: error-code=1
      error DCM_E_PENDING: error-code=10
    DataServices_DID_E335_d_axis_current_setpoint_DID_E335_d_axis_current_setpoint
      operation ReadData: possible-error=[DataServices_DID_E335_d_axis_current_setpoint_DID_E335_d_axis_current_setpoint/E_NOT_OK, DataServices_DID_E335_d_axis_current_setpoint_DID_E335_d_axis_current_setpoint/DCM_E_PENDING]
        arg OpStatus: type=Dcm_OpStatusType, direction=IN
        arg Data: type=Dcm_Data2ByteType, direction=OUT
      operation ConditionCheckRead: possible-error=[DataServices_DID_E335_d_axis_current_setpoint_DID_E335_d_axis_current_setpoint/E_NOT_OK, DataServices_DID_E335_d_axis_current_setpoint_DID_E335_d_axis_current_setpoint/DCM_E_PENDING]
        arg OpStatus: type=Dcm_OpStatusType, direction=IN
        arg ErrorCode: type=Dcm_NegativeResponseCodeType, direction=OUT
      error E_NOT_OK: error-code=1
      error DCM_E_PENDING: error-code=10
    DataServices_DID_EEB2_Three_Phase_Motor_Current_RMS_Current_DID_EEB2_Three_Phase_Motor_Current_RMS_Current
      operation ReadData: possible-error=[DataServices_DID_EEB2_Three_Phase_Motor_Current_RMS_Current_DID_EEB2_Three_Phase_Motor_Current_RMS_Current/E_NOT_OK, DataServices_DID_EEB2_Three_Phase_Motor_Current_RMS_Current_DID_EEB2_Three_Phase_Motor_Current_RMS_Current/DCM_E_PENDING]
        arg OpStatus: type=Dcm_OpStatusType, direction=IN
        arg Data: type=Dcm_Data2ByteType, direction=OUT
      operation ConditionCheckRead: possible-error=[DataServices_DID_EEB2_Three_Phase_Motor_Current_RMS_Current_DID_EEB2_Three_Phase_Motor_Current_RMS_Current/E_NOT_OK, DataServices_DID_EEB2_Three_Phase_Motor_Current_RMS_Current_DID_EEB2_Three_Phase_Motor_Current_RMS_Current/DCM_E_PENDING]
        arg OpStatus: type=Dcm_OpStatusType, direction=IN
        arg ErrorCode: type=Dcm_NegativeResponseCodeType, direction=OUT
      error E_NOT_OK: error-code=1
      error DCM_E_PENDING: error-code=10
    DataServices_DID_E341_q_axis_voltage_DID_E341_q_axis_voltage
      operation ReadData: possible-error=[DataServices_DID_E341_q_axis_voltage_DID_E341_q_axis_voltage/E_NOT_OK, DataServices_DID_E341_q_axis_voltage_DID_E341_q_axis_voltage/DCM_E_PENDING]
        arg OpStatus: type=Dcm_OpStatusType, direction=IN
        arg Data: type=Dcm_Data2ByteType, direction=OUT
      operation ConditionCheckRead: possible-error=[DataServices_DID_E341_q_axis_voltage_DID_E341_q_axis_voltage/E_NOT_OK, DataServices_DID_E341_q_axis_voltage_DID_E341_q_axis_voltage/DCM_E_PENDING]
        arg OpStatus: type=Dcm_OpStatusType, direction=IN
        arg ErrorCode: type=Dcm_NegativeResponseCodeType, direction=OUT
      error E_NOT_OK: error-code=1
      error DCM_E_PENDING: error-code=10
    DataServices_DID_EE9A_Inverter_Coolant_Temperature_DID_EE9A_Inverter_Coolant_Temperature
      operation ReadData: possible-error=[DataServices_DID_EE9A_Inverter_Coolant_Temperature_DID_EE9A_Inverter_Coolant_Temperature/E_NOT_OK, DataServices_DID_EE9A_Inverter_Coolant_Temperature_DID_EE9A_Inverter_Coolant_Temperature/DCM_E_PENDING]
        arg OpStatus: type=Dcm_OpStatusType, direction=IN
        arg Data: type=Dcm_Data1ByteType, direction=OUT
      operation ConditionCheckRead: possible-error=[DataServices_DID_EE9A_Inverter_Coolant_Temperature_DID_EE9A_Inverter_Coolant_Temperature/E_NOT_OK, DataServices_DID_EE9A_Inverter_Coolant_Temperature_DID_EE9A_Inverter_Coolant_Temperature/DCM_E_PENDING]
        arg OpStatus: type=Dcm_OpStatusType, direction=IN
        arg ErrorCode: type=Dcm_NegativeResponseCodeType, direction=OUT
      error E_NOT_OK: error-code=1
      error DCM_E_PENDING: error-code=10
    DataServices_DID_EEB6_ECM_Power_Limitation_maximum_DID_EEB6_ECM_Power_Limitation_maximum
      operation ReadData: possible-error=[DataServices_DID_EEB6_ECM_Power_Limitation_maximum_DID_EEB6_ECM_Power_Limitation_maximum/E_NOT_OK, DataServices_DID_EEB6_ECM_Power_Limitation_maximum_DID_EEB6_ECM_Power_Limitation_maximum/DCM_E_PENDING]
        arg OpStatus: type=Dcm_OpStatusType, direction=IN
        arg Data: type=Dcm_Data2ByteType, direction=OUT
      operation ConditionCheckRead: possible-error=[DataServices_DID_EEB6_ECM_Power_Limitation_maximum_DID_EEB6_ECM_Power_Limitation_maximum/E_NOT_OK, DataServices_DID_EEB6_ECM_Power_Limitation_maximum_DID_EEB6_ECM_Power_Limitation_maximum/DCM_E_PENDING]
        arg OpStatus: type=Dcm_OpStatusType, direction=IN
        arg ErrorCode: type=Dcm_NegativeResponseCodeType, direction=OUT
      error E_NOT_OK: error-code=1
      error DCM_E_PENDING: error-code=10
    DataServices_DID_F1AF_ECU_Software_Extended_Part_Numbers_Geely_DID_F1AF_1_Total_number_of_ECU_Software_Part_Numbers
      operation ReadData: possible-error=[DataServices_DID_F1AF_ECU_Software_Extended_Part_Numbers_Geely_DID_F1AF_1_Total_number_of_ECU_Software_Part_Numbers/E_NOT_OK, DataServices_DID_F1AF_ECU_Software_Extended_Part_Numbers_Geely_DID_F1AF_1_Total_number_of_ECU_Software_Part_Numbers/DCM_E_PENDING]
        arg OpStatus: type=Dcm_OpStatusType, direction=IN
        arg Data: type=Dcm_Data1ByteType, direction=OUT
      operation ConditionCheckRead: possible-error=[DataServices_DID_F1AF_ECU_Software_Extended_Part_Numbers_Geely_DID_F1AF_1_Total_number_of_ECU_Software_Part_Numbers/E_NOT_OK, DataServices_DID_F1AF_ECU_Software_Extended_Part_Numbers_Geely_DID_F1AF_1_Total_number_of_ECU_Software_Part_Numbers/DCM_E_PENDING]
        arg OpStatus: type=Dcm_OpStatusType, direction=IN
        arg ErrorCode: type=Dcm_NegativeResponseCodeType, direction=OUT
      error E_NOT_OK: error-code=1
      error DCM_E_PENDING: error-code=10
    DataServices_DID_F1AF_ECU_Software_Extended_Part_Numbers_Geely_BCD_part_003
      operation ReadData: possible-error=[DataServices_DID_F1AF_ECU_Software_Extended_Part_Numbers_Geely_BCD_part_003/E_NOT_OK, DataServices_DID_F1AF_ECU_Software_Extended_Part_Numbers_Geely_BCD_part_003/DCM_E_PENDING]
        arg OpStatus: type=Dcm_OpStatusType, direction=IN
        arg Data: type=Dcm_Data5ByteType, direction=OUT
      operation ConditionCheckRead: possible-error=[DataServices_DID_F1AF_ECU_Software_Extended_Part_Numbers_Geely_BCD_part_003/E_NOT_OK, DataServices_DID_F1AF_ECU_Software_Extended_Part_Numbers_Geely_BCD_part_003/DCM_E_PENDING]
        arg OpStatus: type=Dcm_OpStatusType, direction=IN
        arg ErrorCode: type=Dcm_NegativeResponseCodeType, direction=OUT
      error E_NOT_OK: error-code=1
      error DCM_E_PENDING: error-code=10
    DataServices_DID_F1AF_ECU_Software_Extended_Part_Numbers_Geely_BCD_part_001
      operation ReadData: possible-error=[DataServices_DID_F1AF_ECU_Software_Extended_Part_Numbers_Geely_BCD_part_001/E_NOT_OK, DataServices_DID_F1AF_ECU_Software_Extended_Part_Numbers_Geely_BCD_part_001/DCM_E_PENDING]
        arg OpStatus: type=Dcm_OpStatusType, direction=IN
        arg Data: type=Dcm_Data5ByteType, direction=OUT
      operation ConditionCheckRead: possible-error=[DataServices_DID_F1AF_ECU_Software_Extended_Part_Numbers_Geely_BCD_part_001/E_NOT_OK, DataServices_DID_F1AF_ECU_Software_Extended_Part_Numbers_Geely_BCD_part_001/DCM_E_PENDING]
        arg OpStatus: type=Dcm_OpStatusType, direction=IN
        arg ErrorCode: type=Dcm_NegativeResponseCodeType, direction=OUT
      error E_NOT_OK: error-code=1
      error DCM_E_PENDING: error-code=10
    DataServices_DID_F1AF_ECU_Software_Extended_Part_Numbers_Geely_BCD_part_002
      operation ReadData: possible-error=[DataServices_DID_F1AF_ECU_Software_Extended_Part_Numbers_Geely_BCD_part_002/E_NOT_OK, DataServices_DID_F1AF_ECU_Software_Extended_Part_Numbers_Geely_BCD_part_002/DCM_E_PENDING]
        arg OpStatus: type=Dcm_OpStatusType, direction=IN
        arg Data: type=Dcm_Data5ByteType, direction=OUT
      operation ConditionCheckRead: possible-error=[DataServices_DID_F1AF_ECU_Software_Extended_Part_Numbers_Geely_BCD_part_002/E_NOT_OK, DataServices_DID_F1AF_ECU_Software_Extended_Part_Numbers_Geely_BCD_part_002/DCM_E_PENDING]
        arg OpStatus: type=Dcm_OpStatusType, direction=IN
        arg ErrorCode: type=Dcm_NegativeResponseCodeType, direction=OUT
      error E_NOT_OK: error-code=1
      error DCM_E_PENDING: error-code=10
    DataServices_DID_F1AF_ECU_Software_Extended_Part_Numbers_Geely_ASCII_part_001
      operation ReadData: possible-error=[DataServices_DID_F1AF_ECU_Software_Extended_Part_Numbers_Geely_ASCII_part_001/E_NOT_OK, DataServices_DID_F1AF_ECU_Software_Extended_Part_Numbers_Geely_ASCII_part_001/DCM_E_PENDING]
        arg OpStatus: type=Dcm_OpStatusType, direction=IN
        arg Data: type=Dcm_Data3ByteType, direction=OUT
      operation ConditionCheckRead: possible-error=[DataServices_DID_F1AF_ECU_Software_Extended_Part_Numbers_Geely_ASCII_part_001/E_NOT_OK, DataServices_DID_F1AF_ECU_Software_Extended_Part_Numbers_Geely_ASCII_part_001/DCM_E_PENDING]
        arg OpStatus: type=Dcm_OpStatusType, direction=IN
        arg ErrorCode: type=Dcm_NegativeResponseCodeType, direction=OUT
      error E_NOT_OK: error-code=1
      error DCM_E_PENDING: error-code=10
    DataServices_DID_F1AF_ECU_Software_Extended_Part_Numbers_Geely_ASCII_part_002
      operation ReadData: possible-error=[DataServices_DID_F1AF_ECU_Software_Extended_Part_Numbers_Geely_ASCII_part_002/E_NOT_OK, DataServices_DID_F1AF_ECU_Software_Extended_Part_Numbers_Geely_ASCII_part_002/DCM_E_PENDING]
        arg OpStatus: type=Dcm_OpStatusType, direction=IN
        arg Data: type=Dcm_Data3ByteType, direction=OUT
      operation ConditionCheckRead: possible-error=[DataServices_DID_F1AF_ECU_Software_Extended_Part_Numbers_Geely_ASCII_part_002/E_NOT_OK, DataServices_DID_F1AF_ECU_Software_Extended_Part_Numbers_Geely_ASCII_part_002/DCM_E_PENDING]
        arg OpStatus: type=Dcm_OpStatusType, direction=IN
        arg ErrorCode: type=Dcm_NegativeResponseCodeType, direction=OUT
      error E_NOT_OK: error-code=1
      error DCM_E_PENDING: error-code=10
    DataServices_DID_F1AF_ECU_Software_Extended_Part_Numbers_Geely_ASCII_part_003
      operation ReadData: possible-error=[DataServices_DID_F1AF_ECU_Software_Extended_Part_Numbers_Geely_ASCII_part_003/E_NOT_OK, DataServices_DID_F1AF_ECU_Software_Extended_Part_Numbers_Geely_ASCII_part_003/DCM_E_PENDING]
        arg OpStatus: type=Dcm_OpStatusType, direction=IN
        arg Data: type=Dcm_Data3ByteType, direction=OUT
      operation ConditionCheckRead: possible-error=[DataServices_DID_F1AF_ECU_Software_Extended_Part_Numbers_Geely_ASCII_part_003/E_NOT_OK, DataServices_DID_F1AF_ECU_Software_Extended_Part_Numbers_Geely_ASCII_part_003/DCM_E_PENDING]
        arg OpStatus: type=Dcm_OpStatusType, direction=IN
        arg ErrorCode: type=Dcm_NegativeResponseCodeType, direction=OUT
      error E_NOT_OK: error-code=1
      error DCM_E_PENDING: error-code=10
    DataServices_DID_F1AF_ECU_Software_Extended_Part_Numbers_Geely_ASCII_part
      operation ReadData: possible-error=[DataServices_DID_F1AF_ECU_Software_Extended_Part_Numbers_Geely_ASCII_part/E_NOT_OK, DataServices_DID_F1AF_ECU_Software_Extended_Part_Numbers_Geely_ASCII_part/DCM_E_PENDING]
        arg OpStatus: type=Dcm_OpStatusType, direction=IN
        arg Data: type=Dcm_Data3ByteType, direction=OUT
      operation ConditionCheckRead: possible-error=[DataServices_DID_F1AF_ECU_Software_Extended_Part_Numbers_Geely_ASCII_part/E_NOT_OK, DataServices_DID_F1AF_ECU_Software_Extended_Part_Numbers_Geely_ASCII_part/DCM_E_PENDING]
        arg OpStatus: type=Dcm_OpStatusType, direction=IN
        arg ErrorCode: type=Dcm_NegativeResponseCodeType, direction=OUT
      error E_NOT_OK: error-code=1
      error DCM_E_PENDING: error-code=10
    DataServices_DID_F1AF_ECU_Software_Extended_Part_Numbers_Geely_BCD_part
      operation ReadData: possible-error=[DataServices_DID_F1AF_ECU_Software_Extended_Part_Numbers_Geely_BCD_part/E_NOT_OK, DataServices_DID_F1AF_ECU_Software_Extended_Part_Numbers_Geely_BCD_part/DCM_E_PENDING]
        arg OpStatus: type=Dcm_OpStatusType, direction=IN
        arg Data: type=Dcm_Data5ByteType, direction=OUT
      operation ConditionCheckRead: possible-error=[DataServices_DID_F1AF_ECU_Software_Extended_Part_Numbers_Geely_BCD_part/E_NOT_OK, DataServices_DID_F1AF_ECU_Software_Extended_Part_Numbers_Geely_BCD_part/DCM_E_PENDING]
        arg OpStatus: type=Dcm_OpStatusType, direction=IN
        arg ErrorCode: type=Dcm_NegativeResponseCodeType, direction=OUT
      error E_NOT_OK: error-code=1
      error DCM_E_PENDING: error-code=10
    DataServices_DID_E331_Software_Version_DID_E331_2_BSW_Software_Version
      operation ReadData: possible-error=[DataServices_DID_E331_Software_Version_DID_E331_2_BSW_Software_Version/E_NOT_OK, DataServices_DID_E331_Software_Version_DID_E331_2_BSW_Software_Version/DCM_E_PENDING]
        arg OpStatus: type=Dcm_OpStatusType, direction=IN
        arg Data: type=Dcm_Data8ByteType, direction=OUT
      operation ConditionCheckRead: possible-error=[DataServices_DID_E331_Software_Version_DID_E331_2_BSW_Software_Version/E_NOT_OK, DataServices_DID_E331_Software_Version_DID_E331_2_BSW_Software_Version/DCM_E_PENDING]
        arg OpStatus: type=Dcm_OpStatusType, direction=IN
        arg ErrorCode: type=Dcm_NegativeResponseCodeType, direction=OUT
      error E_NOT_OK: error-code=1
      error DCM_E_PENDING: error-code=10
    DataServices_DID_E331_Software_Version_DID_E331_3_Calibration_Data_Software_Version
      operation ReadData: possible-error=[DataServices_DID_E331_Software_Version_DID_E331_3_Calibration_Data_Software_Version/E_NOT_OK, DataServices_DID_E331_Software_Version_DID_E331_3_Calibration_Data_Software_Version/DCM_E_PENDING]
        arg OpStatus: type=Dcm_OpStatusType, direction=IN
        arg Data: type=Dcm_Data8ByteType, direction=OUT
      operation ConditionCheckRead: possible-error=[DataServices_DID_E331_Software_Version_DID_E331_3_Calibration_Data_Software_Version/E_NOT_OK, DataServices_DID_E331_Software_Version_DID_E331_3_Calibration_Data_Software_Version/DCM_E_PENDING]
        arg OpStatus: type=Dcm_OpStatusType, direction=IN
        arg ErrorCode: type=Dcm_NegativeResponseCodeType, direction=OUT
      error E_NOT_OK: error-code=1
      error DCM_E_PENDING: error-code=10
    DataServices_DID_E331_Software_Version_DID_E331_1_ASW_Software_Version
      operation ReadData: possible-error=[DataServices_DID_E331_Software_Version_DID_E331_1_ASW_Software_Version/E_NOT_OK, DataServices_DID_E331_Software_Version_DID_E331_1_ASW_Software_Version/DCM_E_PENDING]
        arg OpStatus: type=Dcm_OpStatusType, direction=IN
        arg Data: type=Dcm_Data8ByteType, direction=OUT
      operation ConditionCheckRead: possible-error=[DataServices_DID_E331_Software_Version_DID_E331_1_ASW_Software_Version/E_NOT_OK, DataServices_DID_E331_Software_Version_DID_E331_1_ASW_Software_Version/DCM_E_PENDING]
        arg OpStatus: type=Dcm_OpStatusType, direction=IN
        arg ErrorCode: type=Dcm_NegativeResponseCodeType, direction=OUT
      error E_NOT_OK: error-code=1
      error DCM_E_PENDING: error-code=10
    DataServices_DID_EE9E_Transient_Phase_Current_C_DID_EE9E_Transient_Phase_Current_C
      operation ReadData: possible-error=[DataServices_DID_EE9E_Transient_Phase_Current_C_DID_EE9E_Transient_Phase_Current_C/E_NOT_OK, DataServices_DID_EE9E_Transient_Phase_Current_C_DID_EE9E_Transient_Phase_Current_C/DCM_E_PENDING]
        arg OpStatus: type=Dcm_OpStatusType, direction=IN
        arg Data: type=Dcm_Data2ByteType, direction=OUT
      operation ConditionCheckRead: possible-error=[DataServices_DID_EE9E_Transient_Phase_Current_C_DID_EE9E_Transient_Phase_Current_C/E_NOT_OK, DataServices_DID_EE9E_Transient_Phase_Current_C_DID_EE9E_Transient_Phase_Current_C/DCM_E_PENDING]
        arg OpStatus: type=Dcm_OpStatusType, direction=IN
        arg ErrorCode: type=Dcm_NegativeResponseCodeType, direction=OUT
      error E_NOT_OK: error-code=1
      error DCM_E_PENDING: error-code=10
    DataServices_DID_D005_High_Quiescent_Current_Fault_Identification_Data_DID_D005_5st_Usage_Mode_when_DID_is_triggered
      operation ReadData: possible-error=[DataServices_DID_D005_High_Quiescent_Current_Fault_Identification_Data_DID_D005_5st_Usage_Mode_when_DID_is_triggered/E_NOT_OK, DataServices_DID_D005_High_Quiescent_Current_Fault_Identification_Data_DID_D005_5st_Usage_Mode_when_DID_is_triggered/DCM_E_PENDING]
        arg OpStatus: type=Dcm_OpStatusType, direction=IN
        arg Data: type=Dcm_Data1ByteType, direction=OUT
      operation ConditionCheckRead: possible-error=[DataServices_DID_D005_High_Quiescent_Current_Fault_Identification_Data_DID_D005_5st_Usage_Mode_when_DID_is_triggered/E_NOT_OK, DataServices_DID_D005_High_Quiescent_Current_Fault_Identification_Data_DID_D005_5st_Usage_Mode_when_DID_is_triggered/DCM_E_PENDING]
        arg OpStatus: type=Dcm_OpStatusType, direction=IN
        arg ErrorCode: type=Dcm_NegativeResponseCodeType, direction=OUT
      error E_NOT_OK: error-code=1
      error DCM_E_PENDING: error-code=10

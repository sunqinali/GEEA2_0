AUTOSAR XML (schema 4-2-2)
package /AURIX2G/EcucDefs/Port_ib_bswmd/BswModuleDescriptions
  bsw module description Port
    bsw internal behavior PortBehavior

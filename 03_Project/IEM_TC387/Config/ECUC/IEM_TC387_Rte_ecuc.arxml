[part 2 of 5: package /ActiveEcuC]
AUTOSAR XML (schema 4-2-2)
package /ActiveEcuC  (continued)
  module config Rte: implementation-config-variant=VARIANT-PRE-COMPILE, module-description=Rte_Impl  (continued)
    7 x RteSwComponentInstance:  (continued)
      DemSatellite_0_EcuSwComposition: RteSoftwareComponentInstanceRef=DemSatellite_0  (continued)
        4544 x RteEventToTaskMapping, all with RteImmediateRestart=false:  (continued)
          OpEventGetEventStatus_GetEventStatus_Event_INV_EM_STATOR_TEMP_ELE_FLT: RteEventRef=OpEventGetEventStatus_GetEventStatus_Event_INV_EM_STATOR_TEMP_ELE_FLT
          OpEventGetEventStatus_GetEventStatus_EvtInfo_INV_INTERLOCK_FLT: RteEventRef=OpEventGetEventStatus_GetEventStatus_EvtInfo_INV_INTERLOCK_FLT
          OpEventGetEventStatus_GetEventStatus_Event_INV_INTERLOCK_FLT: RteEventRef=OpEventGetEventStatus_GetEventStatus_Event_INV_INTERLOCK_FLT
          OpEventGetEventStatus_GetEventStatus_EvtInfo_Ga_ZeroFindDistanFailure: RteEventRef=OpEventGetEventStatus_GetEventStatus_EvtInfo_Ga_ZeroFindDistanFailure
          OpEventGetEventStatus_GetEventStatus_Event_Ga_ZeroFindDistanFailure: RteEventRef=OpEventGetEventStatus_GetEventStatus_Event_Ga_ZeroFindDistanFailure
          OpEventGetEventStatus_GetEventStatus_EvtInfo_PLOCK_Current_RNG_OUT: RteEventRef=OpEventGetEventStatus_GetEventStatus_EvtInfo_PLOCK_Current_RNG_OUT
          OpEventGetEventStatus_GetEventStatus_Event_PLOCK_Current_RNG_OUT: RteEventRef=OpEventGetEventStatus_GetEventStatus_Event_PLOCK_Current_RNG_OUT
          OpEventGetEventStatus_GetEventStatus_EvtInfo_VCEvVddmPropFr05Tioutd: RteEventRef=OpEventGetEventStatus_GetEventStatus_EvtInfo_VCEvVddmPropFr05Tioutd
          OpEventGetEventStatus_GetEventStatus_Event_VCEvVddmPropFr05Tioutd: RteEventRef=OpEventGetEventStatus_GetEventStatus_Event_VCEvVddmPropFr05Tioutd
          OpEventGetEventStatus_GetEventStatus_EvtInfo_INV_IGBT_TEMP_V_GRDT: RteEventRef=OpEventGetEventStatus_GetEventStatus_EvtInfo_INV_IGBT_TEMP_V_GRDT
          OpEventGetEventStatus_GetEventStatus_Event_INV_IGBT_TEMP_V_GRDT: RteEventRef=OpEventGetEventStatus_GetEventStatus_Event_INV_IGBT_TEMP_V_GRDT
          OpEventGetEventStatus_GetEventStatus_EvtInfo_PS_5V_Fault: RteEventRef=OpEventGetEventStatus_GetEventStatus_EvtInfo_PS_5V_Fault
          OpEventGetEventStatus_GetEventStatus_Event_PS_5V_Fault: RteEventRef=OpEventGetEventStatus_GetEventStatus_Event_PS_5V_Fault
          OpEventGetEventStatus_GetEventStatus_EvtInfo_VcEvCntrCrashStsSafe: RteEventRef=OpEventGetEventStatus_GetEventStatus_EvtInfo_VcEvCntrCrashStsSafe
          OpEventGetEventStatus_GetEventStatus_Event_VcEvCntrCrashStsSafe: RteEventRef=OpEventGetEventStatus_GetEventStatus_Event_VcEvCntrCrashStsSafe
          OpEventGetEventStatus_GetEventStatus_EvtInfo_INV_EM_STATOR_TEMP_GRDT: RteEventRef=OpEventGetEventStatus_GetEventStatus_EvtInfo_INV_EM_STATOR_TEMP_GRDT
          OpEventGetEventStatus_GetEventStatus_Event_INV_EM_STATOR_TEMP_GRDT: RteEventRef=OpEventGetEventStatus_GetEventStatus_Event_INV_EM_STATOR_TEMP_GRDT
          OpEventGetEventStatus_GetEventStatus_EvtInfo_PS_P15_V_FLT: RteEventRef=OpEventGetEventStatus_GetEventStatus_EvtInfo_PS_P15_V_FLT
          OpEventGetEventStatus_GetEventStatus_Event_PS_P15_V_FLT: RteEventRef=OpEventGetEventStatus_GetEventStatus_Event_PS_P15_V_FLT
          OpEventGetEventStatus_GetEventStatus_EvtInfo_INV_EM_STATOR_TEMP_RNG_NOK: RteEventRef=OpEventGetEventStatus_GetEventStatus_EvtInfo_INV_EM_STATOR_TEMP_RNG_NOK
          OpEventGetEventStatus_GetEventStatus_Event_INV_EM_STATOR_TEMP_RNG_NOK: RteEventRef=OpEventGetEventStatus_GetEventStatus_Event_INV_EM_STATOR_TEMP_RNG_NOK
          OpEventGetEventStatus_GetEventStatus_EvtInfo_INV_RSLVR_SIN_RNG_NOK: RteEventRef=OpEventGetEventStatus_GetEventStatus_EvtInfo_INV_RSLVR_SIN_RNG_NOK
          OpEventGetEventStatus_GetEventStatus_Event_INV_RSLVR_SIN_RNG_NOK: RteEventRef=OpEventGetEventStatus_GetEventStatus_Event_INV_RSLVR_SIN_RNG_NOK
          OpEventGetEventStatus_GetEventStatus_EvtInfo_INV_IAC_U_OFFS: RteEventRef=OpEventGetEventStatus_GetEventStatus_EvtInfo_INV_IAC_U_OFFS
          OpEventGetEventStatus_GetEventStatus_Event_INV_IAC_U_OFFS: RteEventRef=OpEventGetEventStatus_GetEventStatus_Event_INV_IAC_U_OFFS
          OpEventGetEventStatus_GetEventStatus_EvtInfo_PS_KL30_BACKUP_FLT: RteEventRef=OpEventGetEventStatus_GetEventStatus_EvtInfo_PS_KL30_BACKUP_FLT
          OpEventGetEventStatus_GetEventStatus_Event_PS_KL30_BACKUP_FLT: RteEventRef=OpEventGetEventStatus_GetEventStatus_Event_PS_KL30_BACKUP_FLT
          OpEventGetEventStatus_GetEventStatus_EvtInfo_INV_IGBT_TEMP_U_RNG_LO: RteEventRef=OpEventGetEventStatus_GetEventStatus_EvtInfo_INV_IGBT_TEMP_U_RNG_LO
          OpEventGetEventStatus_GetEventStatus_Event_INV_IGBT_TEMP_U_RNG_LO: RteEventRef=OpEventGetEventStatus_GetEventStatus_Event_INV_IGBT_TEMP_U_RNG_LO
          OpEventGetEventStatus_GetEventStatus_EvtInfo_INV_EM_STATOR_TEMP_HWP: RteEventRef=OpEventGetEventStatus_GetEventStatus_EvtInfo_INV_EM_STATOR_TEMP_HWP
          OpEventGetEventStatus_GetEventStatus_Event_INV_EM_STATOR_TEMP_HWP: RteEventRef=OpEventGetEventStatus_GetEventStatus_Event_INV_EM_STATOR_TEMP_HWP
          OpEventGetEventStatus_GetEventStatus_EvtInfo_CU_TEMP1_RNG_HI: RteEventRef=OpEventGetEventStatus_GetEventStatus_EvtInfo_CU_TEMP1_RNG_HI
          OpEventGetEventStatus_GetEventStatus_Event_CU_TEMP1_RNG_HI: RteEventRef=OpEventGetEventStatus_GetEventStatus_Event_CU_TEMP1_RNG_HI
          OpEventGetEventStatus_GetEventStatus_EvtInfo_INV_IGBT_TEMP_V_RNG_HI: RteEventRef=OpEventGetEventStatus_GetEventStatus_EvtInfo_INV_IGBT_TEMP_V_RNG_HI
          OpEventGetEventStatus_GetEventStatus_Event_INV_IGBT_TEMP_V_RNG_HI: RteEventRef=OpEventGetEventStatus_GetEventStatus_Event_INV_IGBT_TEMP_V_RNG_HI
          OpEventGetEventStatus_GetEventStatus_EvtInfo_VcEvNodeMisVDDM: RteEventRef=OpEventGetEventStatus_GetEventStatus_EvtInfo_VcEvNodeMisVDDM
          OpEventGetEventStatus_GetEventStatus_Event_VcEvNodeMisVDDM: RteEventRef=OpEventGetEventStatus_GetEventStatus_Event_VcEvNodeMisVDDM
          OpEventGetEventStatus_GetEventStatus_EvtInfo_INV_UHVDC_PLAUS: RteEventRef=OpEventGetEventStatus_GetEventStatus_EvtInfo_INV_UHVDC_PLAUS
          OpEventGetEventStatus_GetEventStatus_Event_INV_UHVDC_PLAUS: RteEventRef=OpEventGetEventStatus_GetEventStatus_Event_INV_UHVDC_PLAUS
          OpEventGetEventStatus_GetEventStatus_EvtInfo_INV_QUIESCENT_FLT: RteEventRef=OpEventGetEventStatus_GetEventStatus_EvtInfo_INV_QUIESCENT_FLT
          OpEventGetEventStatus_GetEventStatus_Event_INV_QUIESCENT_FLT: RteEventRef=OpEventGetEventStatus_GetEventStatus_Event_INV_QUIESCENT_FLT
          OpEventGetEventStatus_GetEventStatus_EvtInfo_INV_RSLVR_EXCT_RNG_HI: RteEventRef=OpEventGetEventStatus_GetEventStatus_EvtInfo_INV_RSLVR_EXCT_RNG_HI
          OpEventGetEventStatus_GetEventStatus_Event_INV_RSLVR_EXCT_RNG_HI: RteEventRef=OpEventGetEventStatus_GetEventStatus_Event_INV_RSLVR_EXCT_RNG_HI
          OpEventGetEventStatus_GetEventStatus_GeneralEvtInfo: RteEventRef=OpEventGetEventStatus_GetEventStatus_GeneralEvtInfo
          OpEventGetEventFailed_GetEventFailed_EvtInfo_VCEvBecmPropFr01Tioutd: RteEventRef=OpEventGetEventFailed_GetEventFailed_EvtInfo_VCEvBecmPropFr01Tioutd
          OpEventGetEventFailed_GetEventFailed_Event_VCEvBecmPropFr01Tioutd: RteEventRef=OpEventGetEventFailed_GetEventFailed_Event_VCEvBecmPropFr01Tioutd
          OpEventGetEventFailed_GetEventFailed_EvtInfo_INV_CU_TEMP2_RNG_NOK: RteEventRef=OpEventGetEventFailed_GetEventFailed_EvtInfo_INV_CU_TEMP2_RNG_NOK
          OpEventGetEventFailed_GetEventFailed_Event_INV_CU_TEMP2_RNG_NOK: RteEventRef=OpEventGetEventFailed_GetEventFailed_Event_INV_CU_TEMP2_RNG_NOK
          OpEventGetEventFailed_GetEventFailed_EvtInfo_COM_Busoff: RteEventRef=OpEventGetEventFailed_GetEventFailed_EvtInfo_COM_Busoff
          OpEventGetEventFailed_GetEventFailed_Event_COM_Busoff: RteEventRef=OpEventGetEventFailed_GetEventFailed_Event_COM_Busoff
          OpEventGetEventFailed_GetEventFailed_EvtInfo_INV_IMMO_NOKEY: RteEventRef=OpEventGetEventFailed_GetEventFailed_EvtInfo_INV_IMMO_NOKEY
          OpEventGetEventFailed_GetEventFailed_Event_INV_IMMO_NOKEY: RteEventRef=OpEventGetEventFailed_GetEventFailed_Event_INV_IMMO_NOKEY
          OpEventGetEventFailed_GetEventFailed_EvtInfo_INV_RSLVR_EXCT_OC_HWP: RteEventRef=OpEventGetEventFailed_GetEventFailed_EvtInfo_INV_RSLVR_EXCT_OC_HWP
          OpEventGetEventFailed_GetEventFailed_Event_INV_RSLVR_EXCT_OC_HWP: RteEventRef=OpEventGetEventFailed_GetEventFailed_Event_INV_RSLVR_EXCT_OC_HWP
          OpEventGetEventFailed_GetEventFailed_EvtInfo_PS_P15_W_FLT: RteEventRef=OpEventGetEventFailed_GetEventFailed_EvtInfo_PS_P15_W_FLT
          OpEventGetEventFailed_GetEventFailed_Event_PS_P15_W_FLT: RteEventRef=OpEventGetEventFailed_GetEventFailed_Event_PS_P15_W_FLT
          OpEventGetEventFailed_GetEventFailed_EvtInfo_INV_IAC_PLAUS_SUM: RteEventRef=OpEventGetEventFailed_GetEventFailed_EvtInfo_INV_IAC_PLAUS_SUM
          OpEventGetEventFailed_GetEventFailed_Event_INV_IAC_PLAUS_SUM: RteEventRef=OpEventGetEventFailed_GetEventFailed_Event_INV_IAC_PLAUS_SUM
          OpEventGetEventFailed_GetEventFailed_EvtInfo_PA_ELE_FLT: RteEventRef=OpEventGetEventFailed_GetEventFailed_EvtInfo_PA_ELE_FLT
          OpEventGetEventFailed_GetEventFailed_Event_PA_ELE_FLT: RteEventRef=OpEventGetEventFailed_GetEventFailed_Event_PA_ELE_FLT
          OpEventGetEventFailed_GetEventFailed_EvtInfo_CU_TEMP_GRDT: RteEventRef=OpEventGetEventFailed_GetEventFailed_EvtInfo_CU_TEMP_GRDT
          OpEventGetEventFailed_GetEventFailed_Event_CU_TEMP_GRDT: RteEventRef=OpEventGetEventFailed_GetEventFailed_Event_CU_TEMP_GRDT
          OpEventGetEventFailed_GetEventFailed_EvtInfo_INV_IGBT_TEMP_V_PLAUS: RteEventRef=OpEventGetEventFailed_GetEventFailed_EvtInfo_INV_IGBT_TEMP_V_PLAUS
          OpEventGetEventFailed_GetEventFailed_Event_INV_IGBT_TEMP_V_PLAUS: RteEventRef=OpEventGetEventFailed_GetEventFailed_Event_INV_IGBT_TEMP_V_PLAUS
          OpEventGetEventFailed_GetEventFailed_EvtInfo_Ga_GAEngageFailure: RteEventRef=OpEventGetEventFailed_GetEventFailed_EvtInfo_Ga_GAEngageFailure
          OpEventGetEventFailed_GetEventFailed_Event_Ga_GAEngageFailure: RteEventRef=OpEventGetEventFailed_GetEventFailed_Event_Ga_GAEngageFailure
          OpEventGetEventFailed_GetEventFailed_EvtInfo_INV_IAC_W_RNG_LO: RteEventRef=OpEventGetEventFailed_GetEventFailed_EvtInfo_INV_IAC_W_RNG_LO
          OpEventGetEventFailed_GetEventFailed_Event_INV_IAC_W_RNG_LO: RteEventRef=OpEventGetEventFailed_GetEventFailed_Event_INV_IAC_W_RNG_LO
          OpEventGetEventFailed_GetEventFailed_EvtInfo_PS_WhlSnsr_Vltg_FLT: RteEventRef=OpEventGetEventFailed_GetEventFailed_EvtInfo_PS_WhlSnsr_Vltg_FLT
          OpEventGetEventFailed_GetEventFailed_Event_PS_WhlSnsr_Vltg_FLT: RteEventRef=OpEventGetEventFailed_GetEventFailed_Event_PS_WhlSnsr_Vltg_FLT
          OpEventGetEventFailed_GetEventFailed_EvtInfo_VCEvEcmPropFr02Tioutd: RteEventRef=OpEventGetEventFailed_GetEventFailed_EvtInfo_VCEvEcmPropFr02Tioutd
          OpEventGetEventFailed_GetEventFailed_Event_VCEvEcmPropFr02Tioutd: RteEventRef=OpEventGetEventFailed_GetEventFailed_Event_VCEvEcmPropFr02Tioutd
          OpEventGetEventFailed_GetEventFailed_EvtInfo_Ga_TmSpdSyncFailed: RteEventRef=OpEventGetEventFailed_GetEventFailed_EvtInfo_Ga_TmSpdSyncFailed
          OpEventGetEventFailed_GetEventFailed_Event_Ga_TmSpdSyncFailed: RteEventRef=OpEventGetEventFailed_GetEventFailed_Event_Ga_TmSpdSyncFailed
          OpEventGetEventFailed_GetEventFailed_EvtInfo_INV_RSLVR_EXCT_ELEC_LO: RteEventRef=OpEventGetEventFailed_GetEventFailed_EvtInfo_INV_RSLVR_EXCT_ELEC_LO
          OpEventGetEventFailed_GetEventFailed_Event_INV_RSLVR_EXCT_ELEC_LO: RteEventRef=OpEventGetEventFailed_GetEventFailed_Event_INV_RSLVR_EXCT_ELEC_LO
          OpEventGetEventFailed_GetEventFailed_EvtInfo_VCEvEcmPropXevFr06Tioutd: RteEventRef=OpEventGetEventFailed_GetEventFailed_EvtInfo_VCEvEcmPropXevFr06Tioutd
          OpEventGetEventFailed_GetEventFailed_Event_VCEvEcmPropXevFr06Tioutd: RteEventRef=OpEventGetEventFailed_GetEventFailed_Event_VCEvEcmPropXevFr06Tioutd
          OpEventGetEventFailed_GetEventFailed_EvtInfo_VcEvCntrWhlMotSysTqAllwd: RteEventRef=OpEventGetEventFailed_GetEventFailed_EvtInfo_VcEvCntrWhlMotSysTqAllwd
          OpEventGetEventFailed_GetEventFailed_Event_VcEvCntrWhlMotSysTqAllwd: RteEventRef=OpEventGetEventFailed_GetEventFailed_Event_VcEvCntrWhlMotSysTqAllwd
          OpEventGetEventFailed_GetEventFailed_EvtInfo_INV_UHVDC_1_ELEC_HI: RteEventRef=OpEventGetEventFailed_GetEventFailed_EvtInfo_INV_UHVDC_1_ELEC_HI
          OpEventGetEventFailed_GetEventFailed_Event_INV_UHVDC_1_ELEC_HI: RteEventRef=OpEventGetEventFailed_GetEventFailed_Event_INV_UHVDC_1_ELEC_HI
          OpEventGetEventFailed_GetEventFailed_EvtInfo_INV_EM_STATOR_TEMP2_ELE_FLT: RteEventRef=OpEventGetEventFailed_GetEventFailed_EvtInfo_INV_EM_STATOR_TEMP2_ELE_FLT
          OpEventGetEventFailed_GetEventFailed_Event_INV_EM_STATOR_TEMP2_ELE_FLT: RteEventRef=OpEventGetEventFailed_GetEventFailed_Event_INV_EM_STATOR_TEMP2_ELE_FLT
          OpEventGetEventFailed_GetEventFailed_EvtInfo_AURIX_RST_SNG: RteEventRef=OpEventGetEventFailed_GetEventFailed_EvtInfo_AURIX_RST_SNG
          OpEventGetEventFailed_GetEventFailed_Event_AURIX_RST_SNG: RteEventRef=OpEventGetEventFailed_GetEventFailed_Event_AURIX_RST_SNG
          OpEventGetEventFailed_GetEventFailed_EvtInfo_VCEvEcmPropFr24MgmFr01Tioutd: RteEventRef=OpEventGetEventFailed_GetEventFailed_EvtInfo_VCEvEcmPropFr24MgmFr01Tioutd
          OpEventGetEventFailed_GetEventFailed_Event_VCEvEcmPropFr24MgmFr01Tioutd: RteEventRef=OpEventGetEventFailed_GetEventFailed_Event_VCEvEcmPropFr24MgmFr01Tioutd
          OpEventGetEventFailed_GetEventFailed_EvtInfo_INV_RSLVR_COS_ELEC_OPEN: RteEventRef=OpEventGetEventFailed_GetEventFailed_EvtInfo_INV_RSLVR_COS_ELEC_OPEN
          OpEventGetEventFailed_GetEventFailed_Event_INV_RSLVR_COS_ELEC_OPEN: RteEventRef=OpEventGetEventFailed_GetEventFailed_Event_INV_RSLVR_COS_ELEC_OPEN
          OpEventGetEventFailed_GetEventFailed_EvtInfo_INV_IAC_V_ELEC_LO: RteEventRef=OpEventGetEventFailed_GetEventFailed_EvtInfo_INV_IAC_V_ELEC_LO
          OpEventGetEventFailed_GetEventFailed_Event_INV_IAC_V_ELEC_LO: RteEventRef=OpEventGetEventFailed_GetEventFailed_Event_INV_IAC_V_ELEC_LO
          OpEventGetEventFailed_GetEventFailed_EvtInfo_INV_IAC_W_OFFS: RteEventRef=OpEventGetEventFailed_GetEventFailed_EvtInfo_INV_IAC_W_OFFS
          OpEventGetEventFailed_GetEventFailed_Event_INV_IAC_W_OFFS: RteEventRef=OpEventGetEventFailed_GetEventFailed_Event_INV_IAC_W_OFFS
          OpEventGetEventFailed_GetEventFailed_EvtInfo_INV_EM_STATOR_TEMP2_GRDT: RteEventRef=OpEventGetEventFailed_GetEventFailed_EvtInfo_INV_EM_STATOR_TEMP2_GRDT
          OpEventGetEventFailed_GetEventFailed_Event_INV_EM_STATOR_TEMP2_GRDT: RteEventRef=OpEventGetEventFailed_GetEventFailed_Event_INV_EM_STATOR_TEMP2_GRDT
          OpEventGetEventFailed_GetEventFailed_EvtInfo_INV_EM_OVRSPD_HWP: RteEventRef=OpEventGetEventFailed_GetEventFailed_EvtInfo_INV_EM_OVRSPD_HWP
          OpEventGetEventFailed_GetEventFailed_Event_INV_EM_OVRSPD_HWP: RteEventRef=OpEventGetEventFailed_GetEventFailed_Event_INV_EM_OVRSPD_HWP
          OpEventGetEventFailed_GetEventFailed_EvtInfo_CU_TEMP_HWP: RteEventRef=OpEventGetEventFailed_GetEventFailed_EvtInfo_CU_TEMP_HWP
          OpEventGetEventFailed_GetEventFailed_Event_CU_TEMP_HWP: RteEventRef=OpEventGetEventFailed_GetEventFailed_Event_CU_TEMP_HWP
          OpEventGetEventFailed_GetEventFailed_EvtInfo_INV_UHVDC_1_RNG_HI: RteEventRef=OpEventGetEventFailed_GetEventFailed_EvtInfo_INV_UHVDC_1_RNG_HI
          OpEventGetEventFailed_GetEventFailed_Event_INV_UHVDC_1_RNG_HI: RteEventRef=OpEventGetEventFailed_GetEventFailed_Event_INV_UHVDC_1_RNG_HI
          OpEventGetEventFailed_GetEventFailed_EvtInfo_VcEvEMPerfPlaus: RteEventRef=OpEventGetEventFailed_GetEventFailed_EvtInfo_VcEvEMPerfPlaus
          OpEventGetEventFailed_GetEventFailed_Event_VcEvEMPerfPlaus: RteEventRef=OpEventGetEventFailed_GetEventFailed_Event_VcEvEMPerfPlaus
          OpEventGetEventFailed_GetEventFailed_EvtInfo_VCEvVddmPropFr18Tioutd: RteEventRef=OpEventGetEventFailed_GetEventFailed_EvtInfo_VCEvVddmPropFr18Tioutd
          OpEventGetEventFailed_GetEventFailed_Event_VCEvVddmPropFr18Tioutd: RteEventRef=OpEventGetEventFailed_GetEventFailed_Event_VCEvVddmPropFr18Tioutd
          OpEventGetEventFailed_GetEventFailed_EvtInfo_INV_IAC_U_ELEC_HWP: RteEventRef=OpEventGetEventFailed_GetEventFailed_EvtInfo_INV_IAC_U_ELEC_HWP
          OpEventGetEventFailed_GetEventFailed_Event_INV_IAC_U_ELEC_HWP: RteEventRef=OpEventGetEventFailed_GetEventFailed_Event_INV_IAC_U_ELEC_HWP
          OpEventGetEventFailed_GetEventFailed_EvtInfo_VCEvVddmPropFr15Tioutd: RteEventRef=OpEventGetEventFailed_GetEventFailed_EvtInfo_VCEvVddmPropFr15Tioutd
          OpEventGetEventFailed_GetEventFailed_Event_VCEvVddmPropFr15Tioutd: RteEventRef=OpEventGetEventFailed_GetEventFailed_Event_VCEvVddmPropFr15Tioutd
          OpEventGetEventFailed_GetEventFailed_EvtInfo_Ga_GADisengageFailure: RteEventRef=OpEventGetEventFailed_GetEventFailed_EvtInfo_Ga_GADisengageFailure
          OpEventGetEventFailed_GetEventFailed_Event_Ga_GADisengageFailure: RteEventRef=OpEventGetEventFailed_GetEventFailed_Event_Ga_GADisengageFailure
          OpEventGetEventFailed_GetEventFailed_EvtInfo_CU_TEMP2_RNG_LO: RteEventRef=OpEventGetEventFailed_GetEventFailed_EvtInfo_CU_TEMP2_RNG_LO
          OpEventGetEventFailed_GetEventFailed_Event_CU_TEMP2_RNG_LO: RteEventRef=OpEventGetEventFailed_GetEventFailed_Event_CU_TEMP2_RNG_LO
          OpEventGetEventFailed_GetEventFailed_EvtInfo_INV_RSLVR_SIN_ELEC_OPEN: RteEventRef=OpEventGetEventFailed_GetEventFailed_EvtInfo_INV_RSLVR_SIN_ELEC_OPEN
          OpEventGetEventFailed_GetEventFailed_Event_INV_RSLVR_SIN_ELEC_OPEN: RteEventRef=OpEventGetEventFailed_GetEventFailed_Event_INV_RSLVR_SIN_ELEC_OPEN
          OpEventGetEventFailed_GetEventFailed_EvtInfo_VcEvChkSum: RteEventRef=OpEventGetEventFailed_GetEventFailed_EvtInfo_VcEvChkSum
          OpEventGetEventFailed_GetEventFailed_Event_VcEvChkSum: RteEventRef=OpEventGetEventFailed_GetEventFailed_Event_VcEvChkSum
          OpEventGetEventFailed_GetEventFailed_EvtInfo_PS_P5_UC_FLT: RteEventRef=OpEventGetEventFailed_GetEventFailed_EvtInfo_PS_P5_UC_FLT
          OpEventGetEventFailed_GetEventFailed_Event_PS_P5_UC_FLT: RteEventRef=OpEventGetEventFailed_GetEventFailed_Event_PS_P5_UC_FLT
          OpEventGetEventFailed_GetEventFailed_EvtInfo_INV_RSLVR_COS_ELEC_FLT: RteEventRef=OpEventGetEventFailed_GetEventFailed_EvtInfo_INV_RSLVR_COS_ELEC_FLT
          OpEventGetEventFailed_GetEventFailed_Event_INV_RSLVR_COS_ELEC_FLT: RteEventRef=OpEventGetEventFailed_GetEventFailed_Event_INV_RSLVR_COS_ELEC_FLT
          OpEventGetEventFailed_GetEventFailed_EvtInfo_INV_IAC_W_RNG_HI: RteEventRef=OpEventGetEventFailed_GetEventFailed_EvtInfo_INV_IAC_W_RNG_HI
          OpEventGetEventFailed_GetEventFailed_Event_INV_IAC_W_RNG_HI: RteEventRef=OpEventGetEventFailed_GetEventFailed_Event_INV_IAC_W_RNG_HI
          OpEventGetEventFailed_GetEventFailed_EvtInfo_PS_ECUSUPPLY_HIGH: RteEventRef=OpEventGetEventFailed_GetEventFailed_EvtInfo_PS_ECUSUPPLY_HIGH
          OpEventGetEventFailed_GetEventFailed_Event_PS_ECUSUPPLY_HIGH: RteEventRef=OpEventGetEventFailed_GetEventFailed_Event_PS_ECUSUPPLY_HIGH
          OpEventGetEventFailed_GetEventFailed_EvtInfo_VCEvEcmPropFr05Tioutd: RteEventRef=OpEventGetEventFailed_GetEventFailed_EvtInfo_VCEvEcmPropFr05Tioutd
          OpEventGetEventFailed_GetEventFailed_Event_VCEvEcmPropFr05Tioutd: RteEventRef=OpEventGetEventFailed_GetEventFailed_Event_VCEvEcmPropFr05Tioutd
          OpEventGetEventFailed_GetEventFailed_EvtInfo_PS_ECUSUPPLY_LOW: RteEventRef=OpEventGetEventFailed_GetEventFailed_EvtInfo_PS_ECUSUPPLY_LOW
          OpEventGetEventFailed_GetEventFailed_Event_PS_ECUSUPPLY_LOW: RteEventRef=OpEventGetEventFailed_GetEventFailed_Event_PS_ECUSUPPLY_LOW
          OpEventGetEventFailed_GetEventFailed_EvtInfo_VcEvChkSumHvSysRlySts: RteEventRef=OpEventGetEventFailed_GetEventFailed_EvtInfo_VcEvChkSumHvSysRlySts
          OpEventGetEventFailed_GetEventFailed_Event_VcEvChkSumHvSysRlySts: RteEventRef=OpEventGetEventFailed_GetEventFailed_Event_VcEvChkSumHvSysRlySts
          OpEventGetEventFailed_GetEventFailed_EvtInfo_VcEvMonMode: RteEventRef=OpEventGetEventFailed_GetEventFailed_EvtInfo_VcEvMonMode
          OpEventGetEventFailed_GetEventFailed_Event_VcEvMonMode: RteEventRef=OpEventGetEventFailed_GetEventFailed_Event_VcEvMonMode
          OpEventGetEventFailed_GetEventFailed_EvtInfo_INV_IAC_OC_SWP: RteEventRef=OpEventGetEventFailed_GetEventFailed_EvtInfo_INV_IAC_OC_SWP
          OpEventGetEventFailed_GetEventFailed_Event_INV_IAC_OC_SWP: RteEventRef=OpEventGetEventFailed_GetEventFailed_Event_INV_IAC_OC_SWP
          OpEventGetEventFailed_GetEventFailed_EvtInfo_INV_IMMO_AUTHFAIL: RteEventRef=OpEventGetEventFailed_GetEventFailed_EvtInfo_INV_IMMO_AUTHFAIL
          OpEventGetEventFailed_GetEventFailed_Event_INV_IMMO_AUTHFAIL: RteEventRef=OpEventGetEventFailed_GetEventFailed_Event_INV_IMMO_AUTHFAIL
          OpEventGetEventFailed_GetEventFailed_EvtInfo_PA_OpenCirc_FLT: RteEventRef=OpEventGetEventFailed_GetEventFailed_EvtInfo_PA_OpenCirc_FLT
          OpEventGetEventFailed_GetEventFailed_Event_PA_OpenCirc_FLT: RteEventRef=OpEventGetEventFailed_GetEventFailed_Event_PA_OpenCirc_FLT
          OpEventGetEventFailed_GetEventFailed_EvtInfo_INV_IAC_V_ELEC_HI: RteEventRef=OpEventGetEventFailed_GetEventFailed_EvtInfo_INV_IAC_V_ELEC_HI
          OpEventGetEventFailed_GetEventFailed_Event_INV_IAC_V_ELEC_HI: RteEventRef=OpEventGetEventFailed_GetEventFailed_Event_INV_IAC_V_ELEC_HI
          OpEventGetEventFailed_GetEventFailed_EvtInfo_VCEvEcmPropFr04Tioutd: RteEventRef=OpEventGetEventFailed_GetEventFailed_EvtInfo_VCEvEcmPropFr04Tioutd
          OpEventGetEventFailed_GetEventFailed_Event_VCEvEcmPropFr04Tioutd: RteEventRef=OpEventGetEventFailed_GetEventFailed_Event_VCEvEcmPropFr04Tioutd
          OpEventGetEventFailed_GetEventFailed_EvtInfo_VcEvMonTrqActPlaus: RteEventRef=OpEventGetEventFailed_GetEventFailed_EvtInfo_VcEvMonTrqActPlaus
          OpEventGetEventFailed_GetEventFailed_Event_VcEvMonTrqActPlaus: RteEventRef=OpEventGetEventFailed_GetEventFailed_Event_VcEvMonTrqActPlaus
          OpEventGetEventFailed_GetEventFailed_EvtInfo_VcEvMonTrqAct: RteEventRef=OpEventGetEventFailed_GetEventFailed_EvtInfo_VcEvMonTrqAct
          OpEventGetEventFailed_GetEventFailed_Event_VcEvMonTrqAct: RteEventRef=OpEventGetEventFailed_GetEventFailed_Event_VcEvMonTrqAct
          OpEventGetEventFailed_GetEventFailed_EvtInfo_INV_RSLVR_COS_ELEC_LO: RteEventRef=OpEventGetEventFailed_GetEventFailed_EvtInfo_INV_RSLVR_COS_ELEC_LO
          OpEventGetEventFailed_GetEventFailed_Event_INV_RSLVR_COS_ELEC_LO: RteEventRef=OpEventGetEventFailed_GetEventFailed_Event_INV_RSLVR_COS_ELEC_LO
          OpEventGetEventFailed_GetEventFailed_EvtInfo_INV_COOLT_INLET_TEMP_HWP: RteEventRef=OpEventGetEventFailed_GetEventFailed_EvtInfo_INV_COOLT_INLET_TEMP_HWP
          OpEventGetEventFailed_GetEventFailed_Event_INV_COOLT_INLET_TEMP_HWP: RteEventRef=OpEventGetEventFailed_GetEventFailed_Event_INV_COOLT_INLET_TEMP_HWP
          OpEventGetEventFailed_GetEventFailed_EvtInfo_VCEvEcmPropFr11Tioutd: RteEventRef=OpEventGetEventFailed_GetEventFailed_EvtInfo_VCEvEcmPropFr11Tioutd
          OpEventGetEventFailed_GetEventFailed_Event_VCEvEcmPropFr11Tioutd: RteEventRef=OpEventGetEventFailed_GetEventFailed_Event_VCEvEcmPropFr11Tioutd
          OpEventGetEventFailed_GetEventFailed_EvtInfo_PS_KL30_RNG_HI: RteEventRef=OpEventGetEventFailed_GetEventFailed_EvtInfo_PS_KL30_RNG_HI
          OpEventGetEventFailed_GetEventFailed_Event_PS_KL30_RNG_HI: RteEventRef=OpEventGetEventFailed_GetEventFailed_Event_PS_KL30_RNG_HI
          OpEventGetEventFailed_GetEventFailed_EvtInfo_INV_IAC_OC_HWP: RteEventRef=OpEventGetEventFailed_GetEventFailed_EvtInfo_INV_IAC_OC_HWP
          OpEventGetEventFailed_GetEventFailed_Event_INV_IAC_OC_HWP: RteEventRef=OpEventGetEventFailed_GetEventFailed_Event_INV_IAC_OC_HWP
          OpEventGetEventFailed_GetEventFailed_EvtInfo_INV_RSLVR_COS_RNG_HI: RteEventRef=OpEventGetEventFailed_GetEventFailed_EvtInfo_INV_RSLVR_COS_RNG_HI
          OpEventGetEventFailed_GetEventFailed_Event_INV_RSLVR_COS_RNG_HI: RteEventRef=OpEventGetEventFailed_GetEventFailed_Event_INV_RSLVR_COS_RNG_HI
          OpEventGetEventFailed_GetEventFailed_EvtInfo_INV_IAC_U_ELEC_HI: RteEventRef=OpEventGetEventFailed_GetEventFailed_EvtInfo_INV_IAC_U_ELEC_HI
          OpEventGetEventFailed_GetEventFailed_Event_INV_IAC_U_ELEC_HI: RteEventRef=OpEventGetEventFailed_GetEventFailed_Event_INV_IAC_U_ELEC_HI
          OpEventGetEventFailed_GetEventFailed_EvtInfo_INV_IAC_V_RNG_LO: RteEventRef=OpEventGetEventFailed_GetEventFailed_EvtInfo_INV_IAC_V_RNG_LO
          OpEventGetEventFailed_GetEventFailed_Event_INV_IAC_V_RNG_LO: RteEventRef=OpEventGetEventFailed_GetEventFailed_Event_INV_IAC_V_RNG_LO
          OpEventGetEventFailed_GetEventFailed_EvtInfo_INV_IAC_U_RNG_HI: RteEventRef=OpEventGetEventFailed_GetEventFailed_EvtInfo_INV_IAC_U_RNG_HI
          OpEventGetEventFailed_GetEventFailed_Event_INV_IAC_U_RNG_HI: RteEventRef=OpEventGetEventFailed_GetEventFailed_Event_INV_IAC_U_RNG_HI
          OpEventGetEventFailed_GetEventFailed_EvtInfo_VCEvEcmPropFr25Tioutd: RteEventRef=OpEventGetEventFailed_GetEventFailed_EvtInfo_VCEvEcmPropFr25Tioutd
          OpEventGetEventFailed_GetEventFailed_Event_VCEvEcmPropFr25Tioutd: RteEventRef=OpEventGetEventFailed_GetEventFailed_Event_VCEvEcmPropFr25Tioutd
          OpEventGetEventFailed_GetEventFailed_EvtInfo_INV_IGBT_TEMP_W_RNG_LO: RteEventRef=OpEventGetEventFailed_GetEventFailed_EvtInfo_INV_IGBT_TEMP_W_RNG_LO
          OpEventGetEventFailed_GetEventFailed_Event_INV_IGBT_TEMP_W_RNG_LO: RteEventRef=OpEventGetEventFailed_GetEventFailed_Event_INV_IGBT_TEMP_W_RNG_LO
          OpEventGetEventFailed_GetEventFailed_EvtInfo_PSnsr_RNG_NOK: RteEventRef=OpEventGetEventFailed_GetEventFailed_EvtInfo_PSnsr_RNG_NOK
          OpEventGetEventFailed_GetEventFailed_Event_PSnsr_RNG_NOK: RteEventRef=OpEventGetEventFailed_GetEventFailed_Event_PSnsr_RNG_NOK
          OpEventGetEventFailed_GetEventFailed_EvtInfo_INV_RSLVR_COS_RNG_NOK: RteEventRef=OpEventGetEventFailed_GetEventFailed_EvtInfo_INV_RSLVR_COS_RNG_NOK
          OpEventGetEventFailed_GetEventFailed_Event_INV_RSLVR_COS_RNG_NOK: RteEventRef=OpEventGetEventFailed_GetEventFailed_Event_INV_RSLVR_COS_RNG_NOK
          OpEventGetEventFailed_GetEventFailed_EvtInfo_PS_DRVB_Fault: RteEventRef=OpEventGetEventFailed_GetEventFailed_EvtInfo_PS_DRVB_Fault
          OpEventGetEventFailed_GetEventFailed_Event_PS_DRVB_Fault: RteEventRef=OpEventGetEventFailed_GetEventFailed_Event_PS_DRVB_Fault
          OpEventGetEventFailed_GetEventFailed_EvtInfo_INV_CU_TEMP1_RNG_NOK: RteEventRef=OpEventGetEventFailed_GetEventFailed_EvtInfo_INV_CU_TEMP1_RNG_NOK
          OpEventGetEventFailed_GetEventFailed_Event_INV_CU_TEMP1_RNG_NOK: RteEventRef=OpEventGetEventFailed_GetEventFailed_Event_INV_CU_TEMP1_RNG_NOK
          OpEventGetEventFailed_GetEventFailed_EvtInfo_VcEvCntr: RteEventRef=OpEventGetEventFailed_GetEventFailed_EvtInfo_VcEvCntr
          OpEventGetEventFailed_GetEventFailed_Event_VcEvCntr: RteEventRef=OpEventGetEventFailed_GetEventFailed_Event_VcEvCntr
          OpEventGetEventFailed_GetEventFailed_EvtInfo_INV_RSLVR_SIN_AMP: RteEventRef=OpEventGetEventFailed_GetEventFailed_EvtInfo_INV_RSLVR_SIN_AMP
          OpEventGetEventFailed_GetEventFailed_Event_INV_RSLVR_SIN_AMP: RteEventRef=OpEventGetEventFailed_GetEventFailed_Event_INV_RSLVR_SIN_AMP
          OpEventGetEventFailed_GetEventFailed_EvtInfo_INV_UHVDC_2_RNG_HI: RteEventRef=OpEventGetEventFailed_GetEventFailed_EvtInfo_INV_UHVDC_2_RNG_HI
          OpEventGetEventFailed_GetEventFailed_Event_INV_UHVDC_2_RNG_HI: RteEventRef=OpEventGetEventFailed_GetEventFailed_Event_INV_UHVDC_2_RNG_HI
          OpEventGetEventFailed_GetEventFailed_EvtInfo_INV_IGBT_TEMP_U_GRDT: RteEventRef=OpEventGetEventFailed_GetEventFailed_EvtInfo_INV_IGBT_TEMP_U_GRDT
          OpEventGetEventFailed_GetEventFailed_Event_INV_IGBT_TEMP_U_GRDT: RteEventRef=OpEventGetEventFailed_GetEventFailed_Event_INV_IGBT_TEMP_U_GRDT
          OpEventGetEventFailed_GetEventFailed_EvtInfo_MON_TQ_PLAUS_PWR_MDL: RteEventRef=OpEventGetEventFailed_GetEventFailed_EvtInfo_MON_TQ_PLAUS_PWR_MDL
          OpEventGetEventFailed_GetEventFailed_Event_MON_TQ_PLAUS_PWR_MDL: RteEventRef=OpEventGetEventFailed_GetEventFailed_Event_MON_TQ_PLAUS_PWR_MDL
          OpEventGetEventFailed_GetEventFailed_EvtInfo_INV_IGBT_TEMP_W_PLAUS: RteEventRef=OpEventGetEventFailed_GetEventFailed_EvtInfo_INV_IGBT_TEMP_W_PLAUS
          OpEventGetEventFailed_GetEventFailed_Event_INV_IGBT_TEMP_W_PLAUS: RteEventRef=OpEventGetEventFailed_GetEventFailed_Event_INV_IGBT_TEMP_W_PLAUS
          OpEventGetEventFailed_GetEventFailed_EvtInfo_PS_BLDC_UV_FLT: RteEventRef=OpEventGetEventFailed_GetEventFailed_EvtInfo_PS_BLDC_UV_FLT
          OpEventGetEventFailed_GetEventFailed_Event_PS_BLDC_UV_FLT: RteEventRef=OpEventGetEventFailed_GetEventFailed_Event_PS_BLDC_UV_FLT
          OpEventGetEventFailed_GetEventFailed_EvtInfo_INV_IAC_V_OFFS: RteEventRef=OpEventGetEventFailed_GetEventFailed_EvtInfo_INV_IAC_V_OFFS
          OpEventGetEventFailed_GetEventFailed_Event_INV_IAC_V_OFFS: RteEventRef=OpEventGetEventFailed_GetEventFailed_Event_INV_IAC_V_OFFS
          OpEventGetEventFailed_GetEventFailed_EvtInfo_INV_RSLVR_EXCT_FREQ_RNG_NOK: RteEventRef=OpEventGetEventFailed_GetEventFailed_EvtInfo_INV_RSLVR_EXCT_FREQ_RNG_NOK
          OpEventGetEventFailed_GetEventFailed_Event_INV_RSLVR_EXCT_FREQ_RNG_NOK: RteEventRef=OpEventGetEventFailed_GetEventFailed_Event_INV_RSLVR_EXCT_FREQ_RNG_NOK
          OpEventGetEventFailed_GetEventFailed_EvtInfo_PS_KL30_RNG_LO: RteEventRef=OpEventGetEventFailed_GetEventFailed_EvtInfo_PS_KL30_RNG_LO
          OpEventGetEventFailed_GetEventFailed_Event_PS_KL30_RNG_LO: RteEventRef=OpEventGetEventFailed_GetEventFailed_Event_PS_KL30_RNG_LO
          OpEventGetEventFailed_GetEventFailed_EvtInfo_INV_RSLVR_COS_RNG_LO: RteEventRef=OpEventGetEventFailed_GetEventFailed_EvtInfo_INV_RSLVR_COS_RNG_LO
          OpEventGetEventFailed_GetEventFailed_Event_INV_RSLVR_COS_RNG_LO: RteEventRef=OpEventGetEventFailed_GetEventFailed_Event_INV_RSLVR_COS_RNG_LO
          OpEventGetEventFailed_GetEventFailed_EvtInfo_PSnsr_ELE_FLT: RteEventRef=OpEventGetEventFailed_GetEventFailed_EvtInfo_PSnsr_ELE_FLT
          OpEventGetEventFailed_GetEventFailed_Event_PSnsr_ELE_FLT: RteEventRef=OpEventGetEventFailed_GetEventFailed_Event_PSnsr_ELE_FLT
          OpEventGetEventFailed_GetEventFailed_EvtInfo_INV_RSLVR_SIN_COS_PLAUS_AMP: RteEventRef=OpEventGetEventFailed_GetEventFailed_EvtInfo_INV_RSLVR_SIN_COS_PLAUS_AMP
          OpEventGetEventFailed_GetEventFailed_Event_INV_RSLVR_SIN_COS_PLAUS_AMP: RteEventRef=OpEventGetEventFailed_GetEventFailed_Event_INV_RSLVR_SIN_COS_PLAUS_AMP
          OpEventGetEventFailed_GetEventFailed_EvtInfo_INV_IAC_U_ELEC_LO: RteEventRef=OpEventGetEventFailed_GetEventFailed_EvtInfo_INV_IAC_U_ELEC_LO
          OpEventGetEventFailed_GetEventFailed_Event_INV_IAC_U_ELEC_LO: RteEventRef=OpEventGetEventFailed_GetEventFailed_Event_INV_IAC_U_ELEC_LO
          OpEventGetEventFailed_GetEventFailed_EvtInfo_INV_RSLVR_EXCT_ELEC_HI: RteEventRef=OpEventGetEventFailed_GetEventFailed_EvtInfo_INV_RSLVR_EXCT_ELEC_HI
          OpEventGetEventFailed_GetEventFailed_Event_INV_RSLVR_EXCT_ELEC_HI: RteEventRef=OpEventGetEventFailed_GetEventFailed_Event_INV_RSLVR_EXCT_ELEC_HI
          OpEventGetEventFailed_GetEventFailed_EvtInfo_INV_IAC_U_RNG_LO: RteEventRef=OpEventGetEventFailed_GetEventFailed_EvtInfo_INV_IAC_U_RNG_LO
          OpEventGetEventFailed_GetEventFailed_Event_INV_IAC_U_RNG_LO: RteEventRef=OpEventGetEventFailed_GetEventFailed_Event_INV_IAC_U_RNG_LO
          OpEventGetEventFailed_GetEventFailed_EvtInfo_INV_IAC_V_RNG_HI: RteEventRef=OpEventGetEventFailed_GetEventFailed_EvtInfo_INV_IAC_V_RNG_HI
          OpEventGetEventFailed_GetEventFailed_Event_INV_IAC_V_RNG_HI: RteEventRef=OpEventGetEventFailed_GetEventFailed_Event_INV_IAC_V_RNG_HI
          OpEventGetEventFailed_GetEventFailed_EvtInfo_INV_IGBT_TEMP_U_PLAUS: RteEventRef=OpEventGetEventFailed_GetEventFailed_EvtInfo_INV_IGBT_TEMP_U_PLAUS
          OpEventGetEventFailed_GetEventFailed_Event_INV_IGBT_TEMP_U_PLAUS: RteEventRef=OpEventGetEventFailed_GetEventFailed_Event_INV_IGBT_TEMP_U_PLAUS
          OpEventGetEventFailed_GetEventFailed_EvtInfo_INV_RSLVR_OFFS_DFT: RteEventRef=OpEventGetEventFailed_GetEventFailed_EvtInfo_INV_RSLVR_OFFS_DFT
          OpEventGetEventFailed_GetEventFailed_Event_INV_RSLVR_OFFS_DFT: RteEventRef=OpEventGetEventFailed_GetEventFailed_Event_INV_RSLVR_OFFS_DFT
          OpEventGetEventFailed_GetEventFailed_EvtInfo_Ga_MoveOverThd: RteEventRef=OpEventGetEventFailed_GetEventFailed_EvtInfo_Ga_MoveOverThd
          OpEventGetEventFailed_GetEventFailed_Event_Ga_MoveOverThd: RteEventRef=OpEventGetEventFailed_GetEventFailed_Event_Ga_MoveOverThd
          OpEventGetEventFailed_GetEventFailed_EvtInfo_VcEvMonIPH: RteEventRef=OpEventGetEventFailed_GetEventFailed_EvtInfo_VcEvMonIPH
          OpEventGetEventFailed_GetEventFailed_Event_VcEvMonIPH: RteEventRef=OpEventGetEventFailed_GetEventFailed_Event_VcEvMonIPH
          OpEventGetEventFailed_GetEventFailed_EvtInfo_INV_RSLVR_HW_FLT: RteEventRef=OpEventGetEventFailed_GetEventFailed_EvtInfo_INV_RSLVR_HW_FLT
          OpEventGetEventFailed_GetEventFailed_Event_INV_RSLVR_HW_FLT: RteEventRef=OpEventGetEventFailed_GetEventFailed_Event_INV_RSLVR_HW_FLT
          OpEventGetEventFailed_GetEventFailed_EvtInfo_INV_RSLVR_SIN_ELEC_LO: RteEventRef=OpEventGetEventFailed_GetEventFailed_EvtInfo_INV_RSLVR_SIN_ELEC_LO
          OpEventGetEventFailed_GetEventFailed_Event_INV_RSLVR_SIN_ELEC_LO: RteEventRef=OpEventGetEventFailed_GetEventFailed_Event_INV_RSLVR_SIN_ELEC_LO
          OpEventGetEventFailed_GetEventFailed_EvtInfo_INV_IAC_W_AMP: RteEventRef=OpEventGetEventFailed_GetEventFailed_EvtInfo_INV_IAC_W_AMP
          OpEventGetEventFailed_GetEventFailed_Event_INV_IAC_W_AMP: RteEventRef=OpEventGetEventFailed_GetEventFailed_Event_INV_IAC_W_AMP
          OpEventGetEventFailed_GetEventFailed_EvtInfo_VCC_OverVoltage: RteEventRef=OpEventGetEventFailed_GetEventFailed_EvtInfo_VCC_OverVoltage
          OpEventGetEventFailed_GetEventFailed_Event_VCC_OverVoltage: RteEventRef=OpEventGetEventFailed_GetEventFailed_Event_VCC_OverVoltage
          OpEventGetEventFailed_GetEventFailed_EvtInfo_PS_BLDC_OV_FLT: RteEventRef=OpEventGetEventFailed_GetEventFailed_EvtInfo_PS_BLDC_OV_FLT
          OpEventGetEventFailed_GetEventFailed_Event_PS_BLDC_OV_FLT: RteEventRef=OpEventGetEventFailed_GetEventFailed_Event_PS_BLDC_OV_FLT
          OpEventGetEventFailed_GetEventFailed_EvtInfo_AURIX_EEPROM_FLT: RteEventRef=OpEventGetEventFailed_GetEventFailed_EvtInfo_AURIX_EEPROM_FLT
          OpEventGetEventFailed_GetEventFailed_Event_AURIX_EEPROM_FLT: RteEventRef=OpEventGetEventFailed_GetEventFailed_Event_AURIX_EEPROM_FLT
          OpEventGetEventFailed_GetEventFailed_EvtInfo_FS_MONITIOR_ASC_FW_FLT: RteEventRef=OpEventGetEventFailed_GetEventFailed_EvtInfo_FS_MONITIOR_ASC_FW_FLT
          OpEventGetEventFailed_GetEventFailed_Event_FS_MONITIOR_ASC_FW_FLT: RteEventRef=OpEventGetEventFailed_GetEventFailed_Event_FS_MONITIOR_ASC_FW_FLT
          OpEventGetEventFailed_GetEventFailed_EvtInfo_VCEvSrsPropFr02Tioutd: RteEventRef=OpEventGetEventFailed_GetEventFailed_EvtInfo_VCEvSrsPropFr02Tioutd
          OpEventGetEventFailed_GetEventFailed_Event_VCEvSrsPropFr02Tioutd: RteEventRef=OpEventGetEventFailed_GetEventFailed_Event_VCEvSrsPropFr02Tioutd
          OpEventGetEventFailed_GetEventFailed_EvtInfo_VcEvMonErrMode: RteEventRef=OpEventGetEventFailed_GetEventFailed_EvtInfo_VcEvMonErrMode
          OpEventGetEventFailed_GetEventFailed_Event_VcEvMonErrMode: RteEventRef=OpEventGetEventFailed_GetEventFailed_Event_VcEvMonErrMode
          OpEventGetEventFailed_GetEventFailed_EvtInfo_AURIX_RST_MPL: RteEventRef=OpEventGetEventFailed_GetEventFailed_EvtInfo_AURIX_RST_MPL
          OpEventGetEventFailed_GetEventFailed_Event_AURIX_RST_MPL: RteEventRef=OpEventGetEventFailed_GetEventFailed_Event_AURIX_RST_MPL
          OpEventGetEventFailed_GetEventFailed_EvtInfo_VcEvNodeMisECM: RteEventRef=OpEventGetEventFailed_GetEventFailed_EvtInfo_VcEvNodeMisECM
          OpEventGetEventFailed_GetEventFailed_Event_VcEvNodeMisECM: RteEventRef=OpEventGetEventFailed_GetEventFailed_Event_VcEvNodeMisECM
          OpEventGetEventFailed_GetEventFailed_EvtInfo_PS_KL30_PLAUS: RteEventRef=OpEventGetEventFailed_GetEventFailed_EvtInfo_PS_KL30_PLAUS
          OpEventGetEventFailed_GetEventFailed_Event_PS_KL30_PLAUS: RteEventRef=OpEventGetEventFailed_GetEventFailed_Event_PS_KL30_PLAUS
          OpEventGetEventFailed_GetEventFailed_EvtInfo_INV_IAC_W_ELEC_HI: RteEventRef=OpEventGetEventFailed_GetEventFailed_EvtInfo_INV_IAC_W_ELEC_HI
          OpEventGetEventFailed_GetEventFailed_Event_INV_IAC_W_ELEC_HI: RteEventRef=OpEventGetEventFailed_GetEventFailed_Event_INV_IAC_W_ELEC_HI
          OpEventGetEventFailed_GetEventFailed_EvtInfo_VCEvVddmPropFr19Tioutd: RteEventRef=OpEventGetEventFailed_GetEventFailed_EvtInfo_VCEvVddmPropFr19Tioutd
          OpEventGetEventFailed_GetEventFailed_Event_VCEvVddmPropFr19Tioutd: RteEventRef=OpEventGetEventFailed_GetEventFailed_Event_VCEvVddmPropFr19Tioutd
          OpEventGetEventFailed_GetEventFailed_EvtInfo_INV_TEMP_DCHA_HW: RteEventRef=OpEventGetEventFailed_GetEventFailed_EvtInfo_INV_TEMP_DCHA_HW
          OpEventGetEventFailed_GetEventFailed_Event_INV_TEMP_DCHA_HW: RteEventRef=OpEventGetEventFailed_GetEventFailed_Event_INV_TEMP_DCHA_HW
          OpEventGetEventFailed_GetEventFailed_EvtInfo_VcEvPropCANGlbTiOutd: RteEventRef=OpEventGetEventFailed_GetEventFailed_EvtInfo_VcEvPropCANGlbTiOutd
          OpEventGetEventFailed_GetEventFailed_Event_VcEvPropCANGlbTiOutd: RteEventRef=OpEventGetEventFailed_GetEventFailed_Event_VcEvPropCANGlbTiOutd
          OpEventGetEventFailed_GetEventFailed_EvtInfo_INV_EM_STATOR_TEMP2_RNG_NOK: RteEventRef=OpEventGetEventFailed_GetEventFailed_EvtInfo_INV_EM_STATOR_TEMP2_RNG_NOK
          OpEventGetEventFailed_GetEventFailed_Event_INV_EM_STATOR_TEMP2_RNG_NOK: RteEventRef=OpEventGetEventFailed_GetEventFailed_Event_INV_EM_STATOR_TEMP2_RNG_NOK
          OpEventGetEventFailed_GetEventFailed_EvtInfo_INV_UHVDC_OV_HWP: RteEventRef=OpEventGetEventFailed_GetEventFailed_EvtInfo_INV_UHVDC_OV_HWP
          OpEventGetEventFailed_GetEventFailed_Event_INV_UHVDC_OV_HWP: RteEventRef=OpEventGetEventFailed_GetEventFailed_Event_INV_UHVDC_OV_HWP
          OpEventGetEventFailed_GetEventFailed_EvtInfo_Ga_FindEngleAngleFailed: RteEventRef=OpEventGetEventFailed_GetEventFailed_EvtInfo_Ga_FindEngleAngleFailed
          OpEventGetEventFailed_GetEventFailed_Event_Ga_FindEngleAngleFailed: RteEventRef=OpEventGetEventFailed_GetEventFailed_Event_Ga_FindEngleAngleFailed
          OpEventGetEventFailed_GetEventFailed_EvtInfo_VcEvMonTrqCmp: RteEventRef=OpEventGetEventFailed_GetEventFailed_EvtInfo_VcEvMonTrqCmp
          OpEventGetEventFailed_GetEventFailed_Event_VcEvMonTrqCmp: RteEventRef=OpEventGetEventFailed_GetEventFailed_Event_VcEvMonTrqCmp
          OpEventGetEventFailed_GetEventFailed_EvtInfo_INV_IGBT_TEMP_V_RNG_LO: RteEventRef=OpEventGetEventFailed_GetEventFailed_EvtInfo_INV_IGBT_TEMP_V_RNG_LO
          OpEventGetEventFailed_GetEventFailed_Event_INV_IGBT_TEMP_V_RNG_LO: RteEventRef=OpEventGetEventFailed_GetEventFailed_Event_INV_IGBT_TEMP_V_RNG_LO
          OpEventGetEventFailed_GetEventFailed_EvtInfo_INV_CONTROL_LIMIT: RteEventRef=OpEventGetEventFailed_GetEventFailed_EvtInfo_INV_CONTROL_LIMIT
          OpEventGetEventFailed_GetEventFailed_Event_INV_CONTROL_LIMIT: RteEventRef=OpEventGetEventFailed_GetEventFailed_Event_INV_CONTROL_LIMIT
          OpEventGetEventFailed_GetEventFailed_EvtInfo_COM_CarConfigErr: RteEventRef=OpEventGetEventFailed_GetEventFailed_EvtInfo_COM_CarConfigErr
          OpEventGetEventFailed_GetEventFailed_Event_COM_CarConfigErr: RteEventRef=OpEventGetEventFailed_GetEventFailed_Event_COM_CarConfigErr
          OpEventGetEventFailed_GetEventFailed_EvtInfo_VCEvEcmPropFr08Tioutd: RteEventRef=OpEventGetEventFailed_GetEventFailed_EvtInfo_VCEvEcmPropFr08Tioutd
          OpEventGetEventFailed_GetEventFailed_Event_VCEvEcmPropFr08Tioutd: RteEventRef=OpEventGetEventFailed_GetEventFailed_Event_VCEvEcmPropFr08Tioutd
          OpEventGetEventFailed_GetEventFailed_EvtInfo_CU_TEMP1_RNG_LO: RteEventRef=OpEventGetEventFailed_GetEventFailed_EvtInfo_CU_TEMP1_RNG_LO
          OpEventGetEventFailed_GetEventFailed_Event_CU_TEMP1_RNG_LO: RteEventRef=OpEventGetEventFailed_GetEventFailed_Event_CU_TEMP1_RNG_LO
          OpEventGetEventFailed_GetEventFailed_EvtInfo_INV_EM_STATOR_TEMP2_RNG_SWT: RteEventRef=OpEventGetEventFailed_GetEventFailed_EvtInfo_INV_EM_STATOR_TEMP2_RNG_SWT
          OpEventGetEventFailed_GetEventFailed_Event_INV_EM_STATOR_TEMP2_RNG_SWT: RteEventRef=OpEventGetEventFailed_GetEventFailed_Event_INV_EM_STATOR_TEMP2_RNG_SWT
          OpEventGetEventFailed_GetEventFailed_EvtInfo_GA_BLDC_POS_FLT: RteEventRef=OpEventGetEventFailed_GetEventFailed_EvtInfo_GA_BLDC_POS_FLT
          OpEventGetEventFailed_GetEventFailed_Event_GA_BLDC_POS_FLT: RteEventRef=OpEventGetEventFailed_GetEventFailed_Event_GA_BLDC_POS_FLT
          OpEventGetEventFailed_GetEventFailed_EvtInfo_PS_WhlSnsr_FLT: RteEventRef=OpEventGetEventFailed_GetEventFailed_EvtInfo_PS_WhlSnsr_FLT
          OpEventGetEventFailed_GetEventFailed_Event_PS_WhlSnsr_FLT: RteEventRef=OpEventGetEventFailed_GetEventFailed_Event_PS_WhlSnsr_FLT
          OpEventGetEventFailed_GetEventFailed_EvtInfo_INV_EM_STATOR_TEMP_RNG_LO: RteEventRef=OpEventGetEventFailed_GetEventFailed_EvtInfo_INV_EM_STATOR_TEMP_RNG_LO
          OpEventGetEventFailed_GetEventFailed_Event_INV_EM_STATOR_TEMP_RNG_LO: RteEventRef=OpEventGetEventFailed_GetEventFailed_Event_INV_EM_STATOR_TEMP_RNG_LO
          OpEventGetEventFailed_GetEventFailed_EvtInfo_INV_RSLVR_SIN_ELEC_HI: RteEventRef=OpEventGetEventFailed_GetEventFailed_EvtInfo_INV_RSLVR_SIN_ELEC_HI
          OpEventGetEventFailed_GetEventFailed_Event_INV_RSLVR_SIN_ELEC_HI: RteEventRef=OpEventGetEventFailed_GetEventFailed_Event_INV_RSLVR_SIN_ELEC_HI
          OpEventGetEventFailed_GetEventFailed_EvtInfo_INV_RSLVR_SIN_COS_PLAUS: RteEventRef=OpEventGetEventFailed_GetEventFailed_EvtInfo_INV_RSLVR_SIN_COS_PLAUS
          OpEventGetEventFailed_GetEventFailed_Event_INV_RSLVR_SIN_COS_PLAUS: RteEventRef=OpEventGetEventFailed_GetEventFailed_Event_INV_RSLVR_SIN_COS_PLAUS
          OpEventGetEventFailed_GetEventFailed_EvtInfo_INV_RSLVR_COS_AMP: RteEventRef=OpEventGetEventFailed_GetEventFailed_EvtInfo_INV_RSLVR_COS_AMP
          OpEventGetEventFailed_GetEventFailed_Event_INV_RSLVR_COS_AMP: RteEventRef=OpEventGetEventFailed_GetEventFailed_Event_INV_RSLVR_COS_AMP
          OpEventGetEventFailed_GetEventFailed_EvtInfo_INV_GATE_DRVR_BOT_HWP: RteEventRef=OpEventGetEventFailed_GetEventFailed_EvtInfo_INV_GATE_DRVR_BOT_HWP
          OpEventGetEventFailed_GetEventFailed_Event_INV_GATE_DRVR_BOT_HWP: RteEventRef=OpEventGetEventFailed_GetEventFailed_Event_INV_GATE_DRVR_BOT_HWP
          OpEventGetEventFailed_GetEventFailed_EvtInfo_Eg_HallVolWrong: RteEventRef=OpEventGetEventFailed_GetEventFailed_EvtInfo_Eg_HallVolWrong
          OpEventGetEventFailed_GetEventFailed_Event_Eg_HallVolWrong: RteEventRef=OpEventGetEventFailed_GetEventFailed_Event_Eg_HallVolWrong
          OpEventGetEventFailed_GetEventFailed_EvtInfo_INV_RSLVR_EXCT_RNG_NOK: RteEventRef=OpEventGetEventFailed_GetEventFailed_EvtInfo_INV_RSLVR_EXCT_RNG_NOK
          OpEventGetEventFailed_GetEventFailed_Event_INV_RSLVR_EXCT_RNG_NOK: RteEventRef=OpEventGetEventFailed_GetEventFailed_Event_INV_RSLVR_EXCT_RNG_NOK
          OpEventGetEventFailed_GetEventFailed_EvtInfo_PA_OpenCirc: RteEventRef=OpEventGetEventFailed_GetEventFailed_EvtInfo_PA_OpenCirc
          OpEventGetEventFailed_GetEventFailed_Event_PA_OpenCirc: RteEventRef=OpEventGetEventFailed_GetEventFailed_Event_PA_OpenCirc
          OpEventGetEventFailed_GetEventFailed_EvtInfo_INV_RSLVR_COS_ELEC_HI: RteEventRef=OpEventGetEventFailed_GetEventFailed_EvtInfo_INV_RSLVR_COS_ELEC_HI
          OpEventGetEventFailed_GetEventFailed_Event_INV_RSLVR_COS_ELEC_HI: RteEventRef=OpEventGetEventFailed_GetEventFailed_Event_INV_RSLVR_COS_ELEC_HI
          OpEventGetEventFailed_GetEventFailed_EvtInfo_VcEvCntrHvSysRlySts: RteEventRef=OpEventGetEventFailed_GetEventFailed_EvtInfo_VcEvCntrHvSysRlySts
          OpEventGetEventFailed_GetEventFailed_Event_VcEvCntrHvSysRlySts: RteEventRef=OpEventGetEventFailed_GetEventFailed_Event_VcEvCntrHvSysRlySts
          OpEventGetEventFailed_GetEventFailed_EvtInfo_CRASH_DTC: RteEventRef=OpEventGetEventFailed_GetEventFailed_EvtInfo_CRASH_DTC
          OpEventGetEventFailed_GetEventFailed_Event_CRASH_DTC: RteEventRef=OpEventGetEventFailed_GetEventFailed_Event_CRASH_DTC
          OpEventGetEventFailed_GetEventFailed_EvtInfo_INV_IGBT_TEMP_W_RNG_HI: RteEventRef=OpEventGetEventFailed_GetEventFailed_EvtInfo_INV_IGBT_TEMP_W_RNG_HI
          OpEventGetEventFailed_GetEventFailed_Event_INV_IGBT_TEMP_W_RNG_HI: RteEventRef=OpEventGetEventFailed_GetEventFailed_Event_INV_IGBT_TEMP_W_RNG_HI
          OpEventGetEventFailed_GetEventFailed_EvtInfo_VCEvBecmPropFr02Tioutd: RteEventRef=OpEventGetEventFailed_GetEventFailed_EvtInfo_VCEvBecmPropFr02Tioutd
          OpEventGetEventFailed_GetEventFailed_Event_VCEvBecmPropFr02Tioutd: RteEventRef=OpEventGetEventFailed_GetEventFailed_Event_VCEvBecmPropFr02Tioutd
          OpEventGetEventFailed_GetEventFailed_EvtInfo_INV_IGBT_TEMP_W_GRDT: RteEventRef=OpEventGetEventFailed_GetEventFailed_EvtInfo_INV_IGBT_TEMP_W_GRDT
          OpEventGetEventFailed_GetEventFailed_Event_INV_IGBT_TEMP_W_GRDT: RteEventRef=OpEventGetEventFailed_GetEventFailed_Event_INV_IGBT_TEMP_W_GRDT
          OpEventGetEventFailed_GetEventFailed_EvtInfo_EXT_UC_SPI_FLT: RteEventRef=OpEventGetEventFailed_GetEventFailed_EvtInfo_EXT_UC_SPI_FLT
          OpEventGetEventFailed_GetEventFailed_Event_EXT_UC_SPI_FLT: RteEventRef=OpEventGetEventFailed_GetEventFailed_Event_EXT_UC_SPI_FLT
          OpEventGetEventFailed_GetEventFailed_EvtInfo_INV_IAC_V_ELEC_HWP_001: RteEventRef=OpEventGetEventFailed_GetEventFailed_EvtInfo_INV_IAC_V_ELEC_HWP_001
          OpEventGetEventFailed_GetEventFailed_Event_INV_IAC_V_ELEC_HWP_001: RteEventRef=OpEventGetEventFailed_GetEventFailed_Event_INV_IAC_V_ELEC_HWP_001
          OpEventGetEventFailed_GetEventFailed_EvtInfo_VcEvChkSumWhlMotSysTqAllwd: RteEventRef=OpEventGetEventFailed_GetEventFailed_EvtInfo_VcEvChkSumWhlMotSysTqAllwd
          OpEventGetEventFailed_GetEventFailed_Event_VcEvChkSumWhlMotSysTqAllwd: RteEventRef=OpEventGetEventFailed_GetEventFailed_Event_VcEvChkSumWhlMotSysTqAllwd
          OpEventGetEventFailed_GetEventFailed_EvtInfo_FS_MONITIOR_ASC_FLT: RteEventRef=OpEventGetEventFailed_GetEventFailed_EvtInfo_FS_MONITIOR_ASC_FLT
          OpEventGetEventFailed_GetEventFailed_Event_FS_MONITIOR_ASC_FLT: RteEventRef=OpEventGetEventFailed_GetEventFailed_Event_FS_MONITIOR_ASC_FLT
          OpEventGetEventFailed_GetEventFailed_EvtInfo_INV_IAC_V_AMP: RteEventRef=OpEventGetEventFailed_GetEventFailed_EvtInfo_INV_IAC_V_AMP
          OpEventGetEventFailed_GetEventFailed_Event_INV_IAC_V_AMP: RteEventRef=OpEventGetEventFailed_GetEventFailed_Event_INV_IAC_V_AMP
          OpEventGetEventFailed_GetEventFailed_EvtInfo_INV_IAC_W_ELEC_LO: RteEventRef=OpEventGetEventFailed_GetEventFailed_EvtInfo_INV_IAC_W_ELEC_LO
          OpEventGetEventFailed_GetEventFailed_Event_INV_IAC_W_ELEC_LO: RteEventRef=OpEventGetEventFailed_GetEventFailed_Event_INV_IAC_W_ELEC_LO
          OpEventGetEventFailed_GetEventFailed_EvtInfo_VCEvVddmPropFr08Tioutd_001: RteEventRef=OpEventGetEventFailed_GetEventFailed_EvtInfo_VCEvVddmPropFr08Tioutd_001
          OpEventGetEventFailed_GetEventFailed_Event_VCEvVddmPropFr08Tioutd_001: RteEventRef=OpEventGetEventFailed_GetEventFailed_Event_VCEvVddmPropFr08Tioutd_001
          OpEventGetEventFailed_GetEventFailed_EvtInfo_PS_P12_RES_FLT: RteEventRef=OpEventGetEventFailed_GetEventFailed_EvtInfo_PS_P12_RES_FLT
          OpEventGetEventFailed_GetEventFailed_Event_PS_P12_RES_FLT: RteEventRef=OpEventGetEventFailed_GetEventFailed_Event_PS_P12_RES_FLT
          OpEventGetEventFailed_GetEventFailed_EvtInfo_INV_RSLVR_SIN_RNG_LO: RteEventRef=OpEventGetEventFailed_GetEventFailed_EvtInfo_INV_RSLVR_SIN_RNG_LO
          OpEventGetEventFailed_GetEventFailed_Event_INV_RSLVR_SIN_RNG_LO: RteEventRef=OpEventGetEventFailed_GetEventFailed_Event_INV_RSLVR_SIN_RNG_LO
          OpEventGetEventFailed_GetEventFailed_EvtInfo_CU_TEMP_HW_FLT: RteEventRef=OpEventGetEventFailed_GetEventFailed_EvtInfo_CU_TEMP_HW_FLT
          OpEventGetEventFailed_GetEventFailed_Event_CU_TEMP_HW_FLT: RteEventRef=OpEventGetEventFailed_GetEventFailed_Event_CU_TEMP_HW_FLT
          OpEventGetEventFailed_GetEventFailed_EvtInfo_VCEvEcmPropFr02MgmFr00Tioutd: RteEventRef=OpEventGetEventFailed_GetEventFailed_EvtInfo_VCEvEcmPropFr02MgmFr00Tioutd
          OpEventGetEventFailed_GetEventFailed_Event_VCEvEcmPropFr02MgmFr00Tioutd: RteEventRef=OpEventGetEventFailed_GetEventFailed_Event_VCEvEcmPropFr02MgmFr00Tioutd
          OpEventGetEventFailed_GetEventFailed_EvtInfo_PS_KL15_RNG_HI: RteEventRef=OpEventGetEventFailed_GetEventFailed_EvtInfo_PS_KL15_RNG_HI
          OpEventGetEventFailed_GetEventFailed_Event_PS_KL15_RNG_HI: RteEventRef=OpEventGetEventFailed_GetEventFailed_Event_PS_KL15_RNG_HI
          OpEventGetEventFailed_GetEventFailed_EvtInfo_VCEvVddmPropFr17Tioutd: RteEventRef=OpEventGetEventFailed_GetEventFailed_EvtInfo_VCEvVddmPropFr17Tioutd
          OpEventGetEventFailed_GetEventFailed_Event_VCEvVddmPropFr17Tioutd: RteEventRef=OpEventGetEventFailed_GetEventFailed_Event_VCEvVddmPropFr17Tioutd
          OpEventGetEventFailed_GetEventFailed_EvtInfo_VcEvChkSumCrashStsSafe: RteEventRef=OpEventGetEventFailed_GetEventFailed_EvtInfo_VcEvChkSumCrashStsSafe
          OpEventGetEventFailed_GetEventFailed_Event_VcEvChkSumCrashStsSafe: RteEventRef=OpEventGetEventFailed_GetEventFailed_Event_VcEvChkSumCrashStsSafe
          OpEventGetEventFailed_GetEventFailed_EvtInfo_DiagC_ClutchService: RteEventRef=OpEventGetEventFailed_GetEventFailed_EvtInfo_DiagC_ClutchService
          OpEventGetEventFailed_GetEventFailed_Event_DiagC_ClutchService: RteEventRef=OpEventGetEventFailed_GetEventFailed_Event_DiagC_ClutchService
          OpEventGetEventFailed_GetEventFailed_EvtInfo_INV_EM_STATOR_TEMP_RNG_HI: RteEventRef=OpEventGetEventFailed_GetEventFailed_EvtInfo_INV_EM_STATOR_TEMP_RNG_HI
          OpEventGetEventFailed_GetEventFailed_Event_INV_EM_STATOR_TEMP_RNG_HI: RteEventRef=OpEventGetEventFailed_GetEventFailed_Event_INV_EM_STATOR_TEMP_RNG_HI
          OpEventGetEventFailed_GetEventFailed_EvtInfo_INV_RSLVR_OFFS_OUT_RANG: RteEventRef=OpEventGetEventFailed_GetEventFailed_EvtInfo_INV_RSLVR_OFFS_OUT_RANG
          OpEventGetEventFailed_GetEventFailed_Event_INV_RSLVR_OFFS_OUT_RANG: RteEventRef=OpEventGetEventFailed_GetEventFailed_Event_INV_RSLVR_OFFS_OUT_RANG
          OpEventGetEventFailed_GetEventFailed_EvtInfo_INV_EM_STATOR_TEMP2_RNG_LO: RteEventRef=OpEventGetEventFailed_GetEventFailed_EvtInfo_INV_EM_STATOR_TEMP2_RNG_LO
          OpEventGetEventFailed_GetEventFailed_Event_INV_EM_STATOR_TEMP2_RNG_LO: RteEventRef=OpEventGetEventFailed_GetEventFailed_Event_INV_EM_STATOR_TEMP2_RNG_LO
          OpEventGetEventFailed_GetEventFailed_EvtInfo_VcEvMonISAR: RteEventRef=OpEventGetEventFailed_GetEventFailed_EvtInfo_VcEvMonISAR
          OpEventGetEventFailed_GetEventFailed_Event_VcEvMonISAR: RteEventRef=OpEventGetEventFailed_GetEventFailed_Event_VcEvMonISAR
          OpEventGetEventFailed_GetEventFailed_EvtInfo_GA_BLDC_FLT: RteEventRef=OpEventGetEventFailed_GetEventFailed_EvtInfo_GA_BLDC_FLT
          OpEventGetEventFailed_GetEventFailed_Event_GA_BLDC_FLT: RteEventRef=OpEventGetEventFailed_GetEventFailed_Event_GA_BLDC_FLT
          OpEventGetEventFailed_GetEventFailed_EvtInfo_INV_RSLVR_EXCT_ELEC_OPEN: RteEventRef=OpEventGetEventFailed_GetEventFailed_EvtInfo_INV_RSLVR_EXCT_ELEC_OPEN
          OpEventGetEventFailed_GetEventFailed_Event_INV_RSLVR_EXCT_ELEC_OPEN: RteEventRef=OpEventGetEventFailed_GetEventFailed_Event_INV_RSLVR_EXCT_ELEC_OPEN
          OpEventGetEventFailed_GetEventFailed_EvtInfo_INV_RSLVR_EXCT_PLAUS: RteEventRef=OpEventGetEventFailed_GetEventFailed_EvtInfo_INV_RSLVR_EXCT_PLAUS
          OpEventGetEventFailed_GetEventFailed_Event_INV_RSLVR_EXCT_PLAUS: RteEventRef=OpEventGetEventFailed_GetEventFailed_Event_INV_RSLVR_EXCT_PLAUS
          OpEventGetEventFailed_GetEventFailed_EvtInfo_PS_P15_U_FLT: RteEventRef=OpEventGetEventFailed_GetEventFailed_EvtInfo_PS_P15_U_FLT
          OpEventGetEventFailed_GetEventFailed_Event_PS_P15_U_FLT: RteEventRef=OpEventGetEventFailed_GetEventFailed_Event_PS_P15_U_FLT
          OpEventGetEventFailed_GetEventFailed_EvtInfo_INV_EM_STATOR_TEMP_RNG_SWT: RteEventRef=OpEventGetEventFailed_GetEventFailed_EvtInfo_INV_EM_STATOR_TEMP_RNG_SWT
          OpEventGetEventFailed_GetEventFailed_Event_INV_EM_STATOR_TEMP_RNG_SWT: RteEventRef=OpEventGetEventFailed_GetEventFailed_Event_INV_EM_STATOR_TEMP_RNG_SWT
          OpEventGetEventFailed_GetEventFailed_EvtInfo_INV_UHVDC_OV_SWP: RteEventRef=OpEventGetEventFailed_GetEventFailed_EvtInfo_INV_UHVDC_OV_SWP
          OpEventGetEventFailed_GetEventFailed_Event_INV_UHVDC_OV_SWP: RteEventRef=OpEventGetEventFailed_GetEventFailed_Event_INV_UHVDC_OV_SWP
          OpEventGetEventFailed_GetEventFailed_EvtInfo_AURIX_HW_FLT: RteEventRef=OpEventGetEventFailed_GetEventFailed_EvtInfo_AURIX_HW_FLT
          OpEventGetEventFailed_GetEventFailed_Event_AURIX_HW_FLT: RteEventRef=OpEventGetEventFailed_GetEventFailed_Event_AURIX_HW_FLT
          OpEventGetEventFailed_GetEventFailed_EvtInfo_INV_GATE_DRVR_TOP_HWP: RteEventRef=OpEventGetEventFailed_GetEventFailed_EvtInfo_INV_GATE_DRVR_TOP_HWP
          OpEventGetEventFailed_GetEventFailed_Event_INV_GATE_DRVR_TOP_HWP: RteEventRef=OpEventGetEventFailed_GetEventFailed_Event_INV_GATE_DRVR_TOP_HWP
          OpEventGetEventFailed_GetEventFailed_EvtInfo_INV_ACTV_DCHA_HW: RteEventRef=OpEventGetEventFailed_GetEventFailed_EvtInfo_INV_ACTV_DCHA_HW
          OpEventGetEventFailed_GetEventFailed_Event_INV_ACTV_DCHA_HW: RteEventRef=OpEventGetEventFailed_GetEventFailed_Event_INV_ACTV_DCHA_HW
          OpEventGetEventFailed_GetEventFailed_EvtInfo_INV_IGBT_TEMP_HWP: RteEventRef=OpEventGetEventFailed_GetEventFailed_EvtInfo_INV_IGBT_TEMP_HWP
          OpEventGetEventFailed_GetEventFailed_Event_INV_IGBT_TEMP_HWP: RteEventRef=OpEventGetEventFailed_GetEventFailed_Event_INV_IGBT_TEMP_HWP
          OpEventGetEventFailed_GetEventFailed_EvtInfo_INV_RSLVR_SIN_ELEC_FLT: RteEventRef=OpEventGetEventFailed_GetEventFailed_EvtInfo_INV_RSLVR_SIN_ELEC_FLT
          OpEventGetEventFailed_GetEventFailed_Event_INV_RSLVR_SIN_ELEC_FLT: RteEventRef=OpEventGetEventFailed_GetEventFailed_Event_INV_RSLVR_SIN_ELEC_FLT
          OpEventGetEventFailed_GetEventFailed_EvtInfo_CU_TEMP2_RNG_HI: RteEventRef=OpEventGetEventFailed_GetEventFailed_EvtInfo_CU_TEMP2_RNG_HI
          OpEventGetEventFailed_GetEventFailed_Event_CU_TEMP2_RNG_HI: RteEventRef=OpEventGetEventFailed_GetEventFailed_Event_CU_TEMP2_RNG_HI
          OpEventGetEventFailed_GetEventFailed_EvtInfo_INV_IAC_PHA_LOSS_MPL: RteEventRef=OpEventGetEventFailed_GetEventFailed_EvtInfo_INV_IAC_PHA_LOSS_MPL
          OpEventGetEventFailed_GetEventFailed_Event_INV_IAC_PHA_LOSS_MPL: RteEventRef=OpEventGetEventFailed_GetEventFailed_Event_INV_IAC_PHA_LOSS_MPL
          OpEventGetEventFailed_GetEventFailed_EvtInfo_INV_IAC_U_AMP: RteEventRef=OpEventGetEventFailed_GetEventFailed_EvtInfo_INV_IAC_U_AMP
          OpEventGetEventFailed_GetEventFailed_Event_INV_IAC_U_AMP: RteEventRef=OpEventGetEventFailed_GetEventFailed_Event_INV_IAC_U_AMP
          OpEventGetEventFailed_GetEventFailed_EvtInfo_PSnsr_GRADT_Flt: RteEventRef=OpEventGetEventFailed_GetEventFailed_EvtInfo_PSnsr_GRADT_Flt
          OpEventGetEventFailed_GetEventFailed_Event_PSnsr_GRADT_Flt: RteEventRef=OpEventGetEventFailed_GetEventFailed_Event_PSnsr_GRADT_Flt
          OpEventGetEventFailed_GetEventFailed_EvtInfo_AURIX_WATHDOG_FLT: RteEventRef=OpEventGetEventFailed_GetEventFailed_EvtInfo_AURIX_WATHDOG_FLT
          OpEventGetEventFailed_GetEventFailed_Event_AURIX_WATHDOG_FLT: RteEventRef=OpEventGetEventFailed_GetEventFailed_Event_AURIX_WATHDOG_FLT
          OpEventGetEventFailed_GetEventFailed_EvtInfo_VcEvNodeMisBECM: RteEventRef=OpEventGetEventFailed_GetEventFailed_EvtInfo_VcEvNodeMisBECM
          OpEventGetEventFailed_GetEventFailed_Event_VcEvNodeMisBECM: RteEventRef=OpEventGetEventFailed_GetEventFailed_Event_VcEvNodeMisBECM
          OpEventGetEventFailed_GetEventFailed_EvtInfo_INV_UHVDC_UV_HWP: RteEventRef=OpEventGetEventFailed_GetEventFailed_EvtInfo_INV_UHVDC_UV_HWP
          OpEventGetEventFailed_GetEventFailed_Event_INV_UHVDC_UV_HWP: RteEventRef=OpEventGetEventFailed_GetEventFailed_Event_INV_UHVDC_UV_HWP
          OpEventGetEventFailed_GetEventFailed_EvtInfo_VcEvMonESpd: RteEventRef=OpEventGetEventFailed_GetEventFailed_EvtInfo_VcEvMonESpd
          OpEventGetEventFailed_GetEventFailed_Event_VcEvMonESpd: RteEventRef=OpEventGetEventFailed_GetEventFailed_Event_VcEvMonESpd
          OpEventGetEventFailed_GetEventFailed_EvtInfo_COM_NotConfig: RteEventRef=OpEventGetEventFailed_GetEventFailed_EvtInfo_COM_NotConfig
          OpEventGetEventFailed_GetEventFailed_Event_COM_NotConfig: RteEventRef=OpEventGetEventFailed_GetEventFailed_Event_COM_NotConfig
          OpEventGetEventFailed_GetEventFailed_EvtInfo_INV_RSLVR_SIN_RNG_HI: RteEventRef=OpEventGetEventFailed_GetEventFailed_EvtInfo_INV_RSLVR_SIN_RNG_HI
          OpEventGetEventFailed_GetEventFailed_Event_INV_RSLVR_SIN_RNG_HI: RteEventRef=OpEventGetEventFailed_GetEventFailed_Event_INV_RSLVR_SIN_RNG_HI
          OpEventGetEventFailed_GetEventFailed_EvtInfo_INV_IGBT_TEMP_U_RNG_HI: RteEventRef=OpEventGetEventFailed_GetEventFailed_EvtInfo_INV_IGBT_TEMP_U_RNG_HI
          OpEventGetEventFailed_GetEventFailed_Event_INV_IGBT_TEMP_U_RNG_HI: RteEventRef=OpEventGetEventFailed_GetEventFailed_Event_INV_IGBT_TEMP_U_RNG_HI
          OpEventGetEventFailed_GetEventFailed_EvtInfo_VcEvMonMode_001: RteEventRef=OpEventGetEventFailed_GetEventFailed_EvtInfo_VcEvMonMode_001
          OpEventGetEventFailed_GetEventFailed_Event_VcEvMonMode_001: RteEventRef=OpEventGetEventFailed_GetEventFailed_Event_VcEvMonMode_001
          OpEventGetEventFailed_GetEventFailed_EvtInfo_PA_ACTION_FLT: RteEventRef=OpEventGetEventFailed_GetEventFailed_EvtInfo_PA_ACTION_FLT
          OpEventGetEventFailed_GetEventFailed_Event_PA_ACTION_FLT: RteEventRef=OpEventGetEventFailed_GetEventFailed_Event_PA_ACTION_FLT
          OpEventGetEventFailed_GetEventFailed_EvtInfo_INV_IAC_V_ELEC_HWP: RteEventRef=OpEventGetEventFailed_GetEventFailed_EvtInfo_INV_IAC_V_ELEC_HWP
          OpEventGetEventFailed_GetEventFailed_Event_INV_IAC_V_ELEC_HWP: RteEventRef=OpEventGetEventFailed_GetEventFailed_Event_INV_IAC_V_ELEC_HWP
          OpEventGetEventFailed_GetEventFailed_EvtInfo_CU_TEMP_HW_FLT_001: RteEventRef=OpEventGetEventFailed_GetEventFailed_EvtInfo_CU_TEMP_HW_FLT_001
          OpEventGetEventFailed_GetEventFailed_Event_CU_TEMP_HW_FLT_001: RteEventRef=OpEventGetEventFailed_GetEventFailed_Event_CU_TEMP_HW_FLT_001
          OpEventGetEventFailed_GetEventFailed_EvtInfo_VCC_UnderVoltage: RteEventRef=OpEventGetEventFailed_GetEventFailed_EvtInfo_VCC_UnderVoltage
          OpEventGetEventFailed_GetEventFailed_Event_VCC_UnderVoltage: RteEventRef=OpEventGetEventFailed_GetEventFailed_Event_VCC_UnderVoltage
          OpEventGetEventFailed_GetEventFailed_EvtInfo_VcEvTsttrPlaus: RteEventRef=OpEventGetEventFailed_GetEventFailed_EvtInfo_VcEvTsttrPlaus
          OpEventGetEventFailed_GetEventFailed_Event_VcEvTsttrPlaus: RteEventRef=OpEventGetEventFailed_GetEventFailed_Event_VcEvTsttrPlaus
          OpEventGetEventFailed_GetEventFailed_EvtInfo_INV_RSLVR_EXCT_ELEC_FLT: RteEventRef=OpEventGetEventFailed_GetEventFailed_EvtInfo_INV_RSLVR_EXCT_ELEC_FLT
          OpEventGetEventFailed_GetEventFailed_Event_INV_RSLVR_EXCT_ELEC_FLT: RteEventRef=OpEventGetEventFailed_GetEventFailed_Event_INV_RSLVR_EXCT_ELEC_FLT
          OpEventGetEventFailed_GetEventFailed_EvtInfo_INV_RSLVR_EXCT_RNG_LO: RteEventRef=OpEventGetEventFailed_GetEventFailed_EvtInfo_INV_RSLVR_EXCT_RNG_LO
          OpEventGetEventFailed_GetEventFailed_Event_INV_RSLVR_EXCT_RNG_LO: RteEventRef=OpEventGetEventFailed_GetEventFailed_Event_INV_RSLVR_EXCT_RNG_LO
          OpEventGetEventFailed_GetEventFailed_EvtInfo_INV_EM_STATOR_TEMP2_RNG_HI: RteEventRef=OpEventGetEventFailed_GetEventFailed_EvtInfo_INV_EM_STATOR_TEMP2_RNG_HI
          OpEventGetEventFailed_GetEventFailed_Event_INV_EM_STATOR_TEMP2_RNG_HI: RteEventRef=OpEventGetEventFailed_GetEventFailed_Event_INV_EM_STATOR_TEMP2_RNG_HI
          OpEventGetEventFailed_GetEventFailed_EvtInfo_INV_SHUT_OFF_PAH_START_UP: RteEventRef=OpEventGetEventFailed_GetEventFailed_EvtInfo_INV_SHUT_OFF_PAH_START_UP
          OpEventGetEventFailed_GetEventFailed_Event_INV_SHUT_OFF_PAH_START_UP: RteEventRef=OpEventGetEventFailed_GetEventFailed_Event_INV_SHUT_OFF_PAH_START_UP
          OpEventGetEventFailed_GetEventFailed_EvtInfo_VCEvVddmPropFr08Tioutd: RteEventRef=OpEventGetEventFailed_GetEventFailed_EvtInfo_VCEvVddmPropFr08Tioutd
          OpEventGetEventFailed_GetEventFailed_Event_VCEvVddmPropFr08Tioutd: RteEventRef=OpEventGetEventFailed_GetEventFailed_Event_VCEvVddmPropFr08Tioutd
          OpEventGetEventFailed_GetEventFailed_EvtInfo_INV_RSLVR_EXCT_OC_HWP_001: RteEventRef=OpEventGetEventFailed_GetEventFailed_EvtInfo_INV_RSLVR_EXCT_OC_HWP_001
          OpEventGetEventFailed_GetEventFailed_Event_INV_RSLVR_EXCT_OC_HWP_001: RteEventRef=OpEventGetEventFailed_GetEventFailed_Event_INV_RSLVR_EXCT_OC_HWP_001
          OpEventGetEventFailed_GetEventFailed_EvtInfo_INV_RSLVR_EXCT_OC_HWP_002: RteEventRef=OpEventGetEventFailed_GetEventFailed_EvtInfo_INV_RSLVR_EXCT_OC_HWP_002
          OpEventGetEventFailed_GetEventFailed_Event_INV_RSLVR_EXCT_OC_HWP_002: RteEventRef=OpEventGetEventFailed_GetEventFailed_Event_INV_RSLVR_EXCT_OC_HWP_002
          OpEventGetEventFailed_GetEventFailed_EvtInfo_INV_EM_STATOR_TEMP_ELE_FLT: RteEventRef=OpEventGetEventFailed_GetEventFailed_EvtInfo_INV_EM_STATOR_TEMP_ELE_FLT
          OpEventGetEventFailed_GetEventFailed_Event_INV_EM_STATOR_TEMP_ELE_FLT: RteEventRef=OpEventGetEventFailed_GetEventFailed_Event_INV_EM_STATOR_TEMP_ELE_FLT
          OpEventGetEventFailed_GetEventFailed_EvtInfo_INV_INTERLOCK_FLT: RteEventRef=OpEventGetEventFailed_GetEventFailed_EvtInfo_INV_INTERLOCK_FLT
          OpEventGetEventFailed_GetEventFailed_Event_INV_INTERLOCK_FLT: RteEventRef=OpEventGetEventFailed_GetEventFailed_Event_INV_INTERLOCK_FLT
          OpEventGetEventFailed_GetEventFailed_EvtInfo_Ga_ZeroFindDistanFailure: RteEventRef=OpEventGetEventFailed_GetEventFailed_EvtInfo_Ga_ZeroFindDistanFailure
          OpEventGetEventFailed_GetEventFailed_Event_Ga_ZeroFindDistanFailure: RteEventRef=OpEventGetEventFailed_GetEventFailed_Event_Ga_ZeroFindDistanFailure
          OpEventGetEventFailed_GetEventFailed_EvtInfo_PLOCK_Current_RNG_OUT: RteEventRef=OpEventGetEventFailed_GetEventFailed_EvtInfo_PLOCK_Current_RNG_OUT
          OpEventGetEventFailed_GetEventFailed_Event_PLOCK_Current_RNG_OUT: RteEventRef=OpEventGetEventFailed_GetEventFailed_Event_PLOCK_Current_RNG_OUT
          OpEventGetEventFailed_GetEventFailed_EvtInfo_VCEvVddmPropFr05Tioutd: RteEventRef=OpEventGetEventFailed_GetEventFailed_EvtInfo_VCEvVddmPropFr05Tioutd
          OpEventGetEventFailed_GetEventFailed_Event_VCEvVddmPropFr05Tioutd: RteEventRef=OpEventGetEventFailed_GetEventFailed_Event_VCEvVddmPropFr05Tioutd
          OpEventGetEventFailed_GetEventFailed_EvtInfo_INV_IGBT_TEMP_V_GRDT: RteEventRef=OpEventGetEventFailed_GetEventFailed_EvtInfo_INV_IGBT_TEMP_V_GRDT
          OpEventGetEventFailed_GetEventFailed_Event_INV_IGBT_TEMP_V_GRDT: RteEventRef=OpEventGetEventFailed_GetEventFailed_Event_INV_IGBT_TEMP_V_GRDT
          OpEventGetEventFailed_GetEventFailed_EvtInfo_PS_5V_Fault: RteEventRef=OpEventGetEventFailed_GetEventFailed_EvtInfo_PS_5V_Fault
          OpEventGetEventFailed_GetEventFailed_Event_PS_5V_Fault: RteEventRef=OpEventGetEventFailed_GetEventFailed_Event_PS_5V_Fault
          OpEventGetEventFailed_GetEventFailed_EvtInfo_VcEvCntrCrashStsSafe: RteEventRef=OpEventGetEventFailed_GetEventFailed_EvtInfo_VcEvCntrCrashStsSafe
          OpEventGetEventFailed_GetEventFailed_Event_VcEvCntrCrashStsSafe: RteEventRef=OpEventGetEventFailed_GetEventFailed_Event_VcEvCntrCrashStsSafe
          OpEventGetEventFailed_GetEventFailed_EvtInfo_INV_EM_STATOR_TEMP_GRDT: RteEventRef=OpEventGetEventFailed_GetEventFailed_EvtInfo_INV_EM_STATOR_TEMP_GRDT
          OpEventGetEventFailed_GetEventFailed_Event_INV_EM_STATOR_TEMP_GRDT: RteEventRef=OpEventGetEventFailed_GetEventFailed_Event_INV_EM_STATOR_TEMP_GRDT
          OpEventGetEventFailed_GetEventFailed_EvtInfo_PS_P15_V_FLT: RteEventRef=OpEventGetEventFailed_GetEventFailed_EvtInfo_PS_P15_V_FLT
          OpEventGetEventFailed_GetEventFailed_Event_PS_P15_V_FLT: RteEventRef=OpEventGetEventFailed_GetEventFailed_Event_PS_P15_V_FLT
          OpEventGetEventFailed_GetEventFailed_EvtInfo_INV_EM_STATOR_TEMP_RNG_NOK: RteEventRef=OpEventGetEventFailed_GetEventFailed_EvtInfo_INV_EM_STATOR_TEMP_RNG_NOK
          OpEventGetEventFailed_GetEventFailed_Event_INV_EM_STATOR_TEMP_RNG_NOK: RteEventRef=OpEventGetEventFailed_GetEventFailed_Event_INV_EM_STATOR_TEMP_RNG_NOK
          OpEventGetEventFailed_GetEventFailed_EvtInfo_INV_RSLVR_SIN_RNG_NOK: RteEventRef=OpEventGetEventFailed_GetEventFailed_EvtInfo_INV_RSLVR_SIN_RNG_NOK
          OpEventGetEventFailed_GetEventFailed_Event_INV_RSLVR_SIN_RNG_NOK: RteEventRef=OpEventGetEventFailed_GetEventFailed_Event_INV_RSLVR_SIN_RNG_NOK
          OpEventGetEventFailed_GetEventFailed_EvtInfo_INV_IAC_U_OFFS: RteEventRef=OpEventGetEventFailed_GetEventFailed_EvtInfo_INV_IAC_U_OFFS
          OpEventGetEventFailed_GetEventFailed_Event_INV_IAC_U_OFFS: RteEventRef=OpEventGetEventFailed_GetEventFailed_Event_INV_IAC_U_OFFS
          OpEventGetEventFailed_GetEventFailed_EvtInfo_PS_KL30_BACKUP_FLT: RteEventRef=OpEventGetEventFailed_GetEventFailed_EvtInfo_PS_KL30_BACKUP_FLT
          OpEventGetEventFailed_GetEventFailed_Event_PS_KL30_BACKUP_FLT: RteEventRef=OpEventGetEventFailed_GetEventFailed_Event_PS_KL30_BACKUP_FLT
          OpEventGetEventFailed_GetEventFailed_EvtInfo_INV_IGBT_TEMP_U_RNG_LO: RteEventRef=OpEventGetEventFailed_GetEventFailed_EvtInfo_INV_IGBT_TEMP_U_RNG_LO
          OpEventGetEventFailed_GetEventFailed_Event_INV_IGBT_TEMP_U_RNG_LO: RteEventRef=OpEventGetEventFailed_GetEventFailed_Event_INV_IGBT_TEMP_U_RNG_LO
          OpEventGetEventFailed_GetEventFailed_EvtInfo_INV_EM_STATOR_TEMP_HWP: RteEventRef=OpEventGetEventFailed_GetEventFailed_EvtInfo_INV_EM_STATOR_TEMP_HWP
          OpEventGetEventFailed_GetEventFailed_Event_INV_EM_STATOR_TEMP_HWP: RteEventRef=OpEventGetEventFailed_GetEventFailed_Event_INV_EM_STATOR_TEMP_HWP
          OpEventGetEventFailed_GetEventFailed_EvtInfo_CU_TEMP1_RNG_HI: RteEventRef=OpEventGetEventFailed_GetEventFailed_EvtInfo_CU_TEMP1_RNG_HI
          OpEventGetEventFailed_GetEventFailed_Event_CU_TEMP1_RNG_HI: RteEventRef=OpEventGetEventFailed_GetEventFailed_Event_CU_TEMP1_RNG_HI
          OpEventGetEventFailed_GetEventFailed_EvtInfo_INV_IGBT_TEMP_V_RNG_HI: RteEventRef=OpEventGetEventFailed_GetEventFailed_EvtInfo_INV_IGBT_TEMP_V_RNG_HI
          OpEventGetEventFailed_GetEventFailed_Event_INV_IGBT_TEMP_V_RNG_HI: RteEventRef=OpEventGetEventFailed_GetEventFailed_Event_INV_IGBT_TEMP_V_RNG_HI
          OpEventGetEventFailed_GetEventFailed_EvtInfo_VcEvNodeMisVDDM: RteEventRef=OpEventGetEventFailed_GetEventFailed_EvtInfo_VcEvNodeMisVDDM
          OpEventGetEventFailed_GetEventFailed_Event_VcEvNodeMisVDDM: RteEventRef=OpEventGetEventFailed_GetEventFailed_Event_VcEvNodeMisVDDM
          OpEventGetEventFailed_GetEventFailed_EvtInfo_INV_UHVDC_PLAUS: RteEventRef=OpEventGetEventFailed_GetEventFailed_EvtInfo_INV_UHVDC_PLAUS
          OpEventGetEventFailed_GetEventFailed_Event_INV_UHVDC_PLAUS: RteEventRef=OpEventGetEventFailed_GetEventFailed_Event_INV_UHVDC_PLAUS
          OpEventGetEventFailed_GetEventFailed_EvtInfo_INV_QUIESCENT_FLT: RteEventRef=OpEventGetEventFailed_GetEventFailed_EvtInfo_INV_QUIESCENT_FLT
          OpEventGetEventFailed_GetEventFailed_Event_INV_QUIESCENT_FLT: RteEventRef=OpEventGetEventFailed_GetEventFailed_Event_INV_QUIESCENT_FLT
          OpEventGetEventFailed_GetEventFailed_EvtInfo_INV_RSLVR_EXCT_RNG_HI: RteEventRef=OpEventGetEventFailed_GetEventFailed_EvtInfo_INV_RSLVR_EXCT_RNG_HI
          OpEventGetEventFailed_GetEventFailed_Event_INV_RSLVR_EXCT_RNG_HI: RteEventRef=OpEventGetEventFailed_GetEventFailed_Event_INV_RSLVR_EXCT_RNG_HI
          OpEventGetEventFailed_GetEventFailed_GeneralEvtInfo: RteEventRef=OpEventGetEventFailed_GetEventFailed_GeneralEvtInfo
          OpEventGetEventTested_GetEventTested_EvtInfo_VCEvBecmPropFr01Tioutd: RteEventRef=OpEventGetEventTested_GetEventTested_EvtInfo_VCEvBecmPropFr01Tioutd
          OpEventGetEventTested_GetEventTested_Event_VCEvBecmPropFr01Tioutd: RteEventRef=OpEventGetEventTested_GetEventTested_Event_VCEvBecmPropFr01Tioutd
          OpEventGetEventTested_GetEventTested_EvtInfo_INV_CU_TEMP2_RNG_NOK: RteEventRef=OpEventGetEventTested_GetEventTested_EvtInfo_INV_CU_TEMP2_RNG_NOK
          OpEventGetEventTested_GetEventTested_Event_INV_CU_TEMP2_RNG_NOK: RteEventRef=OpEventGetEventTested_GetEventTested_Event_INV_CU_TEMP2_RNG_NOK
          OpEventGetEventTested_GetEventTested_EvtInfo_COM_Busoff: RteEventRef=OpEventGetEventTested_GetEventTested_EvtInfo_COM_Busoff
          OpEventGetEventTested_GetEventTested_Event_COM_Busoff: RteEventRef=OpEventGetEventTested_GetEventTested_Event_COM_Busoff
          OpEventGetEventTested_GetEventTested_EvtInfo_INV_IMMO_NOKEY: RteEventRef=OpEventGetEventTested_GetEventTested_EvtInfo_INV_IMMO_NOKEY
          OpEventGetEventTested_GetEventTested_Event_INV_IMMO_NOKEY: RteEventRef=OpEventGetEventTested_GetEventTested_Event_INV_IMMO_NOKEY
          OpEventGetEventTested_GetEventTested_EvtInfo_INV_RSLVR_EXCT_OC_HWP: RteEventRef=OpEventGetEventTested_GetEventTested_EvtInfo_INV_RSLVR_EXCT_OC_HWP
          OpEventGetEventTested_GetEventTested_Event_INV_RSLVR_EXCT_OC_HWP: RteEventRef=OpEventGetEventTested_GetEventTested_Event_INV_RSLVR_EXCT_OC_HWP
          OpEventGetEventTested_GetEventTested_EvtInfo_PS_P15_W_FLT: RteEventRef=OpEventGetEventTested_GetEventTested_EvtInfo_PS_P15_W_FLT
          OpEventGetEventTested_GetEventTested_Event_PS_P15_W_FLT: RteEventRef=OpEventGetEventTested_GetEventTested_Event_PS_P15_W_FLT
          OpEventGetEventTested_GetEventTested_EvtInfo_INV_IAC_PLAUS_SUM: RteEventRef=OpEventGetEventTested_GetEventTested_EvtInfo_INV_IAC_PLAUS_SUM
          OpEventGetEventTested_GetEventTested_Event_INV_IAC_PLAUS_SUM: RteEventRef=OpEventGetEventTested_GetEventTested_Event_INV_IAC_PLAUS_SUM
          OpEventGetEventTested_GetEventTested_EvtInfo_PA_ELE_FLT: RteEventRef=OpEventGetEventTested_GetEventTested_EvtInfo_PA_ELE_FLT
          OpEventGetEventTested_GetEventTested_Event_PA_ELE_FLT: RteEventRef=OpEventGetEventTested_GetEventTested_Event_PA_ELE_FLT
          OpEventGetEventTested_GetEventTested_EvtInfo_CU_TEMP_GRDT: RteEventRef=OpEventGetEventTested_GetEventTested_EvtInfo_CU_TEMP_GRDT
          OpEventGetEventTested_GetEventTested_Event_CU_TEMP_GRDT: RteEventRef=OpEventGetEventTested_GetEventTested_Event_CU_TEMP_GRDT
          OpEventGetEventTested_GetEventTested_EvtInfo_INV_IGBT_TEMP_V_PLAUS: RteEventRef=OpEventGetEventTested_GetEventTested_EvtInfo_INV_IGBT_TEMP_V_PLAUS
          OpEventGetEventTested_GetEventTested_Event_INV_IGBT_TEMP_V_PLAUS: RteEventRef=OpEventGetEventTested_GetEventTested_Event_INV_IGBT_TEMP_V_PLAUS
          OpEventGetEventTested_GetEventTested_EvtInfo_Ga_GAEngageFailure: RteEventRef=OpEventGetEventTested_GetEventTested_EvtInfo_Ga_GAEngageFailure
          OpEventGetEventTested_GetEventTested_Event_Ga_GAEngageFailure: RteEventRef=OpEventGetEventTested_GetEventTested_Event_Ga_GAEngageFailure
          OpEventGetEventTested_GetEventTested_EvtInfo_INV_IAC_W_RNG_LO: RteEventRef=OpEventGetEventTested_GetEventTested_EvtInfo_INV_IAC_W_RNG_LO
          OpEventGetEventTested_GetEventTested_Event_INV_IAC_W_RNG_LO: RteEventRef=OpEventGetEventTested_GetEventTested_Event_INV_IAC_W_RNG_LO
          OpEventGetEventTested_GetEventTested_EvtInfo_PS_WhlSnsr_Vltg_FLT: RteEventRef=OpEventGetEventTested_GetEventTested_EvtInfo_PS_WhlSnsr_Vltg_FLT
          OpEventGetEventTested_GetEventTested_Event_PS_WhlSnsr_Vltg_FLT: RteEventRef=OpEventGetEventTested_GetEventTested_Event_PS_WhlSnsr_Vltg_FLT
          OpEventGetEventTested_GetEventTested_EvtInfo_VCEvEcmPropFr02Tioutd: RteEventRef=OpEventGetEventTested_GetEventTested_EvtInfo_VCEvEcmPropFr02Tioutd
          OpEventGetEventTested_GetEventTested_Event_VCEvEcmPropFr02Tioutd: RteEventRef=OpEventGetEventTested_GetEventTested_Event_VCEvEcmPropFr02Tioutd
          OpEventGetEventTested_GetEventTested_EvtInfo_Ga_TmSpdSyncFailed: RteEventRef=OpEventGetEventTested_GetEventTested_EvtInfo_Ga_TmSpdSyncFailed
          OpEventGetEventTested_GetEventTested_Event_Ga_TmSpdSyncFailed: RteEventRef=OpEventGetEventTested_GetEventTested_Event_Ga_TmSpdSyncFailed
          OpEventGetEventTested_GetEventTested_EvtInfo_INV_RSLVR_EXCT_ELEC_LO: RteEventRef=OpEventGetEventTested_GetEventTested_EvtInfo_INV_RSLVR_EXCT_ELEC_LO
          OpEventGetEventTested_GetEventTested_Event_INV_RSLVR_EXCT_ELEC_LO: RteEventRef=OpEventGetEventTested_GetEventTested_Event_INV_RSLVR_EXCT_ELEC_LO
          OpEventGetEventTested_GetEventTested_EvtInfo_VCEvEcmPropXevFr06Tioutd: RteEventRef=OpEventGetEventTested_GetEventTested_EvtInfo_VCEvEcmPropXevFr06Tioutd
          OpEventGetEventTested_GetEventTested_Event_VCEvEcmPropXevFr06Tioutd: RteEventRef=OpEventGetEventTested_GetEventTested_Event_VCEvEcmPropXevFr06Tioutd
          OpEventGetEventTested_GetEventTested_EvtInfo_VcEvCntrWhlMotSysTqAllwd: RteEventRef=OpEventGetEventTested_GetEventTested_EvtInfo_VcEvCntrWhlMotSysTqAllwd
          OpEventGetEventTested_GetEventTested_Event_VcEvCntrWhlMotSysTqAllwd: RteEventRef=OpEventGetEventTested_GetEventTested_Event_VcEvCntrWhlMotSysTqAllwd
          OpEventGetEventTested_GetEventTested_EvtInfo_INV_UHVDC_1_ELEC_HI: RteEventRef=OpEventGetEventTested_GetEventTested_EvtInfo_INV_UHVDC_1_ELEC_HI
          OpEventGetEventTested_GetEventTested_Event_INV_UHVDC_1_ELEC_HI: RteEventRef=OpEventGetEventTested_GetEventTested_Event_INV_UHVDC_1_ELEC_HI
          OpEventGetEventTested_GetEventTested_EvtInfo_INV_EM_STATOR_TEMP2_ELE_FLT: RteEventRef=OpEventGetEventTested_GetEventTested_EvtInfo_INV_EM_STATOR_TEMP2_ELE_FLT
          OpEventGetEventTested_GetEventTested_Event_INV_EM_STATOR_TEMP2_ELE_FLT: RteEventRef=OpEventGetEventTested_GetEventTested_Event_INV_EM_STATOR_TEMP2_ELE_FLT
          OpEventGetEventTested_GetEventTested_EvtInfo_AURIX_RST_SNG: RteEventRef=OpEventGetEventTested_GetEventTested_EvtInfo_AURIX_RST_SNG
          OpEventGetEventTested_GetEventTested_Event_AURIX_RST_SNG: RteEventRef=OpEventGetEventTested_GetEventTested_Event_AURIX_RST_SNG
          OpEventGetEventTested_GetEventTested_EvtInfo_VCEvEcmPropFr24MgmFr01Tioutd: RteEventRef=OpEventGetEventTested_GetEventTested_EvtInfo_VCEvEcmPropFr24MgmFr01Tioutd
          OpEventGetEventTested_GetEventTested_Event_VCEvEcmPropFr24MgmFr01Tioutd: RteEventRef=OpEventGetEventTested_GetEventTested_Event_VCEvEcmPropFr24MgmFr01Tioutd
          OpEventGetEventTested_GetEventTested_EvtInfo_INV_RSLVR_COS_ELEC_OPEN: RteEventRef=OpEventGetEventTested_GetEventTested_EvtInfo_INV_RSLVR_COS_ELEC_OPEN
          OpEventGetEventTested_GetEventTested_Event_INV_RSLVR_COS_ELEC_OPEN: RteEventRef=OpEventGetEventTested_GetEventTested_Event_INV_RSLVR_COS_ELEC_OPEN
          OpEventGetEventTested_GetEventTested_EvtInfo_INV_IAC_V_ELEC_LO: RteEventRef=OpEventGetEventTested_GetEventTested_EvtInfo_INV_IAC_V_ELEC_LO
          OpEventGetEventTested_GetEventTested_Event_INV_IAC_V_ELEC_LO: RteEventRef=OpEventGetEventTested_GetEventTested_Event_INV_IAC_V_ELEC_LO
          OpEventGetEventTested_GetEventTested_EvtInfo_INV_IAC_W_OFFS: RteEventRef=OpEventGetEventTested_GetEventTested_EvtInfo_INV_IAC_W_OFFS
          OpEventGetEventTested_GetEventTested_Event_INV_IAC_W_OFFS: RteEventRef=OpEventGetEventTested_GetEventTested_Event_INV_IAC_W_OFFS
          OpEventGetEventTested_GetEventTested_EvtInfo_INV_EM_STATOR_TEMP2_GRDT: RteEventRef=OpEventGetEventTested_GetEventTested_EvtInfo_INV_EM_STATOR_TEMP2_GRDT
          OpEventGetEventTested_GetEventTested_Event_INV_EM_STATOR_TEMP2_GRDT: RteEventRef=OpEventGetEventTested_GetEventTested_Event_INV_EM_STATOR_TEMP2_GRDT
          OpEventGetEventTested_GetEventTested_EvtInfo_INV_EM_OVRSPD_HWP: RteEventRef=OpEventGetEventTested_GetEventTested_EvtInfo_INV_EM_OVRSPD_HWP
          OpEventGetEventTested_GetEventTested_Event_INV_EM_OVRSPD_HWP: RteEventRef=OpEventGetEventTested_GetEventTested_Event_INV_EM_OVRSPD_HWP
          OpEventGetEventTested_GetEventTested_EvtInfo_CU_TEMP_HWP: RteEventRef=OpEventGetEventTested_GetEventTested_EvtInfo_CU_TEMP_HWP
          OpEventGetEventTested_GetEventTested_Event_CU_TEMP_HWP: RteEventRef=OpEventGetEventTested_GetEventTested_Event_CU_TEMP_HWP
          OpEventGetEventTested_GetEventTested_EvtInfo_INV_UHVDC_1_RNG_HI: RteEventRef=OpEventGetEventTested_GetEventTested_EvtInfo_INV_UHVDC_1_RNG_HI
          OpEventGetEventTested_GetEventTested_Event_INV_UHVDC_1_RNG_HI: RteEventRef=OpEventGetEventTested_GetEventTested_Event_INV_UHVDC_1_RNG_HI
          OpEventGetEventTested_GetEventTested_EvtInfo_VcEvEMPerfPlaus: RteEventRef=OpEventGetEventTested_GetEventTested_EvtInfo_VcEvEMPerfPlaus
          OpEventGetEventTested_GetEventTested_Event_VcEvEMPerfPlaus: RteEventRef=OpEventGetEventTested_GetEventTested_Event_VcEvEMPerfPlaus
          OpEventGetEventTested_GetEventTested_EvtInfo_VCEvVddmPropFr18Tioutd: RteEventRef=OpEventGetEventTested_GetEventTested_EvtInfo_VCEvVddmPropFr18Tioutd
          OpEventGetEventTested_GetEventTested_Event_VCEvVddmPropFr18Tioutd: RteEventRef=OpEventGetEventTested_GetEventTested_Event_VCEvVddmPropFr18Tioutd
          OpEventGetEventTested_GetEventTested_EvtInfo_INV_IAC_U_ELEC_HWP: RteEventRef=OpEventGetEventTested_GetEventTested_EvtInfo_INV_IAC_U_ELEC_HWP
          OpEventGetEventTested_GetEventTested_Event_INV_IAC_U_ELEC_HWP: RteEventRef=OpEventGetEventTested_GetEventTested_Event_INV_IAC_U_ELEC_HWP
          OpEventGetEventTested_GetEventTested_EvtInfo_VCEvVddmPropFr15Tioutd: RteEventRef=OpEventGetEventTested_GetEventTested_EvtInfo_VCEvVddmPropFr15Tioutd
          OpEventGetEventTested_GetEventTested_Event_VCEvVddmPropFr15Tioutd: RteEventRef=OpEventGetEventTested_GetEventTested_Event_VCEvVddmPropFr15Tioutd
          OpEventGetEventTested_GetEventTested_EvtInfo_Ga_GADisengageFailure: RteEventRef=OpEventGetEventTested_GetEventTested_EvtInfo_Ga_GADisengageFailure
          OpEventGetEventTested_GetEventTested_Event_Ga_GADisengageFailure: RteEventRef=OpEventGetEventTested_GetEventTested_Event_Ga_GADisengageFailure
          OpEventGetEventTested_GetEventTested_EvtInfo_CU_TEMP2_RNG_LO: RteEventRef=OpEventGetEventTested_GetEventTested_EvtInfo_CU_TEMP2_RNG_LO
          OpEventGetEventTested_GetEventTested_Event_CU_TEMP2_RNG_LO: RteEventRef=OpEventGetEventTested_GetEventTested_Event_CU_TEMP2_RNG_LO
          OpEventGetEventTested_GetEventTested_EvtInfo_INV_RSLVR_SIN_ELEC_OPEN: RteEventRef=OpEventGetEventTested_GetEventTested_EvtInfo_INV_RSLVR_SIN_ELEC_OPEN
          OpEventGetEventTested_GetEventTested_Event_INV_RSLVR_SIN_ELEC_OPEN: RteEventRef=OpEventGetEventTested_GetEventTested_Event_INV_RSLVR_SIN_ELEC_OPEN
          OpEventGetEventTested_GetEventTested_EvtInfo_VcEvChkSum: RteEventRef=OpEventGetEventTested_GetEventTested_EvtInfo_VcEvChkSum
          OpEventGetEventTested_GetEventTested_Event_VcEvChkSum: RteEventRef=OpEventGetEventTested_GetEventTested_Event_VcEvChkSum
          OpEventGetEventTested_GetEventTested_EvtInfo_PS_P5_UC_FLT: RteEventRef=OpEventGetEventTested_GetEventTested_EvtInfo_PS_P5_UC_FLT
          OpEventGetEventTested_GetEventTested_Event_PS_P5_UC_FLT: RteEventRef=OpEventGetEventTested_GetEventTested_Event_PS_P5_UC_FLT
          OpEventGetEventTested_GetEventTested_EvtInfo_INV_RSLVR_COS_ELEC_FLT: RteEventRef=OpEventGetEventTested_GetEventTested_EvtInfo_INV_RSLVR_COS_ELEC_FLT
          OpEventGetEventTested_GetEventTested_Event_INV_RSLVR_COS_ELEC_FLT: RteEventRef=OpEventGetEventTested_GetEventTested_Event_INV_RSLVR_COS_ELEC_FLT
          OpEventGetEventTested_GetEventTested_EvtInfo_INV_IAC_W_RNG_HI: RteEventRef=OpEventGetEventTested_GetEventTested_EvtInfo_INV_IAC_W_RNG_HI
          OpEventGetEventTested_GetEventTested_Event_INV_IAC_W_RNG_HI: RteEventRef=OpEventGetEventTested_GetEventTested_Event_INV_IAC_W_RNG_HI
          OpEventGetEventTested_GetEventTested_EvtInfo_PS_ECUSUPPLY_HIGH: RteEventRef=OpEventGetEventTested_GetEventTested_EvtInfo_PS_ECUSUPPLY_HIGH
          OpEventGetEventTested_GetEventTested_Event_PS_ECUSUPPLY_HIGH: RteEventRef=OpEventGetEventTested_GetEventTested_Event_PS_ECUSUPPLY_HIGH
          OpEventGetEventTested_GetEventTested_EvtInfo_VCEvEcmPropFr05Tioutd: RteEventRef=OpEventGetEventTested_GetEventTested_EvtInfo_VCEvEcmPropFr05Tioutd
          OpEventGetEventTested_GetEventTested_Event_VCEvEcmPropFr05Tioutd: RteEventRef=OpEventGetEventTested_GetEventTested_Event_VCEvEcmPropFr05Tioutd
          OpEventGetEventTested_GetEventTested_EvtInfo_PS_ECUSUPPLY_LOW: RteEventRef=OpEventGetEventTested_GetEventTested_EvtInfo_PS_ECUSUPPLY_LOW
          OpEventGetEventTested_GetEventTested_Event_PS_ECUSUPPLY_LOW: RteEventRef=OpEventGetEventTested_GetEventTested_Event_PS_ECUSUPPLY_LOW
          OpEventGetEventTested_GetEventTested_EvtInfo_VcEvChkSumHvSysRlySts: RteEventRef=OpEventGetEventTested_GetEventTested_EvtInfo_VcEvChkSumHvSysRlySts
          OpEventGetEventTested_GetEventTested_Event_VcEvChkSumHvSysRlySts: RteEventRef=OpEventGetEventTested_GetEventTested_Event_VcEvChkSumHvSysRlySts
          OpEventGetEventTested_GetEventTested_EvtInfo_VcEvMonMode: RteEventRef=OpEventGetEventTested_GetEventTested_EvtInfo_VcEvMonMode
          OpEventGetEventTested_GetEventTested_Event_VcEvMonMode: RteEventRef=OpEventGetEventTested_GetEventTested_Event_VcEvMonMode
          OpEventGetEventTested_GetEventTested_EvtInfo_INV_IAC_OC_SWP: RteEventRef=OpEventGetEventTested_GetEventTested_EvtInfo_INV_IAC_OC_SWP
          OpEventGetEventTested_GetEventTested_Event_INV_IAC_OC_SWP: RteEventRef=OpEventGetEventTested_GetEventTested_Event_INV_IAC_OC_SWP
          OpEventGetEventTested_GetEventTested_EvtInfo_INV_IMMO_AUTHFAIL: RteEventRef=OpEventGetEventTested_GetEventTested_EvtInfo_INV_IMMO_AUTHFAIL
          OpEventGetEventTested_GetEventTested_Event_INV_IMMO_AUTHFAIL: RteEventRef=OpEventGetEventTested_GetEventTested_Event_INV_IMMO_AUTHFAIL
          OpEventGetEventTested_GetEventTested_EvtInfo_PA_OpenCirc_FLT: RteEventRef=OpEventGetEventTested_GetEventTested_EvtInfo_PA_OpenCirc_FLT
          OpEventGetEventTested_GetEventTested_Event_PA_OpenCirc_FLT: RteEventRef=OpEventGetEventTested_GetEventTested_Event_PA_OpenCirc_FLT
          OpEventGetEventTested_GetEventTested_EvtInfo_INV_IAC_V_ELEC_HI: RteEventRef=OpEventGetEventTested_GetEventTested_EvtInfo_INV_IAC_V_ELEC_HI
          OpEventGetEventTested_GetEventTested_Event_INV_IAC_V_ELEC_HI: RteEventRef=OpEventGetEventTested_GetEventTested_Event_INV_IAC_V_ELEC_HI
          OpEventGetEventTested_GetEventTested_EvtInfo_VCEvEcmPropFr04Tioutd: RteEventRef=OpEventGetEventTested_GetEventTested_EvtInfo_VCEvEcmPropFr04Tioutd
          OpEventGetEventTested_GetEventTested_Event_VCEvEcmPropFr04Tioutd: RteEventRef=OpEventGetEventTested_GetEventTested_Event_VCEvEcmPropFr04Tioutd
          OpEventGetEventTested_GetEventTested_EvtInfo_VcEvMonTrqActPlaus: RteEventRef=OpEventGetEventTested_GetEventTested_EvtInfo_VcEvMonTrqActPlaus
          OpEventGetEventTested_GetEventTested_Event_VcEvMonTrqActPlaus: RteEventRef=OpEventGetEventTested_GetEventTested_Event_VcEvMonTrqActPlaus
          OpEventGetEventTested_GetEventTested_EvtInfo_VcEvMonTrqAct: RteEventRef=OpEventGetEventTested_GetEventTested_EvtInfo_VcEvMonTrqAct
          OpEventGetEventTested_GetEventTested_Event_VcEvMonTrqAct: RteEventRef=OpEventGetEventTested_GetEventTested_Event_VcEvMonTrqAct
          OpEventGetEventTested_GetEventTested_EvtInfo_INV_RSLVR_COS_ELEC_LO: RteEventRef=OpEventGetEventTested_GetEventTested_EvtInfo_INV_RSLVR_COS_ELEC_LO
          OpEventGetEventTested_GetEventTested_Event_INV_RSLVR_COS_ELEC_LO: RteEventRef=OpEventGetEventTested_GetEventTested_Event_INV_RSLVR_COS_ELEC_LO
          OpEventGetEventTested_GetEventTested_EvtInfo_INV_COOLT_INLET_TEMP_HWP: RteEventRef=OpEventGetEventTested_GetEventTested_EvtInfo_INV_COOLT_INLET_TEMP_HWP
          OpEventGetEventTested_GetEventTested_Event_INV_COOLT_INLET_TEMP_HWP: RteEventRef=OpEventGetEventTested_GetEventTested_Event_INV_COOLT_INLET_TEMP_HWP
          OpEventGetEventTested_GetEventTested_EvtInfo_VCEvEcmPropFr11Tioutd: RteEventRef=OpEventGetEventTested_GetEventTested_EvtInfo_VCEvEcmPropFr11Tioutd
          OpEventGetEventTested_GetEventTested_Event_VCEvEcmPropFr11Tioutd: RteEventRef=OpEventGetEventTested_GetEventTested_Event_VCEvEcmPropFr11Tioutd
          OpEventGetEventTested_GetEventTested_EvtInfo_PS_KL30_RNG_HI: RteEventRef=OpEventGetEventTested_GetEventTested_EvtInfo_PS_KL30_RNG_HI
          OpEventGetEventTested_GetEventTested_Event_PS_KL30_RNG_HI: RteEventRef=OpEventGetEventTested_GetEventTested_Event_PS_KL30_RNG_HI
          OpEventGetEventTested_GetEventTested_EvtInfo_INV_IAC_OC_HWP: RteEventRef=OpEventGetEventTested_GetEventTested_EvtInfo_INV_IAC_OC_HWP
          OpEventGetEventTested_GetEventTested_Event_INV_IAC_OC_HWP: RteEventRef=OpEventGetEventTested_GetEventTested_Event_INV_IAC_OC_HWP
          OpEventGetEventTested_GetEventTested_EvtInfo_INV_RSLVR_COS_RNG_HI: RteEventRef=OpEventGetEventTested_GetEventTested_EvtInfo_INV_RSLVR_COS_RNG_HI
          OpEventGetEventTested_GetEventTested_Event_INV_RSLVR_COS_RNG_HI: RteEventRef=OpEventGetEventTested_GetEventTested_Event_INV_RSLVR_COS_RNG_HI
          OpEventGetEventTested_GetEventTested_EvtInfo_INV_IAC_U_ELEC_HI: RteEventRef=OpEventGetEventTested_GetEventTested_EvtInfo_INV_IAC_U_ELEC_HI
          OpEventGetEventTested_GetEventTested_Event_INV_IAC_U_ELEC_HI: RteEventRef=OpEventGetEventTested_GetEventTested_Event_INV_IAC_U_ELEC_HI
          OpEventGetEventTested_GetEventTested_EvtInfo_INV_IAC_V_RNG_LO: RteEventRef=OpEventGetEventTested_GetEventTested_EvtInfo_INV_IAC_V_RNG_LO
          OpEventGetEventTested_GetEventTested_Event_INV_IAC_V_RNG_LO: RteEventRef=OpEventGetEventTested_GetEventTested_Event_INV_IAC_V_RNG_LO
          OpEventGetEventTested_GetEventTested_EvtInfo_INV_IAC_U_RNG_HI: RteEventRef=OpEventGetEventTested_GetEventTested_EvtInfo_INV_IAC_U_RNG_HI
          OpEventGetEventTested_GetEventTested_Event_INV_IAC_U_RNG_HI: RteEventRef=OpEventGetEventTested_GetEventTested_Event_INV_IAC_U_RNG_HI
          OpEventGetEventTested_GetEventTested_EvtInfo_VCEvEcmPropFr25Tioutd: RteEventRef=OpEventGetEventTested_GetEventTested_EvtInfo_VCEvEcmPropFr25Tioutd
          OpEventGetEventTested_GetEventTested_Event_VCEvEcmPropFr25Tioutd: RteEventRef=OpEventGetEventTested_GetEventTested_Event_VCEvEcmPropFr25Tioutd
          OpEventGetEventTested_GetEventTested_EvtInfo_INV_IGBT_TEMP_W_RNG_LO: RteEventRef=OpEventGetEventTested_GetEventTested_EvtInfo_INV_IGBT_TEMP_W_RNG_LO
          OpEventGetEventTested_GetEventTested_Event_INV_IGBT_TEMP_W_RNG_LO: RteEventRef=OpEventGetEventTested_GetEventTested_Event_INV_IGBT_TEMP_W_RNG_LO
          OpEventGetEventTested_GetEventTested_EvtInfo_PSnsr_RNG_NOK: RteEventRef=OpEventGetEventTested_GetEventTested_EvtInfo_PSnsr_RNG_NOK
          OpEventGetEventTested_GetEventTested_Event_PSnsr_RNG_NOK: RteEventRef=OpEventGetEventTested_GetEventTested_Event_PSnsr_RNG_NOK
          OpEventGetEventTested_GetEventTested_EvtInfo_INV_RSLVR_COS_RNG_NOK: RteEventRef=OpEventGetEventTested_GetEventTested_EvtInfo_INV_RSLVR_COS_RNG_NOK
          OpEventGetEventTested_GetEventTested_Event_INV_RSLVR_COS_RNG_NOK: RteEventRef=OpEventGetEventTested_GetEventTested_Event_INV_RSLVR_COS_RNG_NOK
          OpEventGetEventTested_GetEventTested_EvtInfo_PS_DRVB_Fault: RteEventRef=OpEventGetEventTested_GetEventTested_EvtInfo_PS_DRVB_Fault
          OpEventGetEventTested_GetEventTested_Event_PS_DRVB_Fault: RteEventRef=OpEventGetEventTested_GetEventTested_Event_PS_DRVB_Fault
          OpEventGetEventTested_GetEventTested_EvtInfo_INV_CU_TEMP1_RNG_NOK: RteEventRef=OpEventGetEventTested_GetEventTested_EvtInfo_INV_CU_TEMP1_RNG_NOK
          OpEventGetEventTested_GetEventTested_Event_INV_CU_TEMP1_RNG_NOK: RteEventRef=OpEventGetEventTested_GetEventTested_Event_INV_CU_TEMP1_RNG_NOK
          OpEventGetEventTested_GetEventTested_EvtInfo_VcEvCntr: RteEventRef=OpEventGetEventTested_GetEventTested_EvtInfo_VcEvCntr
          OpEventGetEventTested_GetEventTested_Event_VcEvCntr: RteEventRef=OpEventGetEventTested_GetEventTested_Event_VcEvCntr
          OpEventGetEventTested_GetEventTested_EvtInfo_INV_RSLVR_SIN_AMP: RteEventRef=OpEventGetEventTested_GetEventTested_EvtInfo_INV_RSLVR_SIN_AMP
          OpEventGetEventTested_GetEventTested_Event_INV_RSLVR_SIN_AMP: RteEventRef=OpEventGetEventTested_GetEventTested_Event_INV_RSLVR_SIN_AMP
          OpEventGetEventTested_GetEventTested_EvtInfo_INV_UHVDC_2_RNG_HI: RteEventRef=OpEventGetEventTested_GetEventTested_EvtInfo_INV_UHVDC_2_RNG_HI
          OpEventGetEventTested_GetEventTested_Event_INV_UHVDC_2_RNG_HI: RteEventRef=OpEventGetEventTested_GetEventTested_Event_INV_UHVDC_2_RNG_HI
          OpEventGetEventTested_GetEventTested_EvtInfo_INV_IGBT_TEMP_U_GRDT: RteEventRef=OpEventGetEventTested_GetEventTested_EvtInfo_INV_IGBT_TEMP_U_GRDT
          OpEventGetEventTested_GetEventTested_Event_INV_IGBT_TEMP_U_GRDT: RteEventRef=OpEventGetEventTested_GetEventTested_Event_INV_IGBT_TEMP_U_GRDT
          OpEventGetEventTested_GetEventTested_EvtInfo_MON_TQ_PLAUS_PWR_MDL: RteEventRef=OpEventGetEventTested_GetEventTested_EvtInfo_MON_TQ_PLAUS_PWR_MDL
          OpEventGetEventTested_GetEventTested_Event_MON_TQ_PLAUS_PWR_MDL: RteEventRef=OpEventGetEventTested_GetEventTested_Event_MON_TQ_PLAUS_PWR_MDL
          OpEventGetEventTested_GetEventTested_EvtInfo_INV_IGBT_TEMP_W_PLAUS: RteEventRef=OpEventGetEventTested_GetEventTested_EvtInfo_INV_IGBT_TEMP_W_PLAUS
          OpEventGetEventTested_GetEventTested_Event_INV_IGBT_TEMP_W_PLAUS: RteEventRef=OpEventGetEventTested_GetEventTested_Event_INV_IGBT_TEMP_W_PLAUS
          OpEventGetEventTested_GetEventTested_EvtInfo_PS_BLDC_UV_FLT: RteEventRef=OpEventGetEventTested_GetEventTested_EvtInfo_PS_BLDC_UV_FLT
          OpEventGetEventTested_GetEventTested_Event_PS_BLDC_UV_FLT: RteEventRef=OpEventGetEventTested_GetEventTested_Event_PS_BLDC_UV_FLT
          OpEventGetEventTested_GetEventTested_EvtInfo_INV_IAC_V_OFFS: RteEventRef=OpEventGetEventTested_GetEventTested_EvtInfo_INV_IAC_V_OFFS
          OpEventGetEventTested_GetEventTested_Event_INV_IAC_V_OFFS: RteEventRef=OpEventGetEventTested_GetEventTested_Event_INV_IAC_V_OFFS
          OpEventGetEventTested_GetEventTested_EvtInfo_INV_RSLVR_EXCT_FREQ_RNG_NOK: RteEventRef=OpEventGetEventTested_GetEventTested_EvtInfo_INV_RSLVR_EXCT_FREQ_RNG_NOK
          OpEventGetEventTested_GetEventTested_Event_INV_RSLVR_EXCT_FREQ_RNG_NOK: RteEventRef=OpEventGetEventTested_GetEventTested_Event_INV_RSLVR_EXCT_FREQ_RNG_NOK
          OpEventGetEventTested_GetEventTested_EvtInfo_PS_KL30_RNG_LO: RteEventRef=OpEventGetEventTested_GetEventTested_EvtInfo_PS_KL30_RNG_LO
          OpEventGetEventTested_GetEventTested_Event_PS_KL30_RNG_LO: RteEventRef=OpEventGetEventTested_GetEventTested_Event_PS_KL30_RNG_LO
          OpEventGetEventTested_GetEventTested_EvtInfo_INV_RSLVR_COS_RNG_LO: RteEventRef=OpEventGetEventTested_GetEventTested_EvtInfo_INV_RSLVR_COS_RNG_LO
          OpEventGetEventTested_GetEventTested_Event_INV_RSLVR_COS_RNG_LO: RteEventRef=OpEventGetEventTested_GetEventTested_Event_INV_RSLVR_COS_RNG_LO
          OpEventGetEventTested_GetEventTested_EvtInfo_PSnsr_ELE_FLT: RteEventRef=OpEventGetEventTested_GetEventTested_EvtInfo_PSnsr_ELE_FLT
          OpEventGetEventTested_GetEventTested_Event_PSnsr_ELE_FLT: RteEventRef=OpEventGetEventTested_GetEventTested_Event_PSnsr_ELE_FLT
          OpEventGetEventTested_GetEventTested_EvtInfo_INV_RSLVR_SIN_COS_PLAUS_AMP: RteEventRef=OpEventGetEventTested_GetEventTested_EvtInfo_INV_RSLVR_SIN_COS_PLAUS_AMP
          OpEventGetEventTested_GetEventTested_Event_INV_RSLVR_SIN_COS_PLAUS_AMP: RteEventRef=OpEventGetEventTested_GetEventTested_Event_INV_RSLVR_SIN_COS_PLAUS_AMP
          OpEventGetEventTested_GetEventTested_EvtInfo_INV_IAC_U_ELEC_LO: RteEventRef=OpEventGetEventTested_GetEventTested_EvtInfo_INV_IAC_U_ELEC_LO
          OpEventGetEventTested_GetEventTested_Event_INV_IAC_U_ELEC_LO: RteEventRef=OpEventGetEventTested_GetEventTested_Event_INV_IAC_U_ELEC_LO
          OpEventGetEventTested_GetEventTested_EvtInfo_INV_RSLVR_EXCT_ELEC_HI: RteEventRef=OpEventGetEventTested_GetEventTested_EvtInfo_INV_RSLVR_EXCT_ELEC_HI
          OpEventGetEventTested_GetEventTested_Event_INV_RSLVR_EXCT_ELEC_HI: RteEventRef=OpEventGetEventTested_GetEventTested_Event_INV_RSLVR_EXCT_ELEC_HI
          OpEventGetEventTested_GetEventTested_EvtInfo_INV_IAC_U_RNG_LO: RteEventRef=OpEventGetEventTested_GetEventTested_EvtInfo_INV_IAC_U_RNG_LO
          OpEventGetEventTested_GetEventTested_Event_INV_IAC_U_RNG_LO: RteEventRef=OpEventGetEventTested_GetEventTested_Event_INV_IAC_U_RNG_LO
          OpEventGetEventTested_GetEventTested_EvtInfo_INV_IAC_V_RNG_HI: RteEventRef=OpEventGetEventTested_GetEventTested_EvtInfo_INV_IAC_V_RNG_HI
          OpEventGetEventTested_GetEventTested_Event_INV_IAC_V_RNG_HI: RteEventRef=OpEventGetEventTested_GetEventTested_Event_INV_IAC_V_RNG_HI
          OpEventGetEventTested_GetEventTested_EvtInfo_INV_IGBT_TEMP_U_PLAUS: RteEventRef=OpEventGetEventTested_GetEventTested_EvtInfo_INV_IGBT_TEMP_U_PLAUS
          OpEventGetEventTested_GetEventTested_Event_INV_IGBT_TEMP_U_PLAUS: RteEventRef=OpEventGetEventTested_GetEventTested_Event_INV_IGBT_TEMP_U_PLAUS
          OpEventGetEventTested_GetEventTested_EvtInfo_INV_RSLVR_OFFS_DFT: RteEventRef=OpEventGetEventTested_GetEventTested_EvtInfo_INV_RSLVR_OFFS_DFT
          OpEventGetEventTested_GetEventTested_Event_INV_RSLVR_OFFS_DFT: RteEventRef=OpEventGetEventTested_GetEventTested_Event_INV_RSLVR_OFFS_DFT
          OpEventGetEventTested_GetEventTested_EvtInfo_Ga_MoveOverThd: RteEventRef=OpEventGetEventTested_GetEventTested_EvtInfo_Ga_MoveOverThd
          OpEventGetEventTested_GetEventTested_Event_Ga_MoveOverThd: RteEventRef=OpEventGetEventTested_GetEventTested_Event_Ga_MoveOverThd
          OpEventGetEventTested_GetEventTested_EvtInfo_VcEvMonIPH: RteEventRef=OpEventGetEventTested_GetEventTested_EvtInfo_VcEvMonIPH
          OpEventGetEventTested_GetEventTested_Event_VcEvMonIPH: RteEventRef=OpEventGetEventTested_GetEventTested_Event_VcEvMonIPH
          OpEventGetEventTested_GetEventTested_EvtInfo_INV_RSLVR_HW_FLT: RteEventRef=OpEventGetEventTested_GetEventTested_EvtInfo_INV_RSLVR_HW_FLT
          OpEventGetEventTested_GetEventTested_Event_INV_RSLVR_HW_FLT: RteEventRef=OpEventGetEventTested_GetEventTested_Event_INV_RSLVR_HW_FLT
          OpEventGetEventTested_GetEventTested_EvtInfo_INV_RSLVR_SIN_ELEC_LO: RteEventRef=OpEventGetEventTested_GetEventTested_EvtInfo_INV_RSLVR_SIN_ELEC_LO
          OpEventGetEventTested_GetEventTested_Event_INV_RSLVR_SIN_ELEC_LO: RteEventRef=OpEventGetEventTested_GetEventTested_Event_INV_RSLVR_SIN_ELEC_LO
          OpEventGetEventTested_GetEventTested_EvtInfo_INV_IAC_W_AMP: RteEventRef=OpEventGetEventTested_GetEventTested_EvtInfo_INV_IAC_W_AMP
          OpEventGetEventTested_GetEventTested_Event_INV_IAC_W_AMP: RteEventRef=OpEventGetEventTested_GetEventTested_Event_INV_IAC_W_AMP
          OpEventGetEventTested_GetEventTested_EvtInfo_VCC_OverVoltage: RteEventRef=OpEventGetEventTested_GetEventTested_EvtInfo_VCC_OverVoltage
          OpEventGetEventTested_GetEventTested_Event_VCC_OverVoltage: RteEventRef=OpEventGetEventTested_GetEventTested_Event_VCC_OverVoltage
          OpEventGetEventTested_GetEventTested_EvtInfo_PS_BLDC_OV_FLT: RteEventRef=OpEventGetEventTested_GetEventTested_EvtInfo_PS_BLDC_OV_FLT
          OpEventGetEventTested_GetEventTested_Event_PS_BLDC_OV_FLT: RteEventRef=OpEventGetEventTested_GetEventTested_Event_PS_BLDC_OV_FLT
          OpEventGetEventTested_GetEventTested_EvtInfo_AURIX_EEPROM_FLT: RteEventRef=OpEventGetEventTested_GetEventTested_EvtInfo_AURIX_EEPROM_FLT
          OpEventGetEventTested_GetEventTested_Event_AURIX_EEPROM_FLT: RteEventRef=OpEventGetEventTested_GetEventTested_Event_AURIX_EEPROM_FLT
          OpEventGetEventTested_GetEventTested_EvtInfo_FS_MONITIOR_ASC_FW_FLT: RteEventRef=OpEventGetEventTested_GetEventTested_EvtInfo_FS_MONITIOR_ASC_FW_FLT
          OpEventGetEventTested_GetEventTested_Event_FS_MONITIOR_ASC_FW_FLT: RteEventRef=OpEventGetEventTested_GetEventTested_Event_FS_MONITIOR_ASC_FW_FLT
          OpEventGetEventTested_GetEventTested_EvtInfo_VCEvSrsPropFr02Tioutd: RteEventRef=OpEventGetEventTested_GetEventTested_EvtInfo_VCEvSrsPropFr02Tioutd
          OpEventGetEventTested_GetEventTested_Event_VCEvSrsPropFr02Tioutd: RteEventRef=OpEventGetEventTested_GetEventTested_Event_VCEvSrsPropFr02Tioutd
          OpEventGetEventTested_GetEventTested_EvtInfo_VcEvMonErrMode: RteEventRef=OpEventGetEventTested_GetEventTested_EvtInfo_VcEvMonErrMode
          OpEventGetEventTested_GetEventTested_Event_VcEvMonErrMode: RteEventRef=OpEventGetEventTested_GetEventTested_Event_VcEvMonErrMode
          OpEventGetEventTested_GetEventTested_EvtInfo_AURIX_RST_MPL: RteEventRef=OpEventGetEventTested_GetEventTested_EvtInfo_AURIX_RST_MPL
          OpEventGetEventTested_GetEventTested_Event_AURIX_RST_MPL: RteEventRef=OpEventGetEventTested_GetEventTested_Event_AURIX_RST_MPL
          OpEventGetEventTested_GetEventTested_EvtInfo_VcEvNodeMisECM: RteEventRef=OpEventGetEventTested_GetEventTested_EvtInfo_VcEvNodeMisECM
          OpEventGetEventTested_GetEventTested_Event_VcEvNodeMisECM: RteEventRef=OpEventGetEventTested_GetEventTested_Event_VcEvNodeMisECM
          OpEventGetEventTested_GetEventTested_EvtInfo_PS_KL30_PLAUS: RteEventRef=OpEventGetEventTested_GetEventTested_EvtInfo_PS_KL30_PLAUS
          OpEventGetEventTested_GetEventTested_Event_PS_KL30_PLAUS: RteEventRef=OpEventGetEventTested_GetEventTested_Event_PS_KL30_PLAUS
          OpEventGetEventTested_GetEventTested_EvtInfo_INV_IAC_W_ELEC_HI: RteEventRef=OpEventGetEventTested_GetEventTested_EvtInfo_INV_IAC_W_ELEC_HI
          OpEventGetEventTested_GetEventTested_Event_INV_IAC_W_ELEC_HI: RteEventRef=OpEventGetEventTested_GetEventTested_Event_INV_IAC_W_ELEC_HI
          OpEventGetEventTested_GetEventTested_EvtInfo_VCEvVddmPropFr19Tioutd: RteEventRef=OpEventGetEventTested_GetEventTested_EvtInfo_VCEvVddmPropFr19Tioutd
          OpEventGetEventTested_GetEventTested_Event_VCEvVddmPropFr19Tioutd: RteEventRef=OpEventGetEventTested_GetEventTested_Event_VCEvVddmPropFr19Tioutd
          OpEventGetEventTested_GetEventTested_EvtInfo_INV_TEMP_DCHA_HW: RteEventRef=OpEventGetEventTested_GetEventTested_EvtInfo_INV_TEMP_DCHA_HW
          OpEventGetEventTested_GetEventTested_Event_INV_TEMP_DCHA_HW: RteEventRef=OpEventGetEventTested_GetEventTested_Event_INV_TEMP_DCHA_HW
          OpEventGetEventTested_GetEventTested_EvtInfo_VcEvPropCANGlbTiOutd: RteEventRef=OpEventGetEventTested_GetEventTested_EvtInfo_VcEvPropCANGlbTiOutd
          OpEventGetEventTested_GetEventTested_Event_VcEvPropCANGlbTiOutd: RteEventRef=OpEventGetEventTested_GetEventTested_Event_VcEvPropCANGlbTiOutd
          OpEventGetEventTested_GetEventTested_EvtInfo_INV_EM_STATOR_TEMP2_RNG_NOK: RteEventRef=OpEventGetEventTested_GetEventTested_EvtInfo_INV_EM_STATOR_TEMP2_RNG_NOK
          OpEventGetEventTested_GetEventTested_Event_INV_EM_STATOR_TEMP2_RNG_NOK: RteEventRef=OpEventGetEventTested_GetEventTested_Event_INV_EM_STATOR_TEMP2_RNG_NOK
          OpEventGetEventTested_GetEventTested_EvtInfo_INV_UHVDC_OV_HWP: RteEventRef=OpEventGetEventTested_GetEventTested_EvtInfo_INV_UHVDC_OV_HWP
          OpEventGetEventTested_GetEventTested_Event_INV_UHVDC_OV_HWP: RteEventRef=OpEventGetEventTested_GetEventTested_Event_INV_UHVDC_OV_HWP
          OpEventGetEventTested_GetEventTested_EvtInfo_Ga_FindEngleAngleFailed: RteEventRef=OpEventGetEventTested_GetEventTested_EvtInfo_Ga_FindEngleAngleFailed
          OpEventGetEventTested_GetEventTested_Event_Ga_FindEngleAngleFailed: RteEventRef=OpEventGetEventTested_GetEventTested_Event_Ga_FindEngleAngleFailed
          OpEventGetEventTested_GetEventTested_EvtInfo_VcEvMonTrqCmp: RteEventRef=OpEventGetEventTested_GetEventTested_EvtInfo_VcEvMonTrqCmp
          OpEventGetEventTested_GetEventTested_Event_VcEvMonTrqCmp: RteEventRef=OpEventGetEventTested_GetEventTested_Event_VcEvMonTrqCmp
          OpEventGetEventTested_GetEventTested_EvtInfo_INV_IGBT_TEMP_V_RNG_LO: RteEventRef=OpEventGetEventTested_GetEventTested_EvtInfo_INV_IGBT_TEMP_V_RNG_LO
          OpEventGetEventTested_GetEventTested_Event_INV_IGBT_TEMP_V_RNG_LO: RteEventRef=OpEventGetEventTested_GetEventTested_Event_INV_IGBT_TEMP_V_RNG_LO
          OpEventGetEventTested_GetEventTested_EvtInfo_INV_CONTROL_LIMIT: RteEventRef=OpEventGetEventTested_GetEventTested_EvtInfo_INV_CONTROL_LIMIT
          OpEventGetEventTested_GetEventTested_Event_INV_CONTROL_LIMIT: RteEventRef=OpEventGetEventTested_GetEventTested_Event_INV_CONTROL_LIMIT
          OpEventGetEventTested_GetEventTested_EvtInfo_COM_CarConfigErr: RteEventRef=OpEventGetEventTested_GetEventTested_EvtInfo_COM_CarConfigErr
          OpEventGetEventTested_GetEventTested_Event_COM_CarConfigErr: RteEventRef=OpEventGetEventTested_GetEventTested_Event_COM_CarConfigErr
          OpEventGetEventTested_GetEventTested_EvtInfo_VCEvEcmPropFr08Tioutd: RteEventRef=OpEventGetEventTested_GetEventTested_EvtInfo_VCEvEcmPropFr08Tioutd
          OpEventGetEventTested_GetEventTested_Event_VCEvEcmPropFr08Tioutd: RteEventRef=OpEventGetEventTested_GetEventTested_Event_VCEvEcmPropFr08Tioutd
          OpEventGetEventTested_GetEventTested_EvtInfo_CU_TEMP1_RNG_LO: RteEventRef=OpEventGetEventTested_GetEventTested_EvtInfo_CU_TEMP1_RNG_LO
          OpEventGetEventTested_GetEventTested_Event_CU_TEMP1_RNG_LO: RteEventRef=OpEventGetEventTested_GetEventTested_Event_CU_TEMP1_RNG_LO
          OpEventGetEventTested_GetEventTested_EvtInfo_INV_EM_STATOR_TEMP2_RNG_SWT: RteEventRef=OpEventGetEventTested_GetEventTested_EvtInfo_INV_EM_STATOR_TEMP2_RNG_SWT
          OpEventGetEventTested_GetEventTested_Event_INV_EM_STATOR_TEMP2_RNG_SWT: RteEventRef=OpEventGetEventTested_GetEventTested_Event_INV_EM_STATOR_TEMP2_RNG_SWT
          OpEventGetEventTested_GetEventTested_EvtInfo_GA_BLDC_POS_FLT: RteEventRef=OpEventGetEventTested_GetEventTested_EvtInfo_GA_BLDC_POS_FLT
          OpEventGetEventTested_GetEventTested_Event_GA_BLDC_POS_FLT: RteEventRef=OpEventGetEventTested_GetEventTested_Event_GA_BLDC_POS_FLT
          OpEventGetEventTested_GetEventTested_EvtInfo_PS_WhlSnsr_FLT: RteEventRef=OpEventGetEventTested_GetEventTested_EvtInfo_PS_WhlSnsr_FLT
          OpEventGetEventTested_GetEventTested_Event_PS_WhlSnsr_FLT: RteEventRef=OpEventGetEventTested_GetEventTested_Event_PS_WhlSnsr_FLT
          OpEventGetEventTested_GetEventTested_EvtInfo_INV_EM_STATOR_TEMP_RNG_LO: RteEventRef=OpEventGetEventTested_GetEventTested_EvtInfo_INV_EM_STATOR_TEMP_RNG_LO
          OpEventGetEventTested_GetEventTested_Event_INV_EM_STATOR_TEMP_RNG_LO: RteEventRef=OpEventGetEventTested_GetEventTested_Event_INV_EM_STATOR_TEMP_RNG_LO
          OpEventGetEventTested_GetEventTested_EvtInfo_INV_RSLVR_SIN_ELEC_HI: RteEventRef=OpEventGetEventTested_GetEventTested_EvtInfo_INV_RSLVR_SIN_ELEC_HI
          OpEventGetEventTested_GetEventTested_Event_INV_RSLVR_SIN_ELEC_HI: RteEventRef=OpEventGetEventTested_GetEventTested_Event_INV_RSLVR_SIN_ELEC_HI
          OpEventGetEventTested_GetEventTested_EvtInfo_INV_RSLVR_SIN_COS_PLAUS: RteEventRef=OpEventGetEventTested_GetEventTested_EvtInfo_INV_RSLVR_SIN_COS_PLAUS
          OpEventGetEventTested_GetEventTested_Event_INV_RSLVR_SIN_COS_PLAUS: RteEventRef=OpEventGetEventTested_GetEventTested_Event_INV_RSLVR_SIN_COS_PLAUS
          OpEventGetEventTested_GetEventTested_EvtInfo_INV_RSLVR_COS_AMP: RteEventRef=OpEventGetEventTested_GetEventTested_EvtInfo_INV_RSLVR_COS_AMP
          OpEventGetEventTested_GetEventTested_Event_INV_RSLVR_COS_AMP: RteEventRef=OpEventGetEventTested_GetEventTested_Event_INV_RSLVR_COS_AMP
          OpEventGetEventTested_GetEventTested_EvtInfo_INV_GATE_DRVR_BOT_HWP: RteEventRef=OpEventGetEventTested_GetEventTested_EvtInfo_INV_GATE_DRVR_BOT_HWP
          OpEventGetEventTested_GetEventTested_Event_INV_GATE_DRVR_BOT_HWP: RteEventRef=OpEventGetEventTested_GetEventTested_Event_INV_GATE_DRVR_BOT_HWP
          OpEventGetEventTested_GetEventTested_EvtInfo_Eg_HallVolWrong: RteEventRef=OpEventGetEventTested_GetEventTested_EvtInfo_Eg_HallVolWrong
          OpEventGetEventTested_GetEventTested_Event_Eg_HallVolWrong: RteEventRef=OpEventGetEventTested_GetEventTested_Event_Eg_HallVolWrong
          OpEventGetEventTested_GetEventTested_EvtInfo_INV_RSLVR_EXCT_RNG_NOK: RteEventRef=OpEventGetEventTested_GetEventTested_EvtInfo_INV_RSLVR_EXCT_RNG_NOK
          OpEventGetEventTested_GetEventTested_Event_INV_RSLVR_EXCT_RNG_NOK: RteEventRef=OpEventGetEventTested_GetEventTested_Event_INV_RSLVR_EXCT_RNG_NOK
          OpEventGetEventTested_GetEventTested_EvtInfo_PA_OpenCirc: RteEventRef=OpEventGetEventTested_GetEventTested_EvtInfo_PA_OpenCirc
          OpEventGetEventTested_GetEventTested_Event_PA_OpenCirc: RteEventRef=OpEventGetEventTested_GetEventTested_Event_PA_OpenCirc
          OpEventGetEventTested_GetEventTested_EvtInfo_INV_RSLVR_COS_ELEC_HI: RteEventRef=OpEventGetEventTested_GetEventTested_EvtInfo_INV_RSLVR_COS_ELEC_HI
          OpEventGetEventTested_GetEventTested_Event_INV_RSLVR_COS_ELEC_HI: RteEventRef=OpEventGetEventTested_GetEventTested_Event_INV_RSLVR_COS_ELEC_HI
          OpEventGetEventTested_GetEventTested_EvtInfo_VcEvCntrHvSysRlySts: RteEventRef=OpEventGetEventTested_GetEventTested_EvtInfo_VcEvCntrHvSysRlySts
          OpEventGetEventTested_GetEventTested_Event_VcEvCntrHvSysRlySts: RteEventRef=OpEventGetEventTested_GetEventTested_Event_VcEvCntrHvSysRlySts
          OpEventGetEventTested_GetEventTested_EvtInfo_CRASH_DTC: RteEventRef=OpEventGetEventTested_GetEventTested_EvtInfo_CRASH_DTC
          OpEventGetEventTested_GetEventTested_Event_CRASH_DTC: RteEventRef=OpEventGetEventTested_GetEventTested_Event_CRASH_DTC
          OpEventGetEventTested_GetEventTested_EvtInfo_INV_IGBT_TEMP_W_RNG_HI: RteEventRef=OpEventGetEventTested_GetEventTested_EvtInfo_INV_IGBT_TEMP_W_RNG_HI
          OpEventGetEventTested_GetEventTested_Event_INV_IGBT_TEMP_W_RNG_HI: RteEventRef=OpEventGetEventTested_GetEventTested_Event_INV_IGBT_TEMP_W_RNG_HI
          OpEventGetEventTested_GetEventTested_EvtInfo_VCEvBecmPropFr02Tioutd: RteEventRef=OpEventGetEventTested_GetEventTested_EvtInfo_VCEvBecmPropFr02Tioutd
          OpEventGetEventTested_GetEventTested_Event_VCEvBecmPropFr02Tioutd: RteEventRef=OpEventGetEventTested_GetEventTested_Event_VCEvBecmPropFr02Tioutd
          OpEventGetEventTested_GetEventTested_EvtInfo_INV_IGBT_TEMP_W_GRDT: RteEventRef=OpEventGetEventTested_GetEventTested_EvtInfo_INV_IGBT_TEMP_W_GRDT
          OpEventGetEventTested_GetEventTested_Event_INV_IGBT_TEMP_W_GRDT: RteEventRef=OpEventGetEventTested_GetEventTested_Event_INV_IGBT_TEMP_W_GRDT
          OpEventGetEventTested_GetEventTested_EvtInfo_EXT_UC_SPI_FLT: RteEventRef=OpEventGetEventTested_GetEventTested_EvtInfo_EXT_UC_SPI_FLT
          OpEventGetEventTested_GetEventTested_Event_EXT_UC_SPI_FLT: RteEventRef=OpEventGetEventTested_GetEventTested_Event_EXT_UC_SPI_FLT
          OpEventGetEventTested_GetEventTested_EvtInfo_INV_IAC_V_ELEC_HWP_001: RteEventRef=OpEventGetEventTested_GetEventTested_EvtInfo_INV_IAC_V_ELEC_HWP_001
          OpEventGetEventTested_GetEventTested_Event_INV_IAC_V_ELEC_HWP_001: RteEventRef=OpEventGetEventTested_GetEventTested_Event_INV_IAC_V_ELEC_HWP_001
          OpEventGetEventTested_GetEventTested_EvtInfo_VcEvChkSumWhlMotSysTqAllwd: RteEventRef=OpEventGetEventTested_GetEventTested_EvtInfo_VcEvChkSumWhlMotSysTqAllwd
          OpEventGetEventTested_GetEventTested_Event_VcEvChkSumWhlMotSysTqAllwd: RteEventRef=OpEventGetEventTested_GetEventTested_Event_VcEvChkSumWhlMotSysTqAllwd
          OpEventGetEventTested_GetEventTested_EvtInfo_FS_MONITIOR_ASC_FLT: RteEventRef=OpEventGetEventTested_GetEventTested_EvtInfo_FS_MONITIOR_ASC_FLT
          OpEventGetEventTested_GetEventTested_Event_FS_MONITIOR_ASC_FLT: RteEventRef=OpEventGetEventTested_GetEventTested_Event_FS_MONITIOR_ASC_FLT
          OpEventGetEventTested_GetEventTested_EvtInfo_INV_IAC_V_AMP: RteEventRef=OpEventGetEventTested_GetEventTested_EvtInfo_INV_IAC_V_AMP
          OpEventGetEventTested_GetEventTested_Event_INV_IAC_V_AMP: RteEventRef=OpEventGetEventTested_GetEventTested_Event_INV_IAC_V_AMP
          OpEventGetEventTested_GetEventTested_EvtInfo_INV_IAC_W_ELEC_LO: RteEventRef=OpEventGetEventTested_GetEventTested_EvtInfo_INV_IAC_W_ELEC_LO
          OpEventGetEventTested_GetEventTested_Event_INV_IAC_W_ELEC_LO: RteEventRef=OpEventGetEventTested_GetEventTested_Event_INV_IAC_W_ELEC_LO
          OpEventGetEventTested_GetEventTested_EvtInfo_VCEvVddmPropFr08Tioutd_001: RteEventRef=OpEventGetEventTested_GetEventTested_EvtInfo_VCEvVddmPropFr08Tioutd_001
          OpEventGetEventTested_GetEventTested_Event_VCEvVddmPropFr08Tioutd_001: RteEventRef=OpEventGetEventTested_GetEventTested_Event_VCEvVddmPropFr08Tioutd_001
          OpEventGetEventTested_GetEventTested_EvtInfo_PS_P12_RES_FLT: RteEventRef=OpEventGetEventTested_GetEventTested_EvtInfo_PS_P12_RES_FLT
          OpEventGetEventTested_GetEventTested_Event_PS_P12_RES_FLT: RteEventRef=OpEventGetEventTested_GetEventTested_Event_PS_P12_RES_FLT
          OpEventGetEventTested_GetEventTested_EvtInfo_INV_RSLVR_SIN_RNG_LO: RteEventRef=OpEventGetEventTested_GetEventTested_EvtInfo_INV_RSLVR_SIN_RNG_LO
          OpEventGetEventTested_GetEventTested_Event_INV_RSLVR_SIN_RNG_LO: RteEventRef=OpEventGetEventTested_GetEventTested_Event_INV_RSLVR_SIN_RNG_LO
          OpEventGetEventTested_GetEventTested_EvtInfo_CU_TEMP_HW_FLT: RteEventRef=OpEventGetEventTested_GetEventTested_EvtInfo_CU_TEMP_HW_FLT
          OpEventGetEventTested_GetEventTested_Event_CU_TEMP_HW_FLT: RteEventRef=OpEventGetEventTested_GetEventTested_Event_CU_TEMP_HW_FLT
          OpEventGetEventTested_GetEventTested_EvtInfo_VCEvEcmPropFr02MgmFr00Tioutd: RteEventRef=OpEventGetEventTested_GetEventTested_EvtInfo_VCEvEcmPropFr02MgmFr00Tioutd
          OpEventGetEventTested_GetEventTested_Event_VCEvEcmPropFr02MgmFr00Tioutd: RteEventRef=OpEventGetEventTested_GetEventTested_Event_VCEvEcmPropFr02MgmFr00Tioutd
          OpEventGetEventTested_GetEventTested_EvtInfo_PS_KL15_RNG_HI: RteEventRef=OpEventGetEventTested_GetEventTested_EvtInfo_PS_KL15_RNG_HI
          OpEventGetEventTested_GetEventTested_Event_PS_KL15_RNG_HI: RteEventRef=OpEventGetEventTested_GetEventTested_Event_PS_KL15_RNG_HI
          OpEventGetEventTested_GetEventTested_EvtInfo_VCEvVddmPropFr17Tioutd: RteEventRef=OpEventGetEventTested_GetEventTested_EvtInfo_VCEvVddmPropFr17Tioutd
          OpEventGetEventTested_GetEventTested_Event_VCEvVddmPropFr17Tioutd: RteEventRef=OpEventGetEventTested_GetEventTested_Event_VCEvVddmPropFr17Tioutd
          OpEventGetEventTested_GetEventTested_EvtInfo_VcEvChkSumCrashStsSafe: RteEventRef=OpEventGetEventTested_GetEventTested_EvtInfo_VcEvChkSumCrashStsSafe
          OpEventGetEventTested_GetEventTested_Event_VcEvChkSumCrashStsSafe: RteEventRef=OpEventGetEventTested_GetEventTested_Event_VcEvChkSumCrashStsSafe
          OpEventGetEventTested_GetEventTested_EvtInfo_DiagC_ClutchService: RteEventRef=OpEventGetEventTested_GetEventTested_EvtInfo_DiagC_ClutchService
          OpEventGetEventTested_GetEventTested_Event_DiagC_ClutchService: RteEventRef=OpEventGetEventTested_GetEventTested_Event_DiagC_ClutchService
          OpEventGetEventTested_GetEventTested_EvtInfo_INV_EM_STATOR_TEMP_RNG_HI: RteEventRef=OpEventGetEventTested_GetEventTested_EvtInfo_INV_EM_STATOR_TEMP_RNG_HI
          OpEventGetEventTested_GetEventTested_Event_INV_EM_STATOR_TEMP_RNG_HI: RteEventRef=OpEventGetEventTested_GetEventTested_Event_INV_EM_STATOR_TEMP_RNG_HI
          OpEventGetEventTested_GetEventTested_EvtInfo_INV_RSLVR_OFFS_OUT_RANG: RteEventRef=OpEventGetEventTested_GetEventTested_EvtInfo_INV_RSLVR_OFFS_OUT_RANG
          OpEventGetEventTested_GetEventTested_Event_INV_RSLVR_OFFS_OUT_RANG: RteEventRef=OpEventGetEventTested_GetEventTested_Event_INV_RSLVR_OFFS_OUT_RANG
          OpEventGetEventTested_GetEventTested_EvtInfo_INV_EM_STATOR_TEMP2_RNG_LO: RteEventRef=OpEventGetEventTested_GetEventTested_EvtInfo_INV_EM_STATOR_TEMP2_RNG_LO
          OpEventGetEventTested_GetEventTested_Event_INV_EM_STATOR_TEMP2_RNG_LO: RteEventRef=OpEventGetEventTested_GetEventTested_Event_INV_EM_STATOR_TEMP2_RNG_LO
          OpEventGetEventTested_GetEventTested_EvtInfo_VcEvMonISAR: RteEventRef=OpEventGetEventTested_GetEventTested_EvtInfo_VcEvMonISAR
          OpEventGetEventTested_GetEventTested_Event_VcEvMonISAR: RteEventRef=OpEventGetEventTested_GetEventTested_Event_VcEvMonISAR
          OpEventGetEventTested_GetEventTested_EvtInfo_GA_BLDC_FLT: RteEventRef=OpEventGetEventTested_GetEventTested_EvtInfo_GA_BLDC_FLT
          OpEventGetEventTested_GetEventTested_Event_GA_BLDC_FLT: RteEventRef=OpEventGetEventTested_GetEventTested_Event_GA_BLDC_FLT
          OpEventGetEventTested_GetEventTested_EvtInfo_INV_RSLVR_EXCT_ELEC_OPEN: RteEventRef=OpEventGetEventTested_GetEventTested_EvtInfo_INV_RSLVR_EXCT_ELEC_OPEN
          OpEventGetEventTested_GetEventTested_Event_INV_RSLVR_EXCT_ELEC_OPEN: RteEventRef=OpEventGetEventTested_GetEventTested_Event_INV_RSLVR_EXCT_ELEC_OPEN
          OpEventGetEventTested_GetEventTested_EvtInfo_INV_RSLVR_EXCT_PLAUS: RteEventRef=OpEventGetEventTested_GetEventTested_EvtInfo_INV_RSLVR_EXCT_PLAUS
          OpEventGetEventTested_GetEventTested_Event_INV_RSLVR_EXCT_PLAUS: RteEventRef=OpEventGetEventTested_GetEventTested_Event_INV_RSLVR_EXCT_PLAUS
          OpEventGetEventTested_GetEventTested_EvtInfo_PS_P15_U_FLT: RteEventRef=OpEventGetEventTested_GetEventTested_EvtInfo_PS_P15_U_FLT
          OpEventGetEventTested_GetEventTested_Event_PS_P15_U_FLT: RteEventRef=OpEventGetEventTested_GetEventTested_Event_PS_P15_U_FLT
          OpEventGetEventTested_GetEventTested_EvtInfo_INV_EM_STATOR_TEMP_RNG_SWT: RteEventRef=OpEventGetEventTested_GetEventTested_EvtInfo_INV_EM_STATOR_TEMP_RNG_SWT
          OpEventGetEventTested_GetEventTested_Event_INV_EM_STATOR_TEMP_RNG_SWT: RteEventRef=OpEventGetEventTested_GetEventTested_Event_INV_EM_STATOR_TEMP_RNG_SWT
          OpEventGetEventTested_GetEventTested_EvtInfo_INV_UHVDC_OV_SWP: RteEventRef=OpEventGetEventTested_GetEventTested_EvtInfo_INV_UHVDC_OV_SWP
          OpEventGetEventTested_GetEventTested_Event_INV_UHVDC_OV_SWP: RteEventRef=OpEventGetEventTested_GetEventTested_Event_INV_UHVDC_OV_SWP
          OpEventGetEventTested_GetEventTested_EvtInfo_AURIX_HW_FLT: RteEventRef=OpEventGetEventTested_GetEventTested_EvtInfo_AURIX_HW_FLT
          OpEventGetEventTested_GetEventTested_Event_AURIX_HW_FLT: RteEventRef=OpEventGetEventTested_GetEventTested_Event_AURIX_HW_FLT
          OpEventGetEventTested_GetEventTested_EvtInfo_INV_GATE_DRVR_TOP_HWP: RteEventRef=OpEventGetEventTested_GetEventTested_EvtInfo_INV_GATE_DRVR_TOP_HWP
          OpEventGetEventTested_GetEventTested_Event_INV_GATE_DRVR_TOP_HWP: RteEventRef=OpEventGetEventTested_GetEventTested_Event_INV_GATE_DRVR_TOP_HWP
          OpEventGetEventTested_GetEventTested_EvtInfo_INV_ACTV_DCHA_HW: RteEventRef=OpEventGetEventTested_GetEventTested_EvtInfo_INV_ACTV_DCHA_HW
          OpEventGetEventTested_GetEventTested_Event_INV_ACTV_DCHA_HW: RteEventRef=OpEventGetEventTested_GetEventTested_Event_INV_ACTV_DCHA_HW
          OpEventGetEventTested_GetEventTested_EvtInfo_INV_IGBT_TEMP_HWP: RteEventRef=OpEventGetEventTested_GetEventTested_EvtInfo_INV_IGBT_TEMP_HWP
          OpEventGetEventTested_GetEventTested_Event_INV_IGBT_TEMP_HWP: RteEventRef=OpEventGetEventTested_GetEventTested_Event_INV_IGBT_TEMP_HWP
          OpEventGetEventTested_GetEventTested_EvtInfo_INV_RSLVR_SIN_ELEC_FLT: RteEventRef=OpEventGetEventTested_GetEventTested_EvtInfo_INV_RSLVR_SIN_ELEC_FLT
          OpEventGetEventTested_GetEventTested_Event_INV_RSLVR_SIN_ELEC_FLT: RteEventRef=OpEventGetEventTested_GetEventTested_Event_INV_RSLVR_SIN_ELEC_FLT
          OpEventGetEventTested_GetEventTested_EvtInfo_CU_TEMP2_RNG_HI: RteEventRef=OpEventGetEventTested_GetEventTested_EvtInfo_CU_TEMP2_RNG_HI
          OpEventGetEventTested_GetEventTested_Event_CU_TEMP2_RNG_HI: RteEventRef=OpEventGetEventTested_GetEventTested_Event_CU_TEMP2_RNG_HI
          OpEventGetEventTested_GetEventTested_EvtInfo_INV_IAC_PHA_LOSS_MPL: RteEventRef=OpEventGetEventTested_GetEventTested_EvtInfo_INV_IAC_PHA_LOSS_MPL
          OpEventGetEventTested_GetEventTested_Event_INV_IAC_PHA_LOSS_MPL: RteEventRef=OpEventGetEventTested_GetEventTested_Event_INV_IAC_PHA_LOSS_MPL
          OpEventGetEventTested_GetEventTested_EvtInfo_INV_IAC_U_AMP: RteEventRef=OpEventGetEventTested_GetEventTested_EvtInfo_INV_IAC_U_AMP
          OpEventGetEventTested_GetEventTested_Event_INV_IAC_U_AMP: RteEventRef=OpEventGetEventTested_GetEventTested_Event_INV_IAC_U_AMP
          OpEventGetEventTested_GetEventTested_EvtInfo_PSnsr_GRADT_Flt: RteEventRef=OpEventGetEventTested_GetEventTested_EvtInfo_PSnsr_GRADT_Flt
          OpEventGetEventTested_GetEventTested_Event_PSnsr_GRADT_Flt: RteEventRef=OpEventGetEventTested_GetEventTested_Event_PSnsr_GRADT_Flt
          OpEventGetEventTested_GetEventTested_EvtInfo_AURIX_WATHDOG_FLT: RteEventRef=OpEventGetEventTested_GetEventTested_EvtInfo_AURIX_WATHDOG_FLT
          OpEventGetEventTested_GetEventTested_Event_AURIX_WATHDOG_FLT: RteEventRef=OpEventGetEventTested_GetEventTested_Event_AURIX_WATHDOG_FLT
          OpEventGetEventTested_GetEventTested_EvtInfo_VcEvNodeMisBECM: RteEventRef=OpEventGetEventTested_GetEventTested_EvtInfo_VcEvNodeMisBECM
          OpEventGetEventTested_GetEventTested_Event_VcEvNodeMisBECM: RteEventRef=OpEventGetEventTested_GetEventTested_Event_VcEvNodeMisBECM
          OpEventGetEventTested_GetEventTested_EvtInfo_INV_UHVDC_UV_HWP: RteEventRef=OpEventGetEventTested_GetEventTested_EvtInfo_INV_UHVDC_UV_HWP
          OpEventGetEventTested_GetEventTested_Event_INV_UHVDC_UV_HWP: RteEventRef=OpEventGetEventTested_GetEventTested_Event_INV_UHVDC_UV_HWP
          OpEventGetEventTested_GetEventTested_EvtInfo_VcEvMonESpd: RteEventRef=OpEventGetEventTested_GetEventTested_EvtInfo_VcEvMonESpd
          OpEventGetEventTested_GetEventTested_Event_VcEvMonESpd: RteEventRef=OpEventGetEventTested_GetEventTested_Event_VcEvMonESpd
          OpEventGetEventTested_GetEventTested_EvtInfo_COM_NotConfig: RteEventRef=OpEventGetEventTested_GetEventTested_EvtInfo_COM_NotConfig
          OpEventGetEventTested_GetEventTested_Event_COM_NotConfig: RteEventRef=OpEventGetEventTested_GetEventTested_Event_COM_NotConfig
          OpEventGetEventTested_GetEventTested_EvtInfo_INV_RSLVR_SIN_RNG_HI: RteEventRef=OpEventGetEventTested_GetEventTested_EvtInfo_INV_RSLVR_SIN_RNG_HI
          OpEventGetEventTested_GetEventTested_Event_INV_RSLVR_SIN_RNG_HI: RteEventRef=OpEventGetEventTested_GetEventTested_Event_INV_RSLVR_SIN_RNG_HI
          OpEventGetEventTested_GetEventTested_EvtInfo_INV_IGBT_TEMP_U_RNG_HI: RteEventRef=OpEventGetEventTested_GetEventTested_EvtInfo_INV_IGBT_TEMP_U_RNG_HI
          OpEventGetEventTested_GetEventTested_Event_INV_IGBT_TEMP_U_RNG_HI: RteEventRef=OpEventGetEventTested_GetEventTested_Event_INV_IGBT_TEMP_U_RNG_HI
          OpEventGetEventTested_GetEventTested_EvtInfo_VcEvMonMode_001: RteEventRef=OpEventGetEventTested_GetEventTested_EvtInfo_VcEvMonMode_001
          OpEventGetEventTested_GetEventTested_Event_VcEvMonMode_001: RteEventRef=OpEventGetEventTested_GetEventTested_Event_VcEvMonMode_001
          OpEventGetEventTested_GetEventTested_EvtInfo_PA_ACTION_FLT: RteEventRef=OpEventGetEventTested_GetEventTested_EvtInfo_PA_ACTION_FLT
          OpEventGetEventTested_GetEventTested_Event_PA_ACTION_FLT: RteEventRef=OpEventGetEventTested_GetEventTested_Event_PA_ACTION_FLT
          OpEventGetEventTested_GetEventTested_EvtInfo_INV_IAC_V_ELEC_HWP: RteEventRef=OpEventGetEventTested_GetEventTested_EvtInfo_INV_IAC_V_ELEC_HWP
          OpEventGetEventTested_GetEventTested_Event_INV_IAC_V_ELEC_HWP: RteEventRef=OpEventGetEventTested_GetEventTested_Event_INV_IAC_V_ELEC_HWP
          OpEventGetEventTested_GetEventTested_EvtInfo_CU_TEMP_HW_FLT_001: RteEventRef=OpEventGetEventTested_GetEventTested_EvtInfo_CU_TEMP_HW_FLT_001
          OpEventGetEventTested_GetEventTested_Event_CU_TEMP_HW_FLT_001: RteEventRef=OpEventGetEventTested_GetEventTested_Event_CU_TEMP_HW_FLT_001
          OpEventGetEventTested_GetEventTested_EvtInfo_VCC_UnderVoltage: RteEventRef=OpEventGetEventTested_GetEventTested_EvtInfo_VCC_UnderVoltage
          OpEventGetEventTested_GetEventTested_Event_VCC_UnderVoltage: RteEventRef=OpEventGetEventTested_GetEventTested_Event_VCC_UnderVoltage
          OpEventGetEventTested_GetEventTested_EvtInfo_VcEvTsttrPlaus: RteEventRef=OpEventGetEventTested_GetEventTested_EvtInfo_VcEvTsttrPlaus
          OpEventGetEventTested_GetEventTested_Event_VcEvTsttrPlaus: RteEventRef=OpEventGetEventTested_GetEventTested_Event_VcEvTsttrPlaus
          OpEventGetEventTested_GetEventTested_EvtInfo_INV_RSLVR_EXCT_ELEC_FLT: RteEventRef=OpEventGetEventTested_GetEventTested_EvtInfo_INV_RSLVR_EXCT_ELEC_FLT
          OpEventGetEventTested_GetEventTested_Event_INV_RSLVR_EXCT_ELEC_FLT: RteEventRef=OpEventGetEventTested_GetEventTested_Event_INV_RSLVR_EXCT_ELEC_FLT
          OpEventGetEventTested_GetEventTested_EvtInfo_INV_RSLVR_EXCT_RNG_LO: RteEventRef=OpEventGetEventTested_GetEventTested_EvtInfo_INV_RSLVR_EXCT_RNG_LO
          OpEventGetEventTested_GetEventTested_Event_INV_RSLVR_EXCT_RNG_LO: RteEventRef=OpEventGetEventTested_GetEventTested_Event_INV_RSLVR_EXCT_RNG_LO
          OpEventGetEventTested_GetEventTested_EvtInfo_INV_EM_STATOR_TEMP2_RNG_HI: RteEventRef=OpEventGetEventTested_GetEventTested_EvtInfo_INV_EM_STATOR_TEMP2_RNG_HI
          OpEventGetEventTested_GetEventTested_Event_INV_EM_STATOR_TEMP2_RNG_HI: RteEventRef=OpEventGetEventTested_GetEventTested_Event_INV_EM_STATOR_TEMP2_RNG_HI
          OpEventGetEventTested_GetEventTested_EvtInfo_INV_SHUT_OFF_PAH_START_UP: RteEventRef=OpEventGetEventTested_GetEventTested_EvtInfo_INV_SHUT_OFF_PAH_START_UP
          OpEventGetEventTested_GetEventTested_Event_INV_SHUT_OFF_PAH_START_UP: RteEventRef=OpEventGetEventTested_GetEventTested_Event_INV_SHUT_OFF_PAH_START_UP
          OpEventGetEventTested_GetEventTested_EvtInfo_VCEvVddmPropFr08Tioutd: RteEventRef=OpEventGetEventTested_GetEventTested_EvtInfo_VCEvVddmPropFr08Tioutd
          OpEventGetEventTested_GetEventTested_Event_VCEvVddmPropFr08Tioutd: RteEventRef=OpEventGetEventTested_GetEventTested_Event_VCEvVddmPropFr08Tioutd
          OpEventGetEventTested_GetEventTested_EvtInfo_INV_RSLVR_EXCT_OC_HWP_001: RteEventRef=OpEventGetEventTested_GetEventTested_EvtInfo_INV_RSLVR_EXCT_OC_HWP_001
          OpEventGetEventTested_GetEventTested_Event_INV_RSLVR_EXCT_OC_HWP_001: RteEventRef=OpEventGetEventTested_GetEventTested_Event_INV_RSLVR_EXCT_OC_HWP_001
          OpEventGetEventTested_GetEventTested_EvtInfo_INV_RSLVR_EXCT_OC_HWP_002: RteEventRef=OpEventGetEventTested_GetEventTested_EvtInfo_INV_RSLVR_EXCT_OC_HWP_002
          OpEventGetEventTested_GetEventTested_Event_INV_RSLVR_EXCT_OC_HWP_002: RteEventRef=OpEventGetEventTested_GetEventTested_Event_INV_RSLVR_EXCT_OC_HWP_002
          OpEventGetEventTested_GetEventTested_EvtInfo_INV_EM_STATOR_TEMP_ELE_FLT: RteEventRef=OpEventGetEventTested_GetEventTested_EvtInfo_INV_EM_STATOR_TEMP_ELE_FLT
          OpEventGetEventTested_GetEventTested_Event_INV_EM_STATOR_TEMP_ELE_FLT: RteEventRef=OpEventGetEventTested_GetEventTested_Event_INV_EM_STATOR_TEMP_ELE_FLT
          OpEventGetEventTested_GetEventTested_EvtInfo_INV_INTERLOCK_FLT: RteEventRef=OpEventGetEventTested_GetEventTested_EvtInfo_INV_INTERLOCK_FLT
          OpEventGetEventTested_GetEventTested_Event_INV_INTERLOCK_FLT: RteEventRef=OpEventGetEventTested_GetEventTested_Event_INV_INTERLOCK_FLT
          OpEventGetEventTested_GetEventTested_EvtInfo_Ga_ZeroFindDistanFailure: RteEventRef=OpEventGetEventTested_GetEventTested_EvtInfo_Ga_ZeroFindDistanFailure
          OpEventGetEventTested_GetEventTested_Event_Ga_ZeroFindDistanFailure: RteEventRef=OpEventGetEventTested_GetEventTested_Event_Ga_ZeroFindDistanFailure
          OpEventGetEventTested_GetEventTested_EvtInfo_PLOCK_Current_RNG_OUT: RteEventRef=OpEventGetEventTested_GetEventTested_EvtInfo_PLOCK_Current_RNG_OUT
          OpEventGetEventTested_GetEventTested_Event_PLOCK_Current_RNG_OUT: RteEventRef=OpEventGetEventTested_GetEventTested_Event_PLOCK_Current_RNG_OUT
          OpEventGetEventTested_GetEventTested_EvtInfo_VCEvVddmPropFr05Tioutd: RteEventRef=OpEventGetEventTested_GetEventTested_EvtInfo_VCEvVddmPropFr05Tioutd
          OpEventGetEventTested_GetEventTested_Event_VCEvVddmPropFr05Tioutd: RteEventRef=OpEventGetEventTested_GetEventTested_Event_VCEvVddmPropFr05Tioutd
          OpEventGetEventTested_GetEventTested_EvtInfo_INV_IGBT_TEMP_V_GRDT: RteEventRef=OpEventGetEventTested_GetEventTested_EvtInfo_INV_IGBT_TEMP_V_GRDT
          OpEventGetEventTested_GetEventTested_Event_INV_IGBT_TEMP_V_GRDT: RteEventRef=OpEventGetEventTested_GetEventTested_Event_INV_IGBT_TEMP_V_GRDT
          OpEventGetEventTested_GetEventTested_EvtInfo_PS_5V_Fault: RteEventRef=OpEventGetEventTested_GetEventTested_EvtInfo_PS_5V_Fault
          OpEventGetEventTested_GetEventTested_Event_PS_5V_Fault: RteEventRef=OpEventGetEventTested_GetEventTested_Event_PS_5V_Fault
          OpEventGetEventTested_GetEventTested_EvtInfo_VcEvCntrCrashStsSafe: RteEventRef=OpEventGetEventTested_GetEventTested_EvtInfo_VcEvCntrCrashStsSafe
          OpEventGetEventTested_GetEventTested_Event_VcEvCntrCrashStsSafe: RteEventRef=OpEventGetEventTested_GetEventTested_Event_VcEvCntrCrashStsSafe
          OpEventGetEventTested_GetEventTested_EvtInfo_INV_EM_STATOR_TEMP_GRDT: RteEventRef=OpEventGetEventTested_GetEventTested_EvtInfo_INV_EM_STATOR_TEMP_GRDT
          OpEventGetEventTested_GetEventTested_Event_INV_EM_STATOR_TEMP_GRDT: RteEventRef=OpEventGetEventTested_GetEventTested_Event_INV_EM_STATOR_TEMP_GRDT
          OpEventGetEventTested_GetEventTested_EvtInfo_PS_P15_V_FLT: RteEventRef=OpEventGetEventTested_GetEventTested_EvtInfo_PS_P15_V_FLT
          OpEventGetEventTested_GetEventTested_Event_PS_P15_V_FLT: RteEventRef=OpEventGetEventTested_GetEventTested_Event_PS_P15_V_FLT
          OpEventGetEventTested_GetEventTested_EvtInfo_INV_EM_STATOR_TEMP_RNG_NOK: RteEventRef=OpEventGetEventTested_GetEventTested_EvtInfo_INV_EM_STATOR_TEMP_RNG_NOK
          OpEventGetEventTested_GetEventTested_Event_INV_EM_STATOR_TEMP_RNG_NOK: RteEventRef=OpEventGetEventTested_GetEventTested_Event_INV_EM_STATOR_TEMP_RNG_NOK
          OpEventGetEventTested_GetEventTested_EvtInfo_INV_RSLVR_SIN_RNG_NOK: RteEventRef=OpEventGetEventTested_GetEventTested_EvtInfo_INV_RSLVR_SIN_RNG_NOK
          OpEventGetEventTested_GetEventTested_Event_INV_RSLVR_SIN_RNG_NOK: RteEventRef=OpEventGetEventTested_GetEventTested_Event_INV_RSLVR_SIN_RNG_NOK
          OpEventGetEventTested_GetEventTested_EvtInfo_INV_IAC_U_OFFS: RteEventRef=OpEventGetEventTested_GetEventTested_EvtInfo_INV_IAC_U_OFFS
          OpEventGetEventTested_GetEventTested_Event_INV_IAC_U_OFFS: RteEventRef=OpEventGetEventTested_GetEventTested_Event_INV_IAC_U_OFFS
          OpEventGetEventTested_GetEventTested_EvtInfo_PS_KL30_BACKUP_FLT: RteEventRef=OpEventGetEventTested_GetEventTested_EvtInfo_PS_KL30_BACKUP_FLT
          OpEventGetEventTested_GetEventTested_Event_PS_KL30_BACKUP_FLT: RteEventRef=OpEventGetEventTested_GetEventTested_Event_PS_KL30_BACKUP_FLT
          OpEventGetEventTested_GetEventTested_EvtInfo_INV_IGBT_TEMP_U_RNG_LO: RteEventRef=OpEventGetEventTested_GetEventTested_EvtInfo_INV_IGBT_TEMP_U_RNG_LO
          OpEventGetEventTested_GetEventTested_Event_INV_IGBT_TEMP_U_RNG_LO: RteEventRef=OpEventGetEventTested_GetEventTested_Event_INV_IGBT_TEMP_U_RNG_LO
          OpEventGetEventTested_GetEventTested_EvtInfo_INV_EM_STATOR_TEMP_HWP: RteEventRef=OpEventGetEventTested_GetEventTested_EvtInfo_INV_EM_STATOR_TEMP_HWP
          OpEventGetEventTested_GetEventTested_Event_INV_EM_STATOR_TEMP_HWP: RteEventRef=OpEventGetEventTested_GetEventTested_Event_INV_EM_STATOR_TEMP_HWP
          OpEventGetEventTested_GetEventTested_EvtInfo_CU_TEMP1_RNG_HI: RteEventRef=OpEventGetEventTested_GetEventTested_EvtInfo_CU_TEMP1_RNG_HI
          OpEventGetEventTested_GetEventTested_Event_CU_TEMP1_RNG_HI: RteEventRef=OpEventGetEventTested_GetEventTested_Event_CU_TEMP1_RNG_HI
          OpEventGetEventTested_GetEventTested_EvtInfo_INV_IGBT_TEMP_V_RNG_HI: RteEventRef=OpEventGetEventTested_GetEventTested_EvtInfo_INV_IGBT_TEMP_V_RNG_HI
          OpEventGetEventTested_GetEventTested_Event_INV_IGBT_TEMP_V_RNG_HI: RteEventRef=OpEventGetEventTested_GetEventTested_Event_INV_IGBT_TEMP_V_RNG_HI
          OpEventGetEventTested_GetEventTested_EvtInfo_VcEvNodeMisVDDM: RteEventRef=OpEventGetEventTested_GetEventTested_EvtInfo_VcEvNodeMisVDDM
          OpEventGetEventTested_GetEventTested_Event_VcEvNodeMisVDDM: RteEventRef=OpEventGetEventTested_GetEventTested_Event_VcEvNodeMisVDDM
          OpEventGetEventTested_GetEventTested_EvtInfo_INV_UHVDC_PLAUS: RteEventRef=OpEventGetEventTested_GetEventTested_EvtInfo_INV_UHVDC_PLAUS
          OpEventGetEventTested_GetEventTested_Event_INV_UHVDC_PLAUS: RteEventRef=OpEventGetEventTested_GetEventTested_Event_INV_UHVDC_PLAUS
          OpEventGetEventTested_GetEventTested_EvtInfo_INV_QUIESCENT_FLT: RteEventRef=OpEventGetEventTested_GetEventTested_EvtInfo_INV_QUIESCENT_FLT
          OpEventGetEventTested_GetEventTested_Event_INV_QUIESCENT_FLT: RteEventRef=OpEventGetEventTested_GetEventTested_Event_INV_QUIESCENT_FLT
          OpEventGetEventTested_GetEventTested_EvtInfo_INV_RSLVR_EXCT_RNG_HI: RteEventRef=OpEventGetEventTested_GetEventTested_EvtInfo_INV_RSLVR_EXCT_RNG_HI
          OpEventGetEventTested_GetEventTested_Event_INV_RSLVR_EXCT_RNG_HI: RteEventRef=OpEventGetEventTested_GetEventTested_Event_INV_RSLVR_EXCT_RNG_HI
          OpEventGetEventTested_GetEventTested_GeneralEvtInfo: RteEventRef=OpEventGetEventTested_GetEventTested_GeneralEvtInfo
          OpEventGetDTCOfEvent_GetDTCOfEvent_EvtInfo_VCEvBecmPropFr01Tioutd: RteEventRef=OpEventGetDTCOfEvent_GetDTCOfEvent_EvtInfo_VCEvBecmPropFr01Tioutd
          OpEventGetDTCOfEvent_GetDTCOfEvent_Event_VCEvBecmPropFr01Tioutd: RteEventRef=OpEventGetDTCOfEvent_GetDTCOfEvent_Event_VCEvBecmPropFr01Tioutd
          OpEventGetDTCOfEvent_GetDTCOfEvent_EvtInfo_INV_CU_TEMP2_RNG_NOK: RteEventRef=OpEventGetDTCOfEvent_GetDTCOfEvent_EvtInfo_INV_CU_TEMP2_RNG_NOK
          OpEventGetDTCOfEvent_GetDTCOfEvent_Event_INV_CU_TEMP2_RNG_NOK: RteEventRef=OpEventGetDTCOfEvent_GetDTCOfEvent_Event_INV_CU_TEMP2_RNG_NOK
          OpEventGetDTCOfEvent_GetDTCOfEvent_EvtInfo_COM_Busoff: RteEventRef=OpEventGetDTCOfEvent_GetDTCOfEvent_EvtInfo_COM_Busoff
          OpEventGetDTCOfEvent_GetDTCOfEvent_Event_COM_Busoff: RteEventRef=OpEventGetDTCOfEvent_GetDTCOfEvent_Event_COM_Busoff
          OpEventGetDTCOfEvent_GetDTCOfEvent_EvtInfo_INV_IMMO_NOKEY: RteEventRef=OpEventGetDTCOfEvent_GetDTCOfEvent_EvtInfo_INV_IMMO_NOKEY
          OpEventGetDTCOfEvent_GetDTCOfEvent_Event_INV_IMMO_NOKEY: RteEventRef=OpEventGetDTCOfEvent_GetDTCOfEvent_Event_INV_IMMO_NOKEY
          OpEventGetDTCOfEvent_GetDTCOfEvent_EvtInfo_INV_RSLVR_EXCT_OC_HWP: RteEventRef=OpEventGetDTCOfEvent_GetDTCOfEvent_EvtInfo_INV_RSLVR_EXCT_OC_HWP
          OpEventGetDTCOfEvent_GetDTCOfEvent_Event_INV_RSLVR_EXCT_OC_HWP: RteEventRef=OpEventGetDTCOfEvent_GetDTCOfEvent_Event_INV_RSLVR_EXCT_OC_HWP
          OpEventGetDTCOfEvent_GetDTCOfEvent_EvtInfo_PS_P15_W_FLT: RteEventRef=OpEventGetDTCOfEvent_GetDTCOfEvent_EvtInfo_PS_P15_W_FLT
          OpEventGetDTCOfEvent_GetDTCOfEvent_Event_PS_P15_W_FLT: RteEventRef=OpEventGetDTCOfEvent_GetDTCOfEvent_Event_PS_P15_W_FLT
          OpEventGetDTCOfEvent_GetDTCOfEvent_EvtInfo_INV_IAC_PLAUS_SUM: RteEventRef=OpEventGetDTCOfEvent_GetDTCOfEvent_EvtInfo_INV_IAC_PLAUS_SUM
          OpEventGetDTCOfEvent_GetDTCOfEvent_Event_INV_IAC_PLAUS_SUM: RteEventRef=OpEventGetDTCOfEvent_GetDTCOfEvent_Event_INV_IAC_PLAUS_SUM
          OpEventGetDTCOfEvent_GetDTCOfEvent_EvtInfo_PA_ELE_FLT: RteEventRef=OpEventGetDTCOfEvent_GetDTCOfEvent_EvtInfo_PA_ELE_FLT
          OpEventGetDTCOfEvent_GetDTCOfEvent_Event_PA_ELE_FLT: RteEventRef=OpEventGetDTCOfEvent_GetDTCOfEvent_Event_PA_ELE_FLT
          OpEventGetDTCOfEvent_GetDTCOfEvent_EvtInfo_CU_TEMP_GRDT: RteEventRef=OpEventGetDTCOfEvent_GetDTCOfEvent_EvtInfo_CU_TEMP_GRDT
          OpEventGetDTCOfEvent_GetDTCOfEvent_Event_CU_TEMP_GRDT: RteEventRef=OpEventGetDTCOfEvent_GetDTCOfEvent_Event_CU_TEMP_GRDT
          OpEventGetDTCOfEvent_GetDTCOfEvent_EvtInfo_INV_IGBT_TEMP_V_PLAUS: RteEventRef=OpEventGetDTCOfEvent_GetDTCOfEvent_EvtInfo_INV_IGBT_TEMP_V_PLAUS
          OpEventGetDTCOfEvent_GetDTCOfEvent_Event_INV_IGBT_TEMP_V_PLAUS: RteEventRef=OpEventGetDTCOfEvent_GetDTCOfEvent_Event_INV_IGBT_TEMP_V_PLAUS
          OpEventGetDTCOfEvent_GetDTCOfEvent_EvtInfo_Ga_GAEngageFailure: RteEventRef=OpEventGetDTCOfEvent_GetDTCOfEvent_EvtInfo_Ga_GAEngageFailure
          OpEventGetDTCOfEvent_GetDTCOfEvent_Event_Ga_GAEngageFailure: RteEventRef=OpEventGetDTCOfEvent_GetDTCOfEvent_Event_Ga_GAEngageFailure
          OpEventGetDTCOfEvent_GetDTCOfEvent_EvtInfo_INV_IAC_W_RNG_LO: RteEventRef=OpEventGetDTCOfEvent_GetDTCOfEvent_EvtInfo_INV_IAC_W_RNG_LO
          OpEventGetDTCOfEvent_GetDTCOfEvent_Event_INV_IAC_W_RNG_LO: RteEventRef=OpEventGetDTCOfEvent_GetDTCOfEvent_Event_INV_IAC_W_RNG_LO
          OpEventGetDTCOfEvent_GetDTCOfEvent_EvtInfo_PS_WhlSnsr_Vltg_FLT: RteEventRef=OpEventGetDTCOfEvent_GetDTCOfEvent_EvtInfo_PS_WhlSnsr_Vltg_FLT
          OpEventGetDTCOfEvent_GetDTCOfEvent_Event_PS_WhlSnsr_Vltg_FLT: RteEventRef=OpEventGetDTCOfEvent_GetDTCOfEvent_Event_PS_WhlSnsr_Vltg_FLT
          OpEventGetDTCOfEvent_GetDTCOfEvent_EvtInfo_VCEvEcmPropFr02Tioutd: RteEventRef=OpEventGetDTCOfEvent_GetDTCOfEvent_EvtInfo_VCEvEcmPropFr02Tioutd
          OpEventGetDTCOfEvent_GetDTCOfEvent_Event_VCEvEcmPropFr02Tioutd: RteEventRef=OpEventGetDTCOfEvent_GetDTCOfEvent_Event_VCEvEcmPropFr02Tioutd
          OpEventGetDTCOfEvent_GetDTCOfEvent_EvtInfo_Ga_TmSpdSyncFailed: RteEventRef=OpEventGetDTCOfEvent_GetDTCOfEvent_EvtInfo_Ga_TmSpdSyncFailed
          OpEventGetDTCOfEvent_GetDTCOfEvent_Event_Ga_TmSpdSyncFailed: RteEventRef=OpEventGetDTCOfEvent_GetDTCOfEvent_Event_Ga_TmSpdSyncFailed
          OpEventGetDTCOfEvent_GetDTCOfEvent_EvtInfo_INV_RSLVR_EXCT_ELEC_LO: RteEventRef=OpEventGetDTCOfEvent_GetDTCOfEvent_EvtInfo_INV_RSLVR_EXCT_ELEC_LO
          OpEventGetDTCOfEvent_GetDTCOfEvent_Event_INV_RSLVR_EXCT_ELEC_LO: RteEventRef=OpEventGetDTCOfEvent_GetDTCOfEvent_Event_INV_RSLVR_EXCT_ELEC_LO
          OpEventGetDTCOfEvent_GetDTCOfEvent_EvtInfo_VCEvEcmPropXevFr06Tioutd: RteEventRef=OpEventGetDTCOfEvent_GetDTCOfEvent_EvtInfo_VCEvEcmPropXevFr06Tioutd
          OpEventGetDTCOfEvent_GetDTCOfEvent_Event_VCEvEcmPropXevFr06Tioutd: RteEventRef=OpEventGetDTCOfEvent_GetDTCOfEvent_Event_VCEvEcmPropXevFr06Tioutd
          OpEventGetDTCOfEvent_GetDTCOfEvent_EvtInfo_VcEvCntrWhlMotSysTqAllwd: RteEventRef=OpEventGetDTCOfEvent_GetDTCOfEvent_EvtInfo_VcEvCntrWhlMotSysTqAllwd
          OpEventGetDTCOfEvent_GetDTCOfEvent_Event_VcEvCntrWhlMotSysTqAllwd: RteEventRef=OpEventGetDTCOfEvent_GetDTCOfEvent_Event_VcEvCntrWhlMotSysTqAllwd
          OpEventGetDTCOfEvent_GetDTCOfEvent_EvtInfo_INV_UHVDC_1_ELEC_HI: RteEventRef=OpEventGetDTCOfEvent_GetDTCOfEvent_EvtInfo_INV_UHVDC_1_ELEC_HI
          OpEventGetDTCOfEvent_GetDTCOfEvent_Event_INV_UHVDC_1_ELEC_HI: RteEventRef=OpEventGetDTCOfEvent_GetDTCOfEvent_Event_INV_UHVDC_1_ELEC_HI
          OpEventGetDTCOfEvent_GetDTCOfEvent_EvtInfo_INV_EM_STATOR_TEMP2_ELE_FLT: RteEventRef=OpEventGetDTCOfEvent_GetDTCOfEvent_EvtInfo_INV_EM_STATOR_TEMP2_ELE_FLT
          OpEventGetDTCOfEvent_GetDTCOfEvent_Event_INV_EM_STATOR_TEMP2_ELE_FLT: RteEventRef=OpEventGetDTCOfEvent_GetDTCOfEvent_Event_INV_EM_STATOR_TEMP2_ELE_FLT
          OpEventGetDTCOfEvent_GetDTCOfEvent_EvtInfo_AURIX_RST_SNG: RteEventRef=OpEventGetDTCOfEvent_GetDTCOfEvent_EvtInfo_AURIX_RST_SNG
          OpEventGetDTCOfEvent_GetDTCOfEvent_Event_AURIX_RST_SNG: RteEventRef=OpEventGetDTCOfEvent_GetDTCOfEvent_Event_AURIX_RST_SNG
          OpEventGetDTCOfEvent_GetDTCOfEvent_EvtInfo_VCEvEcmPropFr24MgmFr01Tioutd: RteEventRef=OpEventGetDTCOfEvent_GetDTCOfEvent_EvtInfo_VCEvEcmPropFr24MgmFr01Tioutd
          OpEventGetDTCOfEvent_GetDTCOfEvent_Event_VCEvEcmPropFr24MgmFr01Tioutd: RteEventRef=OpEventGetDTCOfEvent_GetDTCOfEvent_Event_VCEvEcmPropFr24MgmFr01Tioutd
          OpEventGetDTCOfEvent_GetDTCOfEvent_EvtInfo_INV_RSLVR_COS_ELEC_OPEN: RteEventRef=OpEventGetDTCOfEvent_GetDTCOfEvent_EvtInfo_INV_RSLVR_COS_ELEC_OPEN
          OpEventGetDTCOfEvent_GetDTCOfEvent_Event_INV_RSLVR_COS_ELEC_OPEN: RteEventRef=OpEventGetDTCOfEvent_GetDTCOfEvent_Event_INV_RSLVR_COS_ELEC_OPEN
          OpEventGetDTCOfEvent_GetDTCOfEvent_EvtInfo_INV_IAC_V_ELEC_LO: RteEventRef=OpEventGetDTCOfEvent_GetDTCOfEvent_EvtInfo_INV_IAC_V_ELEC_LO
          OpEventGetDTCOfEvent_GetDTCOfEvent_Event_INV_IAC_V_ELEC_LO: RteEventRef=OpEventGetDTCOfEvent_GetDTCOfEvent_Event_INV_IAC_V_ELEC_LO
          OpEventGetDTCOfEvent_GetDTCOfEvent_EvtInfo_INV_IAC_W_OFFS: RteEventRef=OpEventGetDTCOfEvent_GetDTCOfEvent_EvtInfo_INV_IAC_W_OFFS
          OpEventGetDTCOfEvent_GetDTCOfEvent_Event_INV_IAC_W_OFFS: RteEventRef=OpEventGetDTCOfEvent_GetDTCOfEvent_Event_INV_IAC_W_OFFS
          OpEventGetDTCOfEvent_GetDTCOfEvent_EvtInfo_INV_EM_STATOR_TEMP2_GRDT: RteEventRef=OpEventGetDTCOfEvent_GetDTCOfEvent_EvtInfo_INV_EM_STATOR_TEMP2_GRDT
          OpEventGetDTCOfEvent_GetDTCOfEvent_Event_INV_EM_STATOR_TEMP2_GRDT: RteEventRef=OpEventGetDTCOfEvent_GetDTCOfEvent_Event_INV_EM_STATOR_TEMP2_GRDT
          OpEventGetDTCOfEvent_GetDTCOfEvent_EvtInfo_INV_EM_OVRSPD_HWP: RteEventRef=OpEventGetDTCOfEvent_GetDTCOfEvent_EvtInfo_INV_EM_OVRSPD_HWP
          OpEventGetDTCOfEvent_GetDTCOfEvent_Event_INV_EM_OVRSPD_HWP: RteEventRef=OpEventGetDTCOfEvent_GetDTCOfEvent_Event_INV_EM_OVRSPD_HWP
          OpEventGetDTCOfEvent_GetDTCOfEvent_EvtInfo_CU_TEMP_HWP: RteEventRef=OpEventGetDTCOfEvent_GetDTCOfEvent_EvtInfo_CU_TEMP_HWP
          OpEventGetDTCOfEvent_GetDTCOfEvent_Event_CU_TEMP_HWP: RteEventRef=OpEventGetDTCOfEvent_GetDTCOfEvent_Event_CU_TEMP_HWP
          OpEventGetDTCOfEvent_GetDTCOfEvent_EvtInfo_INV_UHVDC_1_RNG_HI: RteEventRef=OpEventGetDTCOfEvent_GetDTCOfEvent_EvtInfo_INV_UHVDC_1_RNG_HI
          OpEventGetDTCOfEvent_GetDTCOfEvent_Event_INV_UHVDC_1_RNG_HI: RteEventRef=OpEventGetDTCOfEvent_GetDTCOfEvent_Event_INV_UHVDC_1_RNG_HI
          OpEventGetDTCOfEvent_GetDTCOfEvent_EvtInfo_VcEvEMPerfPlaus: RteEventRef=OpEventGetDTCOfEvent_GetDTCOfEvent_EvtInfo_VcEvEMPerfPlaus
          OpEventGetDTCOfEvent_GetDTCOfEvent_Event_VcEvEMPerfPlaus: RteEventRef=OpEventGetDTCOfEvent_GetDTCOfEvent_Event_VcEvEMPerfPlaus
          OpEventGetDTCOfEvent_GetDTCOfEvent_EvtInfo_VCEvVddmPropFr18Tioutd: RteEventRef=OpEventGetDTCOfEvent_GetDTCOfEvent_EvtInfo_VCEvVddmPropFr18Tioutd
          OpEventGetDTCOfEvent_GetDTCOfEvent_Event_VCEvVddmPropFr18Tioutd: RteEventRef=OpEventGetDTCOfEvent_GetDTCOfEvent_Event_VCEvVddmPropFr18Tioutd
          OpEventGetDTCOfEvent_GetDTCOfEvent_EvtInfo_INV_IAC_U_ELEC_HWP: RteEventRef=OpEventGetDTCOfEvent_GetDTCOfEvent_EvtInfo_INV_IAC_U_ELEC_HWP
          OpEventGetDTCOfEvent_GetDTCOfEvent_Event_INV_IAC_U_ELEC_HWP: RteEventRef=OpEventGetDTCOfEvent_GetDTCOfEvent_Event_INV_IAC_U_ELEC_HWP
          OpEventGetDTCOfEvent_GetDTCOfEvent_EvtInfo_VCEvVddmPropFr15Tioutd: RteEventRef=OpEventGetDTCOfEvent_GetDTCOfEvent_EvtInfo_VCEvVddmPropFr15Tioutd
          OpEventGetDTCOfEvent_GetDTCOfEvent_Event_VCEvVddmPropFr15Tioutd: RteEventRef=OpEventGetDTCOfEvent_GetDTCOfEvent_Event_VCEvVddmPropFr15Tioutd
          OpEventGetDTCOfEvent_GetDTCOfEvent_EvtInfo_Ga_GADisengageFailure: RteEventRef=OpEventGetDTCOfEvent_GetDTCOfEvent_EvtInfo_Ga_GADisengageFailure
          OpEventGetDTCOfEvent_GetDTCOfEvent_Event_Ga_GADisengageFailure: RteEventRef=OpEventGetDTCOfEvent_GetDTCOfEvent_Event_Ga_GADisengageFailure
          OpEventGetDTCOfEvent_GetDTCOfEvent_EvtInfo_CU_TEMP2_RNG_LO: RteEventRef=OpEventGetDTCOfEvent_GetDTCOfEvent_EvtInfo_CU_TEMP2_RNG_LO
          OpEventGetDTCOfEvent_GetDTCOfEvent_Event_CU_TEMP2_RNG_LO: RteEventRef=OpEventGetDTCOfEvent_GetDTCOfEvent_Event_CU_TEMP2_RNG_LO
          OpEventGetDTCOfEvent_GetDTCOfEvent_EvtInfo_INV_RSLVR_SIN_ELEC_OPEN: RteEventRef=OpEventGetDTCOfEvent_GetDTCOfEvent_EvtInfo_INV_RSLVR_SIN_ELEC_OPEN
          OpEventGetDTCOfEvent_GetDTCOfEvent_Event_INV_RSLVR_SIN_ELEC_OPEN: RteEventRef=OpEventGetDTCOfEvent_GetDTCOfEvent_Event_INV_RSLVR_SIN_ELEC_OPEN
          OpEventGetDTCOfEvent_GetDTCOfEvent_EvtInfo_VcEvChkSum: RteEventRef=OpEventGetDTCOfEvent_GetDTCOfEvent_EvtInfo_VcEvChkSum
          OpEventGetDTCOfEvent_GetDTCOfEvent_Event_VcEvChkSum: RteEventRef=OpEventGetDTCOfEvent_GetDTCOfEvent_Event_VcEvChkSum
          OpEventGetDTCOfEvent_GetDTCOfEvent_EvtInfo_PS_P5_UC_FLT: RteEventRef=OpEventGetDTCOfEvent_GetDTCOfEvent_EvtInfo_PS_P5_UC_FLT
          OpEventGetDTCOfEvent_GetDTCOfEvent_Event_PS_P5_UC_FLT: RteEventRef=OpEventGetDTCOfEvent_GetDTCOfEvent_Event_PS_P5_UC_FLT
          OpEventGetDTCOfEvent_GetDTCOfEvent_EvtInfo_INV_RSLVR_COS_ELEC_FLT: RteEventRef=OpEventGetDTCOfEvent_GetDTCOfEvent_EvtInfo_INV_RSLVR_COS_ELEC_FLT
          OpEventGetDTCOfEvent_GetDTCOfEvent_Event_INV_RSLVR_COS_ELEC_FLT: RteEventRef=OpEventGetDTCOfEvent_GetDTCOfEvent_Event_INV_RSLVR_COS_ELEC_FLT
          OpEventGetDTCOfEvent_GetDTCOfEvent_EvtInfo_INV_IAC_W_RNG_HI: RteEventRef=OpEventGetDTCOfEvent_GetDTCOfEvent_EvtInfo_INV_IAC_W_RNG_HI
          OpEventGetDTCOfEvent_GetDTCOfEvent_Event_INV_IAC_W_RNG_HI: RteEventRef=OpEventGetDTCOfEvent_GetDTCOfEvent_Event_INV_IAC_W_RNG_HI
          OpEventGetDTCOfEvent_GetDTCOfEvent_EvtInfo_PS_ECUSUPPLY_HIGH: RteEventRef=OpEventGetDTCOfEvent_GetDTCOfEvent_EvtInfo_PS_ECUSUPPLY_HIGH
          OpEventGetDTCOfEvent_GetDTCOfEvent_Event_PS_ECUSUPPLY_HIGH: RteEventRef=OpEventGetDTCOfEvent_GetDTCOfEvent_Event_PS_ECUSUPPLY_HIGH
          OpEventGetDTCOfEvent_GetDTCOfEvent_EvtInfo_VCEvEcmPropFr05Tioutd: RteEventRef=OpEventGetDTCOfEvent_GetDTCOfEvent_EvtInfo_VCEvEcmPropFr05Tioutd
          OpEventGetDTCOfEvent_GetDTCOfEvent_Event_VCEvEcmPropFr05Tioutd: RteEventRef=OpEventGetDTCOfEvent_GetDTCOfEvent_Event_VCEvEcmPropFr05Tioutd
          OpEventGetDTCOfEvent_GetDTCOfEvent_EvtInfo_PS_ECUSUPPLY_LOW: RteEventRef=OpEventGetDTCOfEvent_GetDTCOfEvent_EvtInfo_PS_ECUSUPPLY_LOW
          OpEventGetDTCOfEvent_GetDTCOfEvent_Event_PS_ECUSUPPLY_LOW: RteEventRef=OpEventGetDTCOfEvent_GetDTCOfEvent_Event_PS_ECUSUPPLY_LOW
          OpEventGetDTCOfEvent_GetDTCOfEvent_EvtInfo_VcEvChkSumHvSysRlySts: RteEventRef=OpEventGetDTCOfEvent_GetDTCOfEvent_EvtInfo_VcEvChkSumHvSysRlySts
          OpEventGetDTCOfEvent_GetDTCOfEvent_Event_VcEvChkSumHvSysRlySts: RteEventRef=OpEventGetDTCOfEvent_GetDTCOfEvent_Event_VcEvChkSumHvSysRlySts
          OpEventGetDTCOfEvent_GetDTCOfEvent_EvtInfo_VcEvMonMode: RteEventRef=OpEventGetDTCOfEvent_GetDTCOfEvent_EvtInfo_VcEvMonMode
          OpEventGetDTCOfEvent_GetDTCOfEvent_Event_VcEvMonMode: RteEventRef=OpEventGetDTCOfEvent_GetDTCOfEvent_Event_VcEvMonMode
          OpEventGetDTCOfEvent_GetDTCOfEvent_EvtInfo_INV_IAC_OC_SWP: RteEventRef=OpEventGetDTCOfEvent_GetDTCOfEvent_EvtInfo_INV_IAC_OC_SWP
          OpEventGetDTCOfEvent_GetDTCOfEvent_Event_INV_IAC_OC_SWP: RteEventRef=OpEventGetDTCOfEvent_GetDTCOfEvent_Event_INV_IAC_OC_SWP
          OpEventGetDTCOfEvent_GetDTCOfEvent_EvtInfo_INV_IMMO_AUTHFAIL: RteEventRef=OpEventGetDTCOfEvent_GetDTCOfEvent_EvtInfo_INV_IMMO_AUTHFAIL
          OpEventGetDTCOfEvent_GetDTCOfEvent_Event_INV_IMMO_AUTHFAIL: RteEventRef=OpEventGetDTCOfEvent_GetDTCOfEvent_Event_INV_IMMO_AUTHFAIL
          OpEventGetDTCOfEvent_GetDTCOfEvent_EvtInfo_PA_OpenCirc_FLT: RteEventRef=OpEventGetDTCOfEvent_GetDTCOfEvent_EvtInfo_PA_OpenCirc_FLT
          OpEventGetDTCOfEvent_GetDTCOfEvent_Event_PA_OpenCirc_FLT: RteEventRef=OpEventGetDTCOfEvent_GetDTCOfEvent_Event_PA_OpenCirc_FLT
          OpEventGetDTCOfEvent_GetDTCOfEvent_EvtInfo_INV_IAC_V_ELEC_HI: RteEventRef=OpEventGetDTCOfEvent_GetDTCOfEvent_EvtInfo_INV_IAC_V_ELEC_HI
          OpEventGetDTCOfEvent_GetDTCOfEvent_Event_INV_IAC_V_ELEC_HI: RteEventRef=OpEventGetDTCOfEvent_GetDTCOfEvent_Event_INV_IAC_V_ELEC_HI
          OpEventGetDTCOfEvent_GetDTCOfEvent_EvtInfo_VCEvEcmPropFr04Tioutd: RteEventRef=OpEventGetDTCOfEvent_GetDTCOfEvent_EvtInfo_VCEvEcmPropFr04Tioutd
          OpEventGetDTCOfEvent_GetDTCOfEvent_Event_VCEvEcmPropFr04Tioutd: RteEventRef=OpEventGetDTCOfEvent_GetDTCOfEvent_Event_VCEvEcmPropFr04Tioutd
          OpEventGetDTCOfEvent_GetDTCOfEvent_EvtInfo_VcEvMonTrqActPlaus: RteEventRef=OpEventGetDTCOfEvent_GetDTCOfEvent_EvtInfo_VcEvMonTrqActPlaus
          OpEventGetDTCOfEvent_GetDTCOfEvent_Event_VcEvMonTrqActPlaus: RteEventRef=OpEventGetDTCOfEvent_GetDTCOfEvent_Event_VcEvMonTrqActPlaus
          OpEventGetDTCOfEvent_GetDTCOfEvent_EvtInfo_VcEvMonTrqAct: RteEventRef=OpEventGetDTCOfEvent_GetDTCOfEvent_EvtInfo_VcEvMonTrqAct
          OpEventGetDTCOfEvent_GetDTCOfEvent_Event_VcEvMonTrqAct: RteEventRef=OpEventGetDTCOfEvent_GetDTCOfEvent_Event_VcEvMonTrqAct
          OpEventGetDTCOfEvent_GetDTCOfEvent_EvtInfo_INV_RSLVR_COS_ELEC_LO: RteEventRef=OpEventGetDTCOfEvent_GetDTCOfEvent_EvtInfo_INV_RSLVR_COS_ELEC_LO
          OpEventGetDTCOfEvent_GetDTCOfEvent_Event_INV_RSLVR_COS_ELEC_LO: RteEventRef=OpEventGetDTCOfEvent_GetDTCOfEvent_Event_INV_RSLVR_COS_ELEC_LO
          OpEventGetDTCOfEvent_GetDTCOfEvent_EvtInfo_INV_COOLT_INLET_TEMP_HWP: RteEventRef=OpEventGetDTCOfEvent_GetDTCOfEvent_EvtInfo_INV_COOLT_INLET_TEMP_HWP
          OpEventGetDTCOfEvent_GetDTCOfEvent_Event_INV_COOLT_INLET_TEMP_HWP: RteEventRef=OpEventGetDTCOfEvent_GetDTCOfEvent_Event_INV_COOLT_INLET_TEMP_HWP
          OpEventGetDTCOfEvent_GetDTCOfEvent_EvtInfo_VCEvEcmPropFr11Tioutd: RteEventRef=OpEventGetDTCOfEvent_GetDTCOfEvent_EvtInfo_VCEvEcmPropFr11Tioutd
          OpEventGetDTCOfEvent_GetDTCOfEvent_Event_VCEvEcmPropFr11Tioutd: RteEventRef=OpEventGetDTCOfEvent_GetDTCOfEvent_Event_VCEvEcmPropFr11Tioutd
          OpEventGetDTCOfEvent_GetDTCOfEvent_EvtInfo_PS_KL30_RNG_HI: RteEventRef=OpEventGetDTCOfEvent_GetDTCOfEvent_EvtInfo_PS_KL30_RNG_HI
          OpEventGetDTCOfEvent_GetDTCOfEvent_Event_PS_KL30_RNG_HI: RteEventRef=OpEventGetDTCOfEvent_GetDTCOfEvent_Event_PS_KL30_RNG_HI
          OpEventGetDTCOfEvent_GetDTCOfEvent_EvtInfo_INV_IAC_OC_HWP: RteEventRef=OpEventGetDTCOfEvent_GetDTCOfEvent_EvtInfo_INV_IAC_OC_HWP
          OpEventGetDTCOfEvent_GetDTCOfEvent_Event_INV_IAC_OC_HWP: RteEventRef=OpEventGetDTCOfEvent_GetDTCOfEvent_Event_INV_IAC_OC_HWP
          OpEventGetDTCOfEvent_GetDTCOfEvent_EvtInfo_INV_RSLVR_COS_RNG_HI: RteEventRef=OpEventGetDTCOfEvent_GetDTCOfEvent_EvtInfo_INV_RSLVR_COS_RNG_HI
          OpEventGetDTCOfEvent_GetDTCOfEvent_Event_INV_RSLVR_COS_RNG_HI: RteEventRef=OpEventGetDTCOfEvent_GetDTCOfEvent_Event_INV_RSLVR_COS_RNG_HI
          OpEventGetDTCOfEvent_GetDTCOfEvent_EvtInfo_INV_IAC_U_ELEC_HI: RteEventRef=OpEventGetDTCOfEvent_GetDTCOfEvent_EvtInfo_INV_IAC_U_ELEC_HI
          OpEventGetDTCOfEvent_GetDTCOfEvent_Event_INV_IAC_U_ELEC_HI: RteEventRef=OpEventGetDTCOfEvent_GetDTCOfEvent_Event_INV_IAC_U_ELEC_HI
          OpEventGetDTCOfEvent_GetDTCOfEvent_EvtInfo_INV_IAC_V_RNG_LO: RteEventRef=OpEventGetDTCOfEvent_GetDTCOfEvent_EvtInfo_INV_IAC_V_RNG_LO
          OpEventGetDTCOfEvent_GetDTCOfEvent_Event_INV_IAC_V_RNG_LO: RteEventRef=OpEventGetDTCOfEvent_GetDTCOfEvent_Event_INV_IAC_V_RNG_LO
          OpEventGetDTCOfEvent_GetDTCOfEvent_EvtInfo_INV_IAC_U_RNG_HI: RteEventRef=OpEventGetDTCOfEvent_GetDTCOfEvent_EvtInfo_INV_IAC_U_RNG_HI
          OpEventGetDTCOfEvent_GetDTCOfEvent_Event_INV_IAC_U_RNG_HI: RteEventRef=OpEventGetDTCOfEvent_GetDTCOfEvent_Event_INV_IAC_U_RNG_HI
          OpEventGetDTCOfEvent_GetDTCOfEvent_EvtInfo_VCEvEcmPropFr25Tioutd: RteEventRef=OpEventGetDTCOfEvent_GetDTCOfEvent_EvtInfo_VCEvEcmPropFr25Tioutd
          OpEventGetDTCOfEvent_GetDTCOfEvent_Event_VCEvEcmPropFr25Tioutd: RteEventRef=OpEventGetDTCOfEvent_GetDTCOfEvent_Event_VCEvEcmPropFr25Tioutd
          OpEventGetDTCOfEvent_GetDTCOfEvent_EvtInfo_INV_IGBT_TEMP_W_RNG_LO: RteEventRef=OpEventGetDTCOfEvent_GetDTCOfEvent_EvtInfo_INV_IGBT_TEMP_W_RNG_LO
          OpEventGetDTCOfEvent_GetDTCOfEvent_Event_INV_IGBT_TEMP_W_RNG_LO: RteEventRef=OpEventGetDTCOfEvent_GetDTCOfEvent_Event_INV_IGBT_TEMP_W_RNG_LO
          OpEventGetDTCOfEvent_GetDTCOfEvent_EvtInfo_PSnsr_RNG_NOK: RteEventRef=OpEventGetDTCOfEvent_GetDTCOfEvent_EvtInfo_PSnsr_RNG_NOK
          OpEventGetDTCOfEvent_GetDTCOfEvent_Event_PSnsr_RNG_NOK: RteEventRef=OpEventGetDTCOfEvent_GetDTCOfEvent_Event_PSnsr_RNG_NOK
          OpEventGetDTCOfEvent_GetDTCOfEvent_EvtInfo_INV_RSLVR_COS_RNG_NOK: RteEventRef=OpEventGetDTCOfEvent_GetDTCOfEvent_EvtInfo_INV_RSLVR_COS_RNG_NOK
          OpEventGetDTCOfEvent_GetDTCOfEvent_Event_INV_RSLVR_COS_RNG_NOK: RteEventRef=OpEventGetDTCOfEvent_GetDTCOfEvent_Event_INV_RSLVR_COS_RNG_NOK
          OpEventGetDTCOfEvent_GetDTCOfEvent_EvtInfo_PS_DRVB_Fault: RteEventRef=OpEventGetDTCOfEvent_GetDTCOfEvent_EvtInfo_PS_DRVB_Fault
          OpEventGetDTCOfEvent_GetDTCOfEvent_Event_PS_DRVB_Fault: RteEventRef=OpEventGetDTCOfEvent_GetDTCOfEvent_Event_PS_DRVB_Fault
          OpEventGetDTCOfEvent_GetDTCOfEvent_EvtInfo_INV_CU_TEMP1_RNG_NOK: RteEventRef=OpEventGetDTCOfEvent_GetDTCOfEvent_EvtInfo_INV_CU_TEMP1_RNG_NOK
          OpEventGetDTCOfEvent_GetDTCOfEvent_Event_INV_CU_TEMP1_RNG_NOK: RteEventRef=OpEventGetDTCOfEvent_GetDTCOfEvent_Event_INV_CU_TEMP1_RNG_NOK
          OpEventGetDTCOfEvent_GetDTCOfEvent_EvtInfo_VcEvCntr: RteEventRef=OpEventGetDTCOfEvent_GetDTCOfEvent_EvtInfo_VcEvCntr
          OpEventGetDTCOfEvent_GetDTCOfEvent_Event_VcEvCntr: RteEventRef=OpEventGetDTCOfEvent_GetDTCOfEvent_Event_VcEvCntr
          OpEventGetDTCOfEvent_GetDTCOfEvent_EvtInfo_INV_RSLVR_SIN_AMP: RteEventRef=OpEventGetDTCOfEvent_GetDTCOfEvent_EvtInfo_INV_RSLVR_SIN_AMP
          OpEventGetDTCOfEvent_GetDTCOfEvent_Event_INV_RSLVR_SIN_AMP: RteEventRef=OpEventGetDTCOfEvent_GetDTCOfEvent_Event_INV_RSLVR_SIN_AMP
          OpEventGetDTCOfEvent_GetDTCOfEvent_EvtInfo_INV_UHVDC_2_RNG_HI: RteEventRef=OpEventGetDTCOfEvent_GetDTCOfEvent_EvtInfo_INV_UHVDC_2_RNG_HI
          OpEventGetDTCOfEvent_GetDTCOfEvent_Event_INV_UHVDC_2_RNG_HI: RteEventRef=OpEventGetDTCOfEvent_GetDTCOfEvent_Event_INV_UHVDC_2_RNG_HI
          OpEventGetDTCOfEvent_GetDTCOfEvent_EvtInfo_INV_IGBT_TEMP_U_GRDT: RteEventRef=OpEventGetDTCOfEvent_GetDTCOfEvent_EvtInfo_INV_IGBT_TEMP_U_GRDT
          OpEventGetDTCOfEvent_GetDTCOfEvent_Event_INV_IGBT_TEMP_U_GRDT: RteEventRef=OpEventGetDTCOfEvent_GetDTCOfEvent_Event_INV_IGBT_TEMP_U_GRDT
          OpEventGetDTCOfEvent_GetDTCOfEvent_EvtInfo_MON_TQ_PLAUS_PWR_MDL: RteEventRef=OpEventGetDTCOfEvent_GetDTCOfEvent_EvtInfo_MON_TQ_PLAUS_PWR_MDL
          OpEventGetDTCOfEvent_GetDTCOfEvent_Event_MON_TQ_PLAUS_PWR_MDL: RteEventRef=OpEventGetDTCOfEvent_GetDTCOfEvent_Event_MON_TQ_PLAUS_PWR_MDL
          OpEventGetDTCOfEvent_GetDTCOfEvent_EvtInfo_INV_IGBT_TEMP_W_PLAUS: RteEventRef=OpEventGetDTCOfEvent_GetDTCOfEvent_EvtInfo_INV_IGBT_TEMP_W_PLAUS
          OpEventGetDTCOfEvent_GetDTCOfEvent_Event_INV_IGBT_TEMP_W_PLAUS: RteEventRef=OpEventGetDTCOfEvent_GetDTCOfEvent_Event_INV_IGBT_TEMP_W_PLAUS
          OpEventGetDTCOfEvent_GetDTCOfEvent_EvtInfo_PS_BLDC_UV_FLT: RteEventRef=OpEventGetDTCOfEvent_GetDTCOfEvent_EvtInfo_PS_BLDC_UV_FLT
          OpEventGetDTCOfEvent_GetDTCOfEvent_Event_PS_BLDC_UV_FLT: RteEventRef=OpEventGetDTCOfEvent_GetDTCOfEvent_Event_PS_BLDC_UV_FLT
          OpEventGetDTCOfEvent_GetDTCOfEvent_EvtInfo_INV_IAC_V_OFFS: RteEventRef=OpEventGetDTCOfEvent_GetDTCOfEvent_EvtInfo_INV_IAC_V_OFFS
          OpEventGetDTCOfEvent_GetDTCOfEvent_Event_INV_IAC_V_OFFS: RteEventRef=OpEventGetDTCOfEvent_GetDTCOfEvent_Event_INV_IAC_V_OFFS
          OpEventGetDTCOfEvent_GetDTCOfEvent_EvtInfo_INV_RSLVR_EXCT_FREQ_RNG_NOK: RteEventRef=OpEventGetDTCOfEvent_GetDTCOfEvent_EvtInfo_INV_RSLVR_EXCT_FREQ_RNG_NOK
          OpEventGetDTCOfEvent_GetDTCOfEvent_Event_INV_RSLVR_EXCT_FREQ_RNG_NOK: RteEventRef=OpEventGetDTCOfEvent_GetDTCOfEvent_Event_INV_RSLVR_EXCT_FREQ_RNG_NOK
          OpEventGetDTCOfEvent_GetDTCOfEvent_EvtInfo_PS_KL30_RNG_LO: RteEventRef=OpEventGetDTCOfEvent_GetDTCOfEvent_EvtInfo_PS_KL30_RNG_LO
          OpEventGetDTCOfEvent_GetDTCOfEvent_Event_PS_KL30_RNG_LO: RteEventRef=OpEventGetDTCOfEvent_GetDTCOfEvent_Event_PS_KL30_RNG_LO
          OpEventGetDTCOfEvent_GetDTCOfEvent_EvtInfo_INV_RSLVR_COS_RNG_LO: RteEventRef=OpEventGetDTCOfEvent_GetDTCOfEvent_EvtInfo_INV_RSLVR_COS_RNG_LO
          OpEventGetDTCOfEvent_GetDTCOfEvent_Event_INV_RSLVR_COS_RNG_LO: RteEventRef=OpEventGetDTCOfEvent_GetDTCOfEvent_Event_INV_RSLVR_COS_RNG_LO
          OpEventGetDTCOfEvent_GetDTCOfEvent_EvtInfo_PSnsr_ELE_FLT: RteEventRef=OpEventGetDTCOfEvent_GetDTCOfEvent_EvtInfo_PSnsr_ELE_FLT
          OpEventGetDTCOfEvent_GetDTCOfEvent_Event_PSnsr_ELE_FLT: RteEventRef=OpEventGetDTCOfEvent_GetDTCOfEvent_Event_PSnsr_ELE_FLT
          OpEventGetDTCOfEvent_GetDTCOfEvent_EvtInfo_INV_RSLVR_SIN_COS_PLAUS_AMP: RteEventRef=OpEventGetDTCOfEvent_GetDTCOfEvent_EvtInfo_INV_RSLVR_SIN_COS_PLAUS_AMP
          OpEventGetDTCOfEvent_GetDTCOfEvent_Event_INV_RSLVR_SIN_COS_PLAUS_AMP: RteEventRef=OpEventGetDTCOfEvent_GetDTCOfEvent_Event_INV_RSLVR_SIN_COS_PLAUS_AMP
          OpEventGetDTCOfEvent_GetDTCOfEvent_EvtInfo_INV_IAC_U_ELEC_LO: RteEventRef=OpEventGetDTCOfEvent_GetDTCOfEvent_EvtInfo_INV_IAC_U_ELEC_LO
          OpEventGetDTCOfEvent_GetDTCOfEvent_Event_INV_IAC_U_ELEC_LO: RteEventRef=OpEventGetDTCOfEvent_GetDTCOfEvent_Event_INV_IAC_U_ELEC_LO
          OpEventGetDTCOfEvent_GetDTCOfEvent_EvtInfo_INV_RSLVR_EXCT_ELEC_HI: RteEventRef=OpEventGetDTCOfEvent_GetDTCOfEvent_EvtInfo_INV_RSLVR_EXCT_ELEC_HI
          OpEventGetDTCOfEvent_GetDTCOfEvent_Event_INV_RSLVR_EXCT_ELEC_HI: RteEventRef=OpEventGetDTCOfEvent_GetDTCOfEvent_Event_INV_RSLVR_EXCT_ELEC_HI
          OpEventGetDTCOfEvent_GetDTCOfEvent_EvtInfo_INV_IAC_U_RNG_LO: RteEventRef=OpEventGetDTCOfEvent_GetDTCOfEvent_EvtInfo_INV_IAC_U_RNG_LO
          OpEventGetDTCOfEvent_GetDTCOfEvent_Event_INV_IAC_U_RNG_LO: RteEventRef=OpEventGetDTCOfEvent_GetDTCOfEvent_Event_INV_IAC_U_RNG_LO
          OpEventGetDTCOfEvent_GetDTCOfEvent_EvtInfo_INV_IAC_V_RNG_HI: RteEventRef=OpEventGetDTCOfEvent_GetDTCOfEvent_EvtInfo_INV_IAC_V_RNG_HI
          OpEventGetDTCOfEvent_GetDTCOfEvent_Event_INV_IAC_V_RNG_HI: RteEventRef=OpEventGetDTCOfEvent_GetDTCOfEvent_Event_INV_IAC_V_RNG_HI
          OpEventGetDTCOfEvent_GetDTCOfEvent_EvtInfo_INV_IGBT_TEMP_U_PLAUS: RteEventRef=OpEventGetDTCOfEvent_GetDTCOfEvent_EvtInfo_INV_IGBT_TEMP_U_PLAUS
          OpEventGetDTCOfEvent_GetDTCOfEvent_Event_INV_IGBT_TEMP_U_PLAUS: RteEventRef=OpEventGetDTCOfEvent_GetDTCOfEvent_Event_INV_IGBT_TEMP_U_PLAUS
          OpEventGetDTCOfEvent_GetDTCOfEvent_EvtInfo_INV_RSLVR_OFFS_DFT: RteEventRef=OpEventGetDTCOfEvent_GetDTCOfEvent_EvtInfo_INV_RSLVR_OFFS_DFT
          OpEventGetDTCOfEvent_GetDTCOfEvent_Event_INV_RSLVR_OFFS_DFT: RteEventRef=OpEventGetDTCOfEvent_GetDTCOfEvent_Event_INV_RSLVR_OFFS_DFT
          OpEventGetDTCOfEvent_GetDTCOfEvent_EvtInfo_Ga_MoveOverThd: RteEventRef=OpEventGetDTCOfEvent_GetDTCOfEvent_EvtInfo_Ga_MoveOverThd
          OpEventGetDTCOfEvent_GetDTCOfEvent_Event_Ga_MoveOverThd: RteEventRef=OpEventGetDTCOfEvent_GetDTCOfEvent_Event_Ga_MoveOverThd
          OpEventGetDTCOfEvent_GetDTCOfEvent_EvtInfo_VcEvMonIPH: RteEventRef=OpEventGetDTCOfEvent_GetDTCOfEvent_EvtInfo_VcEvMonIPH
          OpEventGetDTCOfEvent_GetDTCOfEvent_Event_VcEvMonIPH: RteEventRef=OpEventGetDTCOfEvent_GetDTCOfEvent_Event_VcEvMonIPH
          OpEventGetDTCOfEvent_GetDTCOfEvent_EvtInfo_INV_RSLVR_HW_FLT: RteEventRef=OpEventGetDTCOfEvent_GetDTCOfEvent_EvtInfo_INV_RSLVR_HW_FLT
          OpEventGetDTCOfEvent_GetDTCOfEvent_Event_INV_RSLVR_HW_FLT: RteEventRef=OpEventGetDTCOfEvent_GetDTCOfEvent_Event_INV_RSLVR_HW_FLT
          OpEventGetDTCOfEvent_GetDTCOfEvent_EvtInfo_INV_RSLVR_SIN_ELEC_LO: RteEventRef=OpEventGetDTCOfEvent_GetDTCOfEvent_EvtInfo_INV_RSLVR_SIN_ELEC_LO
          OpEventGetDTCOfEvent_GetDTCOfEvent_Event_INV_RSLVR_SIN_ELEC_LO: RteEventRef=OpEventGetDTCOfEvent_GetDTCOfEvent_Event_INV_RSLVR_SIN_ELEC_LO
          OpEventGetDTCOfEvent_GetDTCOfEvent_EvtInfo_INV_IAC_W_AMP: RteEventRef=OpEventGetDTCOfEvent_GetDTCOfEvent_EvtInfo_INV_IAC_W_AMP
          OpEventGetDTCOfEvent_GetDTCOfEvent_Event_INV_IAC_W_AMP: RteEventRef=OpEventGetDTCOfEvent_GetDTCOfEvent_Event_INV_IAC_W_AMP
          OpEventGetDTCOfEvent_GetDTCOfEvent_EvtInfo_VCC_OverVoltage: RteEventRef=OpEventGetDTCOfEvent_GetDTCOfEvent_EvtInfo_VCC_OverVoltage
          OpEventGetDTCOfEvent_GetDTCOfEvent_Event_VCC_OverVoltage: RteEventRef=OpEventGetDTCOfEvent_GetDTCOfEvent_Event_VCC_OverVoltage
          OpEventGetDTCOfEvent_GetDTCOfEvent_EvtInfo_PS_BLDC_OV_FLT: RteEventRef=OpEventGetDTCOfEvent_GetDTCOfEvent_EvtInfo_PS_BLDC_OV_FLT
          OpEventGetDTCOfEvent_GetDTCOfEvent_Event_PS_BLDC_OV_FLT: RteEventRef=OpEventGetDTCOfEvent_GetDTCOfEvent_Event_PS_BLDC_OV_FLT
          OpEventGetDTCOfEvent_GetDTCOfEvent_EvtInfo_AURIX_EEPROM_FLT: RteEventRef=OpEventGetDTCOfEvent_GetDTCOfEvent_EvtInfo_AURIX_EEPROM_FLT
          OpEventGetDTCOfEvent_GetDTCOfEvent_Event_AURIX_EEPROM_FLT: RteEventRef=OpEventGetDTCOfEvent_GetDTCOfEvent_Event_AURIX_EEPROM_FLT
          OpEventGetDTCOfEvent_GetDTCOfEvent_EvtInfo_FS_MONITIOR_ASC_FW_FLT: RteEventRef=OpEventGetDTCOfEvent_GetDTCOfEvent_EvtInfo_FS_MONITIOR_ASC_FW_FLT
          OpEventGetDTCOfEvent_GetDTCOfEvent_Event_FS_MONITIOR_ASC_FW_FLT: RteEventRef=OpEventGetDTCOfEvent_GetDTCOfEvent_Event_FS_MONITIOR_ASC_FW_FLT
          OpEventGetDTCOfEvent_GetDTCOfEvent_EvtInfo_VCEvSrsPropFr02Tioutd: RteEventRef=OpEventGetDTCOfEvent_GetDTCOfEvent_EvtInfo_VCEvSrsPropFr02Tioutd
          OpEventGetDTCOfEvent_GetDTCOfEvent_Event_VCEvSrsPropFr02Tioutd: RteEventRef=OpEventGetDTCOfEvent_GetDTCOfEvent_Event_VCEvSrsPropFr02Tioutd
          OpEventGetDTCOfEvent_GetDTCOfEvent_EvtInfo_VcEvMonErrMode: RteEventRef=OpEventGetDTCOfEvent_GetDTCOfEvent_EvtInfo_VcEvMonErrMode
          OpEventGetDTCOfEvent_GetDTCOfEvent_Event_VcEvMonErrMode: RteEventRef=OpEventGetDTCOfEvent_GetDTCOfEvent_Event_VcEvMonErrMode
          OpEventGetDTCOfEvent_GetDTCOfEvent_EvtInfo_AURIX_RST_MPL: RteEventRef=OpEventGetDTCOfEvent_GetDTCOfEvent_EvtInfo_AURIX_RST_MPL
          OpEventGetDTCOfEvent_GetDTCOfEvent_Event_AURIX_RST_MPL: RteEventRef=OpEventGetDTCOfEvent_GetDTCOfEvent_Event_AURIX_RST_MPL
          OpEventGetDTCOfEvent_GetDTCOfEvent_EvtInfo_VcEvNodeMisECM: RteEventRef=OpEventGetDTCOfEvent_GetDTCOfEvent_EvtInfo_VcEvNodeMisECM
          OpEventGetDTCOfEvent_GetDTCOfEvent_Event_VcEvNodeMisECM: RteEventRef=OpEventGetDTCOfEvent_GetDTCOfEvent_Event_VcEvNodeMisECM
          OpEventGetDTCOfEvent_GetDTCOfEvent_EvtInfo_PS_KL30_PLAUS: RteEventRef=OpEventGetDTCOfEvent_GetDTCOfEvent_EvtInfo_PS_KL30_PLAUS
          OpEventGetDTCOfEvent_GetDTCOfEvent_Event_PS_KL30_PLAUS: RteEventRef=OpEventGetDTCOfEvent_GetDTCOfEvent_Event_PS_KL30_PLAUS
          OpEventGetDTCOfEvent_GetDTCOfEvent_EvtInfo_INV_IAC_W_ELEC_HI: RteEventRef=OpEventGetDTCOfEvent_GetDTCOfEvent_EvtInfo_INV_IAC_W_ELEC_HI
          OpEventGetDTCOfEvent_GetDTCOfEvent_Event_INV_IAC_W_ELEC_HI: RteEventRef=OpEventGetDTCOfEvent_GetDTCOfEvent_Event_INV_IAC_W_ELEC_HI
          OpEventGetDTCOfEvent_GetDTCOfEvent_EvtInfo_VCEvVddmPropFr19Tioutd: RteEventRef=OpEventGetDTCOfEvent_GetDTCOfEvent_EvtInfo_VCEvVddmPropFr19Tioutd
          OpEventGetDTCOfEvent_GetDTCOfEvent_Event_VCEvVddmPropFr19Tioutd: RteEventRef=OpEventGetDTCOfEvent_GetDTCOfEvent_Event_VCEvVddmPropFr19Tioutd
          OpEventGetDTCOfEvent_GetDTCOfEvent_EvtInfo_INV_TEMP_DCHA_HW: RteEventRef=OpEventGetDTCOfEvent_GetDTCOfEvent_EvtInfo_INV_TEMP_DCHA_HW
          OpEventGetDTCOfEvent_GetDTCOfEvent_Event_INV_TEMP_DCHA_HW: RteEventRef=OpEventGetDTCOfEvent_GetDTCOfEvent_Event_INV_TEMP_DCHA_HW
          OpEventGetDTCOfEvent_GetDTCOfEvent_EvtInfo_VcEvPropCANGlbTiOutd: RteEventRef=OpEventGetDTCOfEvent_GetDTCOfEvent_EvtInfo_VcEvPropCANGlbTiOutd
          OpEventGetDTCOfEvent_GetDTCOfEvent_Event_VcEvPropCANGlbTiOutd: RteEventRef=OpEventGetDTCOfEvent_GetDTCOfEvent_Event_VcEvPropCANGlbTiOutd
          OpEventGetDTCOfEvent_GetDTCOfEvent_EvtInfo_INV_EM_STATOR_TEMP2_RNG_NOK: RteEventRef=OpEventGetDTCOfEvent_GetDTCOfEvent_EvtInfo_INV_EM_STATOR_TEMP2_RNG_NOK
          OpEventGetDTCOfEvent_GetDTCOfEvent_Event_INV_EM_STATOR_TEMP2_RNG_NOK: RteEventRef=OpEventGetDTCOfEvent_GetDTCOfEvent_Event_INV_EM_STATOR_TEMP2_RNG_NOK
          OpEventGetDTCOfEvent_GetDTCOfEvent_EvtInfo_INV_UHVDC_OV_HWP: RteEventRef=OpEventGetDTCOfEvent_GetDTCOfEvent_EvtInfo_INV_UHVDC_OV_HWP
          OpEventGetDTCOfEvent_GetDTCOfEvent_Event_INV_UHVDC_OV_HWP: RteEventRef=OpEventGetDTCOfEvent_GetDTCOfEvent_Event_INV_UHVDC_OV_HWP
          OpEventGetDTCOfEvent_GetDTCOfEvent_EvtInfo_Ga_FindEngleAngleFailed: RteEventRef=OpEventGetDTCOfEvent_GetDTCOfEvent_EvtInfo_Ga_FindEngleAngleFailed
          OpEventGetDTCOfEvent_GetDTCOfEvent_Event_Ga_FindEngleAngleFailed: RteEventRef=OpEventGetDTCOfEvent_GetDTCOfEvent_Event_Ga_FindEngleAngleFailed
          OpEventGetDTCOfEvent_GetDTCOfEvent_EvtInfo_VcEvMonTrqCmp: RteEventRef=OpEventGetDTCOfEvent_GetDTCOfEvent_EvtInfo_VcEvMonTrqCmp
          OpEventGetDTCOfEvent_GetDTCOfEvent_Event_VcEvMonTrqCmp: RteEventRef=OpEventGetDTCOfEvent_GetDTCOfEvent_Event_VcEvMonTrqCmp
          OpEventGetDTCOfEvent_GetDTCOfEvent_EvtInfo_INV_IGBT_TEMP_V_RNG_LO: RteEventRef=OpEventGetDTCOfEvent_GetDTCOfEvent_EvtInfo_INV_IGBT_TEMP_V_RNG_LO
          OpEventGetDTCOfEvent_GetDTCOfEvent_Event_INV_IGBT_TEMP_V_RNG_LO: RteEventRef=OpEventGetDTCOfEvent_GetDTCOfEvent_Event_INV_IGBT_TEMP_V_RNG_LO
          OpEventGetDTCOfEvent_GetDTCOfEvent_EvtInfo_INV_CONTROL_LIMIT: RteEventRef=OpEventGetDTCOfEvent_GetDTCOfEvent_EvtInfo_INV_CONTROL_LIMIT
          OpEventGetDTCOfEvent_GetDTCOfEvent_Event_INV_CONTROL_LIMIT: RteEventRef=OpEventGetDTCOfEvent_GetDTCOfEvent_Event_INV_CONTROL_LIMIT
          OpEventGetDTCOfEvent_GetDTCOfEvent_EvtInfo_COM_CarConfigErr: RteEventRef=OpEventGetDTCOfEvent_GetDTCOfEvent_EvtInfo_COM_CarConfigErr
          OpEventGetDTCOfEvent_GetDTCOfEvent_Event_COM_CarConfigErr: RteEventRef=OpEventGetDTCOfEvent_GetDTCOfEvent_Event_COM_CarConfigErr
          OpEventGetDTCOfEvent_GetDTCOfEvent_EvtInfo_VCEvEcmPropFr08Tioutd: RteEventRef=OpEventGetDTCOfEvent_GetDTCOfEvent_EvtInfo_VCEvEcmPropFr08Tioutd
          OpEventGetDTCOfEvent_GetDTCOfEvent_Event_VCEvEcmPropFr08Tioutd: RteEventRef=OpEventGetDTCOfEvent_GetDTCOfEvent_Event_VCEvEcmPropFr08Tioutd
          OpEventGetDTCOfEvent_GetDTCOfEvent_EvtInfo_CU_TEMP1_RNG_LO: RteEventRef=OpEventGetDTCOfEvent_GetDTCOfEvent_EvtInfo_CU_TEMP1_RNG_LO
          OpEventGetDTCOfEvent_GetDTCOfEvent_Event_CU_TEMP1_RNG_LO: RteEventRef=OpEventGetDTCOfEvent_GetDTCOfEvent_Event_CU_TEMP1_RNG_LO
          OpEventGetDTCOfEvent_GetDTCOfEvent_EvtInfo_INV_EM_STATOR_TEMP2_RNG_SWT: RteEventRef=OpEventGetDTCOfEvent_GetDTCOfEvent_EvtInfo_INV_EM_STATOR_TEMP2_RNG_SWT
          OpEventGetDTCOfEvent_GetDTCOfEvent_Event_INV_EM_STATOR_TEMP2_RNG_SWT: RteEventRef=OpEventGetDTCOfEvent_GetDTCOfEvent_Event_INV_EM_STATOR_TEMP2_RNG_SWT
          OpEventGetDTCOfEvent_GetDTCOfEvent_EvtInfo_GA_BLDC_POS_FLT: RteEventRef=OpEventGetDTCOfEvent_GetDTCOfEvent_EvtInfo_GA_BLDC_POS_FLT
          OpEventGetDTCOfEvent_GetDTCOfEvent_Event_GA_BLDC_POS_FLT: RteEventRef=OpEventGetDTCOfEvent_GetDTCOfEvent_Event_GA_BLDC_POS_FLT
          OpEventGetDTCOfEvent_GetDTCOfEvent_EvtInfo_PS_WhlSnsr_FLT: RteEventRef=OpEventGetDTCOfEvent_GetDTCOfEvent_EvtInfo_PS_WhlSnsr_FLT
          OpEventGetDTCOfEvent_GetDTCOfEvent_Event_PS_WhlSnsr_FLT: RteEventRef=OpEventGetDTCOfEvent_GetDTCOfEvent_Event_PS_WhlSnsr_FLT
          OpEventGetDTCOfEvent_GetDTCOfEvent_EvtInfo_INV_EM_STATOR_TEMP_RNG_LO: RteEventRef=OpEventGetDTCOfEvent_GetDTCOfEvent_EvtInfo_INV_EM_STATOR_TEMP_RNG_LO
          OpEventGetDTCOfEvent_GetDTCOfEvent_Event_INV_EM_STATOR_TEMP_RNG_LO: RteEventRef=OpEventGetDTCOfEvent_GetDTCOfEvent_Event_INV_EM_STATOR_TEMP_RNG_LO
          OpEventGetDTCOfEvent_GetDTCOfEvent_EvtInfo_INV_RSLVR_SIN_ELEC_HI: RteEventRef=OpEventGetDTCOfEvent_GetDTCOfEvent_EvtInfo_INV_RSLVR_SIN_ELEC_HI

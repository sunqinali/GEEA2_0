[part 3 of 5: package /ActiveEcuC]
AUTOSAR XML (schema 4-2-2)
package /ActiveEcuC  (continued)
  module config Rte: implementation-config-variant=VARIANT-PRE-COMPILE, module-description=Rte_Impl  (continued)
    7 x RteSwComponentInstance:  (continued)
      DemSatellite_0_EcuSwComposition: RteSoftwareComponentInstanceRef=DemSatellite_0  (continued)
        4544 x RteEventToTaskMapping, all with RteImmediateRestart=false:  (continued)
          OpEventGetDTCOfEvent_GetDTCOfEvent_Event_INV_RSLVR_SIN_ELEC_HI: RteEventRef=OpEventGetDTCOfEvent_GetDTCOfEvent_Event_INV_RSLVR_SIN_ELEC_HI
          OpEventGetDTCOfEvent_GetDTCOfEvent_EvtInfo_INV_RSLVR_SIN_COS_PLAUS: RteEventRef=OpEventGetDTCOfEvent_GetDTCOfEvent_EvtInfo_INV_RSLVR_SIN_COS_PLAUS
          OpEventGetDTCOfEvent_GetDTCOfEvent_Event_INV_RSLVR_SIN_COS_PLAUS: RteEventRef=OpEventGetDTCOfEvent_GetDTCOfEvent_Event_INV_RSLVR_SIN_COS_PLAUS
          OpEventGetDTCOfEvent_GetDTCOfEvent_EvtInfo_INV_RSLVR_COS_AMP: RteEventRef=OpEventGetDTCOfEvent_GetDTCOfEvent_EvtInfo_INV_RSLVR_COS_AMP
          OpEventGetDTCOfEvent_GetDTCOfEvent_Event_INV_RSLVR_COS_AMP: RteEventRef=OpEventGetDTCOfEvent_GetDTCOfEvent_Event_INV_RSLVR_COS_AMP
          OpEventGetDTCOfEvent_GetDTCOfEvent_EvtInfo_INV_GATE_DRVR_BOT_HWP: RteEventRef=OpEventGetDTCOfEvent_GetDTCOfEvent_EvtInfo_INV_GATE_DRVR_BOT_HWP
          OpEventGetDTCOfEvent_GetDTCOfEvent_Event_INV_GATE_DRVR_BOT_HWP: RteEventRef=OpEventGetDTCOfEvent_GetDTCOfEvent_Event_INV_GATE_DRVR_BOT_HWP
          OpEventGetDTCOfEvent_GetDTCOfEvent_EvtInfo_Eg_HallVolWrong: RteEventRef=OpEventGetDTCOfEvent_GetDTCOfEvent_EvtInfo_Eg_HallVolWrong
          OpEventGetDTCOfEvent_GetDTCOfEvent_Event_Eg_HallVolWrong: RteEventRef=OpEventGetDTCOfEvent_GetDTCOfEvent_Event_Eg_HallVolWrong
          OpEventGetDTCOfEvent_GetDTCOfEvent_EvtInfo_INV_RSLVR_EXCT_RNG_NOK: RteEventRef=OpEventGetDTCOfEvent_GetDTCOfEvent_EvtInfo_INV_RSLVR_EXCT_RNG_NOK
          OpEventGetDTCOfEvent_GetDTCOfEvent_Event_INV_RSLVR_EXCT_RNG_NOK: RteEventRef=OpEventGetDTCOfEvent_GetDTCOfEvent_Event_INV_RSLVR_EXCT_RNG_NOK
          OpEventGetDTCOfEvent_GetDTCOfEvent_EvtInfo_PA_OpenCirc: RteEventRef=OpEventGetDTCOfEvent_GetDTCOfEvent_EvtInfo_PA_OpenCirc
          OpEventGetDTCOfEvent_GetDTCOfEvent_Event_PA_OpenCirc: RteEventRef=OpEventGetDTCOfEvent_GetDTCOfEvent_Event_PA_OpenCirc
          OpEventGetDTCOfEvent_GetDTCOfEvent_EvtInfo_INV_RSLVR_COS_ELEC_HI: RteEventRef=OpEventGetDTCOfEvent_GetDTCOfEvent_EvtInfo_INV_RSLVR_COS_ELEC_HI
          OpEventGetDTCOfEvent_GetDTCOfEvent_Event_INV_RSLVR_COS_ELEC_HI: RteEventRef=OpEventGetDTCOfEvent_GetDTCOfEvent_Event_INV_RSLVR_COS_ELEC_HI
          OpEventGetDTCOfEvent_GetDTCOfEvent_EvtInfo_VcEvCntrHvSysRlySts: RteEventRef=OpEventGetDTCOfEvent_GetDTCOfEvent_EvtInfo_VcEvCntrHvSysRlySts
          OpEventGetDTCOfEvent_GetDTCOfEvent_Event_VcEvCntrHvSysRlySts: RteEventRef=OpEventGetDTCOfEvent_GetDTCOfEvent_Event_VcEvCntrHvSysRlySts
          OpEventGetDTCOfEvent_GetDTCOfEvent_EvtInfo_CRASH_DTC: RteEventRef=OpEventGetDTCOfEvent_GetDTCOfEvent_EvtInfo_CRASH_DTC
          OpEventGetDTCOfEvent_GetDTCOfEvent_Event_CRASH_DTC: RteEventRef=OpEventGetDTCOfEvent_GetDTCOfEvent_Event_CRASH_DTC
          OpEventGetDTCOfEvent_GetDTCOfEvent_EvtInfo_INV_IGBT_TEMP_W_RNG_HI: RteEventRef=OpEventGetDTCOfEvent_GetDTCOfEvent_EvtInfo_INV_IGBT_TEMP_W_RNG_HI
          OpEventGetDTCOfEvent_GetDTCOfEvent_Event_INV_IGBT_TEMP_W_RNG_HI: RteEventRef=OpEventGetDTCOfEvent_GetDTCOfEvent_Event_INV_IGBT_TEMP_W_RNG_HI
          OpEventGetDTCOfEvent_GetDTCOfEvent_EvtInfo_VCEvBecmPropFr02Tioutd: RteEventRef=OpEventGetDTCOfEvent_GetDTCOfEvent_EvtInfo_VCEvBecmPropFr02Tioutd
          OpEventGetDTCOfEvent_GetDTCOfEvent_Event_VCEvBecmPropFr02Tioutd: RteEventRef=OpEventGetDTCOfEvent_GetDTCOfEvent_Event_VCEvBecmPropFr02Tioutd
          OpEventGetDTCOfEvent_GetDTCOfEvent_EvtInfo_INV_IGBT_TEMP_W_GRDT: RteEventRef=OpEventGetDTCOfEvent_GetDTCOfEvent_EvtInfo_INV_IGBT_TEMP_W_GRDT
          OpEventGetDTCOfEvent_GetDTCOfEvent_Event_INV_IGBT_TEMP_W_GRDT: RteEventRef=OpEventGetDTCOfEvent_GetDTCOfEvent_Event_INV_IGBT_TEMP_W_GRDT
          OpEventGetDTCOfEvent_GetDTCOfEvent_EvtInfo_EXT_UC_SPI_FLT: RteEventRef=OpEventGetDTCOfEvent_GetDTCOfEvent_EvtInfo_EXT_UC_SPI_FLT
          OpEventGetDTCOfEvent_GetDTCOfEvent_Event_EXT_UC_SPI_FLT: RteEventRef=OpEventGetDTCOfEvent_GetDTCOfEvent_Event_EXT_UC_SPI_FLT
          OpEventGetDTCOfEvent_GetDTCOfEvent_EvtInfo_INV_IAC_V_ELEC_HWP_001: RteEventRef=OpEventGetDTCOfEvent_GetDTCOfEvent_EvtInfo_INV_IAC_V_ELEC_HWP_001
          OpEventGetDTCOfEvent_GetDTCOfEvent_Event_INV_IAC_V_ELEC_HWP_001: RteEventRef=OpEventGetDTCOfEvent_GetDTCOfEvent_Event_INV_IAC_V_ELEC_HWP_001
          OpEventGetDTCOfEvent_GetDTCOfEvent_EvtInfo_VcEvChkSumWhlMotSysTqAllwd: RteEventRef=OpEventGetDTCOfEvent_GetDTCOfEvent_EvtInfo_VcEvChkSumWhlMotSysTqAllwd
          OpEventGetDTCOfEvent_GetDTCOfEvent_Event_VcEvChkSumWhlMotSysTqAllwd: RteEventRef=OpEventGetDTCOfEvent_GetDTCOfEvent_Event_VcEvChkSumWhlMotSysTqAllwd
          OpEventGetDTCOfEvent_GetDTCOfEvent_EvtInfo_FS_MONITIOR_ASC_FLT: RteEventRef=OpEventGetDTCOfEvent_GetDTCOfEvent_EvtInfo_FS_MONITIOR_ASC_FLT
          OpEventGetDTCOfEvent_GetDTCOfEvent_Event_FS_MONITIOR_ASC_FLT: RteEventRef=OpEventGetDTCOfEvent_GetDTCOfEvent_Event_FS_MONITIOR_ASC_FLT
          OpEventGetDTCOfEvent_GetDTCOfEvent_EvtInfo_INV_IAC_V_AMP: RteEventRef=OpEventGetDTCOfEvent_GetDTCOfEvent_EvtInfo_INV_IAC_V_AMP
          OpEventGetDTCOfEvent_GetDTCOfEvent_Event_INV_IAC_V_AMP: RteEventRef=OpEventGetDTCOfEvent_GetDTCOfEvent_Event_INV_IAC_V_AMP
          OpEventGetDTCOfEvent_GetDTCOfEvent_EvtInfo_INV_IAC_W_ELEC_LO: RteEventRef=OpEventGetDTCOfEvent_GetDTCOfEvent_EvtInfo_INV_IAC_W_ELEC_LO
          OpEventGetDTCOfEvent_GetDTCOfEvent_Event_INV_IAC_W_ELEC_LO: RteEventRef=OpEventGetDTCOfEvent_GetDTCOfEvent_Event_INV_IAC_W_ELEC_LO
          OpEventGetDTCOfEvent_GetDTCOfEvent_EvtInfo_VCEvVddmPropFr08Tioutd_001: RteEventRef=OpEventGetDTCOfEvent_GetDTCOfEvent_EvtInfo_VCEvVddmPropFr08Tioutd_001
          OpEventGetDTCOfEvent_GetDTCOfEvent_Event_VCEvVddmPropFr08Tioutd_001: RteEventRef=OpEventGetDTCOfEvent_GetDTCOfEvent_Event_VCEvVddmPropFr08Tioutd_001
          OpEventGetDTCOfEvent_GetDTCOfEvent_EvtInfo_PS_P12_RES_FLT: RteEventRef=OpEventGetDTCOfEvent_GetDTCOfEvent_EvtInfo_PS_P12_RES_FLT
          OpEventGetDTCOfEvent_GetDTCOfEvent_Event_PS_P12_RES_FLT: RteEventRef=OpEventGetDTCOfEvent_GetDTCOfEvent_Event_PS_P12_RES_FLT
          OpEventGetDTCOfEvent_GetDTCOfEvent_EvtInfo_INV_RSLVR_SIN_RNG_LO: RteEventRef=OpEventGetDTCOfEvent_GetDTCOfEvent_EvtInfo_INV_RSLVR_SIN_RNG_LO
          OpEventGetDTCOfEvent_GetDTCOfEvent_Event_INV_RSLVR_SIN_RNG_LO: RteEventRef=OpEventGetDTCOfEvent_GetDTCOfEvent_Event_INV_RSLVR_SIN_RNG_LO
          OpEventGetDTCOfEvent_GetDTCOfEvent_EvtInfo_CU_TEMP_HW_FLT: RteEventRef=OpEventGetDTCOfEvent_GetDTCOfEvent_EvtInfo_CU_TEMP_HW_FLT
          OpEventGetDTCOfEvent_GetDTCOfEvent_Event_CU_TEMP_HW_FLT: RteEventRef=OpEventGetDTCOfEvent_GetDTCOfEvent_Event_CU_TEMP_HW_FLT
          OpEventGetDTCOfEvent_GetDTCOfEvent_EvtInfo_VCEvEcmPropFr02MgmFr00Tioutd: RteEventRef=OpEventGetDTCOfEvent_GetDTCOfEvent_EvtInfo_VCEvEcmPropFr02MgmFr00Tioutd
          OpEventGetDTCOfEvent_GetDTCOfEvent_Event_VCEvEcmPropFr02MgmFr00Tioutd: RteEventRef=OpEventGetDTCOfEvent_GetDTCOfEvent_Event_VCEvEcmPropFr02MgmFr00Tioutd
          OpEventGetDTCOfEvent_GetDTCOfEvent_EvtInfo_PS_KL15_RNG_HI: RteEventRef=OpEventGetDTCOfEvent_GetDTCOfEvent_EvtInfo_PS_KL15_RNG_HI
          OpEventGetDTCOfEvent_GetDTCOfEvent_Event_PS_KL15_RNG_HI: RteEventRef=OpEventGetDTCOfEvent_GetDTCOfEvent_Event_PS_KL15_RNG_HI
          OpEventGetDTCOfEvent_GetDTCOfEvent_EvtInfo_VCEvVddmPropFr17Tioutd: RteEventRef=OpEventGetDTCOfEvent_GetDTCOfEvent_EvtInfo_VCEvVddmPropFr17Tioutd
          OpEventGetDTCOfEvent_GetDTCOfEvent_Event_VCEvVddmPropFr17Tioutd: RteEventRef=OpEventGetDTCOfEvent_GetDTCOfEvent_Event_VCEvVddmPropFr17Tioutd
          OpEventGetDTCOfEvent_GetDTCOfEvent_EvtInfo_VcEvChkSumCrashStsSafe: RteEventRef=OpEventGetDTCOfEvent_GetDTCOfEvent_EvtInfo_VcEvChkSumCrashStsSafe
          OpEventGetDTCOfEvent_GetDTCOfEvent_Event_VcEvChkSumCrashStsSafe: RteEventRef=OpEventGetDTCOfEvent_GetDTCOfEvent_Event_VcEvChkSumCrashStsSafe
          OpEventGetDTCOfEvent_GetDTCOfEvent_EvtInfo_DiagC_ClutchService: RteEventRef=OpEventGetDTCOfEvent_GetDTCOfEvent_EvtInfo_DiagC_ClutchService
          OpEventGetDTCOfEvent_GetDTCOfEvent_Event_DiagC_ClutchService: RteEventRef=OpEventGetDTCOfEvent_GetDTCOfEvent_Event_DiagC_ClutchService
          OpEventGetDTCOfEvent_GetDTCOfEvent_EvtInfo_INV_EM_STATOR_TEMP_RNG_HI: RteEventRef=OpEventGetDTCOfEvent_GetDTCOfEvent_EvtInfo_INV_EM_STATOR_TEMP_RNG_HI
          OpEventGetDTCOfEvent_GetDTCOfEvent_Event_INV_EM_STATOR_TEMP_RNG_HI: RteEventRef=OpEventGetDTCOfEvent_GetDTCOfEvent_Event_INV_EM_STATOR_TEMP_RNG_HI
          OpEventGetDTCOfEvent_GetDTCOfEvent_EvtInfo_INV_RSLVR_OFFS_OUT_RANG: RteEventRef=OpEventGetDTCOfEvent_GetDTCOfEvent_EvtInfo_INV_RSLVR_OFFS_OUT_RANG
          OpEventGetDTCOfEvent_GetDTCOfEvent_Event_INV_RSLVR_OFFS_OUT_RANG: RteEventRef=OpEventGetDTCOfEvent_GetDTCOfEvent_Event_INV_RSLVR_OFFS_OUT_RANG
          OpEventGetDTCOfEvent_GetDTCOfEvent_EvtInfo_INV_EM_STATOR_TEMP2_RNG_LO: RteEventRef=OpEventGetDTCOfEvent_GetDTCOfEvent_EvtInfo_INV_EM_STATOR_TEMP2_RNG_LO
          OpEventGetDTCOfEvent_GetDTCOfEvent_Event_INV_EM_STATOR_TEMP2_RNG_LO: RteEventRef=OpEventGetDTCOfEvent_GetDTCOfEvent_Event_INV_EM_STATOR_TEMP2_RNG_LO
          OpEventGetDTCOfEvent_GetDTCOfEvent_EvtInfo_VcEvMonISAR: RteEventRef=OpEventGetDTCOfEvent_GetDTCOfEvent_EvtInfo_VcEvMonISAR
          OpEventGetDTCOfEvent_GetDTCOfEvent_Event_VcEvMonISAR: RteEventRef=OpEventGetDTCOfEvent_GetDTCOfEvent_Event_VcEvMonISAR
          OpEventGetDTCOfEvent_GetDTCOfEvent_EvtInfo_GA_BLDC_FLT: RteEventRef=OpEventGetDTCOfEvent_GetDTCOfEvent_EvtInfo_GA_BLDC_FLT
          OpEventGetDTCOfEvent_GetDTCOfEvent_Event_GA_BLDC_FLT: RteEventRef=OpEventGetDTCOfEvent_GetDTCOfEvent_Event_GA_BLDC_FLT
          OpEventGetDTCOfEvent_GetDTCOfEvent_EvtInfo_INV_RSLVR_EXCT_ELEC_OPEN: RteEventRef=OpEventGetDTCOfEvent_GetDTCOfEvent_EvtInfo_INV_RSLVR_EXCT_ELEC_OPEN
          OpEventGetDTCOfEvent_GetDTCOfEvent_Event_INV_RSLVR_EXCT_ELEC_OPEN: RteEventRef=OpEventGetDTCOfEvent_GetDTCOfEvent_Event_INV_RSLVR_EXCT_ELEC_OPEN
          OpEventGetDTCOfEvent_GetDTCOfEvent_EvtInfo_INV_RSLVR_EXCT_PLAUS: RteEventRef=OpEventGetDTCOfEvent_GetDTCOfEvent_EvtInfo_INV_RSLVR_EXCT_PLAUS
          OpEventGetDTCOfEvent_GetDTCOfEvent_Event_INV_RSLVR_EXCT_PLAUS: RteEventRef=OpEventGetDTCOfEvent_GetDTCOfEvent_Event_INV_RSLVR_EXCT_PLAUS
          OpEventGetDTCOfEvent_GetDTCOfEvent_EvtInfo_PS_P15_U_FLT: RteEventRef=OpEventGetDTCOfEvent_GetDTCOfEvent_EvtInfo_PS_P15_U_FLT
          OpEventGetDTCOfEvent_GetDTCOfEvent_Event_PS_P15_U_FLT: RteEventRef=OpEventGetDTCOfEvent_GetDTCOfEvent_Event_PS_P15_U_FLT
          OpEventGetDTCOfEvent_GetDTCOfEvent_EvtInfo_INV_EM_STATOR_TEMP_RNG_SWT: RteEventRef=OpEventGetDTCOfEvent_GetDTCOfEvent_EvtInfo_INV_EM_STATOR_TEMP_RNG_SWT
          OpEventGetDTCOfEvent_GetDTCOfEvent_Event_INV_EM_STATOR_TEMP_RNG_SWT: RteEventRef=OpEventGetDTCOfEvent_GetDTCOfEvent_Event_INV_EM_STATOR_TEMP_RNG_SWT
          OpEventGetDTCOfEvent_GetDTCOfEvent_EvtInfo_INV_UHVDC_OV_SWP: RteEventRef=OpEventGetDTCOfEvent_GetDTCOfEvent_EvtInfo_INV_UHVDC_OV_SWP
          OpEventGetDTCOfEvent_GetDTCOfEvent_Event_INV_UHVDC_OV_SWP: RteEventRef=OpEventGetDTCOfEvent_GetDTCOfEvent_Event_INV_UHVDC_OV_SWP
          OpEventGetDTCOfEvent_GetDTCOfEvent_EvtInfo_AURIX_HW_FLT: RteEventRef=OpEventGetDTCOfEvent_GetDTCOfEvent_EvtInfo_AURIX_HW_FLT
          OpEventGetDTCOfEvent_GetDTCOfEvent_Event_AURIX_HW_FLT: RteEventRef=OpEventGetDTCOfEvent_GetDTCOfEvent_Event_AURIX_HW_FLT
          OpEventGetDTCOfEvent_GetDTCOfEvent_EvtInfo_INV_GATE_DRVR_TOP_HWP: RteEventRef=OpEventGetDTCOfEvent_GetDTCOfEvent_EvtInfo_INV_GATE_DRVR_TOP_HWP
          OpEventGetDTCOfEvent_GetDTCOfEvent_Event_INV_GATE_DRVR_TOP_HWP: RteEventRef=OpEventGetDTCOfEvent_GetDTCOfEvent_Event_INV_GATE_DRVR_TOP_HWP
          OpEventGetDTCOfEvent_GetDTCOfEvent_EvtInfo_INV_ACTV_DCHA_HW: RteEventRef=OpEventGetDTCOfEvent_GetDTCOfEvent_EvtInfo_INV_ACTV_DCHA_HW
          OpEventGetDTCOfEvent_GetDTCOfEvent_Event_INV_ACTV_DCHA_HW: RteEventRef=OpEventGetDTCOfEvent_GetDTCOfEvent_Event_INV_ACTV_DCHA_HW
          OpEventGetDTCOfEvent_GetDTCOfEvent_EvtInfo_INV_IGBT_TEMP_HWP: RteEventRef=OpEventGetDTCOfEvent_GetDTCOfEvent_EvtInfo_INV_IGBT_TEMP_HWP
          OpEventGetDTCOfEvent_GetDTCOfEvent_Event_INV_IGBT_TEMP_HWP: RteEventRef=OpEventGetDTCOfEvent_GetDTCOfEvent_Event_INV_IGBT_TEMP_HWP
          OpEventGetDTCOfEvent_GetDTCOfEvent_EvtInfo_INV_RSLVR_SIN_ELEC_FLT: RteEventRef=OpEventGetDTCOfEvent_GetDTCOfEvent_EvtInfo_INV_RSLVR_SIN_ELEC_FLT
          OpEventGetDTCOfEvent_GetDTCOfEvent_Event_INV_RSLVR_SIN_ELEC_FLT: RteEventRef=OpEventGetDTCOfEvent_GetDTCOfEvent_Event_INV_RSLVR_SIN_ELEC_FLT
          OpEventGetDTCOfEvent_GetDTCOfEvent_EvtInfo_CU_TEMP2_RNG_HI: RteEventRef=OpEventGetDTCOfEvent_GetDTCOfEvent_EvtInfo_CU_TEMP2_RNG_HI
          OpEventGetDTCOfEvent_GetDTCOfEvent_Event_CU_TEMP2_RNG_HI: RteEventRef=OpEventGetDTCOfEvent_GetDTCOfEvent_Event_CU_TEMP2_RNG_HI
          OpEventGetDTCOfEvent_GetDTCOfEvent_EvtInfo_INV_IAC_PHA_LOSS_MPL: RteEventRef=OpEventGetDTCOfEvent_GetDTCOfEvent_EvtInfo_INV_IAC_PHA_LOSS_MPL
          OpEventGetDTCOfEvent_GetDTCOfEvent_Event_INV_IAC_PHA_LOSS_MPL: RteEventRef=OpEventGetDTCOfEvent_GetDTCOfEvent_Event_INV_IAC_PHA_LOSS_MPL
          OpEventGetDTCOfEvent_GetDTCOfEvent_EvtInfo_INV_IAC_U_AMP: RteEventRef=OpEventGetDTCOfEvent_GetDTCOfEvent_EvtInfo_INV_IAC_U_AMP
          OpEventGetDTCOfEvent_GetDTCOfEvent_Event_INV_IAC_U_AMP: RteEventRef=OpEventGetDTCOfEvent_GetDTCOfEvent_Event_INV_IAC_U_AMP
          OpEventGetDTCOfEvent_GetDTCOfEvent_EvtInfo_PSnsr_GRADT_Flt: RteEventRef=OpEventGetDTCOfEvent_GetDTCOfEvent_EvtInfo_PSnsr_GRADT_Flt
          OpEventGetDTCOfEvent_GetDTCOfEvent_Event_PSnsr_GRADT_Flt: RteEventRef=OpEventGetDTCOfEvent_GetDTCOfEvent_Event_PSnsr_GRADT_Flt
          OpEventGetDTCOfEvent_GetDTCOfEvent_EvtInfo_AURIX_WATHDOG_FLT: RteEventRef=OpEventGetDTCOfEvent_GetDTCOfEvent_EvtInfo_AURIX_WATHDOG_FLT
          OpEventGetDTCOfEvent_GetDTCOfEvent_Event_AURIX_WATHDOG_FLT: RteEventRef=OpEventGetDTCOfEvent_GetDTCOfEvent_Event_AURIX_WATHDOG_FLT
          OpEventGetDTCOfEvent_GetDTCOfEvent_EvtInfo_VcEvNodeMisBECM: RteEventRef=OpEventGetDTCOfEvent_GetDTCOfEvent_EvtInfo_VcEvNodeMisBECM
          OpEventGetDTCOfEvent_GetDTCOfEvent_Event_VcEvNodeMisBECM: RteEventRef=OpEventGetDTCOfEvent_GetDTCOfEvent_Event_VcEvNodeMisBECM
          OpEventGetDTCOfEvent_GetDTCOfEvent_EvtInfo_INV_UHVDC_UV_HWP: RteEventRef=OpEventGetDTCOfEvent_GetDTCOfEvent_EvtInfo_INV_UHVDC_UV_HWP
          OpEventGetDTCOfEvent_GetDTCOfEvent_Event_INV_UHVDC_UV_HWP: RteEventRef=OpEventGetDTCOfEvent_GetDTCOfEvent_Event_INV_UHVDC_UV_HWP
          OpEventGetDTCOfEvent_GetDTCOfEvent_EvtInfo_VcEvMonESpd: RteEventRef=OpEventGetDTCOfEvent_GetDTCOfEvent_EvtInfo_VcEvMonESpd
          OpEventGetDTCOfEvent_GetDTCOfEvent_Event_VcEvMonESpd: RteEventRef=OpEventGetDTCOfEvent_GetDTCOfEvent_Event_VcEvMonESpd
          OpEventGetDTCOfEvent_GetDTCOfEvent_EvtInfo_COM_NotConfig: RteEventRef=OpEventGetDTCOfEvent_GetDTCOfEvent_EvtInfo_COM_NotConfig
          OpEventGetDTCOfEvent_GetDTCOfEvent_Event_COM_NotConfig: RteEventRef=OpEventGetDTCOfEvent_GetDTCOfEvent_Event_COM_NotConfig
          OpEventGetDTCOfEvent_GetDTCOfEvent_EvtInfo_INV_RSLVR_SIN_RNG_HI: RteEventRef=OpEventGetDTCOfEvent_GetDTCOfEvent_EvtInfo_INV_RSLVR_SIN_RNG_HI
          OpEventGetDTCOfEvent_GetDTCOfEvent_Event_INV_RSLVR_SIN_RNG_HI: RteEventRef=OpEventGetDTCOfEvent_GetDTCOfEvent_Event_INV_RSLVR_SIN_RNG_HI
          OpEventGetDTCOfEvent_GetDTCOfEvent_EvtInfo_INV_IGBT_TEMP_U_RNG_HI: RteEventRef=OpEventGetDTCOfEvent_GetDTCOfEvent_EvtInfo_INV_IGBT_TEMP_U_RNG_HI
          OpEventGetDTCOfEvent_GetDTCOfEvent_Event_INV_IGBT_TEMP_U_RNG_HI: RteEventRef=OpEventGetDTCOfEvent_GetDTCOfEvent_Event_INV_IGBT_TEMP_U_RNG_HI
          OpEventGetDTCOfEvent_GetDTCOfEvent_EvtInfo_VcEvMonMode_001: RteEventRef=OpEventGetDTCOfEvent_GetDTCOfEvent_EvtInfo_VcEvMonMode_001
          OpEventGetDTCOfEvent_GetDTCOfEvent_Event_VcEvMonMode_001: RteEventRef=OpEventGetDTCOfEvent_GetDTCOfEvent_Event_VcEvMonMode_001
          OpEventGetDTCOfEvent_GetDTCOfEvent_EvtInfo_PA_ACTION_FLT: RteEventRef=OpEventGetDTCOfEvent_GetDTCOfEvent_EvtInfo_PA_ACTION_FLT
          OpEventGetDTCOfEvent_GetDTCOfEvent_Event_PA_ACTION_FLT: RteEventRef=OpEventGetDTCOfEvent_GetDTCOfEvent_Event_PA_ACTION_FLT
          OpEventGetDTCOfEvent_GetDTCOfEvent_EvtInfo_INV_IAC_V_ELEC_HWP: RteEventRef=OpEventGetDTCOfEvent_GetDTCOfEvent_EvtInfo_INV_IAC_V_ELEC_HWP
          OpEventGetDTCOfEvent_GetDTCOfEvent_Event_INV_IAC_V_ELEC_HWP: RteEventRef=OpEventGetDTCOfEvent_GetDTCOfEvent_Event_INV_IAC_V_ELEC_HWP
          OpEventGetDTCOfEvent_GetDTCOfEvent_EvtInfo_CU_TEMP_HW_FLT_001: RteEventRef=OpEventGetDTCOfEvent_GetDTCOfEvent_EvtInfo_CU_TEMP_HW_FLT_001
          OpEventGetDTCOfEvent_GetDTCOfEvent_Event_CU_TEMP_HW_FLT_001: RteEventRef=OpEventGetDTCOfEvent_GetDTCOfEvent_Event_CU_TEMP_HW_FLT_001
          OpEventGetDTCOfEvent_GetDTCOfEvent_EvtInfo_VCC_UnderVoltage: RteEventRef=OpEventGetDTCOfEvent_GetDTCOfEvent_EvtInfo_VCC_UnderVoltage
          OpEventGetDTCOfEvent_GetDTCOfEvent_Event_VCC_UnderVoltage: RteEventRef=OpEventGetDTCOfEvent_GetDTCOfEvent_Event_VCC_UnderVoltage
          OpEventGetDTCOfEvent_GetDTCOfEvent_EvtInfo_VcEvTsttrPlaus: RteEventRef=OpEventGetDTCOfEvent_GetDTCOfEvent_EvtInfo_VcEvTsttrPlaus
          OpEventGetDTCOfEvent_GetDTCOfEvent_Event_VcEvTsttrPlaus: RteEventRef=OpEventGetDTCOfEvent_GetDTCOfEvent_Event_VcEvTsttrPlaus
          OpEventGetDTCOfEvent_GetDTCOfEvent_EvtInfo_INV_RSLVR_EXCT_ELEC_FLT: RteEventRef=OpEventGetDTCOfEvent_GetDTCOfEvent_EvtInfo_INV_RSLVR_EXCT_ELEC_FLT
          OpEventGetDTCOfEvent_GetDTCOfEvent_Event_INV_RSLVR_EXCT_ELEC_FLT: RteEventRef=OpEventGetDTCOfEvent_GetDTCOfEvent_Event_INV_RSLVR_EXCT_ELEC_FLT
          OpEventGetDTCOfEvent_GetDTCOfEvent_EvtInfo_INV_RSLVR_EXCT_RNG_LO: RteEventRef=OpEventGetDTCOfEvent_GetDTCOfEvent_EvtInfo_INV_RSLVR_EXCT_RNG_LO
          OpEventGetDTCOfEvent_GetDTCOfEvent_Event_INV_RSLVR_EXCT_RNG_LO: RteEventRef=OpEventGetDTCOfEvent_GetDTCOfEvent_Event_INV_RSLVR_EXCT_RNG_LO
          OpEventGetDTCOfEvent_GetDTCOfEvent_EvtInfo_INV_EM_STATOR_TEMP2_RNG_HI: RteEventRef=OpEventGetDTCOfEvent_GetDTCOfEvent_EvtInfo_INV_EM_STATOR_TEMP2_RNG_HI
          OpEventGetDTCOfEvent_GetDTCOfEvent_Event_INV_EM_STATOR_TEMP2_RNG_HI: RteEventRef=OpEventGetDTCOfEvent_GetDTCOfEvent_Event_INV_EM_STATOR_TEMP2_RNG_HI
          OpEventGetDTCOfEvent_GetDTCOfEvent_EvtInfo_INV_SHUT_OFF_PAH_START_UP: RteEventRef=OpEventGetDTCOfEvent_GetDTCOfEvent_EvtInfo_INV_SHUT_OFF_PAH_START_UP
          OpEventGetDTCOfEvent_GetDTCOfEvent_Event_INV_SHUT_OFF_PAH_START_UP: RteEventRef=OpEventGetDTCOfEvent_GetDTCOfEvent_Event_INV_SHUT_OFF_PAH_START_UP
          OpEventGetDTCOfEvent_GetDTCOfEvent_EvtInfo_VCEvVddmPropFr08Tioutd: RteEventRef=OpEventGetDTCOfEvent_GetDTCOfEvent_EvtInfo_VCEvVddmPropFr08Tioutd
          OpEventGetDTCOfEvent_GetDTCOfEvent_Event_VCEvVddmPropFr08Tioutd: RteEventRef=OpEventGetDTCOfEvent_GetDTCOfEvent_Event_VCEvVddmPropFr08Tioutd
          OpEventGetDTCOfEvent_GetDTCOfEvent_EvtInfo_INV_RSLVR_EXCT_OC_HWP_001: RteEventRef=OpEventGetDTCOfEvent_GetDTCOfEvent_EvtInfo_INV_RSLVR_EXCT_OC_HWP_001
          OpEventGetDTCOfEvent_GetDTCOfEvent_Event_INV_RSLVR_EXCT_OC_HWP_001: RteEventRef=OpEventGetDTCOfEvent_GetDTCOfEvent_Event_INV_RSLVR_EXCT_OC_HWP_001
          OpEventGetDTCOfEvent_GetDTCOfEvent_EvtInfo_INV_RSLVR_EXCT_OC_HWP_002: RteEventRef=OpEventGetDTCOfEvent_GetDTCOfEvent_EvtInfo_INV_RSLVR_EXCT_OC_HWP_002
          OpEventGetDTCOfEvent_GetDTCOfEvent_Event_INV_RSLVR_EXCT_OC_HWP_002: RteEventRef=OpEventGetDTCOfEvent_GetDTCOfEvent_Event_INV_RSLVR_EXCT_OC_HWP_002
          OpEventGetDTCOfEvent_GetDTCOfEvent_EvtInfo_INV_EM_STATOR_TEMP_ELE_FLT: RteEventRef=OpEventGetDTCOfEvent_GetDTCOfEvent_EvtInfo_INV_EM_STATOR_TEMP_ELE_FLT
          OpEventGetDTCOfEvent_GetDTCOfEvent_Event_INV_EM_STATOR_TEMP_ELE_FLT: RteEventRef=OpEventGetDTCOfEvent_GetDTCOfEvent_Event_INV_EM_STATOR_TEMP_ELE_FLT
          OpEventGetDTCOfEvent_GetDTCOfEvent_EvtInfo_INV_INTERLOCK_FLT: RteEventRef=OpEventGetDTCOfEvent_GetDTCOfEvent_EvtInfo_INV_INTERLOCK_FLT
          OpEventGetDTCOfEvent_GetDTCOfEvent_Event_INV_INTERLOCK_FLT: RteEventRef=OpEventGetDTCOfEvent_GetDTCOfEvent_Event_INV_INTERLOCK_FLT
          OpEventGetDTCOfEvent_GetDTCOfEvent_EvtInfo_Ga_ZeroFindDistanFailure: RteEventRef=OpEventGetDTCOfEvent_GetDTCOfEvent_EvtInfo_Ga_ZeroFindDistanFailure
          OpEventGetDTCOfEvent_GetDTCOfEvent_Event_Ga_ZeroFindDistanFailure: RteEventRef=OpEventGetDTCOfEvent_GetDTCOfEvent_Event_Ga_ZeroFindDistanFailure
          OpEventGetDTCOfEvent_GetDTCOfEvent_EvtInfo_PLOCK_Current_RNG_OUT: RteEventRef=OpEventGetDTCOfEvent_GetDTCOfEvent_EvtInfo_PLOCK_Current_RNG_OUT
          OpEventGetDTCOfEvent_GetDTCOfEvent_Event_PLOCK_Current_RNG_OUT: RteEventRef=OpEventGetDTCOfEvent_GetDTCOfEvent_Event_PLOCK_Current_RNG_OUT
          OpEventGetDTCOfEvent_GetDTCOfEvent_EvtInfo_VCEvVddmPropFr05Tioutd: RteEventRef=OpEventGetDTCOfEvent_GetDTCOfEvent_EvtInfo_VCEvVddmPropFr05Tioutd
          OpEventGetDTCOfEvent_GetDTCOfEvent_Event_VCEvVddmPropFr05Tioutd: RteEventRef=OpEventGetDTCOfEvent_GetDTCOfEvent_Event_VCEvVddmPropFr05Tioutd
          OpEventGetDTCOfEvent_GetDTCOfEvent_EvtInfo_INV_IGBT_TEMP_V_GRDT: RteEventRef=OpEventGetDTCOfEvent_GetDTCOfEvent_EvtInfo_INV_IGBT_TEMP_V_GRDT
          OpEventGetDTCOfEvent_GetDTCOfEvent_Event_INV_IGBT_TEMP_V_GRDT: RteEventRef=OpEventGetDTCOfEvent_GetDTCOfEvent_Event_INV_IGBT_TEMP_V_GRDT
          OpEventGetDTCOfEvent_GetDTCOfEvent_EvtInfo_PS_5V_Fault: RteEventRef=OpEventGetDTCOfEvent_GetDTCOfEvent_EvtInfo_PS_5V_Fault
          OpEventGetDTCOfEvent_GetDTCOfEvent_Event_PS_5V_Fault: RteEventRef=OpEventGetDTCOfEvent_GetDTCOfEvent_Event_PS_5V_Fault
          OpEventGetDTCOfEvent_GetDTCOfEvent_EvtInfo_VcEvCntrCrashStsSafe: RteEventRef=OpEventGetDTCOfEvent_GetDTCOfEvent_EvtInfo_VcEvCntrCrashStsSafe
          OpEventGetDTCOfEvent_GetDTCOfEvent_Event_VcEvCntrCrashStsSafe: RteEventRef=OpEventGetDTCOfEvent_GetDTCOfEvent_Event_VcEvCntrCrashStsSafe
          OpEventGetDTCOfEvent_GetDTCOfEvent_EvtInfo_INV_EM_STATOR_TEMP_GRDT: RteEventRef=OpEventGetDTCOfEvent_GetDTCOfEvent_EvtInfo_INV_EM_STATOR_TEMP_GRDT
          OpEventGetDTCOfEvent_GetDTCOfEvent_Event_INV_EM_STATOR_TEMP_GRDT: RteEventRef=OpEventGetDTCOfEvent_GetDTCOfEvent_Event_INV_EM_STATOR_TEMP_GRDT
          OpEventGetDTCOfEvent_GetDTCOfEvent_EvtInfo_PS_P15_V_FLT: RteEventRef=OpEventGetDTCOfEvent_GetDTCOfEvent_EvtInfo_PS_P15_V_FLT
          OpEventGetDTCOfEvent_GetDTCOfEvent_Event_PS_P15_V_FLT: RteEventRef=OpEventGetDTCOfEvent_GetDTCOfEvent_Event_PS_P15_V_FLT
          OpEventGetDTCOfEvent_GetDTCOfEvent_EvtInfo_INV_EM_STATOR_TEMP_RNG_NOK: RteEventRef=OpEventGetDTCOfEvent_GetDTCOfEvent_EvtInfo_INV_EM_STATOR_TEMP_RNG_NOK
          OpEventGetDTCOfEvent_GetDTCOfEvent_Event_INV_EM_STATOR_TEMP_RNG_NOK: RteEventRef=OpEventGetDTCOfEvent_GetDTCOfEvent_Event_INV_EM_STATOR_TEMP_RNG_NOK
          OpEventGetDTCOfEvent_GetDTCOfEvent_EvtInfo_INV_RSLVR_SIN_RNG_NOK: RteEventRef=OpEventGetDTCOfEvent_GetDTCOfEvent_EvtInfo_INV_RSLVR_SIN_RNG_NOK
          OpEventGetDTCOfEvent_GetDTCOfEvent_Event_INV_RSLVR_SIN_RNG_NOK: RteEventRef=OpEventGetDTCOfEvent_GetDTCOfEvent_Event_INV_RSLVR_SIN_RNG_NOK
          OpEventGetDTCOfEvent_GetDTCOfEvent_EvtInfo_INV_IAC_U_OFFS: RteEventRef=OpEventGetDTCOfEvent_GetDTCOfEvent_EvtInfo_INV_IAC_U_OFFS
          OpEventGetDTCOfEvent_GetDTCOfEvent_Event_INV_IAC_U_OFFS: RteEventRef=OpEventGetDTCOfEvent_GetDTCOfEvent_Event_INV_IAC_U_OFFS
          OpEventGetDTCOfEvent_GetDTCOfEvent_EvtInfo_PS_KL30_BACKUP_FLT: RteEventRef=OpEventGetDTCOfEvent_GetDTCOfEvent_EvtInfo_PS_KL30_BACKUP_FLT
          OpEventGetDTCOfEvent_GetDTCOfEvent_Event_PS_KL30_BACKUP_FLT: RteEventRef=OpEventGetDTCOfEvent_GetDTCOfEvent_Event_PS_KL30_BACKUP_FLT
          OpEventGetDTCOfEvent_GetDTCOfEvent_EvtInfo_INV_IGBT_TEMP_U_RNG_LO: RteEventRef=OpEventGetDTCOfEvent_GetDTCOfEvent_EvtInfo_INV_IGBT_TEMP_U_RNG_LO
          OpEventGetDTCOfEvent_GetDTCOfEvent_Event_INV_IGBT_TEMP_U_RNG_LO: RteEventRef=OpEventGetDTCOfEvent_GetDTCOfEvent_Event_INV_IGBT_TEMP_U_RNG_LO
          OpEventGetDTCOfEvent_GetDTCOfEvent_EvtInfo_INV_EM_STATOR_TEMP_HWP: RteEventRef=OpEventGetDTCOfEvent_GetDTCOfEvent_EvtInfo_INV_EM_STATOR_TEMP_HWP
          OpEventGetDTCOfEvent_GetDTCOfEvent_Event_INV_EM_STATOR_TEMP_HWP: RteEventRef=OpEventGetDTCOfEvent_GetDTCOfEvent_Event_INV_EM_STATOR_TEMP_HWP
          OpEventGetDTCOfEvent_GetDTCOfEvent_EvtInfo_CU_TEMP1_RNG_HI: RteEventRef=OpEventGetDTCOfEvent_GetDTCOfEvent_EvtInfo_CU_TEMP1_RNG_HI
          OpEventGetDTCOfEvent_GetDTCOfEvent_Event_CU_TEMP1_RNG_HI: RteEventRef=OpEventGetDTCOfEvent_GetDTCOfEvent_Event_CU_TEMP1_RNG_HI
          OpEventGetDTCOfEvent_GetDTCOfEvent_EvtInfo_INV_IGBT_TEMP_V_RNG_HI: RteEventRef=OpEventGetDTCOfEvent_GetDTCOfEvent_EvtInfo_INV_IGBT_TEMP_V_RNG_HI
          OpEventGetDTCOfEvent_GetDTCOfEvent_Event_INV_IGBT_TEMP_V_RNG_HI: RteEventRef=OpEventGetDTCOfEvent_GetDTCOfEvent_Event_INV_IGBT_TEMP_V_RNG_HI
          OpEventGetDTCOfEvent_GetDTCOfEvent_EvtInfo_VcEvNodeMisVDDM: RteEventRef=OpEventGetDTCOfEvent_GetDTCOfEvent_EvtInfo_VcEvNodeMisVDDM
          OpEventGetDTCOfEvent_GetDTCOfEvent_Event_VcEvNodeMisVDDM: RteEventRef=OpEventGetDTCOfEvent_GetDTCOfEvent_Event_VcEvNodeMisVDDM
          OpEventGetDTCOfEvent_GetDTCOfEvent_EvtInfo_INV_UHVDC_PLAUS: RteEventRef=OpEventGetDTCOfEvent_GetDTCOfEvent_EvtInfo_INV_UHVDC_PLAUS
          OpEventGetDTCOfEvent_GetDTCOfEvent_Event_INV_UHVDC_PLAUS: RteEventRef=OpEventGetDTCOfEvent_GetDTCOfEvent_Event_INV_UHVDC_PLAUS
          OpEventGetDTCOfEvent_GetDTCOfEvent_EvtInfo_INV_QUIESCENT_FLT: RteEventRef=OpEventGetDTCOfEvent_GetDTCOfEvent_EvtInfo_INV_QUIESCENT_FLT
          OpEventGetDTCOfEvent_GetDTCOfEvent_Event_INV_QUIESCENT_FLT: RteEventRef=OpEventGetDTCOfEvent_GetDTCOfEvent_Event_INV_QUIESCENT_FLT
          OpEventGetDTCOfEvent_GetDTCOfEvent_EvtInfo_INV_RSLVR_EXCT_RNG_HI: RteEventRef=OpEventGetDTCOfEvent_GetDTCOfEvent_EvtInfo_INV_RSLVR_EXCT_RNG_HI
          OpEventGetDTCOfEvent_GetDTCOfEvent_Event_INV_RSLVR_EXCT_RNG_HI: RteEventRef=OpEventGetDTCOfEvent_GetDTCOfEvent_Event_INV_RSLVR_EXCT_RNG_HI
          OpEventGetDTCOfEvent_GetDTCOfEvent_GeneralEvtInfo: RteEventRef=OpEventGetDTCOfEvent_GetDTCOfEvent_GeneralEvtInfo
          OpEventGetFaultDetectionCounter_GetFaultDetectionCounter_EvtInfo_VCEvBecmPropFr01Tioutd: RteEventRef=OpEventGetFaultDetectionCounter_GetFaultDetectionCounter_EvtInfo_VCEvBecmPropFr01Tioutd
          OpEventGetFaultDetectionCounter_GetFaultDetectionCounter_Event_VCEvBecmPropFr01Tioutd: RteEventRef=OpEventGetFaultDetectionCounter_GetFaultDetectionCounter_Event_VCEvBecmPropFr01Tioutd
          OpEventGetFaultDetectionCounter_GetFaultDetectionCounter_EvtInfo_INV_CU_TEMP2_RNG_NOK: RteEventRef=OpEventGetFaultDetectionCounter_GetFaultDetectionCounter_EvtInfo_INV_CU_TEMP2_RNG_NOK
          OpEventGetFaultDetectionCounter_GetFaultDetectionCounter_Event_INV_CU_TEMP2_RNG_NOK: RteEventRef=OpEventGetFaultDetectionCounter_GetFaultDetectionCounter_Event_INV_CU_TEMP2_RNG_NOK
          OpEventGetFaultDetectionCounter_GetFaultDetectionCounter_EvtInfo_COM_Busoff: RteEventRef=OpEventGetFaultDetectionCounter_GetFaultDetectionCounter_EvtInfo_COM_Busoff
          OpEventGetFaultDetectionCounter_GetFaultDetectionCounter_Event_COM_Busoff: RteEventRef=OpEventGetFaultDetectionCounter_GetFaultDetectionCounter_Event_COM_Busoff
          OpEventGetFaultDetectionCounter_GetFaultDetectionCounter_EvtInfo_INV_IMMO_NOKEY: RteEventRef=OpEventGetFaultDetectionCounter_GetFaultDetectionCounter_EvtInfo_INV_IMMO_NOKEY
          OpEventGetFaultDetectionCounter_GetFaultDetectionCounter_Event_INV_IMMO_NOKEY: RteEventRef=OpEventGetFaultDetectionCounter_GetFaultDetectionCounter_Event_INV_IMMO_NOKEY
          OpEventGetFaultDetectionCounter_GetFaultDetectionCounter_EvtInfo_INV_RSLVR_EXCT_OC_HWP: RteEventRef=OpEventGetFaultDetectionCounter_GetFaultDetectionCounter_EvtInfo_INV_RSLVR_EXCT_OC_HWP
          OpEventGetFaultDetectionCounter_GetFaultDetectionCounter_Event_INV_RSLVR_EXCT_OC_HWP: RteEventRef=OpEventGetFaultDetectionCounter_GetFaultDetectionCounter_Event_INV_RSLVR_EXCT_OC_HWP
          OpEventGetFaultDetectionCounter_GetFaultDetectionCounter_EvtInfo_PS_P15_W_FLT: RteEventRef=OpEventGetFaultDetectionCounter_GetFaultDetectionCounter_EvtInfo_PS_P15_W_FLT
          OpEventGetFaultDetectionCounter_GetFaultDetectionCounter_Event_PS_P15_W_FLT: RteEventRef=OpEventGetFaultDetectionCounter_GetFaultDetectionCounter_Event_PS_P15_W_FLT
          OpEventGetFaultDetectionCounter_GetFaultDetectionCounter_EvtInfo_INV_IAC_PLAUS_SUM: RteEventRef=OpEventGetFaultDetectionCounter_GetFaultDetectionCounter_EvtInfo_INV_IAC_PLAUS_SUM
          OpEventGetFaultDetectionCounter_GetFaultDetectionCounter_Event_INV_IAC_PLAUS_SUM: RteEventRef=OpEventGetFaultDetectionCounter_GetFaultDetectionCounter_Event_INV_IAC_PLAUS_SUM
          OpEventGetFaultDetectionCounter_GetFaultDetectionCounter_EvtInfo_PA_ELE_FLT: RteEventRef=OpEventGetFaultDetectionCounter_GetFaultDetectionCounter_EvtInfo_PA_ELE_FLT
          OpEventGetFaultDetectionCounter_GetFaultDetectionCounter_Event_PA_ELE_FLT: RteEventRef=OpEventGetFaultDetectionCounter_GetFaultDetectionCounter_Event_PA_ELE_FLT
          OpEventGetFaultDetectionCounter_GetFaultDetectionCounter_EvtInfo_CU_TEMP_GRDT: RteEventRef=OpEventGetFaultDetectionCounter_GetFaultDetectionCounter_EvtInfo_CU_TEMP_GRDT
          OpEventGetFaultDetectionCounter_GetFaultDetectionCounter_Event_CU_TEMP_GRDT: RteEventRef=OpEventGetFaultDetectionCounter_GetFaultDetectionCounter_Event_CU_TEMP_GRDT
          OpEventGetFaultDetectionCounter_GetFaultDetectionCounter_EvtInfo_INV_IGBT_TEMP_V_PLAUS: RteEventRef=OpEventGetFaultDetectionCounter_GetFaultDetectionCounter_EvtInfo_INV_IGBT_TEMP_V_PLAUS
          OpEventGetFaultDetectionCounter_GetFaultDetectionCounter_Event_INV_IGBT_TEMP_V_PLAUS: RteEventRef=OpEventGetFaultDetectionCounter_GetFaultDetectionCounter_Event_INV_IGBT_TEMP_V_PLAUS
          OpEventGetFaultDetectionCounter_GetFaultDetectionCounter_EvtInfo_Ga_GAEngageFailure: RteEventRef=OpEventGetFaultDetectionCounter_GetFaultDetectionCounter_EvtInfo_Ga_GAEngageFailure
          OpEventGetFaultDetectionCounter_GetFaultDetectionCounter_Event_Ga_GAEngageFailure: RteEventRef=OpEventGetFaultDetectionCounter_GetFaultDetectionCounter_Event_Ga_GAEngageFailure
          OpEventGetFaultDetectionCounter_GetFaultDetectionCounter_EvtInfo_INV_IAC_W_RNG_LO: RteEventRef=OpEventGetFaultDetectionCounter_GetFaultDetectionCounter_EvtInfo_INV_IAC_W_RNG_LO
          OpEventGetFaultDetectionCounter_GetFaultDetectionCounter_Event_INV_IAC_W_RNG_LO: RteEventRef=OpEventGetFaultDetectionCounter_GetFaultDetectionCounter_Event_INV_IAC_W_RNG_LO
          OpEventGetFaultDetectionCounter_GetFaultDetectionCounter_EvtInfo_PS_WhlSnsr_Vltg_FLT: RteEventRef=OpEventGetFaultDetectionCounter_GetFaultDetectionCounter_EvtInfo_PS_WhlSnsr_Vltg_FLT
          OpEventGetFaultDetectionCounter_GetFaultDetectionCounter_Event_PS_WhlSnsr_Vltg_FLT: RteEventRef=OpEventGetFaultDetectionCounter_GetFaultDetectionCounter_Event_PS_WhlSnsr_Vltg_FLT
          OpEventGetFaultDetectionCounter_GetFaultDetectionCounter_EvtInfo_VCEvEcmPropFr02Tioutd: RteEventRef=OpEventGetFaultDetectionCounter_GetFaultDetectionCounter_EvtInfo_VCEvEcmPropFr02Tioutd
          OpEventGetFaultDetectionCounter_GetFaultDetectionCounter_Event_VCEvEcmPropFr02Tioutd: RteEventRef=OpEventGetFaultDetectionCounter_GetFaultDetectionCounter_Event_VCEvEcmPropFr02Tioutd
          OpEventGetFaultDetectionCounter_GetFaultDetectionCounter_EvtInfo_Ga_TmSpdSyncFailed: RteEventRef=OpEventGetFaultDetectionCounter_GetFaultDetectionCounter_EvtInfo_Ga_TmSpdSyncFailed
          OpEventGetFaultDetectionCounter_GetFaultDetectionCounter_Event_Ga_TmSpdSyncFailed: RteEventRef=OpEventGetFaultDetectionCounter_GetFaultDetectionCounter_Event_Ga_TmSpdSyncFailed
          OpEventGetFaultDetectionCounter_GetFaultDetectionCounter_EvtInfo_INV_RSLVR_EXCT_ELEC_LO: RteEventRef=OpEventGetFaultDetectionCounter_GetFaultDetectionCounter_EvtInfo_INV_RSLVR_EXCT_ELEC_LO
          OpEventGetFaultDetectionCounter_GetFaultDetectionCounter_Event_INV_RSLVR_EXCT_ELEC_LO: RteEventRef=OpEventGetFaultDetectionCounter_GetFaultDetectionCounter_Event_INV_RSLVR_EXCT_ELEC_LO
          OpEventGetFaultDetectionCounter_GetFaultDetectionCounter_EvtInfo_VCEvEcmPropXevFr06Tioutd: RteEventRef=OpEventGetFaultDetectionCounter_GetFaultDetectionCounter_EvtInfo_VCEvEcmPropXevFr06Tioutd
          OpEventGetFaultDetectionCounter_GetFaultDetectionCounter_Event_VCEvEcmPropXevFr06Tioutd: RteEventRef=OpEventGetFaultDetectionCounter_GetFaultDetectionCounter_Event_VCEvEcmPropXevFr06Tioutd
          OpEventGetFaultDetectionCounter_GetFaultDetectionCounter_EvtInfo_VcEvCntrWhlMotSysTqAllwd: RteEventRef=OpEventGetFaultDetectionCounter_GetFaultDetectionCounter_EvtInfo_VcEvCntrWhlMotSysTqAllwd
          OpEventGetFaultDetectionCounter_GetFaultDetectionCounter_Event_VcEvCntrWhlMotSysTqAllwd: RteEventRef=OpEventGetFaultDetectionCounter_GetFaultDetectionCounter_Event_VcEvCntrWhlMotSysTqAllwd
          OpEventGetFaultDetectionCounter_GetFaultDetectionCounter_EvtInfo_INV_UHVDC_1_ELEC_HI: RteEventRef=OpEventGetFaultDetectionCounter_GetFaultDetectionCounter_EvtInfo_INV_UHVDC_1_ELEC_HI
          OpEventGetFaultDetectionCounter_GetFaultDetectionCounter_Event_INV_UHVDC_1_ELEC_HI: RteEventRef=OpEventGetFaultDetectionCounter_GetFaultDetectionCounter_Event_INV_UHVDC_1_ELEC_HI
          OpEventGetFaultDetectionCounter_GetFaultDetectionCounter_EvtInfo_INV_EM_STATOR_TEMP2_ELE_FLT: RteEventRef=OpEventGetFaultDetectionCounter_GetFaultDetectionCounter_EvtInfo_INV_EM_STATOR_TEMP2_ELE_FLT
          OpEventGetFaultDetectionCounter_GetFaultDetectionCounter_Event_INV_EM_STATOR_TEMP2_ELE_FLT: RteEventRef=OpEventGetFaultDetectionCounter_GetFaultDetectionCounter_Event_INV_EM_STATOR_TEMP2_ELE_FLT
          OpEventGetFaultDetectionCounter_GetFaultDetectionCounter_EvtInfo_AURIX_RST_SNG: RteEventRef=OpEventGetFaultDetectionCounter_GetFaultDetectionCounter_EvtInfo_AURIX_RST_SNG
          OpEventGetFaultDetectionCounter_GetFaultDetectionCounter_Event_AURIX_RST_SNG: RteEventRef=OpEventGetFaultDetectionCounter_GetFaultDetectionCounter_Event_AURIX_RST_SNG
          OpEventGetFaultDetectionCounter_GetFaultDetectionCounter_EvtInfo_VCEvEcmPropFr24MgmFr01Tioutd: RteEventRef=OpEventGetFaultDetectionCounter_GetFaultDetectionCounter_EvtInfo_VCEvEcmPropFr24MgmFr01Tioutd
          OpEventGetFaultDetectionCounter_GetFaultDetectionCounter_Event_VCEvEcmPropFr24MgmFr01Tioutd: RteEventRef=OpEventGetFaultDetectionCounter_GetFaultDetectionCounter_Event_VCEvEcmPropFr24MgmFr01Tioutd
          OpEventGetFaultDetectionCounter_GetFaultDetectionCounter_EvtInfo_INV_RSLVR_COS_ELEC_OPEN: RteEventRef=OpEventGetFaultDetectionCounter_GetFaultDetectionCounter_EvtInfo_INV_RSLVR_COS_ELEC_OPEN
          OpEventGetFaultDetectionCounter_GetFaultDetectionCounter_Event_INV_RSLVR_COS_ELEC_OPEN: RteEventRef=OpEventGetFaultDetectionCounter_GetFaultDetectionCounter_Event_INV_RSLVR_COS_ELEC_OPEN
          OpEventGetFaultDetectionCounter_GetFaultDetectionCounter_EvtInfo_INV_IAC_V_ELEC_LO: RteEventRef=OpEventGetFaultDetectionCounter_GetFaultDetectionCounter_EvtInfo_INV_IAC_V_ELEC_LO
          OpEventGetFaultDetectionCounter_GetFaultDetectionCounter_Event_INV_IAC_V_ELEC_LO: RteEventRef=OpEventGetFaultDetectionCounter_GetFaultDetectionCounter_Event_INV_IAC_V_ELEC_LO
          OpEventGetFaultDetectionCounter_GetFaultDetectionCounter_EvtInfo_INV_IAC_W_OFFS: RteEventRef=OpEventGetFaultDetectionCounter_GetFaultDetectionCounter_EvtInfo_INV_IAC_W_OFFS
          OpEventGetFaultDetectionCounter_GetFaultDetectionCounter_Event_INV_IAC_W_OFFS: RteEventRef=OpEventGetFaultDetectionCounter_GetFaultDetectionCounter_Event_INV_IAC_W_OFFS
          OpEventGetFaultDetectionCounter_GetFaultDetectionCounter_EvtInfo_INV_EM_STATOR_TEMP2_GRDT: RteEventRef=OpEventGetFaultDetectionCounter_GetFaultDetectionCounter_EvtInfo_INV_EM_STATOR_TEMP2_GRDT
          OpEventGetFaultDetectionCounter_GetFaultDetectionCounter_Event_INV_EM_STATOR_TEMP2_GRDT: RteEventRef=OpEventGetFaultDetectionCounter_GetFaultDetectionCounter_Event_INV_EM_STATOR_TEMP2_GRDT
          OpEventGetFaultDetectionCounter_GetFaultDetectionCounter_EvtInfo_INV_EM_OVRSPD_HWP: RteEventRef=OpEventGetFaultDetectionCounter_GetFaultDetectionCounter_EvtInfo_INV_EM_OVRSPD_HWP
          OpEventGetFaultDetectionCounter_GetFaultDetectionCounter_Event_INV_EM_OVRSPD_HWP: RteEventRef=OpEventGetFaultDetectionCounter_GetFaultDetectionCounter_Event_INV_EM_OVRSPD_HWP
          OpEventGetFaultDetectionCounter_GetFaultDetectionCounter_EvtInfo_CU_TEMP_HWP: RteEventRef=OpEventGetFaultDetectionCounter_GetFaultDetectionCounter_EvtInfo_CU_TEMP_HWP
          OpEventGetFaultDetectionCounter_GetFaultDetectionCounter_Event_CU_TEMP_HWP: RteEventRef=OpEventGetFaultDetectionCounter_GetFaultDetectionCounter_Event_CU_TEMP_HWP
          OpEventGetFaultDetectionCounter_GetFaultDetectionCounter_EvtInfo_INV_UHVDC_1_RNG_HI: RteEventRef=OpEventGetFaultDetectionCounter_GetFaultDetectionCounter_EvtInfo_INV_UHVDC_1_RNG_HI
          OpEventGetFaultDetectionCounter_GetFaultDetectionCounter_Event_INV_UHVDC_1_RNG_HI: RteEventRef=OpEventGetFaultDetectionCounter_GetFaultDetectionCounter_Event_INV_UHVDC_1_RNG_HI
          OpEventGetFaultDetectionCounter_GetFaultDetectionCounter_EvtInfo_VcEvEMPerfPlaus: RteEventRef=OpEventGetFaultDetectionCounter_GetFaultDetectionCounter_EvtInfo_VcEvEMPerfPlaus
          OpEventGetFaultDetectionCounter_GetFaultDetectionCounter_Event_VcEvEMPerfPlaus: RteEventRef=OpEventGetFaultDetectionCounter_GetFaultDetectionCounter_Event_VcEvEMPerfPlaus
          OpEventGetFaultDetectionCounter_GetFaultDetectionCounter_EvtInfo_VCEvVddmPropFr18Tioutd: RteEventRef=OpEventGetFaultDetectionCounter_GetFaultDetectionCounter_EvtInfo_VCEvVddmPropFr18Tioutd
          OpEventGetFaultDetectionCounter_GetFaultDetectionCounter_Event_VCEvVddmPropFr18Tioutd: RteEventRef=OpEventGetFaultDetectionCounter_GetFaultDetectionCounter_Event_VCEvVddmPropFr18Tioutd
          OpEventGetFaultDetectionCounter_GetFaultDetectionCounter_EvtInfo_INV_IAC_U_ELEC_HWP: RteEventRef=OpEventGetFaultDetectionCounter_GetFaultDetectionCounter_EvtInfo_INV_IAC_U_ELEC_HWP
          OpEventGetFaultDetectionCounter_GetFaultDetectionCounter_Event_INV_IAC_U_ELEC_HWP: RteEventRef=OpEventGetFaultDetectionCounter_GetFaultDetectionCounter_Event_INV_IAC_U_ELEC_HWP
          OpEventGetFaultDetectionCounter_GetFaultDetectionCounter_EvtInfo_VCEvVddmPropFr15Tioutd: RteEventRef=OpEventGetFaultDetectionCounter_GetFaultDetectionCounter_EvtInfo_VCEvVddmPropFr15Tioutd
          OpEventGetFaultDetectionCounter_GetFaultDetectionCounter_Event_VCEvVddmPropFr15Tioutd: RteEventRef=OpEventGetFaultDetectionCounter_GetFaultDetectionCounter_Event_VCEvVddmPropFr15Tioutd
          OpEventGetFaultDetectionCounter_GetFaultDetectionCounter_EvtInfo_Ga_GADisengageFailure: RteEventRef=OpEventGetFaultDetectionCounter_GetFaultDetectionCounter_EvtInfo_Ga_GADisengageFailure
          OpEventGetFaultDetectionCounter_GetFaultDetectionCounter_Event_Ga_GADisengageFailure: RteEventRef=OpEventGetFaultDetectionCounter_GetFaultDetectionCounter_Event_Ga_GADisengageFailure
          OpEventGetFaultDetectionCounter_GetFaultDetectionCounter_EvtInfo_CU_TEMP2_RNG_LO: RteEventRef=OpEventGetFaultDetectionCounter_GetFaultDetectionCounter_EvtInfo_CU_TEMP2_RNG_LO
          OpEventGetFaultDetectionCounter_GetFaultDetectionCounter_Event_CU_TEMP2_RNG_LO: RteEventRef=OpEventGetFaultDetectionCounter_GetFaultDetectionCounter_Event_CU_TEMP2_RNG_LO
          OpEventGetFaultDetectionCounter_GetFaultDetectionCounter_EvtInfo_INV_RSLVR_SIN_ELEC_OPEN: RteEventRef=OpEventGetFaultDetectionCounter_GetFaultDetectionCounter_EvtInfo_INV_RSLVR_SIN_ELEC_OPEN
          OpEventGetFaultDetectionCounter_GetFaultDetectionCounter_Event_INV_RSLVR_SIN_ELEC_OPEN: RteEventRef=OpEventGetFaultDetectionCounter_GetFaultDetectionCounter_Event_INV_RSLVR_SIN_ELEC_OPEN
          OpEventGetFaultDetectionCounter_GetFaultDetectionCounter_EvtInfo_VcEvChkSum: RteEventRef=OpEventGetFaultDetectionCounter_GetFaultDetectionCounter_EvtInfo_VcEvChkSum
          OpEventGetFaultDetectionCounter_GetFaultDetectionCounter_Event_VcEvChkSum: RteEventRef=OpEventGetFaultDetectionCounter_GetFaultDetectionCounter_Event_VcEvChkSum
          OpEventGetFaultDetectionCounter_GetFaultDetectionCounter_EvtInfo_PS_P5_UC_FLT: RteEventRef=OpEventGetFaultDetectionCounter_GetFaultDetectionCounter_EvtInfo_PS_P5_UC_FLT
          OpEventGetFaultDetectionCounter_GetFaultDetectionCounter_Event_PS_P5_UC_FLT: RteEventRef=OpEventGetFaultDetectionCounter_GetFaultDetectionCounter_Event_PS_P5_UC_FLT
          OpEventGetFaultDetectionCounter_GetFaultDetectionCounter_EvtInfo_INV_RSLVR_COS_ELEC_FLT: RteEventRef=OpEventGetFaultDetectionCounter_GetFaultDetectionCounter_EvtInfo_INV_RSLVR_COS_ELEC_FLT
          OpEventGetFaultDetectionCounter_GetFaultDetectionCounter_Event_INV_RSLVR_COS_ELEC_FLT: RteEventRef=OpEventGetFaultDetectionCounter_GetFaultDetectionCounter_Event_INV_RSLVR_COS_ELEC_FLT
          OpEventGetFaultDetectionCounter_GetFaultDetectionCounter_EvtInfo_INV_IAC_W_RNG_HI: RteEventRef=OpEventGetFaultDetectionCounter_GetFaultDetectionCounter_EvtInfo_INV_IAC_W_RNG_HI
          OpEventGetFaultDetectionCounter_GetFaultDetectionCounter_Event_INV_IAC_W_RNG_HI: RteEventRef=OpEventGetFaultDetectionCounter_GetFaultDetectionCounter_Event_INV_IAC_W_RNG_HI
          OpEventGetFaultDetectionCounter_GetFaultDetectionCounter_EvtInfo_PS_ECUSUPPLY_HIGH: RteEventRef=OpEventGetFaultDetectionCounter_GetFaultDetectionCounter_EvtInfo_PS_ECUSUPPLY_HIGH
          OpEventGetFaultDetectionCounter_GetFaultDetectionCounter_Event_PS_ECUSUPPLY_HIGH: RteEventRef=OpEventGetFaultDetectionCounter_GetFaultDetectionCounter_Event_PS_ECUSUPPLY_HIGH
          OpEventGetFaultDetectionCounter_GetFaultDetectionCounter_EvtInfo_VCEvEcmPropFr05Tioutd: RteEventRef=OpEventGetFaultDetectionCounter_GetFaultDetectionCounter_EvtInfo_VCEvEcmPropFr05Tioutd
          OpEventGetFaultDetectionCounter_GetFaultDetectionCounter_Event_VCEvEcmPropFr05Tioutd: RteEventRef=OpEventGetFaultDetectionCounter_GetFaultDetectionCounter_Event_VCEvEcmPropFr05Tioutd
          OpEventGetFaultDetectionCounter_GetFaultDetectionCounter_EvtInfo_PS_ECUSUPPLY_LOW: RteEventRef=OpEventGetFaultDetectionCounter_GetFaultDetectionCounter_EvtInfo_PS_ECUSUPPLY_LOW
          OpEventGetFaultDetectionCounter_GetFaultDetectionCounter_Event_PS_ECUSUPPLY_LOW: RteEventRef=OpEventGetFaultDetectionCounter_GetFaultDetectionCounter_Event_PS_ECUSUPPLY_LOW
          OpEventGetFaultDetectionCounter_GetFaultDetectionCounter_EvtInfo_VcEvChkSumHvSysRlySts: RteEventRef=OpEventGetFaultDetectionCounter_GetFaultDetectionCounter_EvtInfo_VcEvChkSumHvSysRlySts
          OpEventGetFaultDetectionCounter_GetFaultDetectionCounter_Event_VcEvChkSumHvSysRlySts: RteEventRef=OpEventGetFaultDetectionCounter_GetFaultDetectionCounter_Event_VcEvChkSumHvSysRlySts
          OpEventGetFaultDetectionCounter_GetFaultDetectionCounter_EvtInfo_VcEvMonMode: RteEventRef=OpEventGetFaultDetectionCounter_GetFaultDetectionCounter_EvtInfo_VcEvMonMode
          OpEventGetFaultDetectionCounter_GetFaultDetectionCounter_Event_VcEvMonMode: RteEventRef=OpEventGetFaultDetectionCounter_GetFaultDetectionCounter_Event_VcEvMonMode
          OpEventGetFaultDetectionCounter_GetFaultDetectionCounter_EvtInfo_INV_IAC_OC_SWP: RteEventRef=OpEventGetFaultDetectionCounter_GetFaultDetectionCounter_EvtInfo_INV_IAC_OC_SWP
          OpEventGetFaultDetectionCounter_GetFaultDetectionCounter_Event_INV_IAC_OC_SWP: RteEventRef=OpEventGetFaultDetectionCounter_GetFaultDetectionCounter_Event_INV_IAC_OC_SWP
          OpEventGetFaultDetectionCounter_GetFaultDetectionCounter_EvtInfo_INV_IMMO_AUTHFAIL: RteEventRef=OpEventGetFaultDetectionCounter_GetFaultDetectionCounter_EvtInfo_INV_IMMO_AUTHFAIL
          OpEventGetFaultDetectionCounter_GetFaultDetectionCounter_Event_INV_IMMO_AUTHFAIL: RteEventRef=OpEventGetFaultDetectionCounter_GetFaultDetectionCounter_Event_INV_IMMO_AUTHFAIL
          OpEventGetFaultDetectionCounter_GetFaultDetectionCounter_EvtInfo_PA_OpenCirc_FLT: RteEventRef=OpEventGetFaultDetectionCounter_GetFaultDetectionCounter_EvtInfo_PA_OpenCirc_FLT
          OpEventGetFaultDetectionCounter_GetFaultDetectionCounter_Event_PA_OpenCirc_FLT: RteEventRef=OpEventGetFaultDetectionCounter_GetFaultDetectionCounter_Event_PA_OpenCirc_FLT
          OpEventGetFaultDetectionCounter_GetFaultDetectionCounter_EvtInfo_INV_IAC_V_ELEC_HI: RteEventRef=OpEventGetFaultDetectionCounter_GetFaultDetectionCounter_EvtInfo_INV_IAC_V_ELEC_HI
          OpEventGetFaultDetectionCounter_GetFaultDetectionCounter_Event_INV_IAC_V_ELEC_HI: RteEventRef=OpEventGetFaultDetectionCounter_GetFaultDetectionCounter_Event_INV_IAC_V_ELEC_HI
          OpEventGetFaultDetectionCounter_GetFaultDetectionCounter_EvtInfo_VCEvEcmPropFr04Tioutd: RteEventRef=OpEventGetFaultDetectionCounter_GetFaultDetectionCounter_EvtInfo_VCEvEcmPropFr04Tioutd
          OpEventGetFaultDetectionCounter_GetFaultDetectionCounter_Event_VCEvEcmPropFr04Tioutd: RteEventRef=OpEventGetFaultDetectionCounter_GetFaultDetectionCounter_Event_VCEvEcmPropFr04Tioutd
          OpEventGetFaultDetectionCounter_GetFaultDetectionCounter_EvtInfo_VcEvMonTrqActPlaus: RteEventRef=OpEventGetFaultDetectionCounter_GetFaultDetectionCounter_EvtInfo_VcEvMonTrqActPlaus
          OpEventGetFaultDetectionCounter_GetFaultDetectionCounter_Event_VcEvMonTrqActPlaus: RteEventRef=OpEventGetFaultDetectionCounter_GetFaultDetectionCounter_Event_VcEvMonTrqActPlaus
          OpEventGetFaultDetectionCounter_GetFaultDetectionCounter_EvtInfo_VcEvMonTrqAct: RteEventRef=OpEventGetFaultDetectionCounter_GetFaultDetectionCounter_EvtInfo_VcEvMonTrqAct
          OpEventGetFaultDetectionCounter_GetFaultDetectionCounter_Event_VcEvMonTrqAct: RteEventRef=OpEventGetFaultDetectionCounter_GetFaultDetectionCounter_Event_VcEvMonTrqAct
          OpEventGetFaultDetectionCounter_GetFaultDetectionCounter_EvtInfo_INV_RSLVR_COS_ELEC_LO: RteEventRef=OpEventGetFaultDetectionCounter_GetFaultDetectionCounter_EvtInfo_INV_RSLVR_COS_ELEC_LO
          OpEventGetFaultDetectionCounter_GetFaultDetectionCounter_Event_INV_RSLVR_COS_ELEC_LO: RteEventRef=OpEventGetFaultDetectionCounter_GetFaultDetectionCounter_Event_INV_RSLVR_COS_ELEC_LO
          OpEventGetFaultDetectionCounter_GetFaultDetectionCounter_EvtInfo_INV_COOLT_INLET_TEMP_HWP: RteEventRef=OpEventGetFaultDetectionCounter_GetFaultDetectionCounter_EvtInfo_INV_COOLT_INLET_TEMP_HWP
          OpEventGetFaultDetectionCounter_GetFaultDetectionCounter_Event_INV_COOLT_INLET_TEMP_HWP: RteEventRef=OpEventGetFaultDetectionCounter_GetFaultDetectionCounter_Event_INV_COOLT_INLET_TEMP_HWP
          OpEventGetFaultDetectionCounter_GetFaultDetectionCounter_EvtInfo_VCEvEcmPropFr11Tioutd: RteEventRef=OpEventGetFaultDetectionCounter_GetFaultDetectionCounter_EvtInfo_VCEvEcmPropFr11Tioutd
          OpEventGetFaultDetectionCounter_GetFaultDetectionCounter_Event_VCEvEcmPropFr11Tioutd: RteEventRef=OpEventGetFaultDetectionCounter_GetFaultDetectionCounter_Event_VCEvEcmPropFr11Tioutd
          OpEventGetFaultDetectionCounter_GetFaultDetectionCounter_EvtInfo_PS_KL30_RNG_HI: RteEventRef=OpEventGetFaultDetectionCounter_GetFaultDetectionCounter_EvtInfo_PS_KL30_RNG_HI
          OpEventGetFaultDetectionCounter_GetFaultDetectionCounter_Event_PS_KL30_RNG_HI: RteEventRef=OpEventGetFaultDetectionCounter_GetFaultDetectionCounter_Event_PS_KL30_RNG_HI
          OpEventGetFaultDetectionCounter_GetFaultDetectionCounter_EvtInfo_INV_IAC_OC_HWP: RteEventRef=OpEventGetFaultDetectionCounter_GetFaultDetectionCounter_EvtInfo_INV_IAC_OC_HWP
          OpEventGetFaultDetectionCounter_GetFaultDetectionCounter_Event_INV_IAC_OC_HWP: RteEventRef=OpEventGetFaultDetectionCounter_GetFaultDetectionCounter_Event_INV_IAC_OC_HWP
          OpEventGetFaultDetectionCounter_GetFaultDetectionCounter_EvtInfo_INV_RSLVR_COS_RNG_HI: RteEventRef=OpEventGetFaultDetectionCounter_GetFaultDetectionCounter_EvtInfo_INV_RSLVR_COS_RNG_HI
          OpEventGetFaultDetectionCounter_GetFaultDetectionCounter_Event_INV_RSLVR_COS_RNG_HI: RteEventRef=OpEventGetFaultDetectionCounter_GetFaultDetectionCounter_Event_INV_RSLVR_COS_RNG_HI
          OpEventGetFaultDetectionCounter_GetFaultDetectionCounter_EvtInfo_INV_IAC_U_ELEC_HI: RteEventRef=OpEventGetFaultDetectionCounter_GetFaultDetectionCounter_EvtInfo_INV_IAC_U_ELEC_HI
          OpEventGetFaultDetectionCounter_GetFaultDetectionCounter_Event_INV_IAC_U_ELEC_HI: RteEventRef=OpEventGetFaultDetectionCounter_GetFaultDetectionCounter_Event_INV_IAC_U_ELEC_HI
          OpEventGetFaultDetectionCounter_GetFaultDetectionCounter_EvtInfo_INV_IAC_V_RNG_LO: RteEventRef=OpEventGetFaultDetectionCounter_GetFaultDetectionCounter_EvtInfo_INV_IAC_V_RNG_LO
          OpEventGetFaultDetectionCounter_GetFaultDetectionCounter_Event_INV_IAC_V_RNG_LO: RteEventRef=OpEventGetFaultDetectionCounter_GetFaultDetectionCounter_Event_INV_IAC_V_RNG_LO
          OpEventGetFaultDetectionCounter_GetFaultDetectionCounter_EvtInfo_INV_IAC_U_RNG_HI: RteEventRef=OpEventGetFaultDetectionCounter_GetFaultDetectionCounter_EvtInfo_INV_IAC_U_RNG_HI
          OpEventGetFaultDetectionCounter_GetFaultDetectionCounter_Event_INV_IAC_U_RNG_HI: RteEventRef=OpEventGetFaultDetectionCounter_GetFaultDetectionCounter_Event_INV_IAC_U_RNG_HI
          OpEventGetFaultDetectionCounter_GetFaultDetectionCounter_EvtInfo_VCEvEcmPropFr25Tioutd: RteEventRef=OpEventGetFaultDetectionCounter_GetFaultDetectionCounter_EvtInfo_VCEvEcmPropFr25Tioutd
          OpEventGetFaultDetectionCounter_GetFaultDetectionCounter_Event_VCEvEcmPropFr25Tioutd: RteEventRef=OpEventGetFaultDetectionCounter_GetFaultDetectionCounter_Event_VCEvEcmPropFr25Tioutd
          OpEventGetFaultDetectionCounter_GetFaultDetectionCounter_EvtInfo_INV_IGBT_TEMP_W_RNG_LO: RteEventRef=OpEventGetFaultDetectionCounter_GetFaultDetectionCounter_EvtInfo_INV_IGBT_TEMP_W_RNG_LO
          OpEventGetFaultDetectionCounter_GetFaultDetectionCounter_Event_INV_IGBT_TEMP_W_RNG_LO: RteEventRef=OpEventGetFaultDetectionCounter_GetFaultDetectionCounter_Event_INV_IGBT_TEMP_W_RNG_LO
          OpEventGetFaultDetectionCounter_GetFaultDetectionCounter_EvtInfo_PSnsr_RNG_NOK: RteEventRef=OpEventGetFaultDetectionCounter_GetFaultDetectionCounter_EvtInfo_PSnsr_RNG_NOK
          OpEventGetFaultDetectionCounter_GetFaultDetectionCounter_Event_PSnsr_RNG_NOK: RteEventRef=OpEventGetFaultDetectionCounter_GetFaultDetectionCounter_Event_PSnsr_RNG_NOK
          OpEventGetFaultDetectionCounter_GetFaultDetectionCounter_EvtInfo_INV_RSLVR_COS_RNG_NOK: RteEventRef=OpEventGetFaultDetectionCounter_GetFaultDetectionCounter_EvtInfo_INV_RSLVR_COS_RNG_NOK
          OpEventGetFaultDetectionCounter_GetFaultDetectionCounter_Event_INV_RSLVR_COS_RNG_NOK: RteEventRef=OpEventGetFaultDetectionCounter_GetFaultDetectionCounter_Event_INV_RSLVR_COS_RNG_NOK
          OpEventGetFaultDetectionCounter_GetFaultDetectionCounter_EvtInfo_PS_DRVB_Fault: RteEventRef=OpEventGetFaultDetectionCounter_GetFaultDetectionCounter_EvtInfo_PS_DRVB_Fault
          OpEventGetFaultDetectionCounter_GetFaultDetectionCounter_Event_PS_DRVB_Fault: RteEventRef=OpEventGetFaultDetectionCounter_GetFaultDetectionCounter_Event_PS_DRVB_Fault
          OpEventGetFaultDetectionCounter_GetFaultDetectionCounter_EvtInfo_INV_CU_TEMP1_RNG_NOK: RteEventRef=OpEventGetFaultDetectionCounter_GetFaultDetectionCounter_EvtInfo_INV_CU_TEMP1_RNG_NOK
          OpEventGetFaultDetectionCounter_GetFaultDetectionCounter_Event_INV_CU_TEMP1_RNG_NOK: RteEventRef=OpEventGetFaultDetectionCounter_GetFaultDetectionCounter_Event_INV_CU_TEMP1_RNG_NOK
          OpEventGetFaultDetectionCounter_GetFaultDetectionCounter_EvtInfo_VcEvCntr: RteEventRef=OpEventGetFaultDetectionCounter_GetFaultDetectionCounter_EvtInfo_VcEvCntr
          OpEventGetFaultDetectionCounter_GetFaultDetectionCounter_Event_VcEvCntr: RteEventRef=OpEventGetFaultDetectionCounter_GetFaultDetectionCounter_Event_VcEvCntr
          OpEventGetFaultDetectionCounter_GetFaultDetectionCounter_EvtInfo_INV_RSLVR_SIN_AMP: RteEventRef=OpEventGetFaultDetectionCounter_GetFaultDetectionCounter_EvtInfo_INV_RSLVR_SIN_AMP
          OpEventGetFaultDetectionCounter_GetFaultDetectionCounter_Event_INV_RSLVR_SIN_AMP: RteEventRef=OpEventGetFaultDetectionCounter_GetFaultDetectionCounter_Event_INV_RSLVR_SIN_AMP
          OpEventGetFaultDetectionCounter_GetFaultDetectionCounter_EvtInfo_INV_UHVDC_2_RNG_HI: RteEventRef=OpEventGetFaultDetectionCounter_GetFaultDetectionCounter_EvtInfo_INV_UHVDC_2_RNG_HI
          OpEventGetFaultDetectionCounter_GetFaultDetectionCounter_Event_INV_UHVDC_2_RNG_HI: RteEventRef=OpEventGetFaultDetectionCounter_GetFaultDetectionCounter_Event_INV_UHVDC_2_RNG_HI
          OpEventGetFaultDetectionCounter_GetFaultDetectionCounter_EvtInfo_INV_IGBT_TEMP_U_GRDT: RteEventRef=OpEventGetFaultDetectionCounter_GetFaultDetectionCounter_EvtInfo_INV_IGBT_TEMP_U_GRDT
          OpEventGetFaultDetectionCounter_GetFaultDetectionCounter_Event_INV_IGBT_TEMP_U_GRDT: RteEventRef=OpEventGetFaultDetectionCounter_GetFaultDetectionCounter_Event_INV_IGBT_TEMP_U_GRDT
          OpEventGetFaultDetectionCounter_GetFaultDetectionCounter_EvtInfo_MON_TQ_PLAUS_PWR_MDL: RteEventRef=OpEventGetFaultDetectionCounter_GetFaultDetectionCounter_EvtInfo_MON_TQ_PLAUS_PWR_MDL
          OpEventGetFaultDetectionCounter_GetFaultDetectionCounter_Event_MON_TQ_PLAUS_PWR_MDL: RteEventRef=OpEventGetFaultDetectionCounter_GetFaultDetectionCounter_Event_MON_TQ_PLAUS_PWR_MDL
          OpEventGetFaultDetectionCounter_GetFaultDetectionCounter_EvtInfo_INV_IGBT_TEMP_W_PLAUS: RteEventRef=OpEventGetFaultDetectionCounter_GetFaultDetectionCounter_EvtInfo_INV_IGBT_TEMP_W_PLAUS
          OpEventGetFaultDetectionCounter_GetFaultDetectionCounter_Event_INV_IGBT_TEMP_W_PLAUS: RteEventRef=OpEventGetFaultDetectionCounter_GetFaultDetectionCounter_Event_INV_IGBT_TEMP_W_PLAUS
          OpEventGetFaultDetectionCounter_GetFaultDetectionCounter_EvtInfo_PS_BLDC_UV_FLT: RteEventRef=OpEventGetFaultDetectionCounter_GetFaultDetectionCounter_EvtInfo_PS_BLDC_UV_FLT
          OpEventGetFaultDetectionCounter_GetFaultDetectionCounter_Event_PS_BLDC_UV_FLT: RteEventRef=OpEventGetFaultDetectionCounter_GetFaultDetectionCounter_Event_PS_BLDC_UV_FLT
          OpEventGetFaultDetectionCounter_GetFaultDetectionCounter_EvtInfo_INV_IAC_V_OFFS: RteEventRef=OpEventGetFaultDetectionCounter_GetFaultDetectionCounter_EvtInfo_INV_IAC_V_OFFS
          OpEventGetFaultDetectionCounter_GetFaultDetectionCounter_Event_INV_IAC_V_OFFS: RteEventRef=OpEventGetFaultDetectionCounter_GetFaultDetectionCounter_Event_INV_IAC_V_OFFS
          OpEventGetFaultDetectionCounter_GetFaultDetectionCounter_EvtInfo_INV_RSLVR_EXCT_FREQ_RNG_NOK: RteEventRef=OpEventGetFaultDetectionCounter_GetFaultDetectionCounter_EvtInfo_INV_RSLVR_EXCT_FREQ_RNG_NOK
          OpEventGetFaultDetectionCounter_GetFaultDetectionCounter_Event_INV_RSLVR_EXCT_FREQ_RNG_NOK: RteEventRef=OpEventGetFaultDetectionCounter_GetFaultDetectionCounter_Event_INV_RSLVR_EXCT_FREQ_RNG_NOK
          OpEventGetFaultDetectionCounter_GetFaultDetectionCounter_EvtInfo_PS_KL30_RNG_LO: RteEventRef=OpEventGetFaultDetectionCounter_GetFaultDetectionCounter_EvtInfo_PS_KL30_RNG_LO
          OpEventGetFaultDetectionCounter_GetFaultDetectionCounter_Event_PS_KL30_RNG_LO: RteEventRef=OpEventGetFaultDetectionCounter_GetFaultDetectionCounter_Event_PS_KL30_RNG_LO
          OpEventGetFaultDetectionCounter_GetFaultDetectionCounter_EvtInfo_INV_RSLVR_COS_RNG_LO: RteEventRef=OpEventGetFaultDetectionCounter_GetFaultDetectionCounter_EvtInfo_INV_RSLVR_COS_RNG_LO
          OpEventGetFaultDetectionCounter_GetFaultDetectionCounter_Event_INV_RSLVR_COS_RNG_LO: RteEventRef=OpEventGetFaultDetectionCounter_GetFaultDetectionCounter_Event_INV_RSLVR_COS_RNG_LO
          OpEventGetFaultDetectionCounter_GetFaultDetectionCounter_EvtInfo_PSnsr_ELE_FLT: RteEventRef=OpEventGetFaultDetectionCounter_GetFaultDetectionCounter_EvtInfo_PSnsr_ELE_FLT
          OpEventGetFaultDetectionCounter_GetFaultDetectionCounter_Event_PSnsr_ELE_FLT: RteEventRef=OpEventGetFaultDetectionCounter_GetFaultDetectionCounter_Event_PSnsr_ELE_FLT
          OpEventGetFaultDetectionCounter_GetFaultDetectionCounter_EvtInfo_INV_RSLVR_SIN_COS_PLAUS_AMP: RteEventRef=OpEventGetFaultDetectionCounter_GetFaultDetectionCounter_EvtInfo_INV_RSLVR_SIN_COS_PLAUS_AMP
          OpEventGetFaultDetectionCounter_GetFaultDetectionCounter_Event_INV_RSLVR_SIN_COS_PLAUS_AMP: RteEventRef=OpEventGetFaultDetectionCounter_GetFaultDetectionCounter_Event_INV_RSLVR_SIN_COS_PLAUS_AMP
          OpEventGetFaultDetectionCounter_GetFaultDetectionCounter_EvtInfo_INV_IAC_U_ELEC_LO: RteEventRef=OpEventGetFaultDetectionCounter_GetFaultDetectionCounter_EvtInfo_INV_IAC_U_ELEC_LO
          OpEventGetFaultDetectionCounter_GetFaultDetectionCounter_Event_INV_IAC_U_ELEC_LO: RteEventRef=OpEventGetFaultDetectionCounter_GetFaultDetectionCounter_Event_INV_IAC_U_ELEC_LO
          OpEventGetFaultDetectionCounter_GetFaultDetectionCounter_EvtInfo_INV_RSLVR_EXCT_ELEC_HI: RteEventRef=OpEventGetFaultDetectionCounter_GetFaultDetectionCounter_EvtInfo_INV_RSLVR_EXCT_ELEC_HI
          OpEventGetFaultDetectionCounter_GetFaultDetectionCounter_Event_INV_RSLVR_EXCT_ELEC_HI: RteEventRef=OpEventGetFaultDetectionCounter_GetFaultDetectionCounter_Event_INV_RSLVR_EXCT_ELEC_HI
          OpEventGetFaultDetectionCounter_GetFaultDetectionCounter_EvtInfo_INV_IAC_U_RNG_LO: RteEventRef=OpEventGetFaultDetectionCounter_GetFaultDetectionCounter_EvtInfo_INV_IAC_U_RNG_LO
          OpEventGetFaultDetectionCounter_GetFaultDetectionCounter_Event_INV_IAC_U_RNG_LO: RteEventRef=OpEventGetFaultDetectionCounter_GetFaultDetectionCounter_Event_INV_IAC_U_RNG_LO
          OpEventGetFaultDetectionCounter_GetFaultDetectionCounter_EvtInfo_INV_IAC_V_RNG_HI: RteEventRef=OpEventGetFaultDetectionCounter_GetFaultDetectionCounter_EvtInfo_INV_IAC_V_RNG_HI
          OpEventGetFaultDetectionCounter_GetFaultDetectionCounter_Event_INV_IAC_V_RNG_HI: RteEventRef=OpEventGetFaultDetectionCounter_GetFaultDetectionCounter_Event_INV_IAC_V_RNG_HI
          OpEventGetFaultDetectionCounter_GetFaultDetectionCounter_EvtInfo_INV_IGBT_TEMP_U_PLAUS: RteEventRef=OpEventGetFaultDetectionCounter_GetFaultDetectionCounter_EvtInfo_INV_IGBT_TEMP_U_PLAUS
          OpEventGetFaultDetectionCounter_GetFaultDetectionCounter_Event_INV_IGBT_TEMP_U_PLAUS: RteEventRef=OpEventGetFaultDetectionCounter_GetFaultDetectionCounter_Event_INV_IGBT_TEMP_U_PLAUS
          OpEventGetFaultDetectionCounter_GetFaultDetectionCounter_EvtInfo_INV_RSLVR_OFFS_DFT: RteEventRef=OpEventGetFaultDetectionCounter_GetFaultDetectionCounter_EvtInfo_INV_RSLVR_OFFS_DFT
          OpEventGetFaultDetectionCounter_GetFaultDetectionCounter_Event_INV_RSLVR_OFFS_DFT: RteEventRef=OpEventGetFaultDetectionCounter_GetFaultDetectionCounter_Event_INV_RSLVR_OFFS_DFT
          OpEventGetFaultDetectionCounter_GetFaultDetectionCounter_EvtInfo_Ga_MoveOverThd: RteEventRef=OpEventGetFaultDetectionCounter_GetFaultDetectionCounter_EvtInfo_Ga_MoveOverThd
          OpEventGetFaultDetectionCounter_GetFaultDetectionCounter_Event_Ga_MoveOverThd: RteEventRef=OpEventGetFaultDetectionCounter_GetFaultDetectionCounter_Event_Ga_MoveOverThd
          OpEventGetFaultDetectionCounter_GetFaultDetectionCounter_EvtInfo_VcEvMonIPH: RteEventRef=OpEventGetFaultDetectionCounter_GetFaultDetectionCounter_EvtInfo_VcEvMonIPH
          OpEventGetFaultDetectionCounter_GetFaultDetectionCounter_Event_VcEvMonIPH: RteEventRef=OpEventGetFaultDetectionCounter_GetFaultDetectionCounter_Event_VcEvMonIPH
          OpEventGetFaultDetectionCounter_GetFaultDetectionCounter_EvtInfo_INV_RSLVR_HW_FLT: RteEventRef=OpEventGetFaultDetectionCounter_GetFaultDetectionCounter_EvtInfo_INV_RSLVR_HW_FLT
          OpEventGetFaultDetectionCounter_GetFaultDetectionCounter_Event_INV_RSLVR_HW_FLT: RteEventRef=OpEventGetFaultDetectionCounter_GetFaultDetectionCounter_Event_INV_RSLVR_HW_FLT
          OpEventGetFaultDetectionCounter_GetFaultDetectionCounter_EvtInfo_INV_RSLVR_SIN_ELEC_LO: RteEventRef=OpEventGetFaultDetectionCounter_GetFaultDetectionCounter_EvtInfo_INV_RSLVR_SIN_ELEC_LO
          OpEventGetFaultDetectionCounter_GetFaultDetectionCounter_Event_INV_RSLVR_SIN_ELEC_LO: RteEventRef=OpEventGetFaultDetectionCounter_GetFaultDetectionCounter_Event_INV_RSLVR_SIN_ELEC_LO
          OpEventGetFaultDetectionCounter_GetFaultDetectionCounter_EvtInfo_INV_IAC_W_AMP: RteEventRef=OpEventGetFaultDetectionCounter_GetFaultDetectionCounter_EvtInfo_INV_IAC_W_AMP
          OpEventGetFaultDetectionCounter_GetFaultDetectionCounter_Event_INV_IAC_W_AMP: RteEventRef=OpEventGetFaultDetectionCounter_GetFaultDetectionCounter_Event_INV_IAC_W_AMP
          OpEventGetFaultDetectionCounter_GetFaultDetectionCounter_EvtInfo_VCC_OverVoltage: RteEventRef=OpEventGetFaultDetectionCounter_GetFaultDetectionCounter_EvtInfo_VCC_OverVoltage
          OpEventGetFaultDetectionCounter_GetFaultDetectionCounter_Event_VCC_OverVoltage: RteEventRef=OpEventGetFaultDetectionCounter_GetFaultDetectionCounter_Event_VCC_OverVoltage
          OpEventGetFaultDetectionCounter_GetFaultDetectionCounter_EvtInfo_PS_BLDC_OV_FLT: RteEventRef=OpEventGetFaultDetectionCounter_GetFaultDetectionCounter_EvtInfo_PS_BLDC_OV_FLT
          OpEventGetFaultDetectionCounter_GetFaultDetectionCounter_Event_PS_BLDC_OV_FLT: RteEventRef=OpEventGetFaultDetectionCounter_GetFaultDetectionCounter_Event_PS_BLDC_OV_FLT
          OpEventGetFaultDetectionCounter_GetFaultDetectionCounter_EvtInfo_AURIX_EEPROM_FLT: RteEventRef=OpEventGetFaultDetectionCounter_GetFaultDetectionCounter_EvtInfo_AURIX_EEPROM_FLT
          OpEventGetFaultDetectionCounter_GetFaultDetectionCounter_Event_AURIX_EEPROM_FLT: RteEventRef=OpEventGetFaultDetectionCounter_GetFaultDetectionCounter_Event_AURIX_EEPROM_FLT
          OpEventGetFaultDetectionCounter_GetFaultDetectionCounter_EvtInfo_FS_MONITIOR_ASC_FW_FLT: RteEventRef=OpEventGetFaultDetectionCounter_GetFaultDetectionCounter_EvtInfo_FS_MONITIOR_ASC_FW_FLT
          OpEventGetFaultDetectionCounter_GetFaultDetectionCounter_Event_FS_MONITIOR_ASC_FW_FLT: RteEventRef=OpEventGetFaultDetectionCounter_GetFaultDetectionCounter_Event_FS_MONITIOR_ASC_FW_FLT
          OpEventGetFaultDetectionCounter_GetFaultDetectionCounter_EvtInfo_VCEvSrsPropFr02Tioutd: RteEventRef=OpEventGetFaultDetectionCounter_GetFaultDetectionCounter_EvtInfo_VCEvSrsPropFr02Tioutd
          OpEventGetFaultDetectionCounter_GetFaultDetectionCounter_Event_VCEvSrsPropFr02Tioutd: RteEventRef=OpEventGetFaultDetectionCounter_GetFaultDetectionCounter_Event_VCEvSrsPropFr02Tioutd
          OpEventGetFaultDetectionCounter_GetFaultDetectionCounter_EvtInfo_VcEvMonErrMode: RteEventRef=OpEventGetFaultDetectionCounter_GetFaultDetectionCounter_EvtInfo_VcEvMonErrMode
          OpEventGetFaultDetectionCounter_GetFaultDetectionCounter_Event_VcEvMonErrMode: RteEventRef=OpEventGetFaultDetectionCounter_GetFaultDetectionCounter_Event_VcEvMonErrMode
          OpEventGetFaultDetectionCounter_GetFaultDetectionCounter_EvtInfo_AURIX_RST_MPL: RteEventRef=OpEventGetFaultDetectionCounter_GetFaultDetectionCounter_EvtInfo_AURIX_RST_MPL
          OpEventGetFaultDetectionCounter_GetFaultDetectionCounter_Event_AURIX_RST_MPL: RteEventRef=OpEventGetFaultDetectionCounter_GetFaultDetectionCounter_Event_AURIX_RST_MPL
          OpEventGetFaultDetectionCounter_GetFaultDetectionCounter_EvtInfo_VcEvNodeMisECM: RteEventRef=OpEventGetFaultDetectionCounter_GetFaultDetectionCounter_EvtInfo_VcEvNodeMisECM
          OpEventGetFaultDetectionCounter_GetFaultDetectionCounter_Event_VcEvNodeMisECM: RteEventRef=OpEventGetFaultDetectionCounter_GetFaultDetectionCounter_Event_VcEvNodeMisECM
          OpEventGetFaultDetectionCounter_GetFaultDetectionCounter_EvtInfo_PS_KL30_PLAUS: RteEventRef=OpEventGetFaultDetectionCounter_GetFaultDetectionCounter_EvtInfo_PS_KL30_PLAUS
          OpEventGetFaultDetectionCounter_GetFaultDetectionCounter_Event_PS_KL30_PLAUS: RteEventRef=OpEventGetFaultDetectionCounter_GetFaultDetectionCounter_Event_PS_KL30_PLAUS
          OpEventGetFaultDetectionCounter_GetFaultDetectionCounter_EvtInfo_INV_IAC_W_ELEC_HI: RteEventRef=OpEventGetFaultDetectionCounter_GetFaultDetectionCounter_EvtInfo_INV_IAC_W_ELEC_HI
          OpEventGetFaultDetectionCounter_GetFaultDetectionCounter_Event_INV_IAC_W_ELEC_HI: RteEventRef=OpEventGetFaultDetectionCounter_GetFaultDetectionCounter_Event_INV_IAC_W_ELEC_HI
          OpEventGetFaultDetectionCounter_GetFaultDetectionCounter_EvtInfo_VCEvVddmPropFr19Tioutd: RteEventRef=OpEventGetFaultDetectionCounter_GetFaultDetectionCounter_EvtInfo_VCEvVddmPropFr19Tioutd
          OpEventGetFaultDetectionCounter_GetFaultDetectionCounter_Event_VCEvVddmPropFr19Tioutd: RteEventRef=OpEventGetFaultDetectionCounter_GetFaultDetectionCounter_Event_VCEvVddmPropFr19Tioutd
          OpEventGetFaultDetectionCounter_GetFaultDetectionCounter_EvtInfo_INV_TEMP_DCHA_HW: RteEventRef=OpEventGetFaultDetectionCounter_GetFaultDetectionCounter_EvtInfo_INV_TEMP_DCHA_HW
          OpEventGetFaultDetectionCounter_GetFaultDetectionCounter_Event_INV_TEMP_DCHA_HW: RteEventRef=OpEventGetFaultDetectionCounter_GetFaultDetectionCounter_Event_INV_TEMP_DCHA_HW
          OpEventGetFaultDetectionCounter_GetFaultDetectionCounter_EvtInfo_VcEvPropCANGlbTiOutd: RteEventRef=OpEventGetFaultDetectionCounter_GetFaultDetectionCounter_EvtInfo_VcEvPropCANGlbTiOutd
          OpEventGetFaultDetectionCounter_GetFaultDetectionCounter_Event_VcEvPropCANGlbTiOutd: RteEventRef=OpEventGetFaultDetectionCounter_GetFaultDetectionCounter_Event_VcEvPropCANGlbTiOutd
          OpEventGetFaultDetectionCounter_GetFaultDetectionCounter_EvtInfo_INV_EM_STATOR_TEMP2_RNG_NOK: RteEventRef=OpEventGetFaultDetectionCounter_GetFaultDetectionCounter_EvtInfo_INV_EM_STATOR_TEMP2_RNG_NOK
          OpEventGetFaultDetectionCounter_GetFaultDetectionCounter_Event_INV_EM_STATOR_TEMP2_RNG_NOK: RteEventRef=OpEventGetFaultDetectionCounter_GetFaultDetectionCounter_Event_INV_EM_STATOR_TEMP2_RNG_NOK
          OpEventGetFaultDetectionCounter_GetFaultDetectionCounter_EvtInfo_INV_UHVDC_OV_HWP: RteEventRef=OpEventGetFaultDetectionCounter_GetFaultDetectionCounter_EvtInfo_INV_UHVDC_OV_HWP
          OpEventGetFaultDetectionCounter_GetFaultDetectionCounter_Event_INV_UHVDC_OV_HWP: RteEventRef=OpEventGetFaultDetectionCounter_GetFaultDetectionCounter_Event_INV_UHVDC_OV_HWP
          OpEventGetFaultDetectionCounter_GetFaultDetectionCounter_EvtInfo_Ga_FindEngleAngleFailed: RteEventRef=OpEventGetFaultDetectionCounter_GetFaultDetectionCounter_EvtInfo_Ga_FindEngleAngleFailed
          OpEventGetFaultDetectionCounter_GetFaultDetectionCounter_Event_Ga_FindEngleAngleFailed: RteEventRef=OpEventGetFaultDetectionCounter_GetFaultDetectionCounter_Event_Ga_FindEngleAngleFailed
          OpEventGetFaultDetectionCounter_GetFaultDetectionCounter_EvtInfo_VcEvMonTrqCmp: RteEventRef=OpEventGetFaultDetectionCounter_GetFaultDetectionCounter_EvtInfo_VcEvMonTrqCmp
          OpEventGetFaultDetectionCounter_GetFaultDetectionCounter_Event_VcEvMonTrqCmp: RteEventRef=OpEventGetFaultDetectionCounter_GetFaultDetectionCounter_Event_VcEvMonTrqCmp
          OpEventGetFaultDetectionCounter_GetFaultDetectionCounter_EvtInfo_INV_IGBT_TEMP_V_RNG_LO: RteEventRef=OpEventGetFaultDetectionCounter_GetFaultDetectionCounter_EvtInfo_INV_IGBT_TEMP_V_RNG_LO
          OpEventGetFaultDetectionCounter_GetFaultDetectionCounter_Event_INV_IGBT_TEMP_V_RNG_LO: RteEventRef=OpEventGetFaultDetectionCounter_GetFaultDetectionCounter_Event_INV_IGBT_TEMP_V_RNG_LO
          OpEventGetFaultDetectionCounter_GetFaultDetectionCounter_EvtInfo_INV_CONTROL_LIMIT: RteEventRef=OpEventGetFaultDetectionCounter_GetFaultDetectionCounter_EvtInfo_INV_CONTROL_LIMIT
          OpEventGetFaultDetectionCounter_GetFaultDetectionCounter_Event_INV_CONTROL_LIMIT: RteEventRef=OpEventGetFaultDetectionCounter_GetFaultDetectionCounter_Event_INV_CONTROL_LIMIT
          OpEventGetFaultDetectionCounter_GetFaultDetectionCounter_EvtInfo_COM_CarConfigErr: RteEventRef=OpEventGetFaultDetectionCounter_GetFaultDetectionCounter_EvtInfo_COM_CarConfigErr
          OpEventGetFaultDetectionCounter_GetFaultDetectionCounter_Event_COM_CarConfigErr: RteEventRef=OpEventGetFaultDetectionCounter_GetFaultDetectionCounter_Event_COM_CarConfigErr
          OpEventGetFaultDetectionCounter_GetFaultDetectionCounter_EvtInfo_VCEvEcmPropFr08Tioutd: RteEventRef=OpEventGetFaultDetectionCounter_GetFaultDetectionCounter_EvtInfo_VCEvEcmPropFr08Tioutd
          OpEventGetFaultDetectionCounter_GetFaultDetectionCounter_Event_VCEvEcmPropFr08Tioutd: RteEventRef=OpEventGetFaultDetectionCounter_GetFaultDetectionCounter_Event_VCEvEcmPropFr08Tioutd
          OpEventGetFaultDetectionCounter_GetFaultDetectionCounter_EvtInfo_CU_TEMP1_RNG_LO: RteEventRef=OpEventGetFaultDetectionCounter_GetFaultDetectionCounter_EvtInfo_CU_TEMP1_RNG_LO
          OpEventGetFaultDetectionCounter_GetFaultDetectionCounter_Event_CU_TEMP1_RNG_LO: RteEventRef=OpEventGetFaultDetectionCounter_GetFaultDetectionCounter_Event_CU_TEMP1_RNG_LO
          OpEventGetFaultDetectionCounter_GetFaultDetectionCounter_EvtInfo_INV_EM_STATOR_TEMP2_RNG_SWT: RteEventRef=OpEventGetFaultDetectionCounter_GetFaultDetectionCounter_EvtInfo_INV_EM_STATOR_TEMP2_RNG_SWT
          OpEventGetFaultDetectionCounter_GetFaultDetectionCounter_Event_INV_EM_STATOR_TEMP2_RNG_SWT: RteEventRef=OpEventGetFaultDetectionCounter_GetFaultDetectionCounter_Event_INV_EM_STATOR_TEMP2_RNG_SWT
          OpEventGetFaultDetectionCounter_GetFaultDetectionCounter_EvtInfo_GA_BLDC_POS_FLT: RteEventRef=OpEventGetFaultDetectionCounter_GetFaultDetectionCounter_EvtInfo_GA_BLDC_POS_FLT
          OpEventGetFaultDetectionCounter_GetFaultDetectionCounter_Event_GA_BLDC_POS_FLT: RteEventRef=OpEventGetFaultDetectionCounter_GetFaultDetectionCounter_Event_GA_BLDC_POS_FLT
          OpEventGetFaultDetectionCounter_GetFaultDetectionCounter_EvtInfo_PS_WhlSnsr_FLT: RteEventRef=OpEventGetFaultDetectionCounter_GetFaultDetectionCounter_EvtInfo_PS_WhlSnsr_FLT
          OpEventGetFaultDetectionCounter_GetFaultDetectionCounter_Event_PS_WhlSnsr_FLT: RteEventRef=OpEventGetFaultDetectionCounter_GetFaultDetectionCounter_Event_PS_WhlSnsr_FLT
          OpEventGetFaultDetectionCounter_GetFaultDetectionCounter_EvtInfo_INV_EM_STATOR_TEMP_RNG_LO: RteEventRef=OpEventGetFaultDetectionCounter_GetFaultDetectionCounter_EvtInfo_INV_EM_STATOR_TEMP_RNG_LO
          OpEventGetFaultDetectionCounter_GetFaultDetectionCounter_Event_INV_EM_STATOR_TEMP_RNG_LO: RteEventRef=OpEventGetFaultDetectionCounter_GetFaultDetectionCounter_Event_INV_EM_STATOR_TEMP_RNG_LO
          OpEventGetFaultDetectionCounter_GetFaultDetectionCounter_EvtInfo_INV_RSLVR_SIN_ELEC_HI: RteEventRef=OpEventGetFaultDetectionCounter_GetFaultDetectionCounter_EvtInfo_INV_RSLVR_SIN_ELEC_HI
          OpEventGetFaultDetectionCounter_GetFaultDetectionCounter_Event_INV_RSLVR_SIN_ELEC_HI: RteEventRef=OpEventGetFaultDetectionCounter_GetFaultDetectionCounter_Event_INV_RSLVR_SIN_ELEC_HI
          OpEventGetFaultDetectionCounter_GetFaultDetectionCounter_EvtInfo_INV_RSLVR_SIN_COS_PLAUS: RteEventRef=OpEventGetFaultDetectionCounter_GetFaultDetectionCounter_EvtInfo_INV_RSLVR_SIN_COS_PLAUS
          OpEventGetFaultDetectionCounter_GetFaultDetectionCounter_Event_INV_RSLVR_SIN_COS_PLAUS: RteEventRef=OpEventGetFaultDetectionCounter_GetFaultDetectionCounter_Event_INV_RSLVR_SIN_COS_PLAUS
          OpEventGetFaultDetectionCounter_GetFaultDetectionCounter_EvtInfo_INV_RSLVR_COS_AMP: RteEventRef=OpEventGetFaultDetectionCounter_GetFaultDetectionCounter_EvtInfo_INV_RSLVR_COS_AMP
          OpEventGetFaultDetectionCounter_GetFaultDetectionCounter_Event_INV_RSLVR_COS_AMP: RteEventRef=OpEventGetFaultDetectionCounter_GetFaultDetectionCounter_Event_INV_RSLVR_COS_AMP
          OpEventGetFaultDetectionCounter_GetFaultDetectionCounter_EvtInfo_INV_GATE_DRVR_BOT_HWP: RteEventRef=OpEventGetFaultDetectionCounter_GetFaultDetectionCounter_EvtInfo_INV_GATE_DRVR_BOT_HWP
          OpEventGetFaultDetectionCounter_GetFaultDetectionCounter_Event_INV_GATE_DRVR_BOT_HWP: RteEventRef=OpEventGetFaultDetectionCounter_GetFaultDetectionCounter_Event_INV_GATE_DRVR_BOT_HWP
          OpEventGetFaultDetectionCounter_GetFaultDetectionCounter_EvtInfo_Eg_HallVolWrong: RteEventRef=OpEventGetFaultDetectionCounter_GetFaultDetectionCounter_EvtInfo_Eg_HallVolWrong
          OpEventGetFaultDetectionCounter_GetFaultDetectionCounter_Event_Eg_HallVolWrong: RteEventRef=OpEventGetFaultDetectionCounter_GetFaultDetectionCounter_Event_Eg_HallVolWrong
          OpEventGetFaultDetectionCounter_GetFaultDetectionCounter_EvtInfo_INV_RSLVR_EXCT_RNG_NOK: RteEventRef=OpEventGetFaultDetectionCounter_GetFaultDetectionCounter_EvtInfo_INV_RSLVR_EXCT_RNG_NOK
          OpEventGetFaultDetectionCounter_GetFaultDetectionCounter_Event_INV_RSLVR_EXCT_RNG_NOK: RteEventRef=OpEventGetFaultDetectionCounter_GetFaultDetectionCounter_Event_INV_RSLVR_EXCT_RNG_NOK
          OpEventGetFaultDetectionCounter_GetFaultDetectionCounter_EvtInfo_PA_OpenCirc: RteEventRef=OpEventGetFaultDetectionCounter_GetFaultDetectionCounter_EvtInfo_PA_OpenCirc
          OpEventGetFaultDetectionCounter_GetFaultDetectionCounter_Event_PA_OpenCirc: RteEventRef=OpEventGetFaultDetectionCounter_GetFaultDetectionCounter_Event_PA_OpenCirc
          OpEventGetFaultDetectionCounter_GetFaultDetectionCounter_EvtInfo_INV_RSLVR_COS_ELEC_HI: RteEventRef=OpEventGetFaultDetectionCounter_GetFaultDetectionCounter_EvtInfo_INV_RSLVR_COS_ELEC_HI
          OpEventGetFaultDetectionCounter_GetFaultDetectionCounter_Event_INV_RSLVR_COS_ELEC_HI: RteEventRef=OpEventGetFaultDetectionCounter_GetFaultDetectionCounter_Event_INV_RSLVR_COS_ELEC_HI
          OpEventGetFaultDetectionCounter_GetFaultDetectionCounter_EvtInfo_VcEvCntrHvSysRlySts: RteEventRef=OpEventGetFaultDetectionCounter_GetFaultDetectionCounter_EvtInfo_VcEvCntrHvSysRlySts
          OpEventGetFaultDetectionCounter_GetFaultDetectionCounter_Event_VcEvCntrHvSysRlySts: RteEventRef=OpEventGetFaultDetectionCounter_GetFaultDetectionCounter_Event_VcEvCntrHvSysRlySts
          OpEventGetFaultDetectionCounter_GetFaultDetectionCounter_EvtInfo_CRASH_DTC: RteEventRef=OpEventGetFaultDetectionCounter_GetFaultDetectionCounter_EvtInfo_CRASH_DTC
          OpEventGetFaultDetectionCounter_GetFaultDetectionCounter_Event_CRASH_DTC: RteEventRef=OpEventGetFaultDetectionCounter_GetFaultDetectionCounter_Event_CRASH_DTC
          OpEventGetFaultDetectionCounter_GetFaultDetectionCounter_EvtInfo_INV_IGBT_TEMP_W_RNG_HI: RteEventRef=OpEventGetFaultDetectionCounter_GetFaultDetectionCounter_EvtInfo_INV_IGBT_TEMP_W_RNG_HI
          OpEventGetFaultDetectionCounter_GetFaultDetectionCounter_Event_INV_IGBT_TEMP_W_RNG_HI: RteEventRef=OpEventGetFaultDetectionCounter_GetFaultDetectionCounter_Event_INV_IGBT_TEMP_W_RNG_HI
          OpEventGetFaultDetectionCounter_GetFaultDetectionCounter_EvtInfo_VCEvBecmPropFr02Tioutd: RteEventRef=OpEventGetFaultDetectionCounter_GetFaultDetectionCounter_EvtInfo_VCEvBecmPropFr02Tioutd
          OpEventGetFaultDetectionCounter_GetFaultDetectionCounter_Event_VCEvBecmPropFr02Tioutd: RteEventRef=OpEventGetFaultDetectionCounter_GetFaultDetectionCounter_Event_VCEvBecmPropFr02Tioutd
          OpEventGetFaultDetectionCounter_GetFaultDetectionCounter_EvtInfo_INV_IGBT_TEMP_W_GRDT: RteEventRef=OpEventGetFaultDetectionCounter_GetFaultDetectionCounter_EvtInfo_INV_IGBT_TEMP_W_GRDT
          OpEventGetFaultDetectionCounter_GetFaultDetectionCounter_Event_INV_IGBT_TEMP_W_GRDT: RteEventRef=OpEventGetFaultDetectionCounter_GetFaultDetectionCounter_Event_INV_IGBT_TEMP_W_GRDT
          OpEventGetFaultDetectionCounter_GetFaultDetectionCounter_EvtInfo_EXT_UC_SPI_FLT: RteEventRef=OpEventGetFaultDetectionCounter_GetFaultDetectionCounter_EvtInfo_EXT_UC_SPI_FLT
          OpEventGetFaultDetectionCounter_GetFaultDetectionCounter_Event_EXT_UC_SPI_FLT: RteEventRef=OpEventGetFaultDetectionCounter_GetFaultDetectionCounter_Event_EXT_UC_SPI_FLT
          OpEventGetFaultDetectionCounter_GetFaultDetectionCounter_EvtInfo_INV_IAC_V_ELEC_HWP_001: RteEventRef=OpEventGetFaultDetectionCounter_GetFaultDetectionCounter_EvtInfo_INV_IAC_V_ELEC_HWP_001
          OpEventGetFaultDetectionCounter_GetFaultDetectionCounter_Event_INV_IAC_V_ELEC_HWP_001: RteEventRef=OpEventGetFaultDetectionCounter_GetFaultDetectionCounter_Event_INV_IAC_V_ELEC_HWP_001
          OpEventGetFaultDetectionCounter_GetFaultDetectionCounter_EvtInfo_VcEvChkSumWhlMotSysTqAllwd: RteEventRef=OpEventGetFaultDetectionCounter_GetFaultDetectionCounter_EvtInfo_VcEvChkSumWhlMotSysTqAllwd
          OpEventGetFaultDetectionCounter_GetFaultDetectionCounter_Event_VcEvChkSumWhlMotSysTqAllwd: RteEventRef=OpEventGetFaultDetectionCounter_GetFaultDetectionCounter_Event_VcEvChkSumWhlMotSysTqAllwd
          OpEventGetFaultDetectionCounter_GetFaultDetectionCounter_EvtInfo_FS_MONITIOR_ASC_FLT: RteEventRef=OpEventGetFaultDetectionCounter_GetFaultDetectionCounter_EvtInfo_FS_MONITIOR_ASC_FLT
          OpEventGetFaultDetectionCounter_GetFaultDetectionCounter_Event_FS_MONITIOR_ASC_FLT: RteEventRef=OpEventGetFaultDetectionCounter_GetFaultDetectionCounter_Event_FS_MONITIOR_ASC_FLT
          OpEventGetFaultDetectionCounter_GetFaultDetectionCounter_EvtInfo_INV_IAC_V_AMP: RteEventRef=OpEventGetFaultDetectionCounter_GetFaultDetectionCounter_EvtInfo_INV_IAC_V_AMP
          OpEventGetFaultDetectionCounter_GetFaultDetectionCounter_Event_INV_IAC_V_AMP: RteEventRef=OpEventGetFaultDetectionCounter_GetFaultDetectionCounter_Event_INV_IAC_V_AMP
          OpEventGetFaultDetectionCounter_GetFaultDetectionCounter_EvtInfo_INV_IAC_W_ELEC_LO: RteEventRef=OpEventGetFaultDetectionCounter_GetFaultDetectionCounter_EvtInfo_INV_IAC_W_ELEC_LO
          OpEventGetFaultDetectionCounter_GetFaultDetectionCounter_Event_INV_IAC_W_ELEC_LO: RteEventRef=OpEventGetFaultDetectionCounter_GetFaultDetectionCounter_Event_INV_IAC_W_ELEC_LO
          OpEventGetFaultDetectionCounter_GetFaultDetectionCounter_EvtInfo_VCEvVddmPropFr08Tioutd_001: RteEventRef=OpEventGetFaultDetectionCounter_GetFaultDetectionCounter_EvtInfo_VCEvVddmPropFr08Tioutd_001
          OpEventGetFaultDetectionCounter_GetFaultDetectionCounter_Event_VCEvVddmPropFr08Tioutd_001: RteEventRef=OpEventGetFaultDetectionCounter_GetFaultDetectionCounter_Event_VCEvVddmPropFr08Tioutd_001
          OpEventGetFaultDetectionCounter_GetFaultDetectionCounter_EvtInfo_PS_P12_RES_FLT: RteEventRef=OpEventGetFaultDetectionCounter_GetFaultDetectionCounter_EvtInfo_PS_P12_RES_FLT
          OpEventGetFaultDetectionCounter_GetFaultDetectionCounter_Event_PS_P12_RES_FLT: RteEventRef=OpEventGetFaultDetectionCounter_GetFaultDetectionCounter_Event_PS_P12_RES_FLT
          OpEventGetFaultDetectionCounter_GetFaultDetectionCounter_EvtInfo_INV_RSLVR_SIN_RNG_LO: RteEventRef=OpEventGetFaultDetectionCounter_GetFaultDetectionCounter_EvtInfo_INV_RSLVR_SIN_RNG_LO
          OpEventGetFaultDetectionCounter_GetFaultDetectionCounter_Event_INV_RSLVR_SIN_RNG_LO: RteEventRef=OpEventGetFaultDetectionCounter_GetFaultDetectionCounter_Event_INV_RSLVR_SIN_RNG_LO
          OpEventGetFaultDetectionCounter_GetFaultDetectionCounter_EvtInfo_CU_TEMP_HW_FLT: RteEventRef=OpEventGetFaultDetectionCounter_GetFaultDetectionCounter_EvtInfo_CU_TEMP_HW_FLT
          OpEventGetFaultDetectionCounter_GetFaultDetectionCounter_Event_CU_TEMP_HW_FLT: RteEventRef=OpEventGetFaultDetectionCounter_GetFaultDetectionCounter_Event_CU_TEMP_HW_FLT
          OpEventGetFaultDetectionCounter_GetFaultDetectionCounter_EvtInfo_VCEvEcmPropFr02MgmFr00Tioutd: RteEventRef=OpEventGetFaultDetectionCounter_GetFaultDetectionCounter_EvtInfo_VCEvEcmPropFr02MgmFr00Tioutd
          OpEventGetFaultDetectionCounter_GetFaultDetectionCounter_Event_VCEvEcmPropFr02MgmFr00Tioutd: RteEventRef=OpEventGetFaultDetectionCounter_GetFaultDetectionCounter_Event_VCEvEcmPropFr02MgmFr00Tioutd
          OpEventGetFaultDetectionCounter_GetFaultDetectionCounter_EvtInfo_PS_KL15_RNG_HI: RteEventRef=OpEventGetFaultDetectionCounter_GetFaultDetectionCounter_EvtInfo_PS_KL15_RNG_HI
          OpEventGetFaultDetectionCounter_GetFaultDetectionCounter_Event_PS_KL15_RNG_HI: RteEventRef=OpEventGetFaultDetectionCounter_GetFaultDetectionCounter_Event_PS_KL15_RNG_HI
          OpEventGetFaultDetectionCounter_GetFaultDetectionCounter_EvtInfo_VCEvVddmPropFr17Tioutd: RteEventRef=OpEventGetFaultDetectionCounter_GetFaultDetectionCounter_EvtInfo_VCEvVddmPropFr17Tioutd
          OpEventGetFaultDetectionCounter_GetFaultDetectionCounter_Event_VCEvVddmPropFr17Tioutd: RteEventRef=OpEventGetFaultDetectionCounter_GetFaultDetectionCounter_Event_VCEvVddmPropFr17Tioutd
          OpEventGetFaultDetectionCounter_GetFaultDetectionCounter_EvtInfo_VcEvChkSumCrashStsSafe: RteEventRef=OpEventGetFaultDetectionCounter_GetFaultDetectionCounter_EvtInfo_VcEvChkSumCrashStsSafe
          OpEventGetFaultDetectionCounter_GetFaultDetectionCounter_Event_VcEvChkSumCrashStsSafe: RteEventRef=OpEventGetFaultDetectionCounter_GetFaultDetectionCounter_Event_VcEvChkSumCrashStsSafe
          OpEventGetFaultDetectionCounter_GetFaultDetectionCounter_EvtInfo_DiagC_ClutchService: RteEventRef=OpEventGetFaultDetectionCounter_GetFaultDetectionCounter_EvtInfo_DiagC_ClutchService
          OpEventGetFaultDetectionCounter_GetFaultDetectionCounter_Event_DiagC_ClutchService: RteEventRef=OpEventGetFaultDetectionCounter_GetFaultDetectionCounter_Event_DiagC_ClutchService
          OpEventGetFaultDetectionCounter_GetFaultDetectionCounter_EvtInfo_INV_EM_STATOR_TEMP_RNG_HI: RteEventRef=OpEventGetFaultDetectionCounter_GetFaultDetectionCounter_EvtInfo_INV_EM_STATOR_TEMP_RNG_HI
          OpEventGetFaultDetectionCounter_GetFaultDetectionCounter_Event_INV_EM_STATOR_TEMP_RNG_HI: RteEventRef=OpEventGetFaultDetectionCounter_GetFaultDetectionCounter_Event_INV_EM_STATOR_TEMP_RNG_HI
          OpEventGetFaultDetectionCounter_GetFaultDetectionCounter_EvtInfo_INV_RSLVR_OFFS_OUT_RANG: RteEventRef=OpEventGetFaultDetectionCounter_GetFaultDetectionCounter_EvtInfo_INV_RSLVR_OFFS_OUT_RANG
          OpEventGetFaultDetectionCounter_GetFaultDetectionCounter_Event_INV_RSLVR_OFFS_OUT_RANG: RteEventRef=OpEventGetFaultDetectionCounter_GetFaultDetectionCounter_Event_INV_RSLVR_OFFS_OUT_RANG
          OpEventGetFaultDetectionCounter_GetFaultDetectionCounter_EvtInfo_INV_EM_STATOR_TEMP2_RNG_LO: RteEventRef=OpEventGetFaultDetectionCounter_GetFaultDetectionCounter_EvtInfo_INV_EM_STATOR_TEMP2_RNG_LO
          OpEventGetFaultDetectionCounter_GetFaultDetectionCounter_Event_INV_EM_STATOR_TEMP2_RNG_LO: RteEventRef=OpEventGetFaultDetectionCounter_GetFaultDetectionCounter_Event_INV_EM_STATOR_TEMP2_RNG_LO
          OpEventGetFaultDetectionCounter_GetFaultDetectionCounter_EvtInfo_VcEvMonISAR: RteEventRef=OpEventGetFaultDetectionCounter_GetFaultDetectionCounter_EvtInfo_VcEvMonISAR
          OpEventGetFaultDetectionCounter_GetFaultDetectionCounter_Event_VcEvMonISAR: RteEventRef=OpEventGetFaultDetectionCounter_GetFaultDetectionCounter_Event_VcEvMonISAR
          OpEventGetFaultDetectionCounter_GetFaultDetectionCounter_EvtInfo_GA_BLDC_FLT: RteEventRef=OpEventGetFaultDetectionCounter_GetFaultDetectionCounter_EvtInfo_GA_BLDC_FLT
          OpEventGetFaultDetectionCounter_GetFaultDetectionCounter_Event_GA_BLDC_FLT: RteEventRef=OpEventGetFaultDetectionCounter_GetFaultDetectionCounter_Event_GA_BLDC_FLT
          OpEventGetFaultDetectionCounter_GetFaultDetectionCounter_EvtInfo_INV_RSLVR_EXCT_ELEC_OPEN: RteEventRef=OpEventGetFaultDetectionCounter_GetFaultDetectionCounter_EvtInfo_INV_RSLVR_EXCT_ELEC_OPEN
          OpEventGetFaultDetectionCounter_GetFaultDetectionCounter_Event_INV_RSLVR_EXCT_ELEC_OPEN: RteEventRef=OpEventGetFaultDetectionCounter_GetFaultDetectionCounter_Event_INV_RSLVR_EXCT_ELEC_OPEN
          OpEventGetFaultDetectionCounter_GetFaultDetectionCounter_EvtInfo_INV_RSLVR_EXCT_PLAUS: RteEventRef=OpEventGetFaultDetectionCounter_GetFaultDetectionCounter_EvtInfo_INV_RSLVR_EXCT_PLAUS
          OpEventGetFaultDetectionCounter_GetFaultDetectionCounter_Event_INV_RSLVR_EXCT_PLAUS: RteEventRef=OpEventGetFaultDetectionCounter_GetFaultDetectionCounter_Event_INV_RSLVR_EXCT_PLAUS
          OpEventGetFaultDetectionCounter_GetFaultDetectionCounter_EvtInfo_PS_P15_U_FLT: RteEventRef=OpEventGetFaultDetectionCounter_GetFaultDetectionCounter_EvtInfo_PS_P15_U_FLT
          OpEventGetFaultDetectionCounter_GetFaultDetectionCounter_Event_PS_P15_U_FLT: RteEventRef=OpEventGetFaultDetectionCounter_GetFaultDetectionCounter_Event_PS_P15_U_FLT
          OpEventGetFaultDetectionCounter_GetFaultDetectionCounter_EvtInfo_INV_EM_STATOR_TEMP_RNG_SWT: RteEventRef=OpEventGetFaultDetectionCounter_GetFaultDetectionCounter_EvtInfo_INV_EM_STATOR_TEMP_RNG_SWT
          OpEventGetFaultDetectionCounter_GetFaultDetectionCounter_Event_INV_EM_STATOR_TEMP_RNG_SWT: RteEventRef=OpEventGetFaultDetectionCounter_GetFaultDetectionCounter_Event_INV_EM_STATOR_TEMP_RNG_SWT
          OpEventGetFaultDetectionCounter_GetFaultDetectionCounter_EvtInfo_INV_UHVDC_OV_SWP: RteEventRef=OpEventGetFaultDetectionCounter_GetFaultDetectionCounter_EvtInfo_INV_UHVDC_OV_SWP
          OpEventGetFaultDetectionCounter_GetFaultDetectionCounter_Event_INV_UHVDC_OV_SWP: RteEventRef=OpEventGetFaultDetectionCounter_GetFaultDetectionCounter_Event_INV_UHVDC_OV_SWP
          OpEventGetFaultDetectionCounter_GetFaultDetectionCounter_EvtInfo_AURIX_HW_FLT: RteEventRef=OpEventGetFaultDetectionCounter_GetFaultDetectionCounter_EvtInfo_AURIX_HW_FLT
          OpEventGetFaultDetectionCounter_GetFaultDetectionCounter_Event_AURIX_HW_FLT: RteEventRef=OpEventGetFaultDetectionCounter_GetFaultDetectionCounter_Event_AURIX_HW_FLT
          OpEventGetFaultDetectionCounter_GetFaultDetectionCounter_EvtInfo_INV_GATE_DRVR_TOP_HWP: RteEventRef=OpEventGetFaultDetectionCounter_GetFaultDetectionCounter_EvtInfo_INV_GATE_DRVR_TOP_HWP
          OpEventGetFaultDetectionCounter_GetFaultDetectionCounter_Event_INV_GATE_DRVR_TOP_HWP: RteEventRef=OpEventGetFaultDetectionCounter_GetFaultDetectionCounter_Event_INV_GATE_DRVR_TOP_HWP
          OpEventGetFaultDetectionCounter_GetFaultDetectionCounter_EvtInfo_INV_ACTV_DCHA_HW: RteEventRef=OpEventGetFaultDetectionCounter_GetFaultDetectionCounter_EvtInfo_INV_ACTV_DCHA_HW
          OpEventGetFaultDetectionCounter_GetFaultDetectionCounter_Event_INV_ACTV_DCHA_HW: RteEventRef=OpEventGetFaultDetectionCounter_GetFaultDetectionCounter_Event_INV_ACTV_DCHA_HW
          OpEventGetFaultDetectionCounter_GetFaultDetectionCounter_EvtInfo_INV_IGBT_TEMP_HWP: RteEventRef=OpEventGetFaultDetectionCounter_GetFaultDetectionCounter_EvtInfo_INV_IGBT_TEMP_HWP
          OpEventGetFaultDetectionCounter_GetFaultDetectionCounter_Event_INV_IGBT_TEMP_HWP: RteEventRef=OpEventGetFaultDetectionCounter_GetFaultDetectionCounter_Event_INV_IGBT_TEMP_HWP
          OpEventGetFaultDetectionCounter_GetFaultDetectionCounter_EvtInfo_INV_RSLVR_SIN_ELEC_FLT: RteEventRef=OpEventGetFaultDetectionCounter_GetFaultDetectionCounter_EvtInfo_INV_RSLVR_SIN_ELEC_FLT
          OpEventGetFaultDetectionCounter_GetFaultDetectionCounter_Event_INV_RSLVR_SIN_ELEC_FLT: RteEventRef=OpEventGetFaultDetectionCounter_GetFaultDetectionCounter_Event_INV_RSLVR_SIN_ELEC_FLT
          OpEventGetFaultDetectionCounter_GetFaultDetectionCounter_EvtInfo_CU_TEMP2_RNG_HI: RteEventRef=OpEventGetFaultDetectionCounter_GetFaultDetectionCounter_EvtInfo_CU_TEMP2_RNG_HI
          OpEventGetFaultDetectionCounter_GetFaultDetectionCounter_Event_CU_TEMP2_RNG_HI: RteEventRef=OpEventGetFaultDetectionCounter_GetFaultDetectionCounter_Event_CU_TEMP2_RNG_HI
          OpEventGetFaultDetectionCounter_GetFaultDetectionCounter_EvtInfo_INV_IAC_PHA_LOSS_MPL: RteEventRef=OpEventGetFaultDetectionCounter_GetFaultDetectionCounter_EvtInfo_INV_IAC_PHA_LOSS_MPL
          OpEventGetFaultDetectionCounter_GetFaultDetectionCounter_Event_INV_IAC_PHA_LOSS_MPL: RteEventRef=OpEventGetFaultDetectionCounter_GetFaultDetectionCounter_Event_INV_IAC_PHA_LOSS_MPL
          OpEventGetFaultDetectionCounter_GetFaultDetectionCounter_EvtInfo_INV_IAC_U_AMP: RteEventRef=OpEventGetFaultDetectionCounter_GetFaultDetectionCounter_EvtInfo_INV_IAC_U_AMP
          OpEventGetFaultDetectionCounter_GetFaultDetectionCounter_Event_INV_IAC_U_AMP: RteEventRef=OpEventGetFaultDetectionCounter_GetFaultDetectionCounter_Event_INV_IAC_U_AMP
          OpEventGetFaultDetectionCounter_GetFaultDetectionCounter_EvtInfo_PSnsr_GRADT_Flt: RteEventRef=OpEventGetFaultDetectionCounter_GetFaultDetectionCounter_EvtInfo_PSnsr_GRADT_Flt
          OpEventGetFaultDetectionCounter_GetFaultDetectionCounter_Event_PSnsr_GRADT_Flt: RteEventRef=OpEventGetFaultDetectionCounter_GetFaultDetectionCounter_Event_PSnsr_GRADT_Flt
          OpEventGetFaultDetectionCounter_GetFaultDetectionCounter_EvtInfo_AURIX_WATHDOG_FLT: RteEventRef=OpEventGetFaultDetectionCounter_GetFaultDetectionCounter_EvtInfo_AURIX_WATHDOG_FLT
          OpEventGetFaultDetectionCounter_GetFaultDetectionCounter_Event_AURIX_WATHDOG_FLT: RteEventRef=OpEventGetFaultDetectionCounter_GetFaultDetectionCounter_Event_AURIX_WATHDOG_FLT
          OpEventGetFaultDetectionCounter_GetFaultDetectionCounter_EvtInfo_VcEvNodeMisBECM: RteEventRef=OpEventGetFaultDetectionCounter_GetFaultDetectionCounter_EvtInfo_VcEvNodeMisBECM
          OpEventGetFaultDetectionCounter_GetFaultDetectionCounter_Event_VcEvNodeMisBECM: RteEventRef=OpEventGetFaultDetectionCounter_GetFaultDetectionCounter_Event_VcEvNodeMisBECM
          OpEventGetFaultDetectionCounter_GetFaultDetectionCounter_EvtInfo_INV_UHVDC_UV_HWP: RteEventRef=OpEventGetFaultDetectionCounter_GetFaultDetectionCounter_EvtInfo_INV_UHVDC_UV_HWP
          OpEventGetFaultDetectionCounter_GetFaultDetectionCounter_Event_INV_UHVDC_UV_HWP: RteEventRef=OpEventGetFaultDetectionCounter_GetFaultDetectionCounter_Event_INV_UHVDC_UV_HWP
          OpEventGetFaultDetectionCounter_GetFaultDetectionCounter_EvtInfo_VcEvMonESpd: RteEventRef=OpEventGetFaultDetectionCounter_GetFaultDetectionCounter_EvtInfo_VcEvMonESpd
          OpEventGetFaultDetectionCounter_GetFaultDetectionCounter_Event_VcEvMonESpd: RteEventRef=OpEventGetFaultDetectionCounter_GetFaultDetectionCounter_Event_VcEvMonESpd
          OpEventGetFaultDetectionCounter_GetFaultDetectionCounter_EvtInfo_COM_NotConfig: RteEventRef=OpEventGetFaultDetectionCounter_GetFaultDetectionCounter_EvtInfo_COM_NotConfig
          OpEventGetFaultDetectionCounter_GetFaultDetectionCounter_Event_COM_NotConfig: RteEventRef=OpEventGetFaultDetectionCounter_GetFaultDetectionCounter_Event_COM_NotConfig
          OpEventGetFaultDetectionCounter_GetFaultDetectionCounter_EvtInfo_INV_RSLVR_SIN_RNG_HI: RteEventRef=OpEventGetFaultDetectionCounter_GetFaultDetectionCounter_EvtInfo_INV_RSLVR_SIN_RNG_HI
          OpEventGetFaultDetectionCounter_GetFaultDetectionCounter_Event_INV_RSLVR_SIN_RNG_HI: RteEventRef=OpEventGetFaultDetectionCounter_GetFaultDetectionCounter_Event_INV_RSLVR_SIN_RNG_HI
          OpEventGetFaultDetectionCounter_GetFaultDetectionCounter_EvtInfo_INV_IGBT_TEMP_U_RNG_HI: RteEventRef=OpEventGetFaultDetectionCounter_GetFaultDetectionCounter_EvtInfo_INV_IGBT_TEMP_U_RNG_HI
          OpEventGetFaultDetectionCounter_GetFaultDetectionCounter_Event_INV_IGBT_TEMP_U_RNG_HI: RteEventRef=OpEventGetFaultDetectionCounter_GetFaultDetectionCounter_Event_INV_IGBT_TEMP_U_RNG_HI
          OpEventGetFaultDetectionCounter_GetFaultDetectionCounter_EvtInfo_VcEvMonMode_001: RteEventRef=OpEventGetFaultDetectionCounter_GetFaultDetectionCounter_EvtInfo_VcEvMonMode_001
          OpEventGetFaultDetectionCounter_GetFaultDetectionCounter_Event_VcEvMonMode_001: RteEventRef=OpEventGetFaultDetectionCounter_GetFaultDetectionCounter_Event_VcEvMonMode_001
          OpEventGetFaultDetectionCounter_GetFaultDetectionCounter_EvtInfo_PA_ACTION_FLT: RteEventRef=OpEventGetFaultDetectionCounter_GetFaultDetectionCounter_EvtInfo_PA_ACTION_FLT
          OpEventGetFaultDetectionCounter_GetFaultDetectionCounter_Event_PA_ACTION_FLT: RteEventRef=OpEventGetFaultDetectionCounter_GetFaultDetectionCounter_Event_PA_ACTION_FLT
          OpEventGetFaultDetectionCounter_GetFaultDetectionCounter_EvtInfo_INV_IAC_V_ELEC_HWP: RteEventRef=OpEventGetFaultDetectionCounter_GetFaultDetectionCounter_EvtInfo_INV_IAC_V_ELEC_HWP
          OpEventGetFaultDetectionCounter_GetFaultDetectionCounter_Event_INV_IAC_V_ELEC_HWP: RteEventRef=OpEventGetFaultDetectionCounter_GetFaultDetectionCounter_Event_INV_IAC_V_ELEC_HWP
          OpEventGetFaultDetectionCounter_GetFaultDetectionCounter_EvtInfo_CU_TEMP_HW_FLT_001: RteEventRef=OpEventGetFaultDetectionCounter_GetFaultDetectionCounter_EvtInfo_CU_TEMP_HW_FLT_001
          OpEventGetFaultDetectionCounter_GetFaultDetectionCounter_Event_CU_TEMP_HW_FLT_001: RteEventRef=OpEventGetFaultDetectionCounter_GetFaultDetectionCounter_Event_CU_TEMP_HW_FLT_001
          OpEventGetFaultDetectionCounter_GetFaultDetectionCounter_EvtInfo_VCC_UnderVoltage: RteEventRef=OpEventGetFaultDetectionCounter_GetFaultDetectionCounter_EvtInfo_VCC_UnderVoltage
          OpEventGetFaultDetectionCounter_GetFaultDetectionCounter_Event_VCC_UnderVoltage: RteEventRef=OpEventGetFaultDetectionCounter_GetFaultDetectionCounter_Event_VCC_UnderVoltage
          OpEventGetFaultDetectionCounter_GetFaultDetectionCounter_EvtInfo_VcEvTsttrPlaus: RteEventRef=OpEventGetFaultDetectionCounter_GetFaultDetectionCounter_EvtInfo_VcEvTsttrPlaus
          OpEventGetFaultDetectionCounter_GetFaultDetectionCounter_Event_VcEvTsttrPlaus: RteEventRef=OpEventGetFaultDetectionCounter_GetFaultDetectionCounter_Event_VcEvTsttrPlaus
          OpEventGetFaultDetectionCounter_GetFaultDetectionCounter_EvtInfo_INV_RSLVR_EXCT_ELEC_FLT: RteEventRef=OpEventGetFaultDetectionCounter_GetFaultDetectionCounter_EvtInfo_INV_RSLVR_EXCT_ELEC_FLT
          OpEventGetFaultDetectionCounter_GetFaultDetectionCounter_Event_INV_RSLVR_EXCT_ELEC_FLT: RteEventRef=OpEventGetFaultDetectionCounter_GetFaultDetectionCounter_Event_INV_RSLVR_EXCT_ELEC_FLT
          OpEventGetFaultDetectionCounter_GetFaultDetectionCounter_EvtInfo_INV_RSLVR_EXCT_RNG_LO: RteEventRef=OpEventGetFaultDetectionCounter_GetFaultDetectionCounter_EvtInfo_INV_RSLVR_EXCT_RNG_LO
          OpEventGetFaultDetectionCounter_GetFaultDetectionCounter_Event_INV_RSLVR_EXCT_RNG_LO: RteEventRef=OpEventGetFaultDetectionCounter_GetFaultDetectionCounter_Event_INV_RSLVR_EXCT_RNG_LO
          OpEventGetFaultDetectionCounter_GetFaultDetectionCounter_EvtInfo_INV_EM_STATOR_TEMP2_RNG_HI: RteEventRef=OpEventGetFaultDetectionCounter_GetFaultDetectionCounter_EvtInfo_INV_EM_STATOR_TEMP2_RNG_HI
          OpEventGetFaultDetectionCounter_GetFaultDetectionCounter_Event_INV_EM_STATOR_TEMP2_RNG_HI: RteEventRef=OpEventGetFaultDetectionCounter_GetFaultDetectionCounter_Event_INV_EM_STATOR_TEMP2_RNG_HI
          OpEventGetFaultDetectionCounter_GetFaultDetectionCounter_EvtInfo_INV_SHUT_OFF_PAH_START_UP: RteEventRef=OpEventGetFaultDetectionCounter_GetFaultDetectionCounter_EvtInfo_INV_SHUT_OFF_PAH_START_UP
          OpEventGetFaultDetectionCounter_GetFaultDetectionCounter_Event_INV_SHUT_OFF_PAH_START_UP: RteEventRef=OpEventGetFaultDetectionCounter_GetFaultDetectionCounter_Event_INV_SHUT_OFF_PAH_START_UP
          OpEventGetFaultDetectionCounter_GetFaultDetectionCounter_EvtInfo_VCEvVddmPropFr08Tioutd: RteEventRef=OpEventGetFaultDetectionCounter_GetFaultDetectionCounter_EvtInfo_VCEvVddmPropFr08Tioutd
          OpEventGetFaultDetectionCounter_GetFaultDetectionCounter_Event_VCEvVddmPropFr08Tioutd: RteEventRef=OpEventGetFaultDetectionCounter_GetFaultDetectionCounter_Event_VCEvVddmPropFr08Tioutd
          OpEventGetFaultDetectionCounter_GetFaultDetectionCounter_EvtInfo_INV_RSLVR_EXCT_OC_HWP_001: RteEventRef=OpEventGetFaultDetectionCounter_GetFaultDetectionCounter_EvtInfo_INV_RSLVR_EXCT_OC_HWP_001
          OpEventGetFaultDetectionCounter_GetFaultDetectionCounter_Event_INV_RSLVR_EXCT_OC_HWP_001: RteEventRef=OpEventGetFaultDetectionCounter_GetFaultDetectionCounter_Event_INV_RSLVR_EXCT_OC_HWP_001
          OpEventGetFaultDetectionCounter_GetFaultDetectionCounter_EvtInfo_INV_RSLVR_EXCT_OC_HWP_002: RteEventRef=OpEventGetFaultDetectionCounter_GetFaultDetectionCounter_EvtInfo_INV_RSLVR_EXCT_OC_HWP_002
          OpEventGetFaultDetectionCounter_GetFaultDetectionCounter_Event_INV_RSLVR_EXCT_OC_HWP_002: RteEventRef=OpEventGetFaultDetectionCounter_GetFaultDetectionCounter_Event_INV_RSLVR_EXCT_OC_HWP_002
          OpEventGetFaultDetectionCounter_GetFaultDetectionCounter_EvtInfo_INV_EM_STATOR_TEMP_ELE_FLT: RteEventRef=OpEventGetFaultDetectionCounter_GetFaultDetectionCounter_EvtInfo_INV_EM_STATOR_TEMP_ELE_FLT
          OpEventGetFaultDetectionCounter_GetFaultDetectionCounter_Event_INV_EM_STATOR_TEMP_ELE_FLT: RteEventRef=OpEventGetFaultDetectionCounter_GetFaultDetectionCounter_Event_INV_EM_STATOR_TEMP_ELE_FLT
          OpEventGetFaultDetectionCounter_GetFaultDetectionCounter_EvtInfo_INV_INTERLOCK_FLT: RteEventRef=OpEventGetFaultDetectionCounter_GetFaultDetectionCounter_EvtInfo_INV_INTERLOCK_FLT
          OpEventGetFaultDetectionCounter_GetFaultDetectionCounter_Event_INV_INTERLOCK_FLT: RteEventRef=OpEventGetFaultDetectionCounter_GetFaultDetectionCounter_Event_INV_INTERLOCK_FLT
          OpEventGetFaultDetectionCounter_GetFaultDetectionCounter_EvtInfo_Ga_ZeroFindDistanFailure: RteEventRef=OpEventGetFaultDetectionCounter_GetFaultDetectionCounter_EvtInfo_Ga_ZeroFindDistanFailure
          OpEventGetFaultDetectionCounter_GetFaultDetectionCounter_Event_Ga_ZeroFindDistanFailure: RteEventRef=OpEventGetFaultDetectionCounter_GetFaultDetectionCounter_Event_Ga_ZeroFindDistanFailure
          OpEventGetFaultDetectionCounter_GetFaultDetectionCounter_EvtInfo_PLOCK_Current_RNG_OUT: RteEventRef=OpEventGetFaultDetectionCounter_GetFaultDetectionCounter_EvtInfo_PLOCK_Current_RNG_OUT
          OpEventGetFaultDetectionCounter_GetFaultDetectionCounter_Event_PLOCK_Current_RNG_OUT: RteEventRef=OpEventGetFaultDetectionCounter_GetFaultDetectionCounter_Event_PLOCK_Current_RNG_OUT
          OpEventGetFaultDetectionCounter_GetFaultDetectionCounter_EvtInfo_VCEvVddmPropFr05Tioutd: RteEventRef=OpEventGetFaultDetectionCounter_GetFaultDetectionCounter_EvtInfo_VCEvVddmPropFr05Tioutd
          OpEventGetFaultDetectionCounter_GetFaultDetectionCounter_Event_VCEvVddmPropFr05Tioutd: RteEventRef=OpEventGetFaultDetectionCounter_GetFaultDetectionCounter_Event_VCEvVddmPropFr05Tioutd
          OpEventGetFaultDetectionCounter_GetFaultDetectionCounter_EvtInfo_INV_IGBT_TEMP_V_GRDT: RteEventRef=OpEventGetFaultDetectionCounter_GetFaultDetectionCounter_EvtInfo_INV_IGBT_TEMP_V_GRDT
          OpEventGetFaultDetectionCounter_GetFaultDetectionCounter_Event_INV_IGBT_TEMP_V_GRDT: RteEventRef=OpEventGetFaultDetectionCounter_GetFaultDetectionCounter_Event_INV_IGBT_TEMP_V_GRDT
          OpEventGetFaultDetectionCounter_GetFaultDetectionCounter_EvtInfo_PS_5V_Fault: RteEventRef=OpEventGetFaultDetectionCounter_GetFaultDetectionCounter_EvtInfo_PS_5V_Fault
          OpEventGetFaultDetectionCounter_GetFaultDetectionCounter_Event_PS_5V_Fault: RteEventRef=OpEventGetFaultDetectionCounter_GetFaultDetectionCounter_Event_PS_5V_Fault
          OpEventGetFaultDetectionCounter_GetFaultDetectionCounter_EvtInfo_VcEvCntrCrashStsSafe: RteEventRef=OpEventGetFaultDetectionCounter_GetFaultDetectionCounter_EvtInfo_VcEvCntrCrashStsSafe
          OpEventGetFaultDetectionCounter_GetFaultDetectionCounter_Event_VcEvCntrCrashStsSafe: RteEventRef=OpEventGetFaultDetectionCounter_GetFaultDetectionCounter_Event_VcEvCntrCrashStsSafe
          OpEventGetFaultDetectionCounter_GetFaultDetectionCounter_EvtInfo_INV_EM_STATOR_TEMP_GRDT: RteEventRef=OpEventGetFaultDetectionCounter_GetFaultDetectionCounter_EvtInfo_INV_EM_STATOR_TEMP_GRDT
          OpEventGetFaultDetectionCounter_GetFaultDetectionCounter_Event_INV_EM_STATOR_TEMP_GRDT: RteEventRef=OpEventGetFaultDetectionCounter_GetFaultDetectionCounter_Event_INV_EM_STATOR_TEMP_GRDT
          OpEventGetFaultDetectionCounter_GetFaultDetectionCounter_EvtInfo_PS_P15_V_FLT: RteEventRef=OpEventGetFaultDetectionCounter_GetFaultDetectionCounter_EvtInfo_PS_P15_V_FLT
          OpEventGetFaultDetectionCounter_GetFaultDetectionCounter_Event_PS_P15_V_FLT: RteEventRef=OpEventGetFaultDetectionCounter_GetFaultDetectionCounter_Event_PS_P15_V_FLT
          OpEventGetFaultDetectionCounter_GetFaultDetectionCounter_EvtInfo_INV_EM_STATOR_TEMP_RNG_NOK: RteEventRef=OpEventGetFaultDetectionCounter_GetFaultDetectionCounter_EvtInfo_INV_EM_STATOR_TEMP_RNG_NOK
          OpEventGetFaultDetectionCounter_GetFaultDetectionCounter_Event_INV_EM_STATOR_TEMP_RNG_NOK: RteEventRef=OpEventGetFaultDetectionCounter_GetFaultDetectionCounter_Event_INV_EM_STATOR_TEMP_RNG_NOK
          OpEventGetFaultDetectionCounter_GetFaultDetectionCounter_EvtInfo_INV_RSLVR_SIN_RNG_NOK: RteEventRef=OpEventGetFaultDetectionCounter_GetFaultDetectionCounter_EvtInfo_INV_RSLVR_SIN_RNG_NOK
          OpEventGetFaultDetectionCounter_GetFaultDetectionCounter_Event_INV_RSLVR_SIN_RNG_NOK: RteEventRef=OpEventGetFaultDetectionCounter_GetFaultDetectionCounter_Event_INV_RSLVR_SIN_RNG_NOK
          OpEventGetFaultDetectionCounter_GetFaultDetectionCounter_EvtInfo_INV_IAC_U_OFFS: RteEventRef=OpEventGetFaultDetectionCounter_GetFaultDetectionCounter_EvtInfo_INV_IAC_U_OFFS
          OpEventGetFaultDetectionCounter_GetFaultDetectionCounter_Event_INV_IAC_U_OFFS: RteEventRef=OpEventGetFaultDetectionCounter_GetFaultDetectionCounter_Event_INV_IAC_U_OFFS
          OpEventGetFaultDetectionCounter_GetFaultDetectionCounter_EvtInfo_PS_KL30_BACKUP_FLT: RteEventRef=OpEventGetFaultDetectionCounter_GetFaultDetectionCounter_EvtInfo_PS_KL30_BACKUP_FLT
          OpEventGetFaultDetectionCounter_GetFaultDetectionCounter_Event_PS_KL30_BACKUP_FLT: RteEventRef=OpEventGetFaultDetectionCounter_GetFaultDetectionCounter_Event_PS_KL30_BACKUP_FLT
          OpEventGetFaultDetectionCounter_GetFaultDetectionCounter_EvtInfo_INV_IGBT_TEMP_U_RNG_LO: RteEventRef=OpEventGetFaultDetectionCounter_GetFaultDetectionCounter_EvtInfo_INV_IGBT_TEMP_U_RNG_LO
          OpEventGetFaultDetectionCounter_GetFaultDetectionCounter_Event_INV_IGBT_TEMP_U_RNG_LO: RteEventRef=OpEventGetFaultDetectionCounter_GetFaultDetectionCounter_Event_INV_IGBT_TEMP_U_RNG_LO
          OpEventGetFaultDetectionCounter_GetFaultDetectionCounter_EvtInfo_INV_EM_STATOR_TEMP_HWP: RteEventRef=OpEventGetFaultDetectionCounter_GetFaultDetectionCounter_EvtInfo_INV_EM_STATOR_TEMP_HWP
          OpEventGetFaultDetectionCounter_GetFaultDetectionCounter_Event_INV_EM_STATOR_TEMP_HWP: RteEventRef=OpEventGetFaultDetectionCounter_GetFaultDetectionCounter_Event_INV_EM_STATOR_TEMP_HWP
          OpEventGetFaultDetectionCounter_GetFaultDetectionCounter_EvtInfo_CU_TEMP1_RNG_HI: RteEventRef=OpEventGetFaultDetectionCounter_GetFaultDetectionCounter_EvtInfo_CU_TEMP1_RNG_HI
          OpEventGetFaultDetectionCounter_GetFaultDetectionCounter_Event_CU_TEMP1_RNG_HI: RteEventRef=OpEventGetFaultDetectionCounter_GetFaultDetectionCounter_Event_CU_TEMP1_RNG_HI
          OpEventGetFaultDetectionCounter_GetFaultDetectionCounter_EvtInfo_INV_IGBT_TEMP_V_RNG_HI: RteEventRef=OpEventGetFaultDetectionCounter_GetFaultDetectionCounter_EvtInfo_INV_IGBT_TEMP_V_RNG_HI
          OpEventGetFaultDetectionCounter_GetFaultDetectionCounter_Event_INV_IGBT_TEMP_V_RNG_HI: RteEventRef=OpEventGetFaultDetectionCounter_GetFaultDetectionCounter_Event_INV_IGBT_TEMP_V_RNG_HI
          OpEventGetFaultDetectionCounter_GetFaultDetectionCounter_EvtInfo_VcEvNodeMisVDDM: RteEventRef=OpEventGetFaultDetectionCounter_GetFaultDetectionCounter_EvtInfo_VcEvNodeMisVDDM
          OpEventGetFaultDetectionCounter_GetFaultDetectionCounter_Event_VcEvNodeMisVDDM: RteEventRef=OpEventGetFaultDetectionCounter_GetFaultDetectionCounter_Event_VcEvNodeMisVDDM
          OpEventGetFaultDetectionCounter_GetFaultDetectionCounter_EvtInfo_INV_UHVDC_PLAUS: RteEventRef=OpEventGetFaultDetectionCounter_GetFaultDetectionCounter_EvtInfo_INV_UHVDC_PLAUS
          OpEventGetFaultDetectionCounter_GetFaultDetectionCounter_Event_INV_UHVDC_PLAUS: RteEventRef=OpEventGetFaultDetectionCounter_GetFaultDetectionCounter_Event_INV_UHVDC_PLAUS
          OpEventGetFaultDetectionCounter_GetFaultDetectionCounter_EvtInfo_INV_QUIESCENT_FLT: RteEventRef=OpEventGetFaultDetectionCounter_GetFaultDetectionCounter_EvtInfo_INV_QUIESCENT_FLT
          OpEventGetFaultDetectionCounter_GetFaultDetectionCounter_Event_INV_QUIESCENT_FLT: RteEventRef=OpEventGetFaultDetectionCounter_GetFaultDetectionCounter_Event_INV_QUIESCENT_FLT
          OpEventGetFaultDetectionCounter_GetFaultDetectionCounter_EvtInfo_INV_RSLVR_EXCT_RNG_HI: RteEventRef=OpEventGetFaultDetectionCounter_GetFaultDetectionCounter_EvtInfo_INV_RSLVR_EXCT_RNG_HI
          OpEventGetFaultDetectionCounter_GetFaultDetectionCounter_Event_INV_RSLVR_EXCT_RNG_HI: RteEventRef=OpEventGetFaultDetectionCounter_GetFaultDetectionCounter_Event_INV_RSLVR_EXCT_RNG_HI
          OpEventGetFaultDetectionCounter_GetFaultDetectionCounter_GeneralEvtInfo: RteEventRef=OpEventGetFaultDetectionCounter_GetFaultDetectionCounter_GeneralEvtInfo
          OpEventGetEventFreezeFrameDataEx_GetEventFreezeFrameDataEx_EvtInfo_VCEvBecmPropFr01Tioutd: RteEventRef=OpEventGetEventFreezeFrameDataEx_GetEventFreezeFrameDataEx_EvtInfo_VCEvBecmPropFr01Tioutd
          OpEventGetEventFreezeFrameDataEx_GetEventFreezeFrameDataEx_Event_VCEvBecmPropFr01Tioutd: RteEventRef=OpEventGetEventFreezeFrameDataEx_GetEventFreezeFrameDataEx_Event_VCEvBecmPropFr01Tioutd
          OpEventGetEventFreezeFrameDataEx_GetEventFreezeFrameDataEx_EvtInfo_INV_CU_TEMP2_RNG_NOK: RteEventRef=OpEventGetEventFreezeFrameDataEx_GetEventFreezeFrameDataEx_EvtInfo_INV_CU_TEMP2_RNG_NOK
          OpEventGetEventFreezeFrameDataEx_GetEventFreezeFrameDataEx_Event_INV_CU_TEMP2_RNG_NOK: RteEventRef=OpEventGetEventFreezeFrameDataEx_GetEventFreezeFrameDataEx_Event_INV_CU_TEMP2_RNG_NOK
          OpEventGetEventFreezeFrameDataEx_GetEventFreezeFrameDataEx_EvtInfo_COM_Busoff: RteEventRef=OpEventGetEventFreezeFrameDataEx_GetEventFreezeFrameDataEx_EvtInfo_COM_Busoff
          OpEventGetEventFreezeFrameDataEx_GetEventFreezeFrameDataEx_Event_COM_Busoff: RteEventRef=OpEventGetEventFreezeFrameDataEx_GetEventFreezeFrameDataEx_Event_COM_Busoff
          OpEventGetEventFreezeFrameDataEx_GetEventFreezeFrameDataEx_EvtInfo_INV_IMMO_NOKEY: RteEventRef=OpEventGetEventFreezeFrameDataEx_GetEventFreezeFrameDataEx_EvtInfo_INV_IMMO_NOKEY
          OpEventGetEventFreezeFrameDataEx_GetEventFreezeFrameDataEx_Event_INV_IMMO_NOKEY: RteEventRef=OpEventGetEventFreezeFrameDataEx_GetEventFreezeFrameDataEx_Event_INV_IMMO_NOKEY
          OpEventGetEventFreezeFrameDataEx_GetEventFreezeFrameDataEx_EvtInfo_INV_RSLVR_EXCT_OC_HWP: RteEventRef=OpEventGetEventFreezeFrameDataEx_GetEventFreezeFrameDataEx_EvtInfo_INV_RSLVR_EXCT_OC_HWP
          OpEventGetEventFreezeFrameDataEx_GetEventFreezeFrameDataEx_Event_INV_RSLVR_EXCT_OC_HWP: RteEventRef=OpEventGetEventFreezeFrameDataEx_GetEventFreezeFrameDataEx_Event_INV_RSLVR_EXCT_OC_HWP
          OpEventGetEventFreezeFrameDataEx_GetEventFreezeFrameDataEx_EvtInfo_PS_P15_W_FLT: RteEventRef=OpEventGetEventFreezeFrameDataEx_GetEventFreezeFrameDataEx_EvtInfo_PS_P15_W_FLT
          OpEventGetEventFreezeFrameDataEx_GetEventFreezeFrameDataEx_Event_PS_P15_W_FLT: RteEventRef=OpEventGetEventFreezeFrameDataEx_GetEventFreezeFrameDataEx_Event_PS_P15_W_FLT
          OpEventGetEventFreezeFrameDataEx_GetEventFreezeFrameDataEx_EvtInfo_INV_IAC_PLAUS_SUM: RteEventRef=OpEventGetEventFreezeFrameDataEx_GetEventFreezeFrameDataEx_EvtInfo_INV_IAC_PLAUS_SUM
          OpEventGetEventFreezeFrameDataEx_GetEventFreezeFrameDataEx_Event_INV_IAC_PLAUS_SUM: RteEventRef=OpEventGetEventFreezeFrameDataEx_GetEventFreezeFrameDataEx_Event_INV_IAC_PLAUS_SUM
          OpEventGetEventFreezeFrameDataEx_GetEventFreezeFrameDataEx_EvtInfo_PA_ELE_FLT: RteEventRef=OpEventGetEventFreezeFrameDataEx_GetEventFreezeFrameDataEx_EvtInfo_PA_ELE_FLT
          OpEventGetEventFreezeFrameDataEx_GetEventFreezeFrameDataEx_Event_PA_ELE_FLT: RteEventRef=OpEventGetEventFreezeFrameDataEx_GetEventFreezeFrameDataEx_Event_PA_ELE_FLT
          OpEventGetEventFreezeFrameDataEx_GetEventFreezeFrameDataEx_EvtInfo_CU_TEMP_GRDT: RteEventRef=OpEventGetEventFreezeFrameDataEx_GetEventFreezeFrameDataEx_EvtInfo_CU_TEMP_GRDT
          OpEventGetEventFreezeFrameDataEx_GetEventFreezeFrameDataEx_Event_CU_TEMP_GRDT: RteEventRef=OpEventGetEventFreezeFrameDataEx_GetEventFreezeFrameDataEx_Event_CU_TEMP_GRDT
          OpEventGetEventFreezeFrameDataEx_GetEventFreezeFrameDataEx_EvtInfo_INV_IGBT_TEMP_V_PLAUS: RteEventRef=OpEventGetEventFreezeFrameDataEx_GetEventFreezeFrameDataEx_EvtInfo_INV_IGBT_TEMP_V_PLAUS
          OpEventGetEventFreezeFrameDataEx_GetEventFreezeFrameDataEx_Event_INV_IGBT_TEMP_V_PLAUS: RteEventRef=OpEventGetEventFreezeFrameDataEx_GetEventFreezeFrameDataEx_Event_INV_IGBT_TEMP_V_PLAUS
          OpEventGetEventFreezeFrameDataEx_GetEventFreezeFrameDataEx_EvtInfo_Ga_GAEngageFailure: RteEventRef=OpEventGetEventFreezeFrameDataEx_GetEventFreezeFrameDataEx_EvtInfo_Ga_GAEngageFailure
          OpEventGetEventFreezeFrameDataEx_GetEventFreezeFrameDataEx_Event_Ga_GAEngageFailure: RteEventRef=OpEventGetEventFreezeFrameDataEx_GetEventFreezeFrameDataEx_Event_Ga_GAEngageFailure
          OpEventGetEventFreezeFrameDataEx_GetEventFreezeFrameDataEx_EvtInfo_INV_IAC_W_RNG_LO: RteEventRef=OpEventGetEventFreezeFrameDataEx_GetEventFreezeFrameDataEx_EvtInfo_INV_IAC_W_RNG_LO
          OpEventGetEventFreezeFrameDataEx_GetEventFreezeFrameDataEx_Event_INV_IAC_W_RNG_LO: RteEventRef=OpEventGetEventFreezeFrameDataEx_GetEventFreezeFrameDataEx_Event_INV_IAC_W_RNG_LO
          OpEventGetEventFreezeFrameDataEx_GetEventFreezeFrameDataEx_EvtInfo_PS_WhlSnsr_Vltg_FLT: RteEventRef=OpEventGetEventFreezeFrameDataEx_GetEventFreezeFrameDataEx_EvtInfo_PS_WhlSnsr_Vltg_FLT
          OpEventGetEventFreezeFrameDataEx_GetEventFreezeFrameDataEx_Event_PS_WhlSnsr_Vltg_FLT: RteEventRef=OpEventGetEventFreezeFrameDataEx_GetEventFreezeFrameDataEx_Event_PS_WhlSnsr_Vltg_FLT
          OpEventGetEventFreezeFrameDataEx_GetEventFreezeFrameDataEx_EvtInfo_VCEvEcmPropFr02Tioutd: RteEventRef=OpEventGetEventFreezeFrameDataEx_GetEventFreezeFrameDataEx_EvtInfo_VCEvEcmPropFr02Tioutd
          OpEventGetEventFreezeFrameDataEx_GetEventFreezeFrameDataEx_Event_VCEvEcmPropFr02Tioutd: RteEventRef=OpEventGetEventFreezeFrameDataEx_GetEventFreezeFrameDataEx_Event_VCEvEcmPropFr02Tioutd
          OpEventGetEventFreezeFrameDataEx_GetEventFreezeFrameDataEx_EvtInfo_Ga_TmSpdSyncFailed: RteEventRef=OpEventGetEventFreezeFrameDataEx_GetEventFreezeFrameDataEx_EvtInfo_Ga_TmSpdSyncFailed
          OpEventGetEventFreezeFrameDataEx_GetEventFreezeFrameDataEx_Event_Ga_TmSpdSyncFailed: RteEventRef=OpEventGetEventFreezeFrameDataEx_GetEventFreezeFrameDataEx_Event_Ga_TmSpdSyncFailed
          OpEventGetEventFreezeFrameDataEx_GetEventFreezeFrameDataEx_EvtInfo_INV_RSLVR_EXCT_ELEC_LO: RteEventRef=OpEventGetEventFreezeFrameDataEx_GetEventFreezeFrameDataEx_EvtInfo_INV_RSLVR_EXCT_ELEC_LO
          OpEventGetEventFreezeFrameDataEx_GetEventFreezeFrameDataEx_Event_INV_RSLVR_EXCT_ELEC_LO: RteEventRef=OpEventGetEventFreezeFrameDataEx_GetEventFreezeFrameDataEx_Event_INV_RSLVR_EXCT_ELEC_LO
          OpEventGetEventFreezeFrameDataEx_GetEventFreezeFrameDataEx_EvtInfo_VCEvEcmPropXevFr06Tioutd: RteEventRef=OpEventGetEventFreezeFrameDataEx_GetEventFreezeFrameDataEx_EvtInfo_VCEvEcmPropXevFr06Tioutd
          OpEventGetEventFreezeFrameDataEx_GetEventFreezeFrameDataEx_Event_VCEvEcmPropXevFr06Tioutd: RteEventRef=OpEventGetEventFreezeFrameDataEx_GetEventFreezeFrameDataEx_Event_VCEvEcmPropXevFr06Tioutd
          OpEventGetEventFreezeFrameDataEx_GetEventFreezeFrameDataEx_EvtInfo_VcEvCntrWhlMotSysTqAllwd: RteEventRef=OpEventGetEventFreezeFrameDataEx_GetEventFreezeFrameDataEx_EvtInfo_VcEvCntrWhlMotSysTqAllwd
          OpEventGetEventFreezeFrameDataEx_GetEventFreezeFrameDataEx_Event_VcEvCntrWhlMotSysTqAllwd: RteEventRef=OpEventGetEventFreezeFrameDataEx_GetEventFreezeFrameDataEx_Event_VcEvCntrWhlMotSysTqAllwd
          OpEventGetEventFreezeFrameDataEx_GetEventFreezeFrameDataEx_EvtInfo_INV_UHVDC_1_ELEC_HI: RteEventRef=OpEventGetEventFreezeFrameDataEx_GetEventFreezeFrameDataEx_EvtInfo_INV_UHVDC_1_ELEC_HI
          OpEventGetEventFreezeFrameDataEx_GetEventFreezeFrameDataEx_Event_INV_UHVDC_1_ELEC_HI: RteEventRef=OpEventGetEventFreezeFrameDataEx_GetEventFreezeFrameDataEx_Event_INV_UHVDC_1_ELEC_HI
          OpEventGetEventFreezeFrameDataEx_GetEventFreezeFrameDataEx_EvtInfo_INV_EM_STATOR_TEMP2_ELE_FLT: RteEventRef=OpEventGetEventFreezeFrameDataEx_GetEventFreezeFrameDataEx_EvtInfo_INV_EM_STATOR_TEMP2_ELE_FLT
          OpEventGetEventFreezeFrameDataEx_GetEventFreezeFrameDataEx_Event_INV_EM_STATOR_TEMP2_ELE_FLT: RteEventRef=OpEventGetEventFreezeFrameDataEx_GetEventFreezeFrameDataEx_Event_INV_EM_STATOR_TEMP2_ELE_FLT
          OpEventGetEventFreezeFrameDataEx_GetEventFreezeFrameDataEx_EvtInfo_AURIX_RST_SNG: RteEventRef=OpEventGetEventFreezeFrameDataEx_GetEventFreezeFrameDataEx_EvtInfo_AURIX_RST_SNG
          OpEventGetEventFreezeFrameDataEx_GetEventFreezeFrameDataEx_Event_AURIX_RST_SNG: RteEventRef=OpEventGetEventFreezeFrameDataEx_GetEventFreezeFrameDataEx_Event_AURIX_RST_SNG
          OpEventGetEventFreezeFrameDataEx_GetEventFreezeFrameDataEx_EvtInfo_VCEvEcmPropFr24MgmFr01Tioutd: RteEventRef=OpEventGetEventFreezeFrameDataEx_GetEventFreezeFrameDataEx_EvtInfo_VCEvEcmPropFr24MgmFr01Tioutd
          OpEventGetEventFreezeFrameDataEx_GetEventFreezeFrameDataEx_Event_VCEvEcmPropFr24MgmFr01Tioutd: RteEventRef=OpEventGetEventFreezeFrameDataEx_GetEventFreezeFrameDataEx_Event_VCEvEcmPropFr24MgmFr01Tioutd
          OpEventGetEventFreezeFrameDataEx_GetEventFreezeFrameDataEx_EvtInfo_INV_RSLVR_COS_ELEC_OPEN: RteEventRef=OpEventGetEventFreezeFrameDataEx_GetEventFreezeFrameDataEx_EvtInfo_INV_RSLVR_COS_ELEC_OPEN
          OpEventGetEventFreezeFrameDataEx_GetEventFreezeFrameDataEx_Event_INV_RSLVR_COS_ELEC_OPEN: RteEventRef=OpEventGetEventFreezeFrameDataEx_GetEventFreezeFrameDataEx_Event_INV_RSLVR_COS_ELEC_OPEN
          OpEventGetEventFreezeFrameDataEx_GetEventFreezeFrameDataEx_EvtInfo_INV_IAC_V_ELEC_LO: RteEventRef=OpEventGetEventFreezeFrameDataEx_GetEventFreezeFrameDataEx_EvtInfo_INV_IAC_V_ELEC_LO
          OpEventGetEventFreezeFrameDataEx_GetEventFreezeFrameDataEx_Event_INV_IAC_V_ELEC_LO: RteEventRef=OpEventGetEventFreezeFrameDataEx_GetEventFreezeFrameDataEx_Event_INV_IAC_V_ELEC_LO
          OpEventGetEventFreezeFrameDataEx_GetEventFreezeFrameDataEx_EvtInfo_INV_IAC_W_OFFS: RteEventRef=OpEventGetEventFreezeFrameDataEx_GetEventFreezeFrameDataEx_EvtInfo_INV_IAC_W_OFFS
          OpEventGetEventFreezeFrameDataEx_GetEventFreezeFrameDataEx_Event_INV_IAC_W_OFFS: RteEventRef=OpEventGetEventFreezeFrameDataEx_GetEventFreezeFrameDataEx_Event_INV_IAC_W_OFFS
          OpEventGetEventFreezeFrameDataEx_GetEventFreezeFrameDataEx_EvtInfo_INV_EM_STATOR_TEMP2_GRDT: RteEventRef=OpEventGetEventFreezeFrameDataEx_GetEventFreezeFrameDataEx_EvtInfo_INV_EM_STATOR_TEMP2_GRDT
          OpEventGetEventFreezeFrameDataEx_GetEventFreezeFrameDataEx_Event_INV_EM_STATOR_TEMP2_GRDT: RteEventRef=OpEventGetEventFreezeFrameDataEx_GetEventFreezeFrameDataEx_Event_INV_EM_STATOR_TEMP2_GRDT
          OpEventGetEventFreezeFrameDataEx_GetEventFreezeFrameDataEx_EvtInfo_INV_EM_OVRSPD_HWP: RteEventRef=OpEventGetEventFreezeFrameDataEx_GetEventFreezeFrameDataEx_EvtInfo_INV_EM_OVRSPD_HWP
          OpEventGetEventFreezeFrameDataEx_GetEventFreezeFrameDataEx_Event_INV_EM_OVRSPD_HWP: RteEventRef=OpEventGetEventFreezeFrameDataEx_GetEventFreezeFrameDataEx_Event_INV_EM_OVRSPD_HWP
          OpEventGetEventFreezeFrameDataEx_GetEventFreezeFrameDataEx_EvtInfo_CU_TEMP_HWP: RteEventRef=OpEventGetEventFreezeFrameDataEx_GetEventFreezeFrameDataEx_EvtInfo_CU_TEMP_HWP
          OpEventGetEventFreezeFrameDataEx_GetEventFreezeFrameDataEx_Event_CU_TEMP_HWP: RteEventRef=OpEventGetEventFreezeFrameDataEx_GetEventFreezeFrameDataEx_Event_CU_TEMP_HWP
          OpEventGetEventFreezeFrameDataEx_GetEventFreezeFrameDataEx_EvtInfo_INV_UHVDC_1_RNG_HI: RteEventRef=OpEventGetEventFreezeFrameDataEx_GetEventFreezeFrameDataEx_EvtInfo_INV_UHVDC_1_RNG_HI
          OpEventGetEventFreezeFrameDataEx_GetEventFreezeFrameDataEx_Event_INV_UHVDC_1_RNG_HI: RteEventRef=OpEventGetEventFreezeFrameDataEx_GetEventFreezeFrameDataEx_Event_INV_UHVDC_1_RNG_HI
          OpEventGetEventFreezeFrameDataEx_GetEventFreezeFrameDataEx_EvtInfo_VcEvEMPerfPlaus: RteEventRef=OpEventGetEventFreezeFrameDataEx_GetEventFreezeFrameDataEx_EvtInfo_VcEvEMPerfPlaus
          OpEventGetEventFreezeFrameDataEx_GetEventFreezeFrameDataEx_Event_VcEvEMPerfPlaus: RteEventRef=OpEventGetEventFreezeFrameDataEx_GetEventFreezeFrameDataEx_Event_VcEvEMPerfPlaus
          OpEventGetEventFreezeFrameDataEx_GetEventFreezeFrameDataEx_EvtInfo_VCEvVddmPropFr18Tioutd: RteEventRef=OpEventGetEventFreezeFrameDataEx_GetEventFreezeFrameDataEx_EvtInfo_VCEvVddmPropFr18Tioutd
          OpEventGetEventFreezeFrameDataEx_GetEventFreezeFrameDataEx_Event_VCEvVddmPropFr18Tioutd: RteEventRef=OpEventGetEventFreezeFrameDataEx_GetEventFreezeFrameDataEx_Event_VCEvVddmPropFr18Tioutd
          OpEventGetEventFreezeFrameDataEx_GetEventFreezeFrameDataEx_EvtInfo_INV_IAC_U_ELEC_HWP: RteEventRef=OpEventGetEventFreezeFrameDataEx_GetEventFreezeFrameDataEx_EvtInfo_INV_IAC_U_ELEC_HWP
          OpEventGetEventFreezeFrameDataEx_GetEventFreezeFrameDataEx_Event_INV_IAC_U_ELEC_HWP: RteEventRef=OpEventGetEventFreezeFrameDataEx_GetEventFreezeFrameDataEx_Event_INV_IAC_U_ELEC_HWP
          OpEventGetEventFreezeFrameDataEx_GetEventFreezeFrameDataEx_EvtInfo_VCEvVddmPropFr15Tioutd: RteEventRef=OpEventGetEventFreezeFrameDataEx_GetEventFreezeFrameDataEx_EvtInfo_VCEvVddmPropFr15Tioutd
          OpEventGetEventFreezeFrameDataEx_GetEventFreezeFrameDataEx_Event_VCEvVddmPropFr15Tioutd: RteEventRef=OpEventGetEventFreezeFrameDataEx_GetEventFreezeFrameDataEx_Event_VCEvVddmPropFr15Tioutd
          OpEventGetEventFreezeFrameDataEx_GetEventFreezeFrameDataEx_EvtInfo_Ga_GADisengageFailure: RteEventRef=OpEventGetEventFreezeFrameDataEx_GetEventFreezeFrameDataEx_EvtInfo_Ga_GADisengageFailure
          OpEventGetEventFreezeFrameDataEx_GetEventFreezeFrameDataEx_Event_Ga_GADisengageFailure: RteEventRef=OpEventGetEventFreezeFrameDataEx_GetEventFreezeFrameDataEx_Event_Ga_GADisengageFailure
          OpEventGetEventFreezeFrameDataEx_GetEventFreezeFrameDataEx_EvtInfo_CU_TEMP2_RNG_LO: RteEventRef=OpEventGetEventFreezeFrameDataEx_GetEventFreezeFrameDataEx_EvtInfo_CU_TEMP2_RNG_LO
          OpEventGetEventFreezeFrameDataEx_GetEventFreezeFrameDataEx_Event_CU_TEMP2_RNG_LO: RteEventRef=OpEventGetEventFreezeFrameDataEx_GetEventFreezeFrameDataEx_Event_CU_TEMP2_RNG_LO
          OpEventGetEventFreezeFrameDataEx_GetEventFreezeFrameDataEx_EvtInfo_INV_RSLVR_SIN_ELEC_OPEN: RteEventRef=OpEventGetEventFreezeFrameDataEx_GetEventFreezeFrameDataEx_EvtInfo_INV_RSLVR_SIN_ELEC_OPEN
          OpEventGetEventFreezeFrameDataEx_GetEventFreezeFrameDataEx_Event_INV_RSLVR_SIN_ELEC_OPEN: RteEventRef=OpEventGetEventFreezeFrameDataEx_GetEventFreezeFrameDataEx_Event_INV_RSLVR_SIN_ELEC_OPEN
          OpEventGetEventFreezeFrameDataEx_GetEventFreezeFrameDataEx_EvtInfo_VcEvChkSum: RteEventRef=OpEventGetEventFreezeFrameDataEx_GetEventFreezeFrameDataEx_EvtInfo_VcEvChkSum
          OpEventGetEventFreezeFrameDataEx_GetEventFreezeFrameDataEx_Event_VcEvChkSum: RteEventRef=OpEventGetEventFreezeFrameDataEx_GetEventFreezeFrameDataEx_Event_VcEvChkSum
          OpEventGetEventFreezeFrameDataEx_GetEventFreezeFrameDataEx_EvtInfo_PS_P5_UC_FLT: RteEventRef=OpEventGetEventFreezeFrameDataEx_GetEventFreezeFrameDataEx_EvtInfo_PS_P5_UC_FLT
          OpEventGetEventFreezeFrameDataEx_GetEventFreezeFrameDataEx_Event_PS_P5_UC_FLT: RteEventRef=OpEventGetEventFreezeFrameDataEx_GetEventFreezeFrameDataEx_Event_PS_P5_UC_FLT
          OpEventGetEventFreezeFrameDataEx_GetEventFreezeFrameDataEx_EvtInfo_INV_RSLVR_COS_ELEC_FLT: RteEventRef=OpEventGetEventFreezeFrameDataEx_GetEventFreezeFrameDataEx_EvtInfo_INV_RSLVR_COS_ELEC_FLT
          OpEventGetEventFreezeFrameDataEx_GetEventFreezeFrameDataEx_Event_INV_RSLVR_COS_ELEC_FLT: RteEventRef=OpEventGetEventFreezeFrameDataEx_GetEventFreezeFrameDataEx_Event_INV_RSLVR_COS_ELEC_FLT
          OpEventGetEventFreezeFrameDataEx_GetEventFreezeFrameDataEx_EvtInfo_INV_IAC_W_RNG_HI: RteEventRef=OpEventGetEventFreezeFrameDataEx_GetEventFreezeFrameDataEx_EvtInfo_INV_IAC_W_RNG_HI
          OpEventGetEventFreezeFrameDataEx_GetEventFreezeFrameDataEx_Event_INV_IAC_W_RNG_HI: RteEventRef=OpEventGetEventFreezeFrameDataEx_GetEventFreezeFrameDataEx_Event_INV_IAC_W_RNG_HI
          OpEventGetEventFreezeFrameDataEx_GetEventFreezeFrameDataEx_EvtInfo_PS_ECUSUPPLY_HIGH: RteEventRef=OpEventGetEventFreezeFrameDataEx_GetEventFreezeFrameDataEx_EvtInfo_PS_ECUSUPPLY_HIGH
          OpEventGetEventFreezeFrameDataEx_GetEventFreezeFrameDataEx_Event_PS_ECUSUPPLY_HIGH: RteEventRef=OpEventGetEventFreezeFrameDataEx_GetEventFreezeFrameDataEx_Event_PS_ECUSUPPLY_HIGH
          OpEventGetEventFreezeFrameDataEx_GetEventFreezeFrameDataEx_EvtInfo_VCEvEcmPropFr05Tioutd: RteEventRef=OpEventGetEventFreezeFrameDataEx_GetEventFreezeFrameDataEx_EvtInfo_VCEvEcmPropFr05Tioutd
          OpEventGetEventFreezeFrameDataEx_GetEventFreezeFrameDataEx_Event_VCEvEcmPropFr05Tioutd: RteEventRef=OpEventGetEventFreezeFrameDataEx_GetEventFreezeFrameDataEx_Event_VCEvEcmPropFr05Tioutd
          OpEventGetEventFreezeFrameDataEx_GetEventFreezeFrameDataEx_EvtInfo_PS_ECUSUPPLY_LOW: RteEventRef=OpEventGetEventFreezeFrameDataEx_GetEventFreezeFrameDataEx_EvtInfo_PS_ECUSUPPLY_LOW
          OpEventGetEventFreezeFrameDataEx_GetEventFreezeFrameDataEx_Event_PS_ECUSUPPLY_LOW: RteEventRef=OpEventGetEventFreezeFrameDataEx_GetEventFreezeFrameDataEx_Event_PS_ECUSUPPLY_LOW
          OpEventGetEventFreezeFrameDataEx_GetEventFreezeFrameDataEx_EvtInfo_VcEvChkSumHvSysRlySts: RteEventRef=OpEventGetEventFreezeFrameDataEx_GetEventFreezeFrameDataEx_EvtInfo_VcEvChkSumHvSysRlySts
          OpEventGetEventFreezeFrameDataEx_GetEventFreezeFrameDataEx_Event_VcEvChkSumHvSysRlySts: RteEventRef=OpEventGetEventFreezeFrameDataEx_GetEventFreezeFrameDataEx_Event_VcEvChkSumHvSysRlySts
          OpEventGetEventFreezeFrameDataEx_GetEventFreezeFrameDataEx_EvtInfo_VcEvMonMode: RteEventRef=OpEventGetEventFreezeFrameDataEx_GetEventFreezeFrameDataEx_EvtInfo_VcEvMonMode
          OpEventGetEventFreezeFrameDataEx_GetEventFreezeFrameDataEx_Event_VcEvMonMode: RteEventRef=OpEventGetEventFreezeFrameDataEx_GetEventFreezeFrameDataEx_Event_VcEvMonMode
          OpEventGetEventFreezeFrameDataEx_GetEventFreezeFrameDataEx_EvtInfo_INV_IAC_OC_SWP: RteEventRef=OpEventGetEventFreezeFrameDataEx_GetEventFreezeFrameDataEx_EvtInfo_INV_IAC_OC_SWP
          OpEventGetEventFreezeFrameDataEx_GetEventFreezeFrameDataEx_Event_INV_IAC_OC_SWP: RteEventRef=OpEventGetEventFreezeFrameDataEx_GetEventFreezeFrameDataEx_Event_INV_IAC_OC_SWP
          OpEventGetEventFreezeFrameDataEx_GetEventFreezeFrameDataEx_EvtInfo_INV_IMMO_AUTHFAIL: RteEventRef=OpEventGetEventFreezeFrameDataEx_GetEventFreezeFrameDataEx_EvtInfo_INV_IMMO_AUTHFAIL
          OpEventGetEventFreezeFrameDataEx_GetEventFreezeFrameDataEx_Event_INV_IMMO_AUTHFAIL: RteEventRef=OpEventGetEventFreezeFrameDataEx_GetEventFreezeFrameDataEx_Event_INV_IMMO_AUTHFAIL
          OpEventGetEventFreezeFrameDataEx_GetEventFreezeFrameDataEx_EvtInfo_PA_OpenCirc_FLT: RteEventRef=OpEventGetEventFreezeFrameDataEx_GetEventFreezeFrameDataEx_EvtInfo_PA_OpenCirc_FLT
          OpEventGetEventFreezeFrameDataEx_GetEventFreezeFrameDataEx_Event_PA_OpenCirc_FLT: RteEventRef=OpEventGetEventFreezeFrameDataEx_GetEventFreezeFrameDataEx_Event_PA_OpenCirc_FLT
          OpEventGetEventFreezeFrameDataEx_GetEventFreezeFrameDataEx_EvtInfo_INV_IAC_V_ELEC_HI: RteEventRef=OpEventGetEventFreezeFrameDataEx_GetEventFreezeFrameDataEx_EvtInfo_INV_IAC_V_ELEC_HI
          OpEventGetEventFreezeFrameDataEx_GetEventFreezeFrameDataEx_Event_INV_IAC_V_ELEC_HI: RteEventRef=OpEventGetEventFreezeFrameDataEx_GetEventFreezeFrameDataEx_Event_INV_IAC_V_ELEC_HI
          OpEventGetEventFreezeFrameDataEx_GetEventFreezeFrameDataEx_EvtInfo_VCEvEcmPropFr04Tioutd: RteEventRef=OpEventGetEventFreezeFrameDataEx_GetEventFreezeFrameDataEx_EvtInfo_VCEvEcmPropFr04Tioutd
          OpEventGetEventFreezeFrameDataEx_GetEventFreezeFrameDataEx_Event_VCEvEcmPropFr04Tioutd: RteEventRef=OpEventGetEventFreezeFrameDataEx_GetEventFreezeFrameDataEx_Event_VCEvEcmPropFr04Tioutd
          OpEventGetEventFreezeFrameDataEx_GetEventFreezeFrameDataEx_EvtInfo_VcEvMonTrqActPlaus: RteEventRef=OpEventGetEventFreezeFrameDataEx_GetEventFreezeFrameDataEx_EvtInfo_VcEvMonTrqActPlaus
          OpEventGetEventFreezeFrameDataEx_GetEventFreezeFrameDataEx_Event_VcEvMonTrqActPlaus: RteEventRef=OpEventGetEventFreezeFrameDataEx_GetEventFreezeFrameDataEx_Event_VcEvMonTrqActPlaus
          OpEventGetEventFreezeFrameDataEx_GetEventFreezeFrameDataEx_EvtInfo_VcEvMonTrqAct: RteEventRef=OpEventGetEventFreezeFrameDataEx_GetEventFreezeFrameDataEx_EvtInfo_VcEvMonTrqAct
          OpEventGetEventFreezeFrameDataEx_GetEventFreezeFrameDataEx_Event_VcEvMonTrqAct: RteEventRef=OpEventGetEventFreezeFrameDataEx_GetEventFreezeFrameDataEx_Event_VcEvMonTrqAct
          OpEventGetEventFreezeFrameDataEx_GetEventFreezeFrameDataEx_EvtInfo_INV_RSLVR_COS_ELEC_LO: RteEventRef=OpEventGetEventFreezeFrameDataEx_GetEventFreezeFrameDataEx_EvtInfo_INV_RSLVR_COS_ELEC_LO
          OpEventGetEventFreezeFrameDataEx_GetEventFreezeFrameDataEx_Event_INV_RSLVR_COS_ELEC_LO: RteEventRef=OpEventGetEventFreezeFrameDataEx_GetEventFreezeFrameDataEx_Event_INV_RSLVR_COS_ELEC_LO
          OpEventGetEventFreezeFrameDataEx_GetEventFreezeFrameDataEx_EvtInfo_INV_COOLT_INLET_TEMP_HWP: RteEventRef=OpEventGetEventFreezeFrameDataEx_GetEventFreezeFrameDataEx_EvtInfo_INV_COOLT_INLET_TEMP_HWP
          OpEventGetEventFreezeFrameDataEx_GetEventFreezeFrameDataEx_Event_INV_COOLT_INLET_TEMP_HWP: RteEventRef=OpEventGetEventFreezeFrameDataEx_GetEventFreezeFrameDataEx_Event_INV_COOLT_INLET_TEMP_HWP
          OpEventGetEventFreezeFrameDataEx_GetEventFreezeFrameDataEx_EvtInfo_VCEvEcmPropFr11Tioutd: RteEventRef=OpEventGetEventFreezeFrameDataEx_GetEventFreezeFrameDataEx_EvtInfo_VCEvEcmPropFr11Tioutd
          OpEventGetEventFreezeFrameDataEx_GetEventFreezeFrameDataEx_Event_VCEvEcmPropFr11Tioutd: RteEventRef=OpEventGetEventFreezeFrameDataEx_GetEventFreezeFrameDataEx_Event_VCEvEcmPropFr11Tioutd
          OpEventGetEventFreezeFrameDataEx_GetEventFreezeFrameDataEx_EvtInfo_PS_KL30_RNG_HI: RteEventRef=OpEventGetEventFreezeFrameDataEx_GetEventFreezeFrameDataEx_EvtInfo_PS_KL30_RNG_HI
          OpEventGetEventFreezeFrameDataEx_GetEventFreezeFrameDataEx_Event_PS_KL30_RNG_HI: RteEventRef=OpEventGetEventFreezeFrameDataEx_GetEventFreezeFrameDataEx_Event_PS_KL30_RNG_HI
          OpEventGetEventFreezeFrameDataEx_GetEventFreezeFrameDataEx_EvtInfo_INV_IAC_OC_HWP: RteEventRef=OpEventGetEventFreezeFrameDataEx_GetEventFreezeFrameDataEx_EvtInfo_INV_IAC_OC_HWP
          OpEventGetEventFreezeFrameDataEx_GetEventFreezeFrameDataEx_Event_INV_IAC_OC_HWP: RteEventRef=OpEventGetEventFreezeFrameDataEx_GetEventFreezeFrameDataEx_Event_INV_IAC_OC_HWP
          OpEventGetEventFreezeFrameDataEx_GetEventFreezeFrameDataEx_EvtInfo_INV_RSLVR_COS_RNG_HI: RteEventRef=OpEventGetEventFreezeFrameDataEx_GetEventFreezeFrameDataEx_EvtInfo_INV_RSLVR_COS_RNG_HI
          OpEventGetEventFreezeFrameDataEx_GetEventFreezeFrameDataEx_Event_INV_RSLVR_COS_RNG_HI: RteEventRef=OpEventGetEventFreezeFrameDataEx_GetEventFreezeFrameDataEx_Event_INV_RSLVR_COS_RNG_HI
          OpEventGetEventFreezeFrameDataEx_GetEventFreezeFrameDataEx_EvtInfo_INV_IAC_U_ELEC_HI: RteEventRef=OpEventGetEventFreezeFrameDataEx_GetEventFreezeFrameDataEx_EvtInfo_INV_IAC_U_ELEC_HI
          OpEventGetEventFreezeFrameDataEx_GetEventFreezeFrameDataEx_Event_INV_IAC_U_ELEC_HI: RteEventRef=OpEventGetEventFreezeFrameDataEx_GetEventFreezeFrameDataEx_Event_INV_IAC_U_ELEC_HI
          OpEventGetEventFreezeFrameDataEx_GetEventFreezeFrameDataEx_EvtInfo_INV_IAC_V_RNG_LO: RteEventRef=OpEventGetEventFreezeFrameDataEx_GetEventFreezeFrameDataEx_EvtInfo_INV_IAC_V_RNG_LO
          OpEventGetEventFreezeFrameDataEx_GetEventFreezeFrameDataEx_Event_INV_IAC_V_RNG_LO: RteEventRef=OpEventGetEventFreezeFrameDataEx_GetEventFreezeFrameDataEx_Event_INV_IAC_V_RNG_LO
          OpEventGetEventFreezeFrameDataEx_GetEventFreezeFrameDataEx_EvtInfo_INV_IAC_U_RNG_HI: RteEventRef=OpEventGetEventFreezeFrameDataEx_GetEventFreezeFrameDataEx_EvtInfo_INV_IAC_U_RNG_HI
          OpEventGetEventFreezeFrameDataEx_GetEventFreezeFrameDataEx_Event_INV_IAC_U_RNG_HI: RteEventRef=OpEventGetEventFreezeFrameDataEx_GetEventFreezeFrameDataEx_Event_INV_IAC_U_RNG_HI
          OpEventGetEventFreezeFrameDataEx_GetEventFreezeFrameDataEx_EvtInfo_VCEvEcmPropFr25Tioutd: RteEventRef=OpEventGetEventFreezeFrameDataEx_GetEventFreezeFrameDataEx_EvtInfo_VCEvEcmPropFr25Tioutd
          OpEventGetEventFreezeFrameDataEx_GetEventFreezeFrameDataEx_Event_VCEvEcmPropFr25Tioutd: RteEventRef=OpEventGetEventFreezeFrameDataEx_GetEventFreezeFrameDataEx_Event_VCEvEcmPropFr25Tioutd
          OpEventGetEventFreezeFrameDataEx_GetEventFreezeFrameDataEx_EvtInfo_INV_IGBT_TEMP_W_RNG_LO: RteEventRef=OpEventGetEventFreezeFrameDataEx_GetEventFreezeFrameDataEx_EvtInfo_INV_IGBT_TEMP_W_RNG_LO
          OpEventGetEventFreezeFrameDataEx_GetEventFreezeFrameDataEx_Event_INV_IGBT_TEMP_W_RNG_LO: RteEventRef=OpEventGetEventFreezeFrameDataEx_GetEventFreezeFrameDataEx_Event_INV_IGBT_TEMP_W_RNG_LO
          OpEventGetEventFreezeFrameDataEx_GetEventFreezeFrameDataEx_EvtInfo_PSnsr_RNG_NOK: RteEventRef=OpEventGetEventFreezeFrameDataEx_GetEventFreezeFrameDataEx_EvtInfo_PSnsr_RNG_NOK
          OpEventGetEventFreezeFrameDataEx_GetEventFreezeFrameDataEx_Event_PSnsr_RNG_NOK: RteEventRef=OpEventGetEventFreezeFrameDataEx_GetEventFreezeFrameDataEx_Event_PSnsr_RNG_NOK
          OpEventGetEventFreezeFrameDataEx_GetEventFreezeFrameDataEx_EvtInfo_INV_RSLVR_COS_RNG_NOK: RteEventRef=OpEventGetEventFreezeFrameDataEx_GetEventFreezeFrameDataEx_EvtInfo_INV_RSLVR_COS_RNG_NOK
          OpEventGetEventFreezeFrameDataEx_GetEventFreezeFrameDataEx_Event_INV_RSLVR_COS_RNG_NOK: RteEventRef=OpEventGetEventFreezeFrameDataEx_GetEventFreezeFrameDataEx_Event_INV_RSLVR_COS_RNG_NOK
          OpEventGetEventFreezeFrameDataEx_GetEventFreezeFrameDataEx_EvtInfo_PS_DRVB_Fault: RteEventRef=OpEventGetEventFreezeFrameDataEx_GetEventFreezeFrameDataEx_EvtInfo_PS_DRVB_Fault
          OpEventGetEventFreezeFrameDataEx_GetEventFreezeFrameDataEx_Event_PS_DRVB_Fault: RteEventRef=OpEventGetEventFreezeFrameDataEx_GetEventFreezeFrameDataEx_Event_PS_DRVB_Fault
          OpEventGetEventFreezeFrameDataEx_GetEventFreezeFrameDataEx_EvtInfo_INV_CU_TEMP1_RNG_NOK: RteEventRef=OpEventGetEventFreezeFrameDataEx_GetEventFreezeFrameDataEx_EvtInfo_INV_CU_TEMP1_RNG_NOK
          OpEventGetEventFreezeFrameDataEx_GetEventFreezeFrameDataEx_Event_INV_CU_TEMP1_RNG_NOK: RteEventRef=OpEventGetEventFreezeFrameDataEx_GetEventFreezeFrameDataEx_Event_INV_CU_TEMP1_RNG_NOK
          OpEventGetEventFreezeFrameDataEx_GetEventFreezeFrameDataEx_EvtInfo_VcEvCntr: RteEventRef=OpEventGetEventFreezeFrameDataEx_GetEventFreezeFrameDataEx_EvtInfo_VcEvCntr
          OpEventGetEventFreezeFrameDataEx_GetEventFreezeFrameDataEx_Event_VcEvCntr: RteEventRef=OpEventGetEventFreezeFrameDataEx_GetEventFreezeFrameDataEx_Event_VcEvCntr
          OpEventGetEventFreezeFrameDataEx_GetEventFreezeFrameDataEx_EvtInfo_INV_RSLVR_SIN_AMP: RteEventRef=OpEventGetEventFreezeFrameDataEx_GetEventFreezeFrameDataEx_EvtInfo_INV_RSLVR_SIN_AMP
          OpEventGetEventFreezeFrameDataEx_GetEventFreezeFrameDataEx_Event_INV_RSLVR_SIN_AMP: RteEventRef=OpEventGetEventFreezeFrameDataEx_GetEventFreezeFrameDataEx_Event_INV_RSLVR_SIN_AMP
          OpEventGetEventFreezeFrameDataEx_GetEventFreezeFrameDataEx_EvtInfo_INV_UHVDC_2_RNG_HI: RteEventRef=OpEventGetEventFreezeFrameDataEx_GetEventFreezeFrameDataEx_EvtInfo_INV_UHVDC_2_RNG_HI
          OpEventGetEventFreezeFrameDataEx_GetEventFreezeFrameDataEx_Event_INV_UHVDC_2_RNG_HI: RteEventRef=OpEventGetEventFreezeFrameDataEx_GetEventFreezeFrameDataEx_Event_INV_UHVDC_2_RNG_HI
          OpEventGetEventFreezeFrameDataEx_GetEventFreezeFrameDataEx_EvtInfo_INV_IGBT_TEMP_U_GRDT: RteEventRef=OpEventGetEventFreezeFrameDataEx_GetEventFreezeFrameDataEx_EvtInfo_INV_IGBT_TEMP_U_GRDT
          OpEventGetEventFreezeFrameDataEx_GetEventFreezeFrameDataEx_Event_INV_IGBT_TEMP_U_GRDT: RteEventRef=OpEventGetEventFreezeFrameDataEx_GetEventFreezeFrameDataEx_Event_INV_IGBT_TEMP_U_GRDT
          OpEventGetEventFreezeFrameDataEx_GetEventFreezeFrameDataEx_EvtInfo_MON_TQ_PLAUS_PWR_MDL: RteEventRef=OpEventGetEventFreezeFrameDataEx_GetEventFreezeFrameDataEx_EvtInfo_MON_TQ_PLAUS_PWR_MDL
          OpEventGetEventFreezeFrameDataEx_GetEventFreezeFrameDataEx_Event_MON_TQ_PLAUS_PWR_MDL: RteEventRef=OpEventGetEventFreezeFrameDataEx_GetEventFreezeFrameDataEx_Event_MON_TQ_PLAUS_PWR_MDL
          OpEventGetEventFreezeFrameDataEx_GetEventFreezeFrameDataEx_EvtInfo_INV_IGBT_TEMP_W_PLAUS: RteEventRef=OpEventGetEventFreezeFrameDataEx_GetEventFreezeFrameDataEx_EvtInfo_INV_IGBT_TEMP_W_PLAUS
          OpEventGetEventFreezeFrameDataEx_GetEventFreezeFrameDataEx_Event_INV_IGBT_TEMP_W_PLAUS: RteEventRef=OpEventGetEventFreezeFrameDataEx_GetEventFreezeFrameDataEx_Event_INV_IGBT_TEMP_W_PLAUS
          OpEventGetEventFreezeFrameDataEx_GetEventFreezeFrameDataEx_EvtInfo_PS_BLDC_UV_FLT: RteEventRef=OpEventGetEventFreezeFrameDataEx_GetEventFreezeFrameDataEx_EvtInfo_PS_BLDC_UV_FLT
          OpEventGetEventFreezeFrameDataEx_GetEventFreezeFrameDataEx_Event_PS_BLDC_UV_FLT: RteEventRef=OpEventGetEventFreezeFrameDataEx_GetEventFreezeFrameDataEx_Event_PS_BLDC_UV_FLT
          OpEventGetEventFreezeFrameDataEx_GetEventFreezeFrameDataEx_EvtInfo_INV_IAC_V_OFFS: RteEventRef=OpEventGetEventFreezeFrameDataEx_GetEventFreezeFrameDataEx_EvtInfo_INV_IAC_V_OFFS
          OpEventGetEventFreezeFrameDataEx_GetEventFreezeFrameDataEx_Event_INV_IAC_V_OFFS: RteEventRef=OpEventGetEventFreezeFrameDataEx_GetEventFreezeFrameDataEx_Event_INV_IAC_V_OFFS
          OpEventGetEventFreezeFrameDataEx_GetEventFreezeFrameDataEx_EvtInfo_INV_RSLVR_EXCT_FREQ_RNG_NOK: RteEventRef=OpEventGetEventFreezeFrameDataEx_GetEventFreezeFrameDataEx_EvtInfo_INV_RSLVR_EXCT_FREQ_RNG_NOK
          OpEventGetEventFreezeFrameDataEx_GetEventFreezeFrameDataEx_Event_INV_RSLVR_EXCT_FREQ_RNG_NOK: RteEventRef=OpEventGetEventFreezeFrameDataEx_GetEventFreezeFrameDataEx_Event_INV_RSLVR_EXCT_FREQ_RNG_NOK
          OpEventGetEventFreezeFrameDataEx_GetEventFreezeFrameDataEx_EvtInfo_PS_KL30_RNG_LO: RteEventRef=OpEventGetEventFreezeFrameDataEx_GetEventFreezeFrameDataEx_EvtInfo_PS_KL30_RNG_LO
          OpEventGetEventFreezeFrameDataEx_GetEventFreezeFrameDataEx_Event_PS_KL30_RNG_LO: RteEventRef=OpEventGetEventFreezeFrameDataEx_GetEventFreezeFrameDataEx_Event_PS_KL30_RNG_LO
          OpEventGetEventFreezeFrameDataEx_GetEventFreezeFrameDataEx_EvtInfo_INV_RSLVR_COS_RNG_LO: RteEventRef=OpEventGetEventFreezeFrameDataEx_GetEventFreezeFrameDataEx_EvtInfo_INV_RSLVR_COS_RNG_LO
          OpEventGetEventFreezeFrameDataEx_GetEventFreezeFrameDataEx_Event_INV_RSLVR_COS_RNG_LO: RteEventRef=OpEventGetEventFreezeFrameDataEx_GetEventFreezeFrameDataEx_Event_INV_RSLVR_COS_RNG_LO
          OpEventGetEventFreezeFrameDataEx_GetEventFreezeFrameDataEx_EvtInfo_PSnsr_ELE_FLT: RteEventRef=OpEventGetEventFreezeFrameDataEx_GetEventFreezeFrameDataEx_EvtInfo_PSnsr_ELE_FLT
          OpEventGetEventFreezeFrameDataEx_GetEventFreezeFrameDataEx_Event_PSnsr_ELE_FLT: RteEventRef=OpEventGetEventFreezeFrameDataEx_GetEventFreezeFrameDataEx_Event_PSnsr_ELE_FLT
          OpEventGetEventFreezeFrameDataEx_GetEventFreezeFrameDataEx_EvtInfo_INV_RSLVR_SIN_COS_PLAUS_AMP: RteEventRef=OpEventGetEventFreezeFrameDataEx_GetEventFreezeFrameDataEx_EvtInfo_INV_RSLVR_SIN_COS_PLAUS_AMP
          OpEventGetEventFreezeFrameDataEx_GetEventFreezeFrameDataEx_Event_INV_RSLVR_SIN_COS_PLAUS_AMP: RteEventRef=OpEventGetEventFreezeFrameDataEx_GetEventFreezeFrameDataEx_Event_INV_RSLVR_SIN_COS_PLAUS_AMP
          OpEventGetEventFreezeFrameDataEx_GetEventFreezeFrameDataEx_EvtInfo_INV_IAC_U_ELEC_LO: RteEventRef=OpEventGetEventFreezeFrameDataEx_GetEventFreezeFrameDataEx_EvtInfo_INV_IAC_U_ELEC_LO
          OpEventGetEventFreezeFrameDataEx_GetEventFreezeFrameDataEx_Event_INV_IAC_U_ELEC_LO: RteEventRef=OpEventGetEventFreezeFrameDataEx_GetEventFreezeFrameDataEx_Event_INV_IAC_U_ELEC_LO
          OpEventGetEventFreezeFrameDataEx_GetEventFreezeFrameDataEx_EvtInfo_INV_RSLVR_EXCT_ELEC_HI: RteEventRef=OpEventGetEventFreezeFrameDataEx_GetEventFreezeFrameDataEx_EvtInfo_INV_RSLVR_EXCT_ELEC_HI
          OpEventGetEventFreezeFrameDataEx_GetEventFreezeFrameDataEx_Event_INV_RSLVR_EXCT_ELEC_HI: RteEventRef=OpEventGetEventFreezeFrameDataEx_GetEventFreezeFrameDataEx_Event_INV_RSLVR_EXCT_ELEC_HI
          OpEventGetEventFreezeFrameDataEx_GetEventFreezeFrameDataEx_EvtInfo_INV_IAC_U_RNG_LO: RteEventRef=OpEventGetEventFreezeFrameDataEx_GetEventFreezeFrameDataEx_EvtInfo_INV_IAC_U_RNG_LO
          OpEventGetEventFreezeFrameDataEx_GetEventFreezeFrameDataEx_Event_INV_IAC_U_RNG_LO: RteEventRef=OpEventGetEventFreezeFrameDataEx_GetEventFreezeFrameDataEx_Event_INV_IAC_U_RNG_LO
          OpEventGetEventFreezeFrameDataEx_GetEventFreezeFrameDataEx_EvtInfo_INV_IAC_V_RNG_HI: RteEventRef=OpEventGetEventFreezeFrameDataEx_GetEventFreezeFrameDataEx_EvtInfo_INV_IAC_V_RNG_HI
          OpEventGetEventFreezeFrameDataEx_GetEventFreezeFrameDataEx_Event_INV_IAC_V_RNG_HI: RteEventRef=OpEventGetEventFreezeFrameDataEx_GetEventFreezeFrameDataEx_Event_INV_IAC_V_RNG_HI
          OpEventGetEventFreezeFrameDataEx_GetEventFreezeFrameDataEx_EvtInfo_INV_IGBT_TEMP_U_PLAUS: RteEventRef=OpEventGetEventFreezeFrameDataEx_GetEventFreezeFrameDataEx_EvtInfo_INV_IGBT_TEMP_U_PLAUS
          OpEventGetEventFreezeFrameDataEx_GetEventFreezeFrameDataEx_Event_INV_IGBT_TEMP_U_PLAUS: RteEventRef=OpEventGetEventFreezeFrameDataEx_GetEventFreezeFrameDataEx_Event_INV_IGBT_TEMP_U_PLAUS
          OpEventGetEventFreezeFrameDataEx_GetEventFreezeFrameDataEx_EvtInfo_INV_RSLVR_OFFS_DFT: RteEventRef=OpEventGetEventFreezeFrameDataEx_GetEventFreezeFrameDataEx_EvtInfo_INV_RSLVR_OFFS_DFT
          OpEventGetEventFreezeFrameDataEx_GetEventFreezeFrameDataEx_Event_INV_RSLVR_OFFS_DFT: RteEventRef=OpEventGetEventFreezeFrameDataEx_GetEventFreezeFrameDataEx_Event_INV_RSLVR_OFFS_DFT
          OpEventGetEventFreezeFrameDataEx_GetEventFreezeFrameDataEx_EvtInfo_Ga_MoveOverThd: RteEventRef=OpEventGetEventFreezeFrameDataEx_GetEventFreezeFrameDataEx_EvtInfo_Ga_MoveOverThd
          OpEventGetEventFreezeFrameDataEx_GetEventFreezeFrameDataEx_Event_Ga_MoveOverThd: RteEventRef=OpEventGetEventFreezeFrameDataEx_GetEventFreezeFrameDataEx_Event_Ga_MoveOverThd
          OpEventGetEventFreezeFrameDataEx_GetEventFreezeFrameDataEx_EvtInfo_VcEvMonIPH: RteEventRef=OpEventGetEventFreezeFrameDataEx_GetEventFreezeFrameDataEx_EvtInfo_VcEvMonIPH
          OpEventGetEventFreezeFrameDataEx_GetEventFreezeFrameDataEx_Event_VcEvMonIPH: RteEventRef=OpEventGetEventFreezeFrameDataEx_GetEventFreezeFrameDataEx_Event_VcEvMonIPH
          OpEventGetEventFreezeFrameDataEx_GetEventFreezeFrameDataEx_EvtInfo_INV_RSLVR_HW_FLT: RteEventRef=OpEventGetEventFreezeFrameDataEx_GetEventFreezeFrameDataEx_EvtInfo_INV_RSLVR_HW_FLT
          OpEventGetEventFreezeFrameDataEx_GetEventFreezeFrameDataEx_Event_INV_RSLVR_HW_FLT: RteEventRef=OpEventGetEventFreezeFrameDataEx_GetEventFreezeFrameDataEx_Event_INV_RSLVR_HW_FLT
          OpEventGetEventFreezeFrameDataEx_GetEventFreezeFrameDataEx_EvtInfo_INV_RSLVR_SIN_ELEC_LO: RteEventRef=OpEventGetEventFreezeFrameDataEx_GetEventFreezeFrameDataEx_EvtInfo_INV_RSLVR_SIN_ELEC_LO
          OpEventGetEventFreezeFrameDataEx_GetEventFreezeFrameDataEx_Event_INV_RSLVR_SIN_ELEC_LO: RteEventRef=OpEventGetEventFreezeFrameDataEx_GetEventFreezeFrameDataEx_Event_INV_RSLVR_SIN_ELEC_LO
          OpEventGetEventFreezeFrameDataEx_GetEventFreezeFrameDataEx_EvtInfo_INV_IAC_W_AMP: RteEventRef=OpEventGetEventFreezeFrameDataEx_GetEventFreezeFrameDataEx_EvtInfo_INV_IAC_W_AMP
          OpEventGetEventFreezeFrameDataEx_GetEventFreezeFrameDataEx_Event_INV_IAC_W_AMP: RteEventRef=OpEventGetEventFreezeFrameDataEx_GetEventFreezeFrameDataEx_Event_INV_IAC_W_AMP
          OpEventGetEventFreezeFrameDataEx_GetEventFreezeFrameDataEx_EvtInfo_VCC_OverVoltage: RteEventRef=OpEventGetEventFreezeFrameDataEx_GetEventFreezeFrameDataEx_EvtInfo_VCC_OverVoltage
          OpEventGetEventFreezeFrameDataEx_GetEventFreezeFrameDataEx_Event_VCC_OverVoltage: RteEventRef=OpEventGetEventFreezeFrameDataEx_GetEventFreezeFrameDataEx_Event_VCC_OverVoltage
          OpEventGetEventFreezeFrameDataEx_GetEventFreezeFrameDataEx_EvtInfo_PS_BLDC_OV_FLT: RteEventRef=OpEventGetEventFreezeFrameDataEx_GetEventFreezeFrameDataEx_EvtInfo_PS_BLDC_OV_FLT
          OpEventGetEventFreezeFrameDataEx_GetEventFreezeFrameDataEx_Event_PS_BLDC_OV_FLT: RteEventRef=OpEventGetEventFreezeFrameDataEx_GetEventFreezeFrameDataEx_Event_PS_BLDC_OV_FLT
          OpEventGetEventFreezeFrameDataEx_GetEventFreezeFrameDataEx_EvtInfo_AURIX_EEPROM_FLT: RteEventRef=OpEventGetEventFreezeFrameDataEx_GetEventFreezeFrameDataEx_EvtInfo_AURIX_EEPROM_FLT
          OpEventGetEventFreezeFrameDataEx_GetEventFreezeFrameDataEx_Event_AURIX_EEPROM_FLT: RteEventRef=OpEventGetEventFreezeFrameDataEx_GetEventFreezeFrameDataEx_Event_AURIX_EEPROM_FLT
          OpEventGetEventFreezeFrameDataEx_GetEventFreezeFrameDataEx_EvtInfo_FS_MONITIOR_ASC_FW_FLT: RteEventRef=OpEventGetEventFreezeFrameDataEx_GetEventFreezeFrameDataEx_EvtInfo_FS_MONITIOR_ASC_FW_FLT
          OpEventGetEventFreezeFrameDataEx_GetEventFreezeFrameDataEx_Event_FS_MONITIOR_ASC_FW_FLT: RteEventRef=OpEventGetEventFreezeFrameDataEx_GetEventFreezeFrameDataEx_Event_FS_MONITIOR_ASC_FW_FLT
          OpEventGetEventFreezeFrameDataEx_GetEventFreezeFrameDataEx_EvtInfo_VCEvSrsPropFr02Tioutd: RteEventRef=OpEventGetEventFreezeFrameDataEx_GetEventFreezeFrameDataEx_EvtInfo_VCEvSrsPropFr02Tioutd
          OpEventGetEventFreezeFrameDataEx_GetEventFreezeFrameDataEx_Event_VCEvSrsPropFr02Tioutd: RteEventRef=OpEventGetEventFreezeFrameDataEx_GetEventFreezeFrameDataEx_Event_VCEvSrsPropFr02Tioutd
          OpEventGetEventFreezeFrameDataEx_GetEventFreezeFrameDataEx_EvtInfo_VcEvMonErrMode: RteEventRef=OpEventGetEventFreezeFrameDataEx_GetEventFreezeFrameDataEx_EvtInfo_VcEvMonErrMode
          OpEventGetEventFreezeFrameDataEx_GetEventFreezeFrameDataEx_Event_VcEvMonErrMode: RteEventRef=OpEventGetEventFreezeFrameDataEx_GetEventFreezeFrameDataEx_Event_VcEvMonErrMode
          OpEventGetEventFreezeFrameDataEx_GetEventFreezeFrameDataEx_EvtInfo_AURIX_RST_MPL: RteEventRef=OpEventGetEventFreezeFrameDataEx_GetEventFreezeFrameDataEx_EvtInfo_AURIX_RST_MPL
          OpEventGetEventFreezeFrameDataEx_GetEventFreezeFrameDataEx_Event_AURIX_RST_MPL: RteEventRef=OpEventGetEventFreezeFrameDataEx_GetEventFreezeFrameDataEx_Event_AURIX_RST_MPL
          OpEventGetEventFreezeFrameDataEx_GetEventFreezeFrameDataEx_EvtInfo_VcEvNodeMisECM: RteEventRef=OpEventGetEventFreezeFrameDataEx_GetEventFreezeFrameDataEx_EvtInfo_VcEvNodeMisECM
          OpEventGetEventFreezeFrameDataEx_GetEventFreezeFrameDataEx_Event_VcEvNodeMisECM: RteEventRef=OpEventGetEventFreezeFrameDataEx_GetEventFreezeFrameDataEx_Event_VcEvNodeMisECM
          OpEventGetEventFreezeFrameDataEx_GetEventFreezeFrameDataEx_EvtInfo_PS_KL30_PLAUS: RteEventRef=OpEventGetEventFreezeFrameDataEx_GetEventFreezeFrameDataEx_EvtInfo_PS_KL30_PLAUS
          OpEventGetEventFreezeFrameDataEx_GetEventFreezeFrameDataEx_Event_PS_KL30_PLAUS: RteEventRef=OpEventGetEventFreezeFrameDataEx_GetEventFreezeFrameDataEx_Event_PS_KL30_PLAUS
          OpEventGetEventFreezeFrameDataEx_GetEventFreezeFrameDataEx_EvtInfo_INV_IAC_W_ELEC_HI: RteEventRef=OpEventGetEventFreezeFrameDataEx_GetEventFreezeFrameDataEx_EvtInfo_INV_IAC_W_ELEC_HI
          OpEventGetEventFreezeFrameDataEx_GetEventFreezeFrameDataEx_Event_INV_IAC_W_ELEC_HI: RteEventRef=OpEventGetEventFreezeFrameDataEx_GetEventFreezeFrameDataEx_Event_INV_IAC_W_ELEC_HI
          OpEventGetEventFreezeFrameDataEx_GetEventFreezeFrameDataEx_EvtInfo_VCEvVddmPropFr19Tioutd: RteEventRef=OpEventGetEventFreezeFrameDataEx_GetEventFreezeFrameDataEx_EvtInfo_VCEvVddmPropFr19Tioutd
          OpEventGetEventFreezeFrameDataEx_GetEventFreezeFrameDataEx_Event_VCEvVddmPropFr19Tioutd: RteEventRef=OpEventGetEventFreezeFrameDataEx_GetEventFreezeFrameDataEx_Event_VCEvVddmPropFr19Tioutd
          OpEventGetEventFreezeFrameDataEx_GetEventFreezeFrameDataEx_EvtInfo_INV_TEMP_DCHA_HW: RteEventRef=OpEventGetEventFreezeFrameDataEx_GetEventFreezeFrameDataEx_EvtInfo_INV_TEMP_DCHA_HW
          OpEventGetEventFreezeFrameDataEx_GetEventFreezeFrameDataEx_Event_INV_TEMP_DCHA_HW: RteEventRef=OpEventGetEventFreezeFrameDataEx_GetEventFreezeFrameDataEx_Event_INV_TEMP_DCHA_HW
          OpEventGetEventFreezeFrameDataEx_GetEventFreezeFrameDataEx_EvtInfo_VcEvPropCANGlbTiOutd: RteEventRef=OpEventGetEventFreezeFrameDataEx_GetEventFreezeFrameDataEx_EvtInfo_VcEvPropCANGlbTiOutd
          OpEventGetEventFreezeFrameDataEx_GetEventFreezeFrameDataEx_Event_VcEvPropCANGlbTiOutd: RteEventRef=OpEventGetEventFreezeFrameDataEx_GetEventFreezeFrameDataEx_Event_VcEvPropCANGlbTiOutd
          OpEventGetEventFreezeFrameDataEx_GetEventFreezeFrameDataEx_EvtInfo_INV_EM_STATOR_TEMP2_RNG_NOK: RteEventRef=OpEventGetEventFreezeFrameDataEx_GetEventFreezeFrameDataEx_EvtInfo_INV_EM_STATOR_TEMP2_RNG_NOK
          OpEventGetEventFreezeFrameDataEx_GetEventFreezeFrameDataEx_Event_INV_EM_STATOR_TEMP2_RNG_NOK: RteEventRef=OpEventGetEventFreezeFrameDataEx_GetEventFreezeFrameDataEx_Event_INV_EM_STATOR_TEMP2_RNG_NOK
          OpEventGetEventFreezeFrameDataEx_GetEventFreezeFrameDataEx_EvtInfo_INV_UHVDC_OV_HWP: RteEventRef=OpEventGetEventFreezeFrameDataEx_GetEventFreezeFrameDataEx_EvtInfo_INV_UHVDC_OV_HWP
          OpEventGetEventFreezeFrameDataEx_GetEventFreezeFrameDataEx_Event_INV_UHVDC_OV_HWP: RteEventRef=OpEventGetEventFreezeFrameDataEx_GetEventFreezeFrameDataEx_Event_INV_UHVDC_OV_HWP
          OpEventGetEventFreezeFrameDataEx_GetEventFreezeFrameDataEx_EvtInfo_Ga_FindEngleAngleFailed: RteEventRef=OpEventGetEventFreezeFrameDataEx_GetEventFreezeFrameDataEx_EvtInfo_Ga_FindEngleAngleFailed
          OpEventGetEventFreezeFrameDataEx_GetEventFreezeFrameDataEx_Event_Ga_FindEngleAngleFailed: RteEventRef=OpEventGetEventFreezeFrameDataEx_GetEventFreezeFrameDataEx_Event_Ga_FindEngleAngleFailed
          OpEventGetEventFreezeFrameDataEx_GetEventFreezeFrameDataEx_EvtInfo_VcEvMonTrqCmp: RteEventRef=OpEventGetEventFreezeFrameDataEx_GetEventFreezeFrameDataEx_EvtInfo_VcEvMonTrqCmp
          OpEventGetEventFreezeFrameDataEx_GetEventFreezeFrameDataEx_Event_VcEvMonTrqCmp: RteEventRef=OpEventGetEventFreezeFrameDataEx_GetEventFreezeFrameDataEx_Event_VcEvMonTrqCmp
          OpEventGetEventFreezeFrameDataEx_GetEventFreezeFrameDataEx_EvtInfo_INV_IGBT_TEMP_V_RNG_LO: RteEventRef=OpEventGetEventFreezeFrameDataEx_GetEventFreezeFrameDataEx_EvtInfo_INV_IGBT_TEMP_V_RNG_LO
          OpEventGetEventFreezeFrameDataEx_GetEventFreezeFrameDataEx_Event_INV_IGBT_TEMP_V_RNG_LO: RteEventRef=OpEventGetEventFreezeFrameDataEx_GetEventFreezeFrameDataEx_Event_INV_IGBT_TEMP_V_RNG_LO
          OpEventGetEventFreezeFrameDataEx_GetEventFreezeFrameDataEx_EvtInfo_INV_CONTROL_LIMIT: RteEventRef=OpEventGetEventFreezeFrameDataEx_GetEventFreezeFrameDataEx_EvtInfo_INV_CONTROL_LIMIT
          OpEventGetEventFreezeFrameDataEx_GetEventFreezeFrameDataEx_Event_INV_CONTROL_LIMIT: RteEventRef=OpEventGetEventFreezeFrameDataEx_GetEventFreezeFrameDataEx_Event_INV_CONTROL_LIMIT
          OpEventGetEventFreezeFrameDataEx_GetEventFreezeFrameDataEx_EvtInfo_COM_CarConfigErr: RteEventRef=OpEventGetEventFreezeFrameDataEx_GetEventFreezeFrameDataEx_EvtInfo_COM_CarConfigErr
          OpEventGetEventFreezeFrameDataEx_GetEventFreezeFrameDataEx_Event_COM_CarConfigErr: RteEventRef=OpEventGetEventFreezeFrameDataEx_GetEventFreezeFrameDataEx_Event_COM_CarConfigErr
          OpEventGetEventFreezeFrameDataEx_GetEventFreezeFrameDataEx_EvtInfo_VCEvEcmPropFr08Tioutd: RteEventRef=OpEventGetEventFreezeFrameDataEx_GetEventFreezeFrameDataEx_EvtInfo_VCEvEcmPropFr08Tioutd
          OpEventGetEventFreezeFrameDataEx_GetEventFreezeFrameDataEx_Event_VCEvEcmPropFr08Tioutd: RteEventRef=OpEventGetEventFreezeFrameDataEx_GetEventFreezeFrameDataEx_Event_VCEvEcmPropFr08Tioutd
          OpEventGetEventFreezeFrameDataEx_GetEventFreezeFrameDataEx_EvtInfo_CU_TEMP1_RNG_LO: RteEventRef=OpEventGetEventFreezeFrameDataEx_GetEventFreezeFrameDataEx_EvtInfo_CU_TEMP1_RNG_LO
          OpEventGetEventFreezeFrameDataEx_GetEventFreezeFrameDataEx_Event_CU_TEMP1_RNG_LO: RteEventRef=OpEventGetEventFreezeFrameDataEx_GetEventFreezeFrameDataEx_Event_CU_TEMP1_RNG_LO
          OpEventGetEventFreezeFrameDataEx_GetEventFreezeFrameDataEx_EvtInfo_INV_EM_STATOR_TEMP2_RNG_SWT: RteEventRef=OpEventGetEventFreezeFrameDataEx_GetEventFreezeFrameDataEx_EvtInfo_INV_EM_STATOR_TEMP2_RNG_SWT
          OpEventGetEventFreezeFrameDataEx_GetEventFreezeFrameDataEx_Event_INV_EM_STATOR_TEMP2_RNG_SWT: RteEventRef=OpEventGetEventFreezeFrameDataEx_GetEventFreezeFrameDataEx_Event_INV_EM_STATOR_TEMP2_RNG_SWT
          OpEventGetEventFreezeFrameDataEx_GetEventFreezeFrameDataEx_EvtInfo_GA_BLDC_POS_FLT: RteEventRef=OpEventGetEventFreezeFrameDataEx_GetEventFreezeFrameDataEx_EvtInfo_GA_BLDC_POS_FLT
          OpEventGetEventFreezeFrameDataEx_GetEventFreezeFrameDataEx_Event_GA_BLDC_POS_FLT: RteEventRef=OpEventGetEventFreezeFrameDataEx_GetEventFreezeFrameDataEx_Event_GA_BLDC_POS_FLT
          OpEventGetEventFreezeFrameDataEx_GetEventFreezeFrameDataEx_EvtInfo_PS_WhlSnsr_FLT: RteEventRef=OpEventGetEventFreezeFrameDataEx_GetEventFreezeFrameDataEx_EvtInfo_PS_WhlSnsr_FLT
          OpEventGetEventFreezeFrameDataEx_GetEventFreezeFrameDataEx_Event_PS_WhlSnsr_FLT: RteEventRef=OpEventGetEventFreezeFrameDataEx_GetEventFreezeFrameDataEx_Event_PS_WhlSnsr_FLT
          OpEventGetEventFreezeFrameDataEx_GetEventFreezeFrameDataEx_EvtInfo_INV_EM_STATOR_TEMP_RNG_LO: RteEventRef=OpEventGetEventFreezeFrameDataEx_GetEventFreezeFrameDataEx_EvtInfo_INV_EM_STATOR_TEMP_RNG_LO
          OpEventGetEventFreezeFrameDataEx_GetEventFreezeFrameDataEx_Event_INV_EM_STATOR_TEMP_RNG_LO: RteEventRef=OpEventGetEventFreezeFrameDataEx_GetEventFreezeFrameDataEx_Event_INV_EM_STATOR_TEMP_RNG_LO
          OpEventGetEventFreezeFrameDataEx_GetEventFreezeFrameDataEx_EvtInfo_INV_RSLVR_SIN_ELEC_HI: RteEventRef=OpEventGetEventFreezeFrameDataEx_GetEventFreezeFrameDataEx_EvtInfo_INV_RSLVR_SIN_ELEC_HI
          OpEventGetEventFreezeFrameDataEx_GetEventFreezeFrameDataEx_Event_INV_RSLVR_SIN_ELEC_HI: RteEventRef=OpEventGetEventFreezeFrameDataEx_GetEventFreezeFrameDataEx_Event_INV_RSLVR_SIN_ELEC_HI
          OpEventGetEventFreezeFrameDataEx_GetEventFreezeFrameDataEx_EvtInfo_INV_RSLVR_SIN_COS_PLAUS: RteEventRef=OpEventGetEventFreezeFrameDataEx_GetEventFreezeFrameDataEx_EvtInfo_INV_RSLVR_SIN_COS_PLAUS
          OpEventGetEventFreezeFrameDataEx_GetEventFreezeFrameDataEx_Event_INV_RSLVR_SIN_COS_PLAUS: RteEventRef=OpEventGetEventFreezeFrameDataEx_GetEventFreezeFrameDataEx_Event_INV_RSLVR_SIN_COS_PLAUS
          OpEventGetEventFreezeFrameDataEx_GetEventFreezeFrameDataEx_EvtInfo_INV_RSLVR_COS_AMP: RteEventRef=OpEventGetEventFreezeFrameDataEx_GetEventFreezeFrameDataEx_EvtInfo_INV_RSLVR_COS_AMP
          OpEventGetEventFreezeFrameDataEx_GetEventFreezeFrameDataEx_Event_INV_RSLVR_COS_AMP: RteEventRef=OpEventGetEventFreezeFrameDataEx_GetEventFreezeFrameDataEx_Event_INV_RSLVR_COS_AMP
          OpEventGetEventFreezeFrameDataEx_GetEventFreezeFrameDataEx_EvtInfo_INV_GATE_DRVR_BOT_HWP: RteEventRef=OpEventGetEventFreezeFrameDataEx_GetEventFreezeFrameDataEx_EvtInfo_INV_GATE_DRVR_BOT_HWP
          OpEventGetEventFreezeFrameDataEx_GetEventFreezeFrameDataEx_Event_INV_GATE_DRVR_BOT_HWP: RteEventRef=OpEventGetEventFreezeFrameDataEx_GetEventFreezeFrameDataEx_Event_INV_GATE_DRVR_BOT_HWP
          OpEventGetEventFreezeFrameDataEx_GetEventFreezeFrameDataEx_EvtInfo_Eg_HallVolWrong: RteEventRef=OpEventGetEventFreezeFrameDataEx_GetEventFreezeFrameDataEx_EvtInfo_Eg_HallVolWrong
          OpEventGetEventFreezeFrameDataEx_GetEventFreezeFrameDataEx_Event_Eg_HallVolWrong: RteEventRef=OpEventGetEventFreezeFrameDataEx_GetEventFreezeFrameDataEx_Event_Eg_HallVolWrong
          OpEventGetEventFreezeFrameDataEx_GetEventFreezeFrameDataEx_EvtInfo_INV_RSLVR_EXCT_RNG_NOK: RteEventRef=OpEventGetEventFreezeFrameDataEx_GetEventFreezeFrameDataEx_EvtInfo_INV_RSLVR_EXCT_RNG_NOK
          OpEventGetEventFreezeFrameDataEx_GetEventFreezeFrameDataEx_Event_INV_RSLVR_EXCT_RNG_NOK: RteEventRef=OpEventGetEventFreezeFrameDataEx_GetEventFreezeFrameDataEx_Event_INV_RSLVR_EXCT_RNG_NOK
          OpEventGetEventFreezeFrameDataEx_GetEventFreezeFrameDataEx_EvtInfo_PA_OpenCirc: RteEventRef=OpEventGetEventFreezeFrameDataEx_GetEventFreezeFrameDataEx_EvtInfo_PA_OpenCirc
          OpEventGetEventFreezeFrameDataEx_GetEventFreezeFrameDataEx_Event_PA_OpenCirc: RteEventRef=OpEventGetEventFreezeFrameDataEx_GetEventFreezeFrameDataEx_Event_PA_OpenCirc
          OpEventGetEventFreezeFrameDataEx_GetEventFreezeFrameDataEx_EvtInfo_INV_RSLVR_COS_ELEC_HI: RteEventRef=OpEventGetEventFreezeFrameDataEx_GetEventFreezeFrameDataEx_EvtInfo_INV_RSLVR_COS_ELEC_HI
          OpEventGetEventFreezeFrameDataEx_GetEventFreezeFrameDataEx_Event_INV_RSLVR_COS_ELEC_HI: RteEventRef=OpEventGetEventFreezeFrameDataEx_GetEventFreezeFrameDataEx_Event_INV_RSLVR_COS_ELEC_HI
          OpEventGetEventFreezeFrameDataEx_GetEventFreezeFrameDataEx_EvtInfo_VcEvCntrHvSysRlySts: RteEventRef=OpEventGetEventFreezeFrameDataEx_GetEventFreezeFrameDataEx_EvtInfo_VcEvCntrHvSysRlySts
          OpEventGetEventFreezeFrameDataEx_GetEventFreezeFrameDataEx_Event_VcEvCntrHvSysRlySts: RteEventRef=OpEventGetEventFreezeFrameDataEx_GetEventFreezeFrameDataEx_Event_VcEvCntrHvSysRlySts
          OpEventGetEventFreezeFrameDataEx_GetEventFreezeFrameDataEx_EvtInfo_CRASH_DTC: RteEventRef=OpEventGetEventFreezeFrameDataEx_GetEventFreezeFrameDataEx_EvtInfo_CRASH_DTC
          OpEventGetEventFreezeFrameDataEx_GetEventFreezeFrameDataEx_Event_CRASH_DTC: RteEventRef=OpEventGetEventFreezeFrameDataEx_GetEventFreezeFrameDataEx_Event_CRASH_DTC
          OpEventGetEventFreezeFrameDataEx_GetEventFreezeFrameDataEx_EvtInfo_INV_IGBT_TEMP_W_RNG_HI: RteEventRef=OpEventGetEventFreezeFrameDataEx_GetEventFreezeFrameDataEx_EvtInfo_INV_IGBT_TEMP_W_RNG_HI
          OpEventGetEventFreezeFrameDataEx_GetEventFreezeFrameDataEx_Event_INV_IGBT_TEMP_W_RNG_HI: RteEventRef=OpEventGetEventFreezeFrameDataEx_GetEventFreezeFrameDataEx_Event_INV_IGBT_TEMP_W_RNG_HI
          OpEventGetEventFreezeFrameDataEx_GetEventFreezeFrameDataEx_EvtInfo_VCEvBecmPropFr02Tioutd: RteEventRef=OpEventGetEventFreezeFrameDataEx_GetEventFreezeFrameDataEx_EvtInfo_VCEvBecmPropFr02Tioutd
          OpEventGetEventFreezeFrameDataEx_GetEventFreezeFrameDataEx_Event_VCEvBecmPropFr02Tioutd: RteEventRef=OpEventGetEventFreezeFrameDataEx_GetEventFreezeFrameDataEx_Event_VCEvBecmPropFr02Tioutd
          OpEventGetEventFreezeFrameDataEx_GetEventFreezeFrameDataEx_EvtInfo_INV_IGBT_TEMP_W_GRDT: RteEventRef=OpEventGetEventFreezeFrameDataEx_GetEventFreezeFrameDataEx_EvtInfo_INV_IGBT_TEMP_W_GRDT
          OpEventGetEventFreezeFrameDataEx_GetEventFreezeFrameDataEx_Event_INV_IGBT_TEMP_W_GRDT: RteEventRef=OpEventGetEventFreezeFrameDataEx_GetEventFreezeFrameDataEx_Event_INV_IGBT_TEMP_W_GRDT
          OpEventGetEventFreezeFrameDataEx_GetEventFreezeFrameDataEx_EvtInfo_EXT_UC_SPI_FLT: RteEventRef=OpEventGetEventFreezeFrameDataEx_GetEventFreezeFrameDataEx_EvtInfo_EXT_UC_SPI_FLT
          OpEventGetEventFreezeFrameDataEx_GetEventFreezeFrameDataEx_Event_EXT_UC_SPI_FLT: RteEventRef=OpEventGetEventFreezeFrameDataEx_GetEventFreezeFrameDataEx_Event_EXT_UC_SPI_FLT
          OpEventGetEventFreezeFrameDataEx_GetEventFreezeFrameDataEx_EvtInfo_INV_IAC_V_ELEC_HWP_001: RteEventRef=OpEventGetEventFreezeFrameDataEx_GetEventFreezeFrameDataEx_EvtInfo_INV_IAC_V_ELEC_HWP_001
          OpEventGetEventFreezeFrameDataEx_GetEventFreezeFrameDataEx_Event_INV_IAC_V_ELEC_HWP_001: RteEventRef=OpEventGetEventFreezeFrameDataEx_GetEventFreezeFrameDataEx_Event_INV_IAC_V_ELEC_HWP_001
          OpEventGetEventFreezeFrameDataEx_GetEventFreezeFrameDataEx_EvtInfo_VcEvChkSumWhlMotSysTqAllwd: RteEventRef=OpEventGetEventFreezeFrameDataEx_GetEventFreezeFrameDataEx_EvtInfo_VcEvChkSumWhlMotSysTqAllwd
          OpEventGetEventFreezeFrameDataEx_GetEventFreezeFrameDataEx_Event_VcEvChkSumWhlMotSysTqAllwd: RteEventRef=OpEventGetEventFreezeFrameDataEx_GetEventFreezeFrameDataEx_Event_VcEvChkSumWhlMotSysTqAllwd
          OpEventGetEventFreezeFrameDataEx_GetEventFreezeFrameDataEx_EvtInfo_FS_MONITIOR_ASC_FLT: RteEventRef=OpEventGetEventFreezeFrameDataEx_GetEventFreezeFrameDataEx_EvtInfo_FS_MONITIOR_ASC_FLT
          OpEventGetEventFreezeFrameDataEx_GetEventFreezeFrameDataEx_Event_FS_MONITIOR_ASC_FLT: RteEventRef=OpEventGetEventFreezeFrameDataEx_GetEventFreezeFrameDataEx_Event_FS_MONITIOR_ASC_FLT
          OpEventGetEventFreezeFrameDataEx_GetEventFreezeFrameDataEx_EvtInfo_INV_IAC_V_AMP: RteEventRef=OpEventGetEventFreezeFrameDataEx_GetEventFreezeFrameDataEx_EvtInfo_INV_IAC_V_AMP
          OpEventGetEventFreezeFrameDataEx_GetEventFreezeFrameDataEx_Event_INV_IAC_V_AMP: RteEventRef=OpEventGetEventFreezeFrameDataEx_GetEventFreezeFrameDataEx_Event_INV_IAC_V_AMP
          OpEventGetEventFreezeFrameDataEx_GetEventFreezeFrameDataEx_EvtInfo_INV_IAC_W_ELEC_LO: RteEventRef=OpEventGetEventFreezeFrameDataEx_GetEventFreezeFrameDataEx_EvtInfo_INV_IAC_W_ELEC_LO
          OpEventGetEventFreezeFrameDataEx_GetEventFreezeFrameDataEx_Event_INV_IAC_W_ELEC_LO: RteEventRef=OpEventGetEventFreezeFrameDataEx_GetEventFreezeFrameDataEx_Event_INV_IAC_W_ELEC_LO
          OpEventGetEventFreezeFrameDataEx_GetEventFreezeFrameDataEx_EvtInfo_VCEvVddmPropFr08Tioutd_001: RteEventRef=OpEventGetEventFreezeFrameDataEx_GetEventFreezeFrameDataEx_EvtInfo_VCEvVddmPropFr08Tioutd_001
          OpEventGetEventFreezeFrameDataEx_GetEventFreezeFrameDataEx_Event_VCEvVddmPropFr08Tioutd_001: RteEventRef=OpEventGetEventFreezeFrameDataEx_GetEventFreezeFrameDataEx_Event_VCEvVddmPropFr08Tioutd_001
          OpEventGetEventFreezeFrameDataEx_GetEventFreezeFrameDataEx_EvtInfo_PS_P12_RES_FLT: RteEventRef=OpEventGetEventFreezeFrameDataEx_GetEventFreezeFrameDataEx_EvtInfo_PS_P12_RES_FLT
          OpEventGetEventFreezeFrameDataEx_GetEventFreezeFrameDataEx_Event_PS_P12_RES_FLT: RteEventRef=OpEventGetEventFreezeFrameDataEx_GetEventFreezeFrameDataEx_Event_PS_P12_RES_FLT
          OpEventGetEventFreezeFrameDataEx_GetEventFreezeFrameDataEx_EvtInfo_INV_RSLVR_SIN_RNG_LO: RteEventRef=OpEventGetEventFreezeFrameDataEx_GetEventFreezeFrameDataEx_EvtInfo_INV_RSLVR_SIN_RNG_LO
          OpEventGetEventFreezeFrameDataEx_GetEventFreezeFrameDataEx_Event_INV_RSLVR_SIN_RNG_LO: RteEventRef=OpEventGetEventFreezeFrameDataEx_GetEventFreezeFrameDataEx_Event_INV_RSLVR_SIN_RNG_LO
          OpEventGetEventFreezeFrameDataEx_GetEventFreezeFrameDataEx_EvtInfo_CU_TEMP_HW_FLT: RteEventRef=OpEventGetEventFreezeFrameDataEx_GetEventFreezeFrameDataEx_EvtInfo_CU_TEMP_HW_FLT
          OpEventGetEventFreezeFrameDataEx_GetEventFreezeFrameDataEx_Event_CU_TEMP_HW_FLT: RteEventRef=OpEventGetEventFreezeFrameDataEx_GetEventFreezeFrameDataEx_Event_CU_TEMP_HW_FLT
          OpEventGetEventFreezeFrameDataEx_GetEventFreezeFrameDataEx_EvtInfo_VCEvEcmPropFr02MgmFr00Tioutd: RteEventRef=OpEventGetEventFreezeFrameDataEx_GetEventFreezeFrameDataEx_EvtInfo_VCEvEcmPropFr02MgmFr00Tioutd
          OpEventGetEventFreezeFrameDataEx_GetEventFreezeFrameDataEx_Event_VCEvEcmPropFr02MgmFr00Tioutd: RteEventRef=OpEventGetEventFreezeFrameDataEx_GetEventFreezeFrameDataEx_Event_VCEvEcmPropFr02MgmFr00Tioutd
          OpEventGetEventFreezeFrameDataEx_GetEventFreezeFrameDataEx_EvtInfo_PS_KL15_RNG_HI: RteEventRef=OpEventGetEventFreezeFrameDataEx_GetEventFreezeFrameDataEx_EvtInfo_PS_KL15_RNG_HI
          OpEventGetEventFreezeFrameDataEx_GetEventFreezeFrameDataEx_Event_PS_KL15_RNG_HI: RteEventRef=OpEventGetEventFreezeFrameDataEx_GetEventFreezeFrameDataEx_Event_PS_KL15_RNG_HI
          OpEventGetEventFreezeFrameDataEx_GetEventFreezeFrameDataEx_EvtInfo_VCEvVddmPropFr17Tioutd: RteEventRef=OpEventGetEventFreezeFrameDataEx_GetEventFreezeFrameDataEx_EvtInfo_VCEvVddmPropFr17Tioutd
          OpEventGetEventFreezeFrameDataEx_GetEventFreezeFrameDataEx_Event_VCEvVddmPropFr17Tioutd: RteEventRef=OpEventGetEventFreezeFrameDataEx_GetEventFreezeFrameDataEx_Event_VCEvVddmPropFr17Tioutd
          OpEventGetEventFreezeFrameDataEx_GetEventFreezeFrameDataEx_EvtInfo_VcEvChkSumCrashStsSafe: RteEventRef=OpEventGetEventFreezeFrameDataEx_GetEventFreezeFrameDataEx_EvtInfo_VcEvChkSumCrashStsSafe
          OpEventGetEventFreezeFrameDataEx_GetEventFreezeFrameDataEx_Event_VcEvChkSumCrashStsSafe: RteEventRef=OpEventGetEventFreezeFrameDataEx_GetEventFreezeFrameDataEx_Event_VcEvChkSumCrashStsSafe
          OpEventGetEventFreezeFrameDataEx_GetEventFreezeFrameDataEx_EvtInfo_DiagC_ClutchService: RteEventRef=OpEventGetEventFreezeFrameDataEx_GetEventFreezeFrameDataEx_EvtInfo_DiagC_ClutchService
          OpEventGetEventFreezeFrameDataEx_GetEventFreezeFrameDataEx_Event_DiagC_ClutchService: RteEventRef=OpEventGetEventFreezeFrameDataEx_GetEventFreezeFrameDataEx_Event_DiagC_ClutchService
          OpEventGetEventFreezeFrameDataEx_GetEventFreezeFrameDataEx_EvtInfo_INV_EM_STATOR_TEMP_RNG_HI: RteEventRef=OpEventGetEventFreezeFrameDataEx_GetEventFreezeFrameDataEx_EvtInfo_INV_EM_STATOR_TEMP_RNG_HI
          OpEventGetEventFreezeFrameDataEx_GetEventFreezeFrameDataEx_Event_INV_EM_STATOR_TEMP_RNG_HI: RteEventRef=OpEventGetEventFreezeFrameDataEx_GetEventFreezeFrameDataEx_Event_INV_EM_STATOR_TEMP_RNG_HI
          OpEventGetEventFreezeFrameDataEx_GetEventFreezeFrameDataEx_EvtInfo_INV_RSLVR_OFFS_OUT_RANG: RteEventRef=OpEventGetEventFreezeFrameDataEx_GetEventFreezeFrameDataEx_EvtInfo_INV_RSLVR_OFFS_OUT_RANG
          OpEventGetEventFreezeFrameDataEx_GetEventFreezeFrameDataEx_Event_INV_RSLVR_OFFS_OUT_RANG: RteEventRef=OpEventGetEventFreezeFrameDataEx_GetEventFreezeFrameDataEx_Event_INV_RSLVR_OFFS_OUT_RANG
          OpEventGetEventFreezeFrameDataEx_GetEventFreezeFrameDataEx_EvtInfo_INV_EM_STATOR_TEMP2_RNG_LO: RteEventRef=OpEventGetEventFreezeFrameDataEx_GetEventFreezeFrameDataEx_EvtInfo_INV_EM_STATOR_TEMP2_RNG_LO
          OpEventGetEventFreezeFrameDataEx_GetEventFreezeFrameDataEx_Event_INV_EM_STATOR_TEMP2_RNG_LO: RteEventRef=OpEventGetEventFreezeFrameDataEx_GetEventFreezeFrameDataEx_Event_INV_EM_STATOR_TEMP2_RNG_LO
          OpEventGetEventFreezeFrameDataEx_GetEventFreezeFrameDataEx_EvtInfo_VcEvMonISAR: RteEventRef=OpEventGetEventFreezeFrameDataEx_GetEventFreezeFrameDataEx_EvtInfo_VcEvMonISAR
          OpEventGetEventFreezeFrameDataEx_GetEventFreezeFrameDataEx_Event_VcEvMonISAR: RteEventRef=OpEventGetEventFreezeFrameDataEx_GetEventFreezeFrameDataEx_Event_VcEvMonISAR
          OpEventGetEventFreezeFrameDataEx_GetEventFreezeFrameDataEx_EvtInfo_GA_BLDC_FLT: RteEventRef=OpEventGetEventFreezeFrameDataEx_GetEventFreezeFrameDataEx_EvtInfo_GA_BLDC_FLT
          OpEventGetEventFreezeFrameDataEx_GetEventFreezeFrameDataEx_Event_GA_BLDC_FLT: RteEventRef=OpEventGetEventFreezeFrameDataEx_GetEventFreezeFrameDataEx_Event_GA_BLDC_FLT
          OpEventGetEventFreezeFrameDataEx_GetEventFreezeFrameDataEx_EvtInfo_INV_RSLVR_EXCT_ELEC_OPEN: RteEventRef=OpEventGetEventFreezeFrameDataEx_GetEventFreezeFrameDataEx_EvtInfo_INV_RSLVR_EXCT_ELEC_OPEN
          OpEventGetEventFreezeFrameDataEx_GetEventFreezeFrameDataEx_Event_INV_RSLVR_EXCT_ELEC_OPEN: RteEventRef=OpEventGetEventFreezeFrameDataEx_GetEventFreezeFrameDataEx_Event_INV_RSLVR_EXCT_ELEC_OPEN
          OpEventGetEventFreezeFrameDataEx_GetEventFreezeFrameDataEx_EvtInfo_INV_RSLVR_EXCT_PLAUS: RteEventRef=OpEventGetEventFreezeFrameDataEx_GetEventFreezeFrameDataEx_EvtInfo_INV_RSLVR_EXCT_PLAUS
          OpEventGetEventFreezeFrameDataEx_GetEventFreezeFrameDataEx_Event_INV_RSLVR_EXCT_PLAUS: RteEventRef=OpEventGetEventFreezeFrameDataEx_GetEventFreezeFrameDataEx_Event_INV_RSLVR_EXCT_PLAUS
          OpEventGetEventFreezeFrameDataEx_GetEventFreezeFrameDataEx_EvtInfo_PS_P15_U_FLT: RteEventRef=OpEventGetEventFreezeFrameDataEx_GetEventFreezeFrameDataEx_EvtInfo_PS_P15_U_FLT
          OpEventGetEventFreezeFrameDataEx_GetEventFreezeFrameDataEx_Event_PS_P15_U_FLT: RteEventRef=OpEventGetEventFreezeFrameDataEx_GetEventFreezeFrameDataEx_Event_PS_P15_U_FLT
          OpEventGetEventFreezeFrameDataEx_GetEventFreezeFrameDataEx_EvtInfo_INV_EM_STATOR_TEMP_RNG_SWT: RteEventRef=OpEventGetEventFreezeFrameDataEx_GetEventFreezeFrameDataEx_EvtInfo_INV_EM_STATOR_TEMP_RNG_SWT
          OpEventGetEventFreezeFrameDataEx_GetEventFreezeFrameDataEx_Event_INV_EM_STATOR_TEMP_RNG_SWT: RteEventRef=OpEventGetEventFreezeFrameDataEx_GetEventFreezeFrameDataEx_Event_INV_EM_STATOR_TEMP_RNG_SWT
          OpEventGetEventFreezeFrameDataEx_GetEventFreezeFrameDataEx_EvtInfo_INV_UHVDC_OV_SWP: RteEventRef=OpEventGetEventFreezeFrameDataEx_GetEventFreezeFrameDataEx_EvtInfo_INV_UHVDC_OV_SWP

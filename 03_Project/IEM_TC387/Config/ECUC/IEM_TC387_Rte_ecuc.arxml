[part 4 of 5: package /ActiveEcuC]
AUTOSAR XML (schema 4-2-2)
package /ActiveEcuC  (continued)
  module config Rte: implementation-config-variant=VARIANT-PRE-COMPILE, module-description=Rte_Impl  (continued)
    7 x RteSwComponentInstance:  (continued)
      DemSatellite_0_EcuSwComposition: RteSoftwareComponentInstanceRef=DemSatellite_0  (continued)
        4544 x RteEventToTaskMapping, all with RteImmediateRestart=false:  (continued)
          OpEventGetEventFreezeFrameDataEx_GetEventFreezeFrameDataEx_Event_INV_UHVDC_OV_SWP: RteEventRef=OpEventGetEventFreezeFrameDataEx_GetEventFreezeFrameDataEx_Event_INV_UHVDC_OV_SWP
          OpEventGetEventFreezeFrameDataEx_GetEventFreezeFrameDataEx_EvtInfo_AURIX_HW_FLT: RteEventRef=OpEventGetEventFreezeFrameDataEx_GetEventFreezeFrameDataEx_EvtInfo_AURIX_HW_FLT
          OpEventGetEventFreezeFrameDataEx_GetEventFreezeFrameDataEx_Event_AURIX_HW_FLT: RteEventRef=OpEventGetEventFreezeFrameDataEx_GetEventFreezeFrameDataEx_Event_AURIX_HW_FLT
          OpEventGetEventFreezeFrameDataEx_GetEventFreezeFrameDataEx_EvtInfo_INV_GATE_DRVR_TOP_HWP: RteEventRef=OpEventGetEventFreezeFrameDataEx_GetEventFreezeFrameDataEx_EvtInfo_INV_GATE_DRVR_TOP_HWP
          OpEventGetEventFreezeFrameDataEx_GetEventFreezeFrameDataEx_Event_INV_GATE_DRVR_TOP_HWP: RteEventRef=OpEventGetEventFreezeFrameDataEx_GetEventFreezeFrameDataEx_Event_INV_GATE_DRVR_TOP_HWP
          OpEventGetEventFreezeFrameDataEx_GetEventFreezeFrameDataEx_EvtInfo_INV_ACTV_DCHA_HW: RteEventRef=OpEventGetEventFreezeFrameDataEx_GetEventFreezeFrameDataEx_EvtInfo_INV_ACTV_DCHA_HW
          OpEventGetEventFreezeFrameDataEx_GetEventFreezeFrameDataEx_Event_INV_ACTV_DCHA_HW: RteEventRef=OpEventGetEventFreezeFrameDataEx_GetEventFreezeFrameDataEx_Event_INV_ACTV_DCHA_HW
          OpEventGetEventFreezeFrameDataEx_GetEventFreezeFrameDataEx_EvtInfo_INV_IGBT_TEMP_HWP: RteEventRef=OpEventGetEventFreezeFrameDataEx_GetEventFreezeFrameDataEx_EvtInfo_INV_IGBT_TEMP_HWP
          OpEventGetEventFreezeFrameDataEx_GetEventFreezeFrameDataEx_Event_INV_IGBT_TEMP_HWP: RteEventRef=OpEventGetEventFreezeFrameDataEx_GetEventFreezeFrameDataEx_Event_INV_IGBT_TEMP_HWP
          OpEventGetEventFreezeFrameDataEx_GetEventFreezeFrameDataEx_EvtInfo_INV_RSLVR_SIN_ELEC_FLT: RteEventRef=OpEventGetEventFreezeFrameDataEx_GetEventFreezeFrameDataEx_EvtInfo_INV_RSLVR_SIN_ELEC_FLT
          OpEventGetEventFreezeFrameDataEx_GetEventFreezeFrameDataEx_Event_INV_RSLVR_SIN_ELEC_FLT: RteEventRef=OpEventGetEventFreezeFrameDataEx_GetEventFreezeFrameDataEx_Event_INV_RSLVR_SIN_ELEC_FLT
          OpEventGetEventFreezeFrameDataEx_GetEventFreezeFrameDataEx_EvtInfo_CU_TEMP2_RNG_HI: RteEventRef=OpEventGetEventFreezeFrameDataEx_GetEventFreezeFrameDataEx_EvtInfo_CU_TEMP2_RNG_HI
          OpEventGetEventFreezeFrameDataEx_GetEventFreezeFrameDataEx_Event_CU_TEMP2_RNG_HI: RteEventRef=OpEventGetEventFreezeFrameDataEx_GetEventFreezeFrameDataEx_Event_CU_TEMP2_RNG_HI
          OpEventGetEventFreezeFrameDataEx_GetEventFreezeFrameDataEx_EvtInfo_INV_IAC_PHA_LOSS_MPL: RteEventRef=OpEventGetEventFreezeFrameDataEx_GetEventFreezeFrameDataEx_EvtInfo_INV_IAC_PHA_LOSS_MPL
          OpEventGetEventFreezeFrameDataEx_GetEventFreezeFrameDataEx_Event_INV_IAC_PHA_LOSS_MPL: RteEventRef=OpEventGetEventFreezeFrameDataEx_GetEventFreezeFrameDataEx_Event_INV_IAC_PHA_LOSS_MPL
          OpEventGetEventFreezeFrameDataEx_GetEventFreezeFrameDataEx_EvtInfo_INV_IAC_U_AMP: RteEventRef=OpEventGetEventFreezeFrameDataEx_GetEventFreezeFrameDataEx_EvtInfo_INV_IAC_U_AMP
          OpEventGetEventFreezeFrameDataEx_GetEventFreezeFrameDataEx_Event_INV_IAC_U_AMP: RteEventRef=OpEventGetEventFreezeFrameDataEx_GetEventFreezeFrameDataEx_Event_INV_IAC_U_AMP
          OpEventGetEventFreezeFrameDataEx_GetEventFreezeFrameDataEx_EvtInfo_PSnsr_GRADT_Flt: RteEventRef=OpEventGetEventFreezeFrameDataEx_GetEventFreezeFrameDataEx_EvtInfo_PSnsr_GRADT_Flt
          OpEventGetEventFreezeFrameDataEx_GetEventFreezeFrameDataEx_Event_PSnsr_GRADT_Flt: RteEventRef=OpEventGetEventFreezeFrameDataEx_GetEventFreezeFrameDataEx_Event_PSnsr_GRADT_Flt
          OpEventGetEventFreezeFrameDataEx_GetEventFreezeFrameDataEx_EvtInfo_AURIX_WATHDOG_FLT: RteEventRef=OpEventGetEventFreezeFrameDataEx_GetEventFreezeFrameDataEx_EvtInfo_AURIX_WATHDOG_FLT
          OpEventGetEventFreezeFrameDataEx_GetEventFreezeFrameDataEx_Event_AURIX_WATHDOG_FLT: RteEventRef=OpEventGetEventFreezeFrameDataEx_GetEventFreezeFrameDataEx_Event_AURIX_WATHDOG_FLT
          OpEventGetEventFreezeFrameDataEx_GetEventFreezeFrameDataEx_EvtInfo_VcEvNodeMisBECM: RteEventRef=OpEventGetEventFreezeFrameDataEx_GetEventFreezeFrameDataEx_EvtInfo_VcEvNodeMisBECM
          OpEventGetEventFreezeFrameDataEx_GetEventFreezeFrameDataEx_Event_VcEvNodeMisBECM: RteEventRef=OpEventGetEventFreezeFrameDataEx_GetEventFreezeFrameDataEx_Event_VcEvNodeMisBECM
          OpEventGetEventFreezeFrameDataEx_GetEventFreezeFrameDataEx_EvtInfo_INV_UHVDC_UV_HWP: RteEventRef=OpEventGetEventFreezeFrameDataEx_GetEventFreezeFrameDataEx_EvtInfo_INV_UHVDC_UV_HWP
          OpEventGetEventFreezeFrameDataEx_GetEventFreezeFrameDataEx_Event_INV_UHVDC_UV_HWP: RteEventRef=OpEventGetEventFreezeFrameDataEx_GetEventFreezeFrameDataEx_Event_INV_UHVDC_UV_HWP
          OpEventGetEventFreezeFrameDataEx_GetEventFreezeFrameDataEx_EvtInfo_VcEvMonESpd: RteEventRef=OpEventGetEventFreezeFrameDataEx_GetEventFreezeFrameDataEx_EvtInfo_VcEvMonESpd
          OpEventGetEventFreezeFrameDataEx_GetEventFreezeFrameDataEx_Event_VcEvMonESpd: RteEventRef=OpEventGetEventFreezeFrameDataEx_GetEventFreezeFrameDataEx_Event_VcEvMonESpd
          OpEventGetEventFreezeFrameDataEx_GetEventFreezeFrameDataEx_EvtInfo_COM_NotConfig: RteEventRef=OpEventGetEventFreezeFrameDataEx_GetEventFreezeFrameDataEx_EvtInfo_COM_NotConfig
          OpEventGetEventFreezeFrameDataEx_GetEventFreezeFrameDataEx_Event_COM_NotConfig: RteEventRef=OpEventGetEventFreezeFrameDataEx_GetEventFreezeFrameDataEx_Event_COM_NotConfig
          OpEventGetEventFreezeFrameDataEx_GetEventFreezeFrameDataEx_EvtInfo_INV_RSLVR_SIN_RNG_HI: RteEventRef=OpEventGetEventFreezeFrameDataEx_GetEventFreezeFrameDataEx_EvtInfo_INV_RSLVR_SIN_RNG_HI
          OpEventGetEventFreezeFrameDataEx_GetEventFreezeFrameDataEx_Event_INV_RSLVR_SIN_RNG_HI: RteEventRef=OpEventGetEventFreezeFrameDataEx_GetEventFreezeFrameDataEx_Event_INV_RSLVR_SIN_RNG_HI
          OpEventGetEventFreezeFrameDataEx_GetEventFreezeFrameDataEx_EvtInfo_INV_IGBT_TEMP_U_RNG_HI: RteEventRef=OpEventGetEventFreezeFrameDataEx_GetEventFreezeFrameDataEx_EvtInfo_INV_IGBT_TEMP_U_RNG_HI
          OpEventGetEventFreezeFrameDataEx_GetEventFreezeFrameDataEx_Event_INV_IGBT_TEMP_U_RNG_HI: RteEventRef=OpEventGetEventFreezeFrameDataEx_GetEventFreezeFrameDataEx_Event_INV_IGBT_TEMP_U_RNG_HI
          OpEventGetEventFreezeFrameDataEx_GetEventFreezeFrameDataEx_EvtInfo_VcEvMonMode_001: RteEventRef=OpEventGetEventFreezeFrameDataEx_GetEventFreezeFrameDataEx_EvtInfo_VcEvMonMode_001
          OpEventGetEventFreezeFrameDataEx_GetEventFreezeFrameDataEx_Event_VcEvMonMode_001: RteEventRef=OpEventGetEventFreezeFrameDataEx_GetEventFreezeFrameDataEx_Event_VcEvMonMode_001
          OpEventGetEventFreezeFrameDataEx_GetEventFreezeFrameDataEx_EvtInfo_PA_ACTION_FLT: RteEventRef=OpEventGetEventFreezeFrameDataEx_GetEventFreezeFrameDataEx_EvtInfo_PA_ACTION_FLT
          OpEventGetEventFreezeFrameDataEx_GetEventFreezeFrameDataEx_Event_PA_ACTION_FLT: RteEventRef=OpEventGetEventFreezeFrameDataEx_GetEventFreezeFrameDataEx_Event_PA_ACTION_FLT
          OpEventGetEventFreezeFrameDataEx_GetEventFreezeFrameDataEx_EvtInfo_INV_IAC_V_ELEC_HWP: RteEventRef=OpEventGetEventFreezeFrameDataEx_GetEventFreezeFrameDataEx_EvtInfo_INV_IAC_V_ELEC_HWP
          OpEventGetEventFreezeFrameDataEx_GetEventFreezeFrameDataEx_Event_INV_IAC_V_ELEC_HWP: RteEventRef=OpEventGetEventFreezeFrameDataEx_GetEventFreezeFrameDataEx_Event_INV_IAC_V_ELEC_HWP
          OpEventGetEventFreezeFrameDataEx_GetEventFreezeFrameDataEx_EvtInfo_CU_TEMP_HW_FLT_001: RteEventRef=OpEventGetEventFreezeFrameDataEx_GetEventFreezeFrameDataEx_EvtInfo_CU_TEMP_HW_FLT_001
          OpEventGetEventFreezeFrameDataEx_GetEventFreezeFrameDataEx_Event_CU_TEMP_HW_FLT_001: RteEventRef=OpEventGetEventFreezeFrameDataEx_GetEventFreezeFrameDataEx_Event_CU_TEMP_HW_FLT_001
          OpEventGetEventFreezeFrameDataEx_GetEventFreezeFrameDataEx_EvtInfo_VCC_UnderVoltage: RteEventRef=OpEventGetEventFreezeFrameDataEx_GetEventFreezeFrameDataEx_EvtInfo_VCC_UnderVoltage
          OpEventGetEventFreezeFrameDataEx_GetEventFreezeFrameDataEx_Event_VCC_UnderVoltage: RteEventRef=OpEventGetEventFreezeFrameDataEx_GetEventFreezeFrameDataEx_Event_VCC_UnderVoltage
          OpEventGetEventFreezeFrameDataEx_GetEventFreezeFrameDataEx_EvtInfo_VcEvTsttrPlaus: RteEventRef=OpEventGetEventFreezeFrameDataEx_GetEventFreezeFrameDataEx_EvtInfo_VcEvTsttrPlaus
          OpEventGetEventFreezeFrameDataEx_GetEventFreezeFrameDataEx_Event_VcEvTsttrPlaus: RteEventRef=OpEventGetEventFreezeFrameDataEx_GetEventFreezeFrameDataEx_Event_VcEvTsttrPlaus
          OpEventGetEventFreezeFrameDataEx_GetEventFreezeFrameDataEx_EvtInfo_INV_RSLVR_EXCT_ELEC_FLT: RteEventRef=OpEventGetEventFreezeFrameDataEx_GetEventFreezeFrameDataEx_EvtInfo_INV_RSLVR_EXCT_ELEC_FLT
          OpEventGetEventFreezeFrameDataEx_GetEventFreezeFrameDataEx_Event_INV_RSLVR_EXCT_ELEC_FLT: RteEventRef=OpEventGetEventFreezeFrameDataEx_GetEventFreezeFrameDataEx_Event_INV_RSLVR_EXCT_ELEC_FLT
          OpEventGetEventFreezeFrameDataEx_GetEventFreezeFrameDataEx_EvtInfo_INV_RSLVR_EXCT_RNG_LO: RteEventRef=OpEventGetEventFreezeFrameDataEx_GetEventFreezeFrameDataEx_EvtInfo_INV_RSLVR_EXCT_RNG_LO
          OpEventGetEventFreezeFrameDataEx_GetEventFreezeFrameDataEx_Event_INV_RSLVR_EXCT_RNG_LO: RteEventRef=OpEventGetEventFreezeFrameDataEx_GetEventFreezeFrameDataEx_Event_INV_RSLVR_EXCT_RNG_LO
          OpEventGetEventFreezeFrameDataEx_GetEventFreezeFrameDataEx_EvtInfo_INV_EM_STATOR_TEMP2_RNG_HI: RteEventRef=OpEventGetEventFreezeFrameDataEx_GetEventFreezeFrameDataEx_EvtInfo_INV_EM_STATOR_TEMP2_RNG_HI
          OpEventGetEventFreezeFrameDataEx_GetEventFreezeFrameDataEx_Event_INV_EM_STATOR_TEMP2_RNG_HI: RteEventRef=OpEventGetEventFreezeFrameDataEx_GetEventFreezeFrameDataEx_Event_INV_EM_STATOR_TEMP2_RNG_HI
          OpEventGetEventFreezeFrameDataEx_GetEventFreezeFrameDataEx_EvtInfo_INV_SHUT_OFF_PAH_START_UP: RteEventRef=OpEventGetEventFreezeFrameDataEx_GetEventFreezeFrameDataEx_EvtInfo_INV_SHUT_OFF_PAH_START_UP
          OpEventGetEventFreezeFrameDataEx_GetEventFreezeFrameDataEx_Event_INV_SHUT_OFF_PAH_START_UP: RteEventRef=OpEventGetEventFreezeFrameDataEx_GetEventFreezeFrameDataEx_Event_INV_SHUT_OFF_PAH_START_UP
          OpEventGetEventFreezeFrameDataEx_GetEventFreezeFrameDataEx_EvtInfo_VCEvVddmPropFr08Tioutd: RteEventRef=OpEventGetEventFreezeFrameDataEx_GetEventFreezeFrameDataEx_EvtInfo_VCEvVddmPropFr08Tioutd
          OpEventGetEventFreezeFrameDataEx_GetEventFreezeFrameDataEx_Event_VCEvVddmPropFr08Tioutd: RteEventRef=OpEventGetEventFreezeFrameDataEx_GetEventFreezeFrameDataEx_Event_VCEvVddmPropFr08Tioutd
          OpEventGetEventFreezeFrameDataEx_GetEventFreezeFrameDataEx_EvtInfo_INV_RSLVR_EXCT_OC_HWP_001: RteEventRef=OpEventGetEventFreezeFrameDataEx_GetEventFreezeFrameDataEx_EvtInfo_INV_RSLVR_EXCT_OC_HWP_001
          OpEventGetEventFreezeFrameDataEx_GetEventFreezeFrameDataEx_Event_INV_RSLVR_EXCT_OC_HWP_001: RteEventRef=OpEventGetEventFreezeFrameDataEx_GetEventFreezeFrameDataEx_Event_INV_RSLVR_EXCT_OC_HWP_001
          OpEventGetEventFreezeFrameDataEx_GetEventFreezeFrameDataEx_EvtInfo_INV_RSLVR_EXCT_OC_HWP_002: RteEventRef=OpEventGetEventFreezeFrameDataEx_GetEventFreezeFrameDataEx_EvtInfo_INV_RSLVR_EXCT_OC_HWP_002
          OpEventGetEventFreezeFrameDataEx_GetEventFreezeFrameDataEx_Event_INV_RSLVR_EXCT_OC_HWP_002: RteEventRef=OpEventGetEventFreezeFrameDataEx_GetEventFreezeFrameDataEx_Event_INV_RSLVR_EXCT_OC_HWP_002
          OpEventGetEventFreezeFrameDataEx_GetEventFreezeFrameDataEx_EvtInfo_INV_EM_STATOR_TEMP_ELE_FLT: RteEventRef=OpEventGetEventFreezeFrameDataEx_GetEventFreezeFrameDataEx_EvtInfo_INV_EM_STATOR_TEMP_ELE_FLT
          OpEventGetEventFreezeFrameDataEx_GetEventFreezeFrameDataEx_Event_INV_EM_STATOR_TEMP_ELE_FLT: RteEventRef=OpEventGetEventFreezeFrameDataEx_GetEventFreezeFrameDataEx_Event_INV_EM_STATOR_TEMP_ELE_FLT
          OpEventGetEventFreezeFrameDataEx_GetEventFreezeFrameDataEx_EvtInfo_INV_INTERLOCK_FLT: RteEventRef=OpEventGetEventFreezeFrameDataEx_GetEventFreezeFrameDataEx_EvtInfo_INV_INTERLOCK_FLT
          OpEventGetEventFreezeFrameDataEx_GetEventFreezeFrameDataEx_Event_INV_INTERLOCK_FLT: RteEventRef=OpEventGetEventFreezeFrameDataEx_GetEventFreezeFrameDataEx_Event_INV_INTERLOCK_FLT
          OpEventGetEventFreezeFrameDataEx_GetEventFreezeFrameDataEx_EvtInfo_Ga_ZeroFindDistanFailure: RteEventRef=OpEventGetEventFreezeFrameDataEx_GetEventFreezeFrameDataEx_EvtInfo_Ga_ZeroFindDistanFailure
          OpEventGetEventFreezeFrameDataEx_GetEventFreezeFrameDataEx_Event_Ga_ZeroFindDistanFailure: RteEventRef=OpEventGetEventFreezeFrameDataEx_GetEventFreezeFrameDataEx_Event_Ga_ZeroFindDistanFailure
          OpEventGetEventFreezeFrameDataEx_GetEventFreezeFrameDataEx_EvtInfo_PLOCK_Current_RNG_OUT: RteEventRef=OpEventGetEventFreezeFrameDataEx_GetEventFreezeFrameDataEx_EvtInfo_PLOCK_Current_RNG_OUT
          OpEventGetEventFreezeFrameDataEx_GetEventFreezeFrameDataEx_Event_PLOCK_Current_RNG_OUT: RteEventRef=OpEventGetEventFreezeFrameDataEx_GetEventFreezeFrameDataEx_Event_PLOCK_Current_RNG_OUT
          OpEventGetEventFreezeFrameDataEx_GetEventFreezeFrameDataEx_EvtInfo_VCEvVddmPropFr05Tioutd: RteEventRef=OpEventGetEventFreezeFrameDataEx_GetEventFreezeFrameDataEx_EvtInfo_VCEvVddmPropFr05Tioutd
          OpEventGetEventFreezeFrameDataEx_GetEventFreezeFrameDataEx_Event_VCEvVddmPropFr05Tioutd: RteEventRef=OpEventGetEventFreezeFrameDataEx_GetEventFreezeFrameDataEx_Event_VCEvVddmPropFr05Tioutd
          OpEventGetEventFreezeFrameDataEx_GetEventFreezeFrameDataEx_EvtInfo_INV_IGBT_TEMP_V_GRDT: RteEventRef=OpEventGetEventFreezeFrameDataEx_GetEventFreezeFrameDataEx_EvtInfo_INV_IGBT_TEMP_V_GRDT
          OpEventGetEventFreezeFrameDataEx_GetEventFreezeFrameDataEx_Event_INV_IGBT_TEMP_V_GRDT: RteEventRef=OpEventGetEventFreezeFrameDataEx_GetEventFreezeFrameDataEx_Event_INV_IGBT_TEMP_V_GRDT
          OpEventGetEventFreezeFrameDataEx_GetEventFreezeFrameDataEx_EvtInfo_PS_5V_Fault: RteEventRef=OpEventGetEventFreezeFrameDataEx_GetEventFreezeFrameDataEx_EvtInfo_PS_5V_Fault
          OpEventGetEventFreezeFrameDataEx_GetEventFreezeFrameDataEx_Event_PS_5V_Fault: RteEventRef=OpEventGetEventFreezeFrameDataEx_GetEventFreezeFrameDataEx_Event_PS_5V_Fault
          OpEventGetEventFreezeFrameDataEx_GetEventFreezeFrameDataEx_EvtInfo_VcEvCntrCrashStsSafe: RteEventRef=OpEventGetEventFreezeFrameDataEx_GetEventFreezeFrameDataEx_EvtInfo_VcEvCntrCrashStsSafe
          OpEventGetEventFreezeFrameDataEx_GetEventFreezeFrameDataEx_Event_VcEvCntrCrashStsSafe: RteEventRef=OpEventGetEventFreezeFrameDataEx_GetEventFreezeFrameDataEx_Event_VcEvCntrCrashStsSafe
          OpEventGetEventFreezeFrameDataEx_GetEventFreezeFrameDataEx_EvtInfo_INV_EM_STATOR_TEMP_GRDT: RteEventRef=OpEventGetEventFreezeFrameDataEx_GetEventFreezeFrameDataEx_EvtInfo_INV_EM_STATOR_TEMP_GRDT
          OpEventGetEventFreezeFrameDataEx_GetEventFreezeFrameDataEx_Event_INV_EM_STATOR_TEMP_GRDT: RteEventRef=OpEventGetEventFreezeFrameDataEx_GetEventFreezeFrameDataEx_Event_INV_EM_STATOR_TEMP_GRDT
          OpEventGetEventFreezeFrameDataEx_GetEventFreezeFrameDataEx_EvtInfo_PS_P15_V_FLT: RteEventRef=OpEventGetEventFreezeFrameDataEx_GetEventFreezeFrameDataEx_EvtInfo_PS_P15_V_FLT
          OpEventGetEventFreezeFrameDataEx_GetEventFreezeFrameDataEx_Event_PS_P15_V_FLT: RteEventRef=OpEventGetEventFreezeFrameDataEx_GetEventFreezeFrameDataEx_Event_PS_P15_V_FLT
          OpEventGetEventFreezeFrameDataEx_GetEventFreezeFrameDataEx_EvtInfo_INV_EM_STATOR_TEMP_RNG_NOK: RteEventRef=OpEventGetEventFreezeFrameDataEx_GetEventFreezeFrameDataEx_EvtInfo_INV_EM_STATOR_TEMP_RNG_NOK
          OpEventGetEventFreezeFrameDataEx_GetEventFreezeFrameDataEx_Event_INV_EM_STATOR_TEMP_RNG_NOK: RteEventRef=OpEventGetEventFreezeFrameDataEx_GetEventFreezeFrameDataEx_Event_INV_EM_STATOR_TEMP_RNG_NOK
          OpEventGetEventFreezeFrameDataEx_GetEventFreezeFrameDataEx_EvtInfo_INV_RSLVR_SIN_RNG_NOK: RteEventRef=OpEventGetEventFreezeFrameDataEx_GetEventFreezeFrameDataEx_EvtInfo_INV_RSLVR_SIN_RNG_NOK
          OpEventGetEventFreezeFrameDataEx_GetEventFreezeFrameDataEx_Event_INV_RSLVR_SIN_RNG_NOK: RteEventRef=OpEventGetEventFreezeFrameDataEx_GetEventFreezeFrameDataEx_Event_INV_RSLVR_SIN_RNG_NOK
          OpEventGetEventFreezeFrameDataEx_GetEventFreezeFrameDataEx_EvtInfo_INV_IAC_U_OFFS: RteEventRef=OpEventGetEventFreezeFrameDataEx_GetEventFreezeFrameDataEx_EvtInfo_INV_IAC_U_OFFS
          OpEventGetEventFreezeFrameDataEx_GetEventFreezeFrameDataEx_Event_INV_IAC_U_OFFS: RteEventRef=OpEventGetEventFreezeFrameDataEx_GetEventFreezeFrameDataEx_Event_INV_IAC_U_OFFS
          OpEventGetEventFreezeFrameDataEx_GetEventFreezeFrameDataEx_EvtInfo_PS_KL30_BACKUP_FLT: RteEventRef=OpEventGetEventFreezeFrameDataEx_GetEventFreezeFrameDataEx_EvtInfo_PS_KL30_BACKUP_FLT
          OpEventGetEventFreezeFrameDataEx_GetEventFreezeFrameDataEx_Event_PS_KL30_BACKUP_FLT: RteEventRef=OpEventGetEventFreezeFrameDataEx_GetEventFreezeFrameDataEx_Event_PS_KL30_BACKUP_FLT
          OpEventGetEventFreezeFrameDataEx_GetEventFreezeFrameDataEx_EvtInfo_INV_IGBT_TEMP_U_RNG_LO: RteEventRef=OpEventGetEventFreezeFrameDataEx_GetEventFreezeFrameDataEx_EvtInfo_INV_IGBT_TEMP_U_RNG_LO
          OpEventGetEventFreezeFrameDataEx_GetEventFreezeFrameDataEx_Event_INV_IGBT_TEMP_U_RNG_LO: RteEventRef=OpEventGetEventFreezeFrameDataEx_GetEventFreezeFrameDataEx_Event_INV_IGBT_TEMP_U_RNG_LO
          OpEventGetEventFreezeFrameDataEx_GetEventFreezeFrameDataEx_EvtInfo_INV_EM_STATOR_TEMP_HWP: RteEventRef=OpEventGetEventFreezeFrameDataEx_GetEventFreezeFrameDataEx_EvtInfo_INV_EM_STATOR_TEMP_HWP
          OpEventGetEventFreezeFrameDataEx_GetEventFreezeFrameDataEx_Event_INV_EM_STATOR_TEMP_HWP: RteEventRef=OpEventGetEventFreezeFrameDataEx_GetEventFreezeFrameDataEx_Event_INV_EM_STATOR_TEMP_HWP
          OpEventGetEventFreezeFrameDataEx_GetEventFreezeFrameDataEx_EvtInfo_CU_TEMP1_RNG_HI: RteEventRef=OpEventGetEventFreezeFrameDataEx_GetEventFreezeFrameDataEx_EvtInfo_CU_TEMP1_RNG_HI
          OpEventGetEventFreezeFrameDataEx_GetEventFreezeFrameDataEx_Event_CU_TEMP1_RNG_HI: RteEventRef=OpEventGetEventFreezeFrameDataEx_GetEventFreezeFrameDataEx_Event_CU_TEMP1_RNG_HI
          OpEventGetEventFreezeFrameDataEx_GetEventFreezeFrameDataEx_EvtInfo_INV_IGBT_TEMP_V_RNG_HI: RteEventRef=OpEventGetEventFreezeFrameDataEx_GetEventFreezeFrameDataEx_EvtInfo_INV_IGBT_TEMP_V_RNG_HI
          OpEventGetEventFreezeFrameDataEx_GetEventFreezeFrameDataEx_Event_INV_IGBT_TEMP_V_RNG_HI: RteEventRef=OpEventGetEventFreezeFrameDataEx_GetEventFreezeFrameDataEx_Event_INV_IGBT_TEMP_V_RNG_HI
          OpEventGetEventFreezeFrameDataEx_GetEventFreezeFrameDataEx_EvtInfo_VcEvNodeMisVDDM: RteEventRef=OpEventGetEventFreezeFrameDataEx_GetEventFreezeFrameDataEx_EvtInfo_VcEvNodeMisVDDM
          OpEventGetEventFreezeFrameDataEx_GetEventFreezeFrameDataEx_Event_VcEvNodeMisVDDM: RteEventRef=OpEventGetEventFreezeFrameDataEx_GetEventFreezeFrameDataEx_Event_VcEvNodeMisVDDM
          OpEventGetEventFreezeFrameDataEx_GetEventFreezeFrameDataEx_EvtInfo_INV_UHVDC_PLAUS: RteEventRef=OpEventGetEventFreezeFrameDataEx_GetEventFreezeFrameDataEx_EvtInfo_INV_UHVDC_PLAUS
          OpEventGetEventFreezeFrameDataEx_GetEventFreezeFrameDataEx_Event_INV_UHVDC_PLAUS: RteEventRef=OpEventGetEventFreezeFrameDataEx_GetEventFreezeFrameDataEx_Event_INV_UHVDC_PLAUS
          OpEventGetEventFreezeFrameDataEx_GetEventFreezeFrameDataEx_EvtInfo_INV_QUIESCENT_FLT: RteEventRef=OpEventGetEventFreezeFrameDataEx_GetEventFreezeFrameDataEx_EvtInfo_INV_QUIESCENT_FLT
          OpEventGetEventFreezeFrameDataEx_GetEventFreezeFrameDataEx_Event_INV_QUIESCENT_FLT: RteEventRef=OpEventGetEventFreezeFrameDataEx_GetEventFreezeFrameDataEx_Event_INV_QUIESCENT_FLT
          OpEventGetEventFreezeFrameDataEx_GetEventFreezeFrameDataEx_EvtInfo_INV_RSLVR_EXCT_RNG_HI: RteEventRef=OpEventGetEventFreezeFrameDataEx_GetEventFreezeFrameDataEx_EvtInfo_INV_RSLVR_EXCT_RNG_HI
          OpEventGetEventFreezeFrameDataEx_GetEventFreezeFrameDataEx_Event_INV_RSLVR_EXCT_RNG_HI: RteEventRef=OpEventGetEventFreezeFrameDataEx_GetEventFreezeFrameDataEx_Event_INV_RSLVR_EXCT_RNG_HI
          OpEventGetEventFreezeFrameDataEx_GetEventFreezeFrameDataEx_GeneralEvtInfo: RteEventRef=OpEventGetEventFreezeFrameDataEx_GetEventFreezeFrameDataEx_GeneralEvtInfo
          OpEventGetEventExtendedDataRecordEx_GetEventExtendedDataRecordEx_EvtInfo_VCEvBecmPropFr01Tioutd: RteEventRef=OpEventGetEventExtendedDataRecordEx_GetEventExtendedDataRecordEx_EvtInfo_VCEvBecmPropFr01Tioutd
          OpEventGetEventExtendedDataRecordEx_GetEventExtendedDataRecordEx_Event_VCEvBecmPropFr01Tioutd: RteEventRef=OpEventGetEventExtendedDataRecordEx_GetEventExtendedDataRecordEx_Event_VCEvBecmPropFr01Tioutd
          OpEventGetEventExtendedDataRecordEx_GetEventExtendedDataRecordEx_EvtInfo_INV_CU_TEMP2_RNG_NOK: RteEventRef=OpEventGetEventExtendedDataRecordEx_GetEventExtendedDataRecordEx_EvtInfo_INV_CU_TEMP2_RNG_NOK
          OpEventGetEventExtendedDataRecordEx_GetEventExtendedDataRecordEx_Event_INV_CU_TEMP2_RNG_NOK: RteEventRef=OpEventGetEventExtendedDataRecordEx_GetEventExtendedDataRecordEx_Event_INV_CU_TEMP2_RNG_NOK
          OpEventGetEventExtendedDataRecordEx_GetEventExtendedDataRecordEx_EvtInfo_COM_Busoff: RteEventRef=OpEventGetEventExtendedDataRecordEx_GetEventExtendedDataRecordEx_EvtInfo_COM_Busoff
          OpEventGetEventExtendedDataRecordEx_GetEventExtendedDataRecordEx_Event_COM_Busoff: RteEventRef=OpEventGetEventExtendedDataRecordEx_GetEventExtendedDataRecordEx_Event_COM_Busoff
          OpEventGetEventExtendedDataRecordEx_GetEventExtendedDataRecordEx_EvtInfo_INV_IMMO_NOKEY: RteEventRef=OpEventGetEventExtendedDataRecordEx_GetEventExtendedDataRecordEx_EvtInfo_INV_IMMO_NOKEY
          OpEventGetEventExtendedDataRecordEx_GetEventExtendedDataRecordEx_Event_INV_IMMO_NOKEY: RteEventRef=OpEventGetEventExtendedDataRecordEx_GetEventExtendedDataRecordEx_Event_INV_IMMO_NOKEY
          OpEventGetEventExtendedDataRecordEx_GetEventExtendedDataRecordEx_EvtInfo_INV_RSLVR_EXCT_OC_HWP: RteEventRef=OpEventGetEventExtendedDataRecordEx_GetEventExtendedDataRecordEx_EvtInfo_INV_RSLVR_EXCT_OC_HWP
          OpEventGetEventExtendedDataRecordEx_GetEventExtendedDataRecordEx_Event_INV_RSLVR_EXCT_OC_HWP: RteEventRef=OpEventGetEventExtendedDataRecordEx_GetEventExtendedDataRecordEx_Event_INV_RSLVR_EXCT_OC_HWP
          OpEventGetEventExtendedDataRecordEx_GetEventExtendedDataRecordEx_EvtInfo_PS_P15_W_FLT: RteEventRef=OpEventGetEventExtendedDataRecordEx_GetEventExtendedDataRecordEx_EvtInfo_PS_P15_W_FLT
          OpEventGetEventExtendedDataRecordEx_GetEventExtendedDataRecordEx_Event_PS_P15_W_FLT: RteEventRef=OpEventGetEventExtendedDataRecordEx_GetEventExtendedDataRecordEx_Event_PS_P15_W_FLT
          OpEventGetEventExtendedDataRecordEx_GetEventExtendedDataRecordEx_EvtInfo_INV_IAC_PLAUS_SUM: RteEventRef=OpEventGetEventExtendedDataRecordEx_GetEventExtendedDataRecordEx_EvtInfo_INV_IAC_PLAUS_SUM
          OpEventGetEventExtendedDataRecordEx_GetEventExtendedDataRecordEx_Event_INV_IAC_PLAUS_SUM: RteEventRef=OpEventGetEventExtendedDataRecordEx_GetEventExtendedDataRecordEx_Event_INV_IAC_PLAUS_SUM
          OpEventGetEventExtendedDataRecordEx_GetEventExtendedDataRecordEx_EvtInfo_PA_ELE_FLT: RteEventRef=OpEventGetEventExtendedDataRecordEx_GetEventExtendedDataRecordEx_EvtInfo_PA_ELE_FLT
          OpEventGetEventExtendedDataRecordEx_GetEventExtendedDataRecordEx_Event_PA_ELE_FLT: RteEventRef=OpEventGetEventExtendedDataRecordEx_GetEventExtendedDataRecordEx_Event_PA_ELE_FLT
          OpEventGetEventExtendedDataRecordEx_GetEventExtendedDataRecordEx_EvtInfo_CU_TEMP_GRDT: RteEventRef=OpEventGetEventExtendedDataRecordEx_GetEventExtendedDataRecordEx_EvtInfo_CU_TEMP_GRDT
          OpEventGetEventExtendedDataRecordEx_GetEventExtendedDataRecordEx_Event_CU_TEMP_GRDT: RteEventRef=OpEventGetEventExtendedDataRecordEx_GetEventExtendedDataRecordEx_Event_CU_TEMP_GRDT
          OpEventGetEventExtendedDataRecordEx_GetEventExtendedDataRecordEx_EvtInfo_INV_IGBT_TEMP_V_PLAUS: RteEventRef=OpEventGetEventExtendedDataRecordEx_GetEventExtendedDataRecordEx_EvtInfo_INV_IGBT_TEMP_V_PLAUS
          OpEventGetEventExtendedDataRecordEx_GetEventExtendedDataRecordEx_Event_INV_IGBT_TEMP_V_PLAUS: RteEventRef=OpEventGetEventExtendedDataRecordEx_GetEventExtendedDataRecordEx_Event_INV_IGBT_TEMP_V_PLAUS
          OpEventGetEventExtendedDataRecordEx_GetEventExtendedDataRecordEx_EvtInfo_Ga_GAEngageFailure: RteEventRef=OpEventGetEventExtendedDataRecordEx_GetEventExtendedDataRecordEx_EvtInfo_Ga_GAEngageFailure
          OpEventGetEventExtendedDataRecordEx_GetEventExtendedDataRecordEx_Event_Ga_GAEngageFailure: RteEventRef=OpEventGetEventExtendedDataRecordEx_GetEventExtendedDataRecordEx_Event_Ga_GAEngageFailure
          OpEventGetEventExtendedDataRecordEx_GetEventExtendedDataRecordEx_EvtInfo_INV_IAC_W_RNG_LO: RteEventRef=OpEventGetEventExtendedDataRecordEx_GetEventExtendedDataRecordEx_EvtInfo_INV_IAC_W_RNG_LO
          OpEventGetEventExtendedDataRecordEx_GetEventExtendedDataRecordEx_Event_INV_IAC_W_RNG_LO: RteEventRef=OpEventGetEventExtendedDataRecordEx_GetEventExtendedDataRecordEx_Event_INV_IAC_W_RNG_LO
          OpEventGetEventExtendedDataRecordEx_GetEventExtendedDataRecordEx_EvtInfo_PS_WhlSnsr_Vltg_FLT: RteEventRef=OpEventGetEventExtendedDataRecordEx_GetEventExtendedDataRecordEx_EvtInfo_PS_WhlSnsr_Vltg_FLT
          OpEventGetEventExtendedDataRecordEx_GetEventExtendedDataRecordEx_Event_PS_WhlSnsr_Vltg_FLT: RteEventRef=OpEventGetEventExtendedDataRecordEx_GetEventExtendedDataRecordEx_Event_PS_WhlSnsr_Vltg_FLT
          OpEventGetEventExtendedDataRecordEx_GetEventExtendedDataRecordEx_EvtInfo_VCEvEcmPropFr02Tioutd: RteEventRef=OpEventGetEventExtendedDataRecordEx_GetEventExtendedDataRecordEx_EvtInfo_VCEvEcmPropFr02Tioutd
          OpEventGetEventExtendedDataRecordEx_GetEventExtendedDataRecordEx_Event_VCEvEcmPropFr02Tioutd: RteEventRef=OpEventGetEventExtendedDataRecordEx_GetEventExtendedDataRecordEx_Event_VCEvEcmPropFr02Tioutd
          OpEventGetEventExtendedDataRecordEx_GetEventExtendedDataRecordEx_EvtInfo_Ga_TmSpdSyncFailed: RteEventRef=OpEventGetEventExtendedDataRecordEx_GetEventExtendedDataRecordEx_EvtInfo_Ga_TmSpdSyncFailed
          OpEventGetEventExtendedDataRecordEx_GetEventExtendedDataRecordEx_Event_Ga_TmSpdSyncFailed: RteEventRef=OpEventGetEventExtendedDataRecordEx_GetEventExtendedDataRecordEx_Event_Ga_TmSpdSyncFailed
          OpEventGetEventExtendedDataRecordEx_GetEventExtendedDataRecordEx_EvtInfo_INV_RSLVR_EXCT_ELEC_LO: RteEventRef=OpEventGetEventExtendedDataRecordEx_GetEventExtendedDataRecordEx_EvtInfo_INV_RSLVR_EXCT_ELEC_LO
          OpEventGetEventExtendedDataRecordEx_GetEventExtendedDataRecordEx_Event_INV_RSLVR_EXCT_ELEC_LO: RteEventRef=OpEventGetEventExtendedDataRecordEx_GetEventExtendedDataRecordEx_Event_INV_RSLVR_EXCT_ELEC_LO
          OpEventGetEventExtendedDataRecordEx_GetEventExtendedDataRecordEx_EvtInfo_VCEvEcmPropXevFr06Tioutd: RteEventRef=OpEventGetEventExtendedDataRecordEx_GetEventExtendedDataRecordEx_EvtInfo_VCEvEcmPropXevFr06Tioutd
          OpEventGetEventExtendedDataRecordEx_GetEventExtendedDataRecordEx_Event_VCEvEcmPropXevFr06Tioutd: RteEventRef=OpEventGetEventExtendedDataRecordEx_GetEventExtendedDataRecordEx_Event_VCEvEcmPropXevFr06Tioutd
          OpEventGetEventExtendedDataRecordEx_GetEventExtendedDataRecordEx_EvtInfo_VcEvCntrWhlMotSysTqAllwd: RteEventRef=OpEventGetEventExtendedDataRecordEx_GetEventExtendedDataRecordEx_EvtInfo_VcEvCntrWhlMotSysTqAllwd
          OpEventGetEventExtendedDataRecordEx_GetEventExtendedDataRecordEx_Event_VcEvCntrWhlMotSysTqAllwd: RteEventRef=OpEventGetEventExtendedDataRecordEx_GetEventExtendedDataRecordEx_Event_VcEvCntrWhlMotSysTqAllwd
          OpEventGetEventExtendedDataRecordEx_GetEventExtendedDataRecordEx_EvtInfo_INV_UHVDC_1_ELEC_HI: RteEventRef=OpEventGetEventExtendedDataRecordEx_GetEventExtendedDataRecordEx_EvtInfo_INV_UHVDC_1_ELEC_HI
          OpEventGetEventExtendedDataRecordEx_GetEventExtendedDataRecordEx_Event_INV_UHVDC_1_ELEC_HI: RteEventRef=OpEventGetEventExtendedDataRecordEx_GetEventExtendedDataRecordEx_Event_INV_UHVDC_1_ELEC_HI
          OpEventGetEventExtendedDataRecordEx_GetEventExtendedDataRecordEx_EvtInfo_INV_EM_STATOR_TEMP2_ELE_FLT: RteEventRef=OpEventGetEventExtendedDataRecordEx_GetEventExtendedDataRecordEx_EvtInfo_INV_EM_STATOR_TEMP2_ELE_FLT
          OpEventGetEventExtendedDataRecordEx_GetEventExtendedDataRecordEx_Event_INV_EM_STATOR_TEMP2_ELE_FLT: RteEventRef=OpEventGetEventExtendedDataRecordEx_GetEventExtendedDataRecordEx_Event_INV_EM_STATOR_TEMP2_ELE_FLT
          OpEventGetEventExtendedDataRecordEx_GetEventExtendedDataRecordEx_EvtInfo_AURIX_RST_SNG: RteEventRef=OpEventGetEventExtendedDataRecordEx_GetEventExtendedDataRecordEx_EvtInfo_AURIX_RST_SNG
          OpEventGetEventExtendedDataRecordEx_GetEventExtendedDataRecordEx_Event_AURIX_RST_SNG: RteEventRef=OpEventGetEventExtendedDataRecordEx_GetEventExtendedDataRecordEx_Event_AURIX_RST_SNG
          OpEventGetEventExtendedDataRecordEx_GetEventExtendedDataRecordEx_EvtInfo_VCEvEcmPropFr24MgmFr01Tioutd: RteEventRef=OpEventGetEventExtendedDataRecordEx_GetEventExtendedDataRecordEx_EvtInfo_VCEvEcmPropFr24MgmFr01Tioutd
          OpEventGetEventExtendedDataRecordEx_GetEventExtendedDataRecordEx_Event_VCEvEcmPropFr24MgmFr01Tioutd: RteEventRef=OpEventGetEventExtendedDataRecordEx_GetEventExtendedDataRecordEx_Event_VCEvEcmPropFr24MgmFr01Tioutd
          OpEventGetEventExtendedDataRecordEx_GetEventExtendedDataRecordEx_EvtInfo_INV_RSLVR_COS_ELEC_OPEN: RteEventRef=OpEventGetEventExtendedDataRecordEx_GetEventExtendedDataRecordEx_EvtInfo_INV_RSLVR_COS_ELEC_OPEN
          OpEventGetEventExtendedDataRecordEx_GetEventExtendedDataRecordEx_Event_INV_RSLVR_COS_ELEC_OPEN: RteEventRef=OpEventGetEventExtendedDataRecordEx_GetEventExtendedDataRecordEx_Event_INV_RSLVR_COS_ELEC_OPEN
          OpEventGetEventExtendedDataRecordEx_GetEventExtendedDataRecordEx_EvtInfo_INV_IAC_V_ELEC_LO: RteEventRef=OpEventGetEventExtendedDataRecordEx_GetEventExtendedDataRecordEx_EvtInfo_INV_IAC_V_ELEC_LO
          OpEventGetEventExtendedDataRecordEx_GetEventExtendedDataRecordEx_Event_INV_IAC_V_ELEC_LO: RteEventRef=OpEventGetEventExtendedDataRecordEx_GetEventExtendedDataRecordEx_Event_INV_IAC_V_ELEC_LO
          OpEventGetEventExtendedDataRecordEx_GetEventExtendedDataRecordEx_EvtInfo_INV_IAC_W_OFFS: RteEventRef=OpEventGetEventExtendedDataRecordEx_GetEventExtendedDataRecordEx_EvtInfo_INV_IAC_W_OFFS
          OpEventGetEventExtendedDataRecordEx_GetEventExtendedDataRecordEx_Event_INV_IAC_W_OFFS: RteEventRef=OpEventGetEventExtendedDataRecordEx_GetEventExtendedDataRecordEx_Event_INV_IAC_W_OFFS
          OpEventGetEventExtendedDataRecordEx_GetEventExtendedDataRecordEx_EvtInfo_INV_EM_STATOR_TEMP2_GRDT: RteEventRef=OpEventGetEventExtendedDataRecordEx_GetEventExtendedDataRecordEx_EvtInfo_INV_EM_STATOR_TEMP2_GRDT
          OpEventGetEventExtendedDataRecordEx_GetEventExtendedDataRecordEx_Event_INV_EM_STATOR_TEMP2_GRDT: RteEventRef=OpEventGetEventExtendedDataRecordEx_GetEventExtendedDataRecordEx_Event_INV_EM_STATOR_TEMP2_GRDT
          OpEventGetEventExtendedDataRecordEx_GetEventExtendedDataRecordEx_EvtInfo_INV_EM_OVRSPD_HWP: RteEventRef=OpEventGetEventExtendedDataRecordEx_GetEventExtendedDataRecordEx_EvtInfo_INV_EM_OVRSPD_HWP
          OpEventGetEventExtendedDataRecordEx_GetEventExtendedDataRecordEx_Event_INV_EM_OVRSPD_HWP: RteEventRef=OpEventGetEventExtendedDataRecordEx_GetEventExtendedDataRecordEx_Event_INV_EM_OVRSPD_HWP
          OpEventGetEventExtendedDataRecordEx_GetEventExtendedDataRecordEx_EvtInfo_CU_TEMP_HWP: RteEventRef=OpEventGetEventExtendedDataRecordEx_GetEventExtendedDataRecordEx_EvtInfo_CU_TEMP_HWP
          OpEventGetEventExtendedDataRecordEx_GetEventExtendedDataRecordEx_Event_CU_TEMP_HWP: RteEventRef=OpEventGetEventExtendedDataRecordEx_GetEventExtendedDataRecordEx_Event_CU_TEMP_HWP
          OpEventGetEventExtendedDataRecordEx_GetEventExtendedDataRecordEx_EvtInfo_INV_UHVDC_1_RNG_HI: RteEventRef=OpEventGetEventExtendedDataRecordEx_GetEventExtendedDataRecordEx_EvtInfo_INV_UHVDC_1_RNG_HI
          OpEventGetEventExtendedDataRecordEx_GetEventExtendedDataRecordEx_Event_INV_UHVDC_1_RNG_HI: RteEventRef=OpEventGetEventExtendedDataRecordEx_GetEventExtendedDataRecordEx_Event_INV_UHVDC_1_RNG_HI
          OpEventGetEventExtendedDataRecordEx_GetEventExtendedDataRecordEx_EvtInfo_VcEvEMPerfPlaus: RteEventRef=OpEventGetEventExtendedDataRecordEx_GetEventExtendedDataRecordEx_EvtInfo_VcEvEMPerfPlaus
          OpEventGetEventExtendedDataRecordEx_GetEventExtendedDataRecordEx_Event_VcEvEMPerfPlaus: RteEventRef=OpEventGetEventExtendedDataRecordEx_GetEventExtendedDataRecordEx_Event_VcEvEMPerfPlaus
          OpEventGetEventExtendedDataRecordEx_GetEventExtendedDataRecordEx_EvtInfo_VCEvVddmPropFr18Tioutd: RteEventRef=OpEventGetEventExtendedDataRecordEx_GetEventExtendedDataRecordEx_EvtInfo_VCEvVddmPropFr18Tioutd
          OpEventGetEventExtendedDataRecordEx_GetEventExtendedDataRecordEx_Event_VCEvVddmPropFr18Tioutd: RteEventRef=OpEventGetEventExtendedDataRecordEx_GetEventExtendedDataRecordEx_Event_VCEvVddmPropFr18Tioutd
          OpEventGetEventExtendedDataRecordEx_GetEventExtendedDataRecordEx_EvtInfo_INV_IAC_U_ELEC_HWP: RteEventRef=OpEventGetEventExtendedDataRecordEx_GetEventExtendedDataRecordEx_EvtInfo_INV_IAC_U_ELEC_HWP
          OpEventGetEventExtendedDataRecordEx_GetEventExtendedDataRecordEx_Event_INV_IAC_U_ELEC_HWP: RteEventRef=OpEventGetEventExtendedDataRecordEx_GetEventExtendedDataRecordEx_Event_INV_IAC_U_ELEC_HWP
          OpEventGetEventExtendedDataRecordEx_GetEventExtendedDataRecordEx_EvtInfo_VCEvVddmPropFr15Tioutd: RteEventRef=OpEventGetEventExtendedDataRecordEx_GetEventExtendedDataRecordEx_EvtInfo_VCEvVddmPropFr15Tioutd
          OpEventGetEventExtendedDataRecordEx_GetEventExtendedDataRecordEx_Event_VCEvVddmPropFr15Tioutd: RteEventRef=OpEventGetEventExtendedDataRecordEx_GetEventExtendedDataRecordEx_Event_VCEvVddmPropFr15Tioutd
          OpEventGetEventExtendedDataRecordEx_GetEventExtendedDataRecordEx_EvtInfo_Ga_GADisengageFailure: RteEventRef=OpEventGetEventExtendedDataRecordEx_GetEventExtendedDataRecordEx_EvtInfo_Ga_GADisengageFailure
          OpEventGetEventExtendedDataRecordEx_GetEventExtendedDataRecordEx_Event_Ga_GADisengageFailure: RteEventRef=OpEventGetEventExtendedDataRecordEx_GetEventExtendedDataRecordEx_Event_Ga_GADisengageFailure
          OpEventGetEventExtendedDataRecordEx_GetEventExtendedDataRecordEx_EvtInfo_CU_TEMP2_RNG_LO: RteEventRef=OpEventGetEventExtendedDataRecordEx_GetEventExtendedDataRecordEx_EvtInfo_CU_TEMP2_RNG_LO
          OpEventGetEventExtendedDataRecordEx_GetEventExtendedDataRecordEx_Event_CU_TEMP2_RNG_LO: RteEventRef=OpEventGetEventExtendedDataRecordEx_GetEventExtendedDataRecordEx_Event_CU_TEMP2_RNG_LO
          OpEventGetEventExtendedDataRecordEx_GetEventExtendedDataRecordEx_EvtInfo_INV_RSLVR_SIN_ELEC_OPEN: RteEventRef=OpEventGetEventExtendedDataRecordEx_GetEventExtendedDataRecordEx_EvtInfo_INV_RSLVR_SIN_ELEC_OPEN
          OpEventGetEventExtendedDataRecordEx_GetEventExtendedDataRecordEx_Event_INV_RSLVR_SIN_ELEC_OPEN: RteEventRef=OpEventGetEventExtendedDataRecordEx_GetEventExtendedDataRecordEx_Event_INV_RSLVR_SIN_ELEC_OPEN
          OpEventGetEventExtendedDataRecordEx_GetEventExtendedDataRecordEx_EvtInfo_VcEvChkSum: RteEventRef=OpEventGetEventExtendedDataRecordEx_GetEventExtendedDataRecordEx_EvtInfo_VcEvChkSum
          OpEventGetEventExtendedDataRecordEx_GetEventExtendedDataRecordEx_Event_VcEvChkSum: RteEventRef=OpEventGetEventExtendedDataRecordEx_GetEventExtendedDataRecordEx_Event_VcEvChkSum
          OpEventGetEventExtendedDataRecordEx_GetEventExtendedDataRecordEx_EvtInfo_PS_P5_UC_FLT: RteEventRef=OpEventGetEventExtendedDataRecordEx_GetEventExtendedDataRecordEx_EvtInfo_PS_P5_UC_FLT
          OpEventGetEventExtendedDataRecordEx_GetEventExtendedDataRecordEx_Event_PS_P5_UC_FLT: RteEventRef=OpEventGetEventExtendedDataRecordEx_GetEventExtendedDataRecordEx_Event_PS_P5_UC_FLT
          OpEventGetEventExtendedDataRecordEx_GetEventExtendedDataRecordEx_EvtInfo_INV_RSLVR_COS_ELEC_FLT: RteEventRef=OpEventGetEventExtendedDataRecordEx_GetEventExtendedDataRecordEx_EvtInfo_INV_RSLVR_COS_ELEC_FLT
          OpEventGetEventExtendedDataRecordEx_GetEventExtendedDataRecordEx_Event_INV_RSLVR_COS_ELEC_FLT: RteEventRef=OpEventGetEventExtendedDataRecordEx_GetEventExtendedDataRecordEx_Event_INV_RSLVR_COS_ELEC_FLT
          OpEventGetEventExtendedDataRecordEx_GetEventExtendedDataRecordEx_EvtInfo_INV_IAC_W_RNG_HI: RteEventRef=OpEventGetEventExtendedDataRecordEx_GetEventExtendedDataRecordEx_EvtInfo_INV_IAC_W_RNG_HI
          OpEventGetEventExtendedDataRecordEx_GetEventExtendedDataRecordEx_Event_INV_IAC_W_RNG_HI: RteEventRef=OpEventGetEventExtendedDataRecordEx_GetEventExtendedDataRecordEx_Event_INV_IAC_W_RNG_HI
          OpEventGetEventExtendedDataRecordEx_GetEventExtendedDataRecordEx_EvtInfo_PS_ECUSUPPLY_HIGH: RteEventRef=OpEventGetEventExtendedDataRecordEx_GetEventExtendedDataRecordEx_EvtInfo_PS_ECUSUPPLY_HIGH
          OpEventGetEventExtendedDataRecordEx_GetEventExtendedDataRecordEx_Event_PS_ECUSUPPLY_HIGH: RteEventRef=OpEventGetEventExtendedDataRecordEx_GetEventExtendedDataRecordEx_Event_PS_ECUSUPPLY_HIGH
          OpEventGetEventExtendedDataRecordEx_GetEventExtendedDataRecordEx_EvtInfo_VCEvEcmPropFr05Tioutd: RteEventRef=OpEventGetEventExtendedDataRecordEx_GetEventExtendedDataRecordEx_EvtInfo_VCEvEcmPropFr05Tioutd
          OpEventGetEventExtendedDataRecordEx_GetEventExtendedDataRecordEx_Event_VCEvEcmPropFr05Tioutd: RteEventRef=OpEventGetEventExtendedDataRecordEx_GetEventExtendedDataRecordEx_Event_VCEvEcmPropFr05Tioutd
          OpEventGetEventExtendedDataRecordEx_GetEventExtendedDataRecordEx_EvtInfo_PS_ECUSUPPLY_LOW: RteEventRef=OpEventGetEventExtendedDataRecordEx_GetEventExtendedDataRecordEx_EvtInfo_PS_ECUSUPPLY_LOW
          OpEventGetEventExtendedDataRecordEx_GetEventExtendedDataRecordEx_Event_PS_ECUSUPPLY_LOW: RteEventRef=OpEventGetEventExtendedDataRecordEx_GetEventExtendedDataRecordEx_Event_PS_ECUSUPPLY_LOW
          OpEventGetEventExtendedDataRecordEx_GetEventExtendedDataRecordEx_EvtInfo_VcEvChkSumHvSysRlySts: RteEventRef=OpEventGetEventExtendedDataRecordEx_GetEventExtendedDataRecordEx_EvtInfo_VcEvChkSumHvSysRlySts
          OpEventGetEventExtendedDataRecordEx_GetEventExtendedDataRecordEx_Event_VcEvChkSumHvSysRlySts: RteEventRef=OpEventGetEventExtendedDataRecordEx_GetEventExtendedDataRecordEx_Event_VcEvChkSumHvSysRlySts
          OpEventGetEventExtendedDataRecordEx_GetEventExtendedDataRecordEx_EvtInfo_VcEvMonMode: RteEventRef=OpEventGetEventExtendedDataRecordEx_GetEventExtendedDataRecordEx_EvtInfo_VcEvMonMode
          OpEventGetEventExtendedDataRecordEx_GetEventExtendedDataRecordEx_Event_VcEvMonMode: RteEventRef=OpEventGetEventExtendedDataRecordEx_GetEventExtendedDataRecordEx_Event_VcEvMonMode
          OpEventGetEventExtendedDataRecordEx_GetEventExtendedDataRecordEx_EvtInfo_INV_IAC_OC_SWP: RteEventRef=OpEventGetEventExtendedDataRecordEx_GetEventExtendedDataRecordEx_EvtInfo_INV_IAC_OC_SWP
          OpEventGetEventExtendedDataRecordEx_GetEventExtendedDataRecordEx_Event_INV_IAC_OC_SWP: RteEventRef=OpEventGetEventExtendedDataRecordEx_GetEventExtendedDataRecordEx_Event_INV_IAC_OC_SWP
          OpEventGetEventExtendedDataRecordEx_GetEventExtendedDataRecordEx_EvtInfo_INV_IMMO_AUTHFAIL: RteEventRef=OpEventGetEventExtendedDataRecordEx_GetEventExtendedDataRecordEx_EvtInfo_INV_IMMO_AUTHFAIL
          OpEventGetEventExtendedDataRecordEx_GetEventExtendedDataRecordEx_Event_INV_IMMO_AUTHFAIL: RteEventRef=OpEventGetEventExtendedDataRecordEx_GetEventExtendedDataRecordEx_Event_INV_IMMO_AUTHFAIL
          OpEventGetEventExtendedDataRecordEx_GetEventExtendedDataRecordEx_EvtInfo_PA_OpenCirc_FLT: RteEventRef=OpEventGetEventExtendedDataRecordEx_GetEventExtendedDataRecordEx_EvtInfo_PA_OpenCirc_FLT
          OpEventGetEventExtendedDataRecordEx_GetEventExtendedDataRecordEx_Event_PA_OpenCirc_FLT: RteEventRef=OpEventGetEventExtendedDataRecordEx_GetEventExtendedDataRecordEx_Event_PA_OpenCirc_FLT
          OpEventGetEventExtendedDataRecordEx_GetEventExtendedDataRecordEx_EvtInfo_INV_IAC_V_ELEC_HI: RteEventRef=OpEventGetEventExtendedDataRecordEx_GetEventExtendedDataRecordEx_EvtInfo_INV_IAC_V_ELEC_HI
          OpEventGetEventExtendedDataRecordEx_GetEventExtendedDataRecordEx_Event_INV_IAC_V_ELEC_HI: RteEventRef=OpEventGetEventExtendedDataRecordEx_GetEventExtendedDataRecordEx_Event_INV_IAC_V_ELEC_HI
          OpEventGetEventExtendedDataRecordEx_GetEventExtendedDataRecordEx_EvtInfo_VCEvEcmPropFr04Tioutd: RteEventRef=OpEventGetEventExtendedDataRecordEx_GetEventExtendedDataRecordEx_EvtInfo_VCEvEcmPropFr04Tioutd
          OpEventGetEventExtendedDataRecordEx_GetEventExtendedDataRecordEx_Event_VCEvEcmPropFr04Tioutd: RteEventRef=OpEventGetEventExtendedDataRecordEx_GetEventExtendedDataRecordEx_Event_VCEvEcmPropFr04Tioutd
          OpEventGetEventExtendedDataRecordEx_GetEventExtendedDataRecordEx_EvtInfo_VcEvMonTrqActPlaus: RteEventRef=OpEventGetEventExtendedDataRecordEx_GetEventExtendedDataRecordEx_EvtInfo_VcEvMonTrqActPlaus
          OpEventGetEventExtendedDataRecordEx_GetEventExtendedDataRecordEx_Event_VcEvMonTrqActPlaus: RteEventRef=OpEventGetEventExtendedDataRecordEx_GetEventExtendedDataRecordEx_Event_VcEvMonTrqActPlaus
          OpEventGetEventExtendedDataRecordEx_GetEventExtendedDataRecordEx_EvtInfo_VcEvMonTrqAct: RteEventRef=OpEventGetEventExtendedDataRecordEx_GetEventExtendedDataRecordEx_EvtInfo_VcEvMonTrqAct
          OpEventGetEventExtendedDataRecordEx_GetEventExtendedDataRecordEx_Event_VcEvMonTrqAct: RteEventRef=OpEventGetEventExtendedDataRecordEx_GetEventExtendedDataRecordEx_Event_VcEvMonTrqAct
          OpEventGetEventExtendedDataRecordEx_GetEventExtendedDataRecordEx_EvtInfo_INV_RSLVR_COS_ELEC_LO: RteEventRef=OpEventGetEventExtendedDataRecordEx_GetEventExtendedDataRecordEx_EvtInfo_INV_RSLVR_COS_ELEC_LO
          OpEventGetEventExtendedDataRecordEx_GetEventExtendedDataRecordEx_Event_INV_RSLVR_COS_ELEC_LO: RteEventRef=OpEventGetEventExtendedDataRecordEx_GetEventExtendedDataRecordEx_Event_INV_RSLVR_COS_ELEC_LO
          OpEventGetEventExtendedDataRecordEx_GetEventExtendedDataRecordEx_EvtInfo_INV_COOLT_INLET_TEMP_HWP: RteEventRef=OpEventGetEventExtendedDataRecordEx_GetEventExtendedDataRecordEx_EvtInfo_INV_COOLT_INLET_TEMP_HWP
          OpEventGetEventExtendedDataRecordEx_GetEventExtendedDataRecordEx_Event_INV_COOLT_INLET_TEMP_HWP: RteEventRef=OpEventGetEventExtendedDataRecordEx_GetEventExtendedDataRecordEx_Event_INV_COOLT_INLET_TEMP_HWP
          OpEventGetEventExtendedDataRecordEx_GetEventExtendedDataRecordEx_EvtInfo_VCEvEcmPropFr11Tioutd: RteEventRef=OpEventGetEventExtendedDataRecordEx_GetEventExtendedDataRecordEx_EvtInfo_VCEvEcmPropFr11Tioutd
          OpEventGetEventExtendedDataRecordEx_GetEventExtendedDataRecordEx_Event_VCEvEcmPropFr11Tioutd: RteEventRef=OpEventGetEventExtendedDataRecordEx_GetEventExtendedDataRecordEx_Event_VCEvEcmPropFr11Tioutd
          OpEventGetEventExtendedDataRecordEx_GetEventExtendedDataRecordEx_EvtInfo_PS_KL30_RNG_HI: RteEventRef=OpEventGetEventExtendedDataRecordEx_GetEventExtendedDataRecordEx_EvtInfo_PS_KL30_RNG_HI
          OpEventGetEventExtendedDataRecordEx_GetEventExtendedDataRecordEx_Event_PS_KL30_RNG_HI: RteEventRef=OpEventGetEventExtendedDataRecordEx_GetEventExtendedDataRecordEx_Event_PS_KL30_RNG_HI
          OpEventGetEventExtendedDataRecordEx_GetEventExtendedDataRecordEx_EvtInfo_INV_IAC_OC_HWP: RteEventRef=OpEventGetEventExtendedDataRecordEx_GetEventExtendedDataRecordEx_EvtInfo_INV_IAC_OC_HWP
          OpEventGetEventExtendedDataRecordEx_GetEventExtendedDataRecordEx_Event_INV_IAC_OC_HWP: RteEventRef=OpEventGetEventExtendedDataRecordEx_GetEventExtendedDataRecordEx_Event_INV_IAC_OC_HWP
          OpEventGetEventExtendedDataRecordEx_GetEventExtendedDataRecordEx_EvtInfo_INV_RSLVR_COS_RNG_HI: RteEventRef=OpEventGetEventExtendedDataRecordEx_GetEventExtendedDataRecordEx_EvtInfo_INV_RSLVR_COS_RNG_HI
          OpEventGetEventExtendedDataRecordEx_GetEventExtendedDataRecordEx_Event_INV_RSLVR_COS_RNG_HI: RteEventRef=OpEventGetEventExtendedDataRecordEx_GetEventExtendedDataRecordEx_Event_INV_RSLVR_COS_RNG_HI
          OpEventGetEventExtendedDataRecordEx_GetEventExtendedDataRecordEx_EvtInfo_INV_IAC_U_ELEC_HI: RteEventRef=OpEventGetEventExtendedDataRecordEx_GetEventExtendedDataRecordEx_EvtInfo_INV_IAC_U_ELEC_HI
          OpEventGetEventExtendedDataRecordEx_GetEventExtendedDataRecordEx_Event_INV_IAC_U_ELEC_HI: RteEventRef=OpEventGetEventExtendedDataRecordEx_GetEventExtendedDataRecordEx_Event_INV_IAC_U_ELEC_HI
          OpEventGetEventExtendedDataRecordEx_GetEventExtendedDataRecordEx_EvtInfo_INV_IAC_V_RNG_LO: RteEventRef=OpEventGetEventExtendedDataRecordEx_GetEventExtendedDataRecordEx_EvtInfo_INV_IAC_V_RNG_LO
          OpEventGetEventExtendedDataRecordEx_GetEventExtendedDataRecordEx_Event_INV_IAC_V_RNG_LO: RteEventRef=OpEventGetEventExtendedDataRecordEx_GetEventExtendedDataRecordEx_Event_INV_IAC_V_RNG_LO
          OpEventGetEventExtendedDataRecordEx_GetEventExtendedDataRecordEx_EvtInfo_INV_IAC_U_RNG_HI: RteEventRef=OpEventGetEventExtendedDataRecordEx_GetEventExtendedDataRecordEx_EvtInfo_INV_IAC_U_RNG_HI
          OpEventGetEventExtendedDataRecordEx_GetEventExtendedDataRecordEx_Event_INV_IAC_U_RNG_HI: RteEventRef=OpEventGetEventExtendedDataRecordEx_GetEventExtendedDataRecordEx_Event_INV_IAC_U_RNG_HI
          OpEventGetEventExtendedDataRecordEx_GetEventExtendedDataRecordEx_EvtInfo_VCEvEcmPropFr25Tioutd: RteEventRef=OpEventGetEventExtendedDataRecordEx_GetEventExtendedDataRecordEx_EvtInfo_VCEvEcmPropFr25Tioutd
          OpEventGetEventExtendedDataRecordEx_GetEventExtendedDataRecordEx_Event_VCEvEcmPropFr25Tioutd: RteEventRef=OpEventGetEventExtendedDataRecordEx_GetEventExtendedDataRecordEx_Event_VCEvEcmPropFr25Tioutd
          OpEventGetEventExtendedDataRecordEx_GetEventExtendedDataRecordEx_EvtInfo_INV_IGBT_TEMP_W_RNG_LO: RteEventRef=OpEventGetEventExtendedDataRecordEx_GetEventExtendedDataRecordEx_EvtInfo_INV_IGBT_TEMP_W_RNG_LO
          OpEventGetEventExtendedDataRecordEx_GetEventExtendedDataRecordEx_Event_INV_IGBT_TEMP_W_RNG_LO: RteEventRef=OpEventGetEventExtendedDataRecordEx_GetEventExtendedDataRecordEx_Event_INV_IGBT_TEMP_W_RNG_LO
          OpEventGetEventExtendedDataRecordEx_GetEventExtendedDataRecordEx_EvtInfo_PSnsr_RNG_NOK: RteEventRef=OpEventGetEventExtendedDataRecordEx_GetEventExtendedDataRecordEx_EvtInfo_PSnsr_RNG_NOK
          OpEventGetEventExtendedDataRecordEx_GetEventExtendedDataRecordEx_Event_PSnsr_RNG_NOK: RteEventRef=OpEventGetEventExtendedDataRecordEx_GetEventExtendedDataRecordEx_Event_PSnsr_RNG_NOK
          OpEventGetEventExtendedDataRecordEx_GetEventExtendedDataRecordEx_EvtInfo_INV_RSLVR_COS_RNG_NOK: RteEventRef=OpEventGetEventExtendedDataRecordEx_GetEventExtendedDataRecordEx_EvtInfo_INV_RSLVR_COS_RNG_NOK
          OpEventGetEventExtendedDataRecordEx_GetEventExtendedDataRecordEx_Event_INV_RSLVR_COS_RNG_NOK: RteEventRef=OpEventGetEventExtendedDataRecordEx_GetEventExtendedDataRecordEx_Event_INV_RSLVR_COS_RNG_NOK
          OpEventGetEventExtendedDataRecordEx_GetEventExtendedDataRecordEx_EvtInfo_PS_DRVB_Fault: RteEventRef=OpEventGetEventExtendedDataRecordEx_GetEventExtendedDataRecordEx_EvtInfo_PS_DRVB_Fault
          OpEventGetEventExtendedDataRecordEx_GetEventExtendedDataRecordEx_Event_PS_DRVB_Fault: RteEventRef=OpEventGetEventExtendedDataRecordEx_GetEventExtendedDataRecordEx_Event_PS_DRVB_Fault
          OpEventGetEventExtendedDataRecordEx_GetEventExtendedDataRecordEx_EvtInfo_INV_CU_TEMP1_RNG_NOK: RteEventRef=OpEventGetEventExtendedDataRecordEx_GetEventExtendedDataRecordEx_EvtInfo_INV_CU_TEMP1_RNG_NOK
          OpEventGetEventExtendedDataRecordEx_GetEventExtendedDataRecordEx_Event_INV_CU_TEMP1_RNG_NOK: RteEventRef=OpEventGetEventExtendedDataRecordEx_GetEventExtendedDataRecordEx_Event_INV_CU_TEMP1_RNG_NOK
          OpEventGetEventExtendedDataRecordEx_GetEventExtendedDataRecordEx_EvtInfo_VcEvCntr: RteEventRef=OpEventGetEventExtendedDataRecordEx_GetEventExtendedDataRecordEx_EvtInfo_VcEvCntr
          OpEventGetEventExtendedDataRecordEx_GetEventExtendedDataRecordEx_Event_VcEvCntr: RteEventRef=OpEventGetEventExtendedDataRecordEx_GetEventExtendedDataRecordEx_Event_VcEvCntr
          OpEventGetEventExtendedDataRecordEx_GetEventExtendedDataRecordEx_EvtInfo_INV_RSLVR_SIN_AMP: RteEventRef=OpEventGetEventExtendedDataRecordEx_GetEventExtendedDataRecordEx_EvtInfo_INV_RSLVR_SIN_AMP
          OpEventGetEventExtendedDataRecordEx_GetEventExtendedDataRecordEx_Event_INV_RSLVR_SIN_AMP: RteEventRef=OpEventGetEventExtendedDataRecordEx_GetEventExtendedDataRecordEx_Event_INV_RSLVR_SIN_AMP
          OpEventGetEventExtendedDataRecordEx_GetEventExtendedDataRecordEx_EvtInfo_INV_UHVDC_2_RNG_HI: RteEventRef=OpEventGetEventExtendedDataRecordEx_GetEventExtendedDataRecordEx_EvtInfo_INV_UHVDC_2_RNG_HI
          OpEventGetEventExtendedDataRecordEx_GetEventExtendedDataRecordEx_Event_INV_UHVDC_2_RNG_HI: RteEventRef=OpEventGetEventExtendedDataRecordEx_GetEventExtendedDataRecordEx_Event_INV_UHVDC_2_RNG_HI
          OpEventGetEventExtendedDataRecordEx_GetEventExtendedDataRecordEx_EvtInfo_INV_IGBT_TEMP_U_GRDT: RteEventRef=OpEventGetEventExtendedDataRecordEx_GetEventExtendedDataRecordEx_EvtInfo_INV_IGBT_TEMP_U_GRDT
          OpEventGetEventExtendedDataRecordEx_GetEventExtendedDataRecordEx_Event_INV_IGBT_TEMP_U_GRDT: RteEventRef=OpEventGetEventExtendedDataRecordEx_GetEventExtendedDataRecordEx_Event_INV_IGBT_TEMP_U_GRDT
          OpEventGetEventExtendedDataRecordEx_GetEventExtendedDataRecordEx_EvtInfo_MON_TQ_PLAUS_PWR_MDL: RteEventRef=OpEventGetEventExtendedDataRecordEx_GetEventExtendedDataRecordEx_EvtInfo_MON_TQ_PLAUS_PWR_MDL
          OpEventGetEventExtendedDataRecordEx_GetEventExtendedDataRecordEx_Event_MON_TQ_PLAUS_PWR_MDL: RteEventRef=OpEventGetEventExtendedDataRecordEx_GetEventExtendedDataRecordEx_Event_MON_TQ_PLAUS_PWR_MDL
          OpEventGetEventExtendedDataRecordEx_GetEventExtendedDataRecordEx_EvtInfo_INV_IGBT_TEMP_W_PLAUS: RteEventRef=OpEventGetEventExtendedDataRecordEx_GetEventExtendedDataRecordEx_EvtInfo_INV_IGBT_TEMP_W_PLAUS
          OpEventGetEventExtendedDataRecordEx_GetEventExtendedDataRecordEx_Event_INV_IGBT_TEMP_W_PLAUS: RteEventRef=OpEventGetEventExtendedDataRecordEx_GetEventExtendedDataRecordEx_Event_INV_IGBT_TEMP_W_PLAUS
          OpEventGetEventExtendedDataRecordEx_GetEventExtendedDataRecordEx_EvtInfo_PS_BLDC_UV_FLT: RteEventRef=OpEventGetEventExtendedDataRecordEx_GetEventExtendedDataRecordEx_EvtInfo_PS_BLDC_UV_FLT
          OpEventGetEventExtendedDataRecordEx_GetEventExtendedDataRecordEx_Event_PS_BLDC_UV_FLT: RteEventRef=OpEventGetEventExtendedDataRecordEx_GetEventExtendedDataRecordEx_Event_PS_BLDC_UV_FLT
          OpEventGetEventExtendedDataRecordEx_GetEventExtendedDataRecordEx_EvtInfo_INV_IAC_V_OFFS: RteEventRef=OpEventGetEventExtendedDataRecordEx_GetEventExtendedDataRecordEx_EvtInfo_INV_IAC_V_OFFS
          OpEventGetEventExtendedDataRecordEx_GetEventExtendedDataRecordEx_Event_INV_IAC_V_OFFS: RteEventRef=OpEventGetEventExtendedDataRecordEx_GetEventExtendedDataRecordEx_Event_INV_IAC_V_OFFS
          OpEventGetEventExtendedDataRecordEx_GetEventExtendedDataRecordEx_EvtInfo_INV_RSLVR_EXCT_FREQ_RNG_NOK: RteEventRef=OpEventGetEventExtendedDataRecordEx_GetEventExtendedDataRecordEx_EvtInfo_INV_RSLVR_EXCT_FREQ_RNG_NOK
          OpEventGetEventExtendedDataRecordEx_GetEventExtendedDataRecordEx_Event_INV_RSLVR_EXCT_FREQ_RNG_NOK: RteEventRef=OpEventGetEventExtendedDataRecordEx_GetEventExtendedDataRecordEx_Event_INV_RSLVR_EXCT_FREQ_RNG_NOK
          OpEventGetEventExtendedDataRecordEx_GetEventExtendedDataRecordEx_EvtInfo_PS_KL30_RNG_LO: RteEventRef=OpEventGetEventExtendedDataRecordEx_GetEventExtendedDataRecordEx_EvtInfo_PS_KL30_RNG_LO
          OpEventGetEventExtendedDataRecordEx_GetEventExtendedDataRecordEx_Event_PS_KL30_RNG_LO: RteEventRef=OpEventGetEventExtendedDataRecordEx_GetEventExtendedDataRecordEx_Event_PS_KL30_RNG_LO
          OpEventGetEventExtendedDataRecordEx_GetEventExtendedDataRecordEx_EvtInfo_INV_RSLVR_COS_RNG_LO: RteEventRef=OpEventGetEventExtendedDataRecordEx_GetEventExtendedDataRecordEx_EvtInfo_INV_RSLVR_COS_RNG_LO
          OpEventGetEventExtendedDataRecordEx_GetEventExtendedDataRecordEx_Event_INV_RSLVR_COS_RNG_LO: RteEventRef=OpEventGetEventExtendedDataRecordEx_GetEventExtendedDataRecordEx_Event_INV_RSLVR_COS_RNG_LO
          OpEventGetEventExtendedDataRecordEx_GetEventExtendedDataRecordEx_EvtInfo_PSnsr_ELE_FLT: RteEventRef=OpEventGetEventExtendedDataRecordEx_GetEventExtendedDataRecordEx_EvtInfo_PSnsr_ELE_FLT
          OpEventGetEventExtendedDataRecordEx_GetEventExtendedDataRecordEx_Event_PSnsr_ELE_FLT: RteEventRef=OpEventGetEventExtendedDataRecordEx_GetEventExtendedDataRecordEx_Event_PSnsr_ELE_FLT
          OpEventGetEventExtendedDataRecordEx_GetEventExtendedDataRecordEx_EvtInfo_INV_RSLVR_SIN_COS_PLAUS_AMP: RteEventRef=OpEventGetEventExtendedDataRecordEx_GetEventExtendedDataRecordEx_EvtInfo_INV_RSLVR_SIN_COS_PLAUS_AMP
          OpEventGetEventExtendedDataRecordEx_GetEventExtendedDataRecordEx_Event_INV_RSLVR_SIN_COS_PLAUS_AMP: RteEventRef=OpEventGetEventExtendedDataRecordEx_GetEventExtendedDataRecordEx_Event_INV_RSLVR_SIN_COS_PLAUS_AMP
          OpEventGetEventExtendedDataRecordEx_GetEventExtendedDataRecordEx_EvtInfo_INV_IAC_U_ELEC_LO: RteEventRef=OpEventGetEventExtendedDataRecordEx_GetEventExtendedDataRecordEx_EvtInfo_INV_IAC_U_ELEC_LO
          OpEventGetEventExtendedDataRecordEx_GetEventExtendedDataRecordEx_Event_INV_IAC_U_ELEC_LO: RteEventRef=OpEventGetEventExtendedDataRecordEx_GetEventExtendedDataRecordEx_Event_INV_IAC_U_ELEC_LO
          OpEventGetEventExtendedDataRecordEx_GetEventExtendedDataRecordEx_EvtInfo_INV_RSLVR_EXCT_ELEC_HI: RteEventRef=OpEventGetEventExtendedDataRecordEx_GetEventExtendedDataRecordEx_EvtInfo_INV_RSLVR_EXCT_ELEC_HI
          OpEventGetEventExtendedDataRecordEx_GetEventExtendedDataRecordEx_Event_INV_RSLVR_EXCT_ELEC_HI: RteEventRef=OpEventGetEventExtendedDataRecordEx_GetEventExtendedDataRecordEx_Event_INV_RSLVR_EXCT_ELEC_HI
          OpEventGetEventExtendedDataRecordEx_GetEventExtendedDataRecordEx_EvtInfo_INV_IAC_U_RNG_LO: RteEventRef=OpEventGetEventExtendedDataRecordEx_GetEventExtendedDataRecordEx_EvtInfo_INV_IAC_U_RNG_LO
          OpEventGetEventExtendedDataRecordEx_GetEventExtendedDataRecordEx_Event_INV_IAC_U_RNG_LO: RteEventRef=OpEventGetEventExtendedDataRecordEx_GetEventExtendedDataRecordEx_Event_INV_IAC_U_RNG_LO
          OpEventGetEventExtendedDataRecordEx_GetEventExtendedDataRecordEx_EvtInfo_INV_IAC_V_RNG_HI: RteEventRef=OpEventGetEventExtendedDataRecordEx_GetEventExtendedDataRecordEx_EvtInfo_INV_IAC_V_RNG_HI
          OpEventGetEventExtendedDataRecordEx_GetEventExtendedDataRecordEx_Event_INV_IAC_V_RNG_HI: RteEventRef=OpEventGetEventExtendedDataRecordEx_GetEventExtendedDataRecordEx_Event_INV_IAC_V_RNG_HI
          OpEventGetEventExtendedDataRecordEx_GetEventExtendedDataRecordEx_EvtInfo_INV_IGBT_TEMP_U_PLAUS: RteEventRef=OpEventGetEventExtendedDataRecordEx_GetEventExtendedDataRecordEx_EvtInfo_INV_IGBT_TEMP_U_PLAUS
          OpEventGetEventExtendedDataRecordEx_GetEventExtendedDataRecordEx_Event_INV_IGBT_TEMP_U_PLAUS: RteEventRef=OpEventGetEventExtendedDataRecordEx_GetEventExtendedDataRecordEx_Event_INV_IGBT_TEMP_U_PLAUS
          OpEventGetEventExtendedDataRecordEx_GetEventExtendedDataRecordEx_EvtInfo_INV_RSLVR_OFFS_DFT: RteEventRef=OpEventGetEventExtendedDataRecordEx_GetEventExtendedDataRecordEx_EvtInfo_INV_RSLVR_OFFS_DFT
          OpEventGetEventExtendedDataRecordEx_GetEventExtendedDataRecordEx_Event_INV_RSLVR_OFFS_DFT: RteEventRef=OpEventGetEventExtendedDataRecordEx_GetEventExtendedDataRecordEx_Event_INV_RSLVR_OFFS_DFT
          OpEventGetEventExtendedDataRecordEx_GetEventExtendedDataRecordEx_EvtInfo_Ga_MoveOverThd: RteEventRef=OpEventGetEventExtendedDataRecordEx_GetEventExtendedDataRecordEx_EvtInfo_Ga_MoveOverThd
          OpEventGetEventExtendedDataRecordEx_GetEventExtendedDataRecordEx_Event_Ga_MoveOverThd: RteEventRef=OpEventGetEventExtendedDataRecordEx_GetEventExtendedDataRecordEx_Event_Ga_MoveOverThd
          OpEventGetEventExtendedDataRecordEx_GetEventExtendedDataRecordEx_EvtInfo_VcEvMonIPH: RteEventRef=OpEventGetEventExtendedDataRecordEx_GetEventExtendedDataRecordEx_EvtInfo_VcEvMonIPH
          OpEventGetEventExtendedDataRecordEx_GetEventExtendedDataRecordEx_Event_VcEvMonIPH: RteEventRef=OpEventGetEventExtendedDataRecordEx_GetEventExtendedDataRecordEx_Event_VcEvMonIPH
          OpEventGetEventExtendedDataRecordEx_GetEventExtendedDataRecordEx_EvtInfo_INV_RSLVR_HW_FLT: RteEventRef=OpEventGetEventExtendedDataRecordEx_GetEventExtendedDataRecordEx_EvtInfo_INV_RSLVR_HW_FLT
          OpEventGetEventExtendedDataRecordEx_GetEventExtendedDataRecordEx_Event_INV_RSLVR_HW_FLT: RteEventRef=OpEventGetEventExtendedDataRecordEx_GetEventExtendedDataRecordEx_Event_INV_RSLVR_HW_FLT
          OpEventGetEventExtendedDataRecordEx_GetEventExtendedDataRecordEx_EvtInfo_INV_RSLVR_SIN_ELEC_LO: RteEventRef=OpEventGetEventExtendedDataRecordEx_GetEventExtendedDataRecordEx_EvtInfo_INV_RSLVR_SIN_ELEC_LO
          OpEventGetEventExtendedDataRecordEx_GetEventExtendedDataRecordEx_Event_INV_RSLVR_SIN_ELEC_LO: RteEventRef=OpEventGetEventExtendedDataRecordEx_GetEventExtendedDataRecordEx_Event_INV_RSLVR_SIN_ELEC_LO
          OpEventGetEventExtendedDataRecordEx_GetEventExtendedDataRecordEx_EvtInfo_INV_IAC_W_AMP: RteEventRef=OpEventGetEventExtendedDataRecordEx_GetEventExtendedDataRecordEx_EvtInfo_INV_IAC_W_AMP
          OpEventGetEventExtendedDataRecordEx_GetEventExtendedDataRecordEx_Event_INV_IAC_W_AMP: RteEventRef=OpEventGetEventExtendedDataRecordEx_GetEventExtendedDataRecordEx_Event_INV_IAC_W_AMP
          OpEventGetEventExtendedDataRecordEx_GetEventExtendedDataRecordEx_EvtInfo_VCC_OverVoltage: RteEventRef=OpEventGetEventExtendedDataRecordEx_GetEventExtendedDataRecordEx_EvtInfo_VCC_OverVoltage
          OpEventGetEventExtendedDataRecordEx_GetEventExtendedDataRecordEx_Event_VCC_OverVoltage: RteEventRef=OpEventGetEventExtendedDataRecordEx_GetEventExtendedDataRecordEx_Event_VCC_OverVoltage
          OpEventGetEventExtendedDataRecordEx_GetEventExtendedDataRecordEx_EvtInfo_PS_BLDC_OV_FLT: RteEventRef=OpEventGetEventExtendedDataRecordEx_GetEventExtendedDataRecordEx_EvtInfo_PS_BLDC_OV_FLT
          OpEventGetEventExtendedDataRecordEx_GetEventExtendedDataRecordEx_Event_PS_BLDC_OV_FLT: RteEventRef=OpEventGetEventExtendedDataRecordEx_GetEventExtendedDataRecordEx_Event_PS_BLDC_OV_FLT
          OpEventGetEventExtendedDataRecordEx_GetEventExtendedDataRecordEx_EvtInfo_AURIX_EEPROM_FLT: RteEventRef=OpEventGetEventExtendedDataRecordEx_GetEventExtendedDataRecordEx_EvtInfo_AURIX_EEPROM_FLT
          OpEventGetEventExtendedDataRecordEx_GetEventExtendedDataRecordEx_Event_AURIX_EEPROM_FLT: RteEventRef=OpEventGetEventExtendedDataRecordEx_GetEventExtendedDataRecordEx_Event_AURIX_EEPROM_FLT
          OpEventGetEventExtendedDataRecordEx_GetEventExtendedDataRecordEx_EvtInfo_FS_MONITIOR_ASC_FW_FLT: RteEventRef=OpEventGetEventExtendedDataRecordEx_GetEventExtendedDataRecordEx_EvtInfo_FS_MONITIOR_ASC_FW_FLT
          OpEventGetEventExtendedDataRecordEx_GetEventExtendedDataRecordEx_Event_FS_MONITIOR_ASC_FW_FLT: RteEventRef=OpEventGetEventExtendedDataRecordEx_GetEventExtendedDataRecordEx_Event_FS_MONITIOR_ASC_FW_FLT
          OpEventGetEventExtendedDataRecordEx_GetEventExtendedDataRecordEx_EvtInfo_VCEvSrsPropFr02Tioutd: RteEventRef=OpEventGetEventExtendedDataRecordEx_GetEventExtendedDataRecordEx_EvtInfo_VCEvSrsPropFr02Tioutd
          OpEventGetEventExtendedDataRecordEx_GetEventExtendedDataRecordEx_Event_VCEvSrsPropFr02Tioutd: RteEventRef=OpEventGetEventExtendedDataRecordEx_GetEventExtendedDataRecordEx_Event_VCEvSrsPropFr02Tioutd
          OpEventGetEventExtendedDataRecordEx_GetEventExtendedDataRecordEx_EvtInfo_VcEvMonErrMode: RteEventRef=OpEventGetEventExtendedDataRecordEx_GetEventExtendedDataRecordEx_EvtInfo_VcEvMonErrMode
          OpEventGetEventExtendedDataRecordEx_GetEventExtendedDataRecordEx_Event_VcEvMonErrMode: RteEventRef=OpEventGetEventExtendedDataRecordEx_GetEventExtendedDataRecordEx_Event_VcEvMonErrMode
          OpEventGetEventExtendedDataRecordEx_GetEventExtendedDataRecordEx_EvtInfo_AURIX_RST_MPL: RteEventRef=OpEventGetEventExtendedDataRecordEx_GetEventExtendedDataRecordEx_EvtInfo_AURIX_RST_MPL
          OpEventGetEventExtendedDataRecordEx_GetEventExtendedDataRecordEx_Event_AURIX_RST_MPL: RteEventRef=OpEventGetEventExtendedDataRecordEx_GetEventExtendedDataRecordEx_Event_AURIX_RST_MPL
          OpEventGetEventExtendedDataRecordEx_GetEventExtendedDataRecordEx_EvtInfo_VcEvNodeMisECM: RteEventRef=OpEventGetEventExtendedDataRecordEx_GetEventExtendedDataRecordEx_EvtInfo_VcEvNodeMisECM
          OpEventGetEventExtendedDataRecordEx_GetEventExtendedDataRecordEx_Event_VcEvNodeMisECM: RteEventRef=OpEventGetEventExtendedDataRecordEx_GetEventExtendedDataRecordEx_Event_VcEvNodeMisECM
          OpEventGetEventExtendedDataRecordEx_GetEventExtendedDataRecordEx_EvtInfo_PS_KL30_PLAUS: RteEventRef=OpEventGetEventExtendedDataRecordEx_GetEventExtendedDataRecordEx_EvtInfo_PS_KL30_PLAUS
          OpEventGetEventExtendedDataRecordEx_GetEventExtendedDataRecordEx_Event_PS_KL30_PLAUS: RteEventRef=OpEventGetEventExtendedDataRecordEx_GetEventExtendedDataRecordEx_Event_PS_KL30_PLAUS
          OpEventGetEventExtendedDataRecordEx_GetEventExtendedDataRecordEx_EvtInfo_INV_IAC_W_ELEC_HI: RteEventRef=OpEventGetEventExtendedDataRecordEx_GetEventExtendedDataRecordEx_EvtInfo_INV_IAC_W_ELEC_HI
          OpEventGetEventExtendedDataRecordEx_GetEventExtendedDataRecordEx_Event_INV_IAC_W_ELEC_HI: RteEventRef=OpEventGetEventExtendedDataRecordEx_GetEventExtendedDataRecordEx_Event_INV_IAC_W_ELEC_HI
          OpEventGetEventExtendedDataRecordEx_GetEventExtendedDataRecordEx_EvtInfo_VCEvVddmPropFr19Tioutd: RteEventRef=OpEventGetEventExtendedDataRecordEx_GetEventExtendedDataRecordEx_EvtInfo_VCEvVddmPropFr19Tioutd
          OpEventGetEventExtendedDataRecordEx_GetEventExtendedDataRecordEx_Event_VCEvVddmPropFr19Tioutd: RteEventRef=OpEventGetEventExtendedDataRecordEx_GetEventExtendedDataRecordEx_Event_VCEvVddmPropFr19Tioutd
          OpEventGetEventExtendedDataRecordEx_GetEventExtendedDataRecordEx_EvtInfo_INV_TEMP_DCHA_HW: RteEventRef=OpEventGetEventExtendedDataRecordEx_GetEventExtendedDataRecordEx_EvtInfo_INV_TEMP_DCHA_HW
          OpEventGetEventExtendedDataRecordEx_GetEventExtendedDataRecordEx_Event_INV_TEMP_DCHA_HW: RteEventRef=OpEventGetEventExtendedDataRecordEx_GetEventExtendedDataRecordEx_Event_INV_TEMP_DCHA_HW
          OpEventGetEventExtendedDataRecordEx_GetEventExtendedDataRecordEx_EvtInfo_VcEvPropCANGlbTiOutd: RteEventRef=OpEventGetEventExtendedDataRecordEx_GetEventExtendedDataRecordEx_EvtInfo_VcEvPropCANGlbTiOutd
          OpEventGetEventExtendedDataRecordEx_GetEventExtendedDataRecordEx_Event_VcEvPropCANGlbTiOutd: RteEventRef=OpEventGetEventExtendedDataRecordEx_GetEventExtendedDataRecordEx_Event_VcEvPropCANGlbTiOutd
          OpEventGetEventExtendedDataRecordEx_GetEventExtendedDataRecordEx_EvtInfo_INV_EM_STATOR_TEMP2_RNG_NOK: RteEventRef=OpEventGetEventExtendedDataRecordEx_GetEventExtendedDataRecordEx_EvtInfo_INV_EM_STATOR_TEMP2_RNG_NOK
          OpEventGetEventExtendedDataRecordEx_GetEventExtendedDataRecordEx_Event_INV_EM_STATOR_TEMP2_RNG_NOK: RteEventRef=OpEventGetEventExtendedDataRecordEx_GetEventExtendedDataRecordEx_Event_INV_EM_STATOR_TEMP2_RNG_NOK
          OpEventGetEventExtendedDataRecordEx_GetEventExtendedDataRecordEx_EvtInfo_INV_UHVDC_OV_HWP: RteEventRef=OpEventGetEventExtendedDataRecordEx_GetEventExtendedDataRecordEx_EvtInfo_INV_UHVDC_OV_HWP
          OpEventGetEventExtendedDataRecordEx_GetEventExtendedDataRecordEx_Event_INV_UHVDC_OV_HWP: RteEventRef=OpEventGetEventExtendedDataRecordEx_GetEventExtendedDataRecordEx_Event_INV_UHVDC_OV_HWP
          OpEventGetEventExtendedDataRecordEx_GetEventExtendedDataRecordEx_EvtInfo_Ga_FindEngleAngleFailed: RteEventRef=OpEventGetEventExtendedDataRecordEx_GetEventExtendedDataRecordEx_EvtInfo_Ga_FindEngleAngleFailed
          OpEventGetEventExtendedDataRecordEx_GetEventExtendedDataRecordEx_Event_Ga_FindEngleAngleFailed: RteEventRef=OpEventGetEventExtendedDataRecordEx_GetEventExtendedDataRecordEx_Event_Ga_FindEngleAngleFailed
          OpEventGetEventExtendedDataRecordEx_GetEventExtendedDataRecordEx_EvtInfo_VcEvMonTrqCmp: RteEventRef=OpEventGetEventExtendedDataRecordEx_GetEventExtendedDataRecordEx_EvtInfo_VcEvMonTrqCmp
          OpEventGetEventExtendedDataRecordEx_GetEventExtendedDataRecordEx_Event_VcEvMonTrqCmp: RteEventRef=OpEventGetEventExtendedDataRecordEx_GetEventExtendedDataRecordEx_Event_VcEvMonTrqCmp
          OpEventGetEventExtendedDataRecordEx_GetEventExtendedDataRecordEx_EvtInfo_INV_IGBT_TEMP_V_RNG_LO: RteEventRef=OpEventGetEventExtendedDataRecordEx_GetEventExtendedDataRecordEx_EvtInfo_INV_IGBT_TEMP_V_RNG_LO
          OpEventGetEventExtendedDataRecordEx_GetEventExtendedDataRecordEx_Event_INV_IGBT_TEMP_V_RNG_LO: RteEventRef=OpEventGetEventExtendedDataRecordEx_GetEventExtendedDataRecordEx_Event_INV_IGBT_TEMP_V_RNG_LO
          OpEventGetEventExtendedDataRecordEx_GetEventExtendedDataRecordEx_EvtInfo_INV_CONTROL_LIMIT: RteEventRef=OpEventGetEventExtendedDataRecordEx_GetEventExtendedDataRecordEx_EvtInfo_INV_CONTROL_LIMIT
          OpEventGetEventExtendedDataRecordEx_GetEventExtendedDataRecordEx_Event_INV_CONTROL_LIMIT: RteEventRef=OpEventGetEventExtendedDataRecordEx_GetEventExtendedDataRecordEx_Event_INV_CONTROL_LIMIT
          OpEventGetEventExtendedDataRecordEx_GetEventExtendedDataRecordEx_EvtInfo_COM_CarConfigErr: RteEventRef=OpEventGetEventExtendedDataRecordEx_GetEventExtendedDataRecordEx_EvtInfo_COM_CarConfigErr
          OpEventGetEventExtendedDataRecordEx_GetEventExtendedDataRecordEx_Event_COM_CarConfigErr: RteEventRef=OpEventGetEventExtendedDataRecordEx_GetEventExtendedDataRecordEx_Event_COM_CarConfigErr
          OpEventGetEventExtendedDataRecordEx_GetEventExtendedDataRecordEx_EvtInfo_VCEvEcmPropFr08Tioutd: RteEventRef=OpEventGetEventExtendedDataRecordEx_GetEventExtendedDataRecordEx_EvtInfo_VCEvEcmPropFr08Tioutd
          OpEventGetEventExtendedDataRecordEx_GetEventExtendedDataRecordEx_Event_VCEvEcmPropFr08Tioutd: RteEventRef=OpEventGetEventExtendedDataRecordEx_GetEventExtendedDataRecordEx_Event_VCEvEcmPropFr08Tioutd
          OpEventGetEventExtendedDataRecordEx_GetEventExtendedDataRecordEx_EvtInfo_CU_TEMP1_RNG_LO: RteEventRef=OpEventGetEventExtendedDataRecordEx_GetEventExtendedDataRecordEx_EvtInfo_CU_TEMP1_RNG_LO
          OpEventGetEventExtendedDataRecordEx_GetEventExtendedDataRecordEx_Event_CU_TEMP1_RNG_LO: RteEventRef=OpEventGetEventExtendedDataRecordEx_GetEventExtendedDataRecordEx_Event_CU_TEMP1_RNG_LO
          OpEventGetEventExtendedDataRecordEx_GetEventExtendedDataRecordEx_EvtInfo_INV_EM_STATOR_TEMP2_RNG_SWT: RteEventRef=OpEventGetEventExtendedDataRecordEx_GetEventExtendedDataRecordEx_EvtInfo_INV_EM_STATOR_TEMP2_RNG_SWT
          OpEventGetEventExtendedDataRecordEx_GetEventExtendedDataRecordEx_Event_INV_EM_STATOR_TEMP2_RNG_SWT: RteEventRef=OpEventGetEventExtendedDataRecordEx_GetEventExtendedDataRecordEx_Event_INV_EM_STATOR_TEMP2_RNG_SWT
          OpEventGetEventExtendedDataRecordEx_GetEventExtendedDataRecordEx_EvtInfo_GA_BLDC_POS_FLT: RteEventRef=OpEventGetEventExtendedDataRecordEx_GetEventExtendedDataRecordEx_EvtInfo_GA_BLDC_POS_FLT
          OpEventGetEventExtendedDataRecordEx_GetEventExtendedDataRecordEx_Event_GA_BLDC_POS_FLT: RteEventRef=OpEventGetEventExtendedDataRecordEx_GetEventExtendedDataRecordEx_Event_GA_BLDC_POS_FLT
          OpEventGetEventExtendedDataRecordEx_GetEventExtendedDataRecordEx_EvtInfo_PS_WhlSnsr_FLT: RteEventRef=OpEventGetEventExtendedDataRecordEx_GetEventExtendedDataRecordEx_EvtInfo_PS_WhlSnsr_FLT
          OpEventGetEventExtendedDataRecordEx_GetEventExtendedDataRecordEx_Event_PS_WhlSnsr_FLT: RteEventRef=OpEventGetEventExtendedDataRecordEx_GetEventExtendedDataRecordEx_Event_PS_WhlSnsr_FLT
          OpEventGetEventExtendedDataRecordEx_GetEventExtendedDataRecordEx_EvtInfo_INV_EM_STATOR_TEMP_RNG_LO: RteEventRef=OpEventGetEventExtendedDataRecordEx_GetEventExtendedDataRecordEx_EvtInfo_INV_EM_STATOR_TEMP_RNG_LO
          OpEventGetEventExtendedDataRecordEx_GetEventExtendedDataRecordEx_Event_INV_EM_STATOR_TEMP_RNG_LO: RteEventRef=OpEventGetEventExtendedDataRecordEx_GetEventExtendedDataRecordEx_Event_INV_EM_STATOR_TEMP_RNG_LO
          OpEventGetEventExtendedDataRecordEx_GetEventExtendedDataRecordEx_EvtInfo_INV_RSLVR_SIN_ELEC_HI: RteEventRef=OpEventGetEventExtendedDataRecordEx_GetEventExtendedDataRecordEx_EvtInfo_INV_RSLVR_SIN_ELEC_HI
          OpEventGetEventExtendedDataRecordEx_GetEventExtendedDataRecordEx_Event_INV_RSLVR_SIN_ELEC_HI: RteEventRef=OpEventGetEventExtendedDataRecordEx_GetEventExtendedDataRecordEx_Event_INV_RSLVR_SIN_ELEC_HI
          OpEventGetEventExtendedDataRecordEx_GetEventExtendedDataRecordEx_EvtInfo_INV_RSLVR_SIN_COS_PLAUS: RteEventRef=OpEventGetEventExtendedDataRecordEx_GetEventExtendedDataRecordEx_EvtInfo_INV_RSLVR_SIN_COS_PLAUS
          OpEventGetEventExtendedDataRecordEx_GetEventExtendedDataRecordEx_Event_INV_RSLVR_SIN_COS_PLAUS: RteEventRef=OpEventGetEventExtendedDataRecordEx_GetEventExtendedDataRecordEx_Event_INV_RSLVR_SIN_COS_PLAUS
          OpEventGetEventExtendedDataRecordEx_GetEventExtendedDataRecordEx_EvtInfo_INV_RSLVR_COS_AMP: RteEventRef=OpEventGetEventExtendedDataRecordEx_GetEventExtendedDataRecordEx_EvtInfo_INV_RSLVR_COS_AMP
          OpEventGetEventExtendedDataRecordEx_GetEventExtendedDataRecordEx_Event_INV_RSLVR_COS_AMP: RteEventRef=OpEventGetEventExtendedDataRecordEx_GetEventExtendedDataRecordEx_Event_INV_RSLVR_COS_AMP
          OpEventGetEventExtendedDataRecordEx_GetEventExtendedDataRecordEx_EvtInfo_INV_GATE_DRVR_BOT_HWP: RteEventRef=OpEventGetEventExtendedDataRecordEx_GetEventExtendedDataRecordEx_EvtInfo_INV_GATE_DRVR_BOT_HWP
          OpEventGetEventExtendedDataRecordEx_GetEventExtendedDataRecordEx_Event_INV_GATE_DRVR_BOT_HWP: RteEventRef=OpEventGetEventExtendedDataRecordEx_GetEventExtendedDataRecordEx_Event_INV_GATE_DRVR_BOT_HWP
          OpEventGetEventExtendedDataRecordEx_GetEventExtendedDataRecordEx_EvtInfo_Eg_HallVolWrong: RteEventRef=OpEventGetEventExtendedDataRecordEx_GetEventExtendedDataRecordEx_EvtInfo_Eg_HallVolWrong
          OpEventGetEventExtendedDataRecordEx_GetEventExtendedDataRecordEx_Event_Eg_HallVolWrong: RteEventRef=OpEventGetEventExtendedDataRecordEx_GetEventExtendedDataRecordEx_Event_Eg_HallVolWrong
          OpEventGetEventExtendedDataRecordEx_GetEventExtendedDataRecordEx_EvtInfo_INV_RSLVR_EXCT_RNG_NOK: RteEventRef=OpEventGetEventExtendedDataRecordEx_GetEventExtendedDataRecordEx_EvtInfo_INV_RSLVR_EXCT_RNG_NOK
          OpEventGetEventExtendedDataRecordEx_GetEventExtendedDataRecordEx_Event_INV_RSLVR_EXCT_RNG_NOK: RteEventRef=OpEventGetEventExtendedDataRecordEx_GetEventExtendedDataRecordEx_Event_INV_RSLVR_EXCT_RNG_NOK
          OpEventGetEventExtendedDataRecordEx_GetEventExtendedDataRecordEx_EvtInfo_PA_OpenCirc: RteEventRef=OpEventGetEventExtendedDataRecordEx_GetEventExtendedDataRecordEx_EvtInfo_PA_OpenCirc
          OpEventGetEventExtendedDataRecordEx_GetEventExtendedDataRecordEx_Event_PA_OpenCirc: RteEventRef=OpEventGetEventExtendedDataRecordEx_GetEventExtendedDataRecordEx_Event_PA_OpenCirc
          OpEventGetEventExtendedDataRecordEx_GetEventExtendedDataRecordEx_EvtInfo_INV_RSLVR_COS_ELEC_HI: RteEventRef=OpEventGetEventExtendedDataRecordEx_GetEventExtendedDataRecordEx_EvtInfo_INV_RSLVR_COS_ELEC_HI
          OpEventGetEventExtendedDataRecordEx_GetEventExtendedDataRecordEx_Event_INV_RSLVR_COS_ELEC_HI: RteEventRef=OpEventGetEventExtendedDataRecordEx_GetEventExtendedDataRecordEx_Event_INV_RSLVR_COS_ELEC_HI
          OpEventGetEventExtendedDataRecordEx_GetEventExtendedDataRecordEx_EvtInfo_VcEvCntrHvSysRlySts: RteEventRef=OpEventGetEventExtendedDataRecordEx_GetEventExtendedDataRecordEx_EvtInfo_VcEvCntrHvSysRlySts
          OpEventGetEventExtendedDataRecordEx_GetEventExtendedDataRecordEx_Event_VcEvCntrHvSysRlySts: RteEventRef=OpEventGetEventExtendedDataRecordEx_GetEventExtendedDataRecordEx_Event_VcEvCntrHvSysRlySts
          OpEventGetEventExtendedDataRecordEx_GetEventExtendedDataRecordEx_EvtInfo_CRASH_DTC: RteEventRef=OpEventGetEventExtendedDataRecordEx_GetEventExtendedDataRecordEx_EvtInfo_CRASH_DTC
          OpEventGetEventExtendedDataRecordEx_GetEventExtendedDataRecordEx_Event_CRASH_DTC: RteEventRef=OpEventGetEventExtendedDataRecordEx_GetEventExtendedDataRecordEx_Event_CRASH_DTC
          OpEventGetEventExtendedDataRecordEx_GetEventExtendedDataRecordEx_EvtInfo_INV_IGBT_TEMP_W_RNG_HI: RteEventRef=OpEventGetEventExtendedDataRecordEx_GetEventExtendedDataRecordEx_EvtInfo_INV_IGBT_TEMP_W_RNG_HI
          OpEventGetEventExtendedDataRecordEx_GetEventExtendedDataRecordEx_Event_INV_IGBT_TEMP_W_RNG_HI: RteEventRef=OpEventGetEventExtendedDataRecordEx_GetEventExtendedDataRecordEx_Event_INV_IGBT_TEMP_W_RNG_HI
          OpEventGetEventExtendedDataRecordEx_GetEventExtendedDataRecordEx_EvtInfo_VCEvBecmPropFr02Tioutd: RteEventRef=OpEventGetEventExtendedDataRecordEx_GetEventExtendedDataRecordEx_EvtInfo_VCEvBecmPropFr02Tioutd
          OpEventGetEventExtendedDataRecordEx_GetEventExtendedDataRecordEx_Event_VCEvBecmPropFr02Tioutd: RteEventRef=OpEventGetEventExtendedDataRecordEx_GetEventExtendedDataRecordEx_Event_VCEvBecmPropFr02Tioutd
          OpEventGetEventExtendedDataRecordEx_GetEventExtendedDataRecordEx_EvtInfo_INV_IGBT_TEMP_W_GRDT: RteEventRef=OpEventGetEventExtendedDataRecordEx_GetEventExtendedDataRecordEx_EvtInfo_INV_IGBT_TEMP_W_GRDT
          OpEventGetEventExtendedDataRecordEx_GetEventExtendedDataRecordEx_Event_INV_IGBT_TEMP_W_GRDT: RteEventRef=OpEventGetEventExtendedDataRecordEx_GetEventExtendedDataRecordEx_Event_INV_IGBT_TEMP_W_GRDT
          OpEventGetEventExtendedDataRecordEx_GetEventExtendedDataRecordEx_EvtInfo_EXT_UC_SPI_FLT: RteEventRef=OpEventGetEventExtendedDataRecordEx_GetEventExtendedDataRecordEx_EvtInfo_EXT_UC_SPI_FLT
          OpEventGetEventExtendedDataRecordEx_GetEventExtendedDataRecordEx_Event_EXT_UC_SPI_FLT: RteEventRef=OpEventGetEventExtendedDataRecordEx_GetEventExtendedDataRecordEx_Event_EXT_UC_SPI_FLT
          OpEventGetEventExtendedDataRecordEx_GetEventExtendedDataRecordEx_EvtInfo_INV_IAC_V_ELEC_HWP_001: RteEventRef=OpEventGetEventExtendedDataRecordEx_GetEventExtendedDataRecordEx_EvtInfo_INV_IAC_V_ELEC_HWP_001
          OpEventGetEventExtendedDataRecordEx_GetEventExtendedDataRecordEx_Event_INV_IAC_V_ELEC_HWP_001: RteEventRef=OpEventGetEventExtendedDataRecordEx_GetEventExtendedDataRecordEx_Event_INV_IAC_V_ELEC_HWP_001
          OpEventGetEventExtendedDataRecordEx_GetEventExtendedDataRecordEx_EvtInfo_VcEvChkSumWhlMotSysTqAllwd: RteEventRef=OpEventGetEventExtendedDataRecordEx_GetEventExtendedDataRecordEx_EvtInfo_VcEvChkSumWhlMotSysTqAllwd
          OpEventGetEventExtendedDataRecordEx_GetEventExtendedDataRecordEx_Event_VcEvChkSumWhlMotSysTqAllwd: RteEventRef=OpEventGetEventExtendedDataRecordEx_GetEventExtendedDataRecordEx_Event_VcEvChkSumWhlMotSysTqAllwd
          OpEventGetEventExtendedDataRecordEx_GetEventExtendedDataRecordEx_EvtInfo_FS_MONITIOR_ASC_FLT: RteEventRef=OpEventGetEventExtendedDataRecordEx_GetEventExtendedDataRecordEx_EvtInfo_FS_MONITIOR_ASC_FLT
          OpEventGetEventExtendedDataRecordEx_GetEventExtendedDataRecordEx_Event_FS_MONITIOR_ASC_FLT: RteEventRef=OpEventGetEventExtendedDataRecordEx_GetEventExtendedDataRecordEx_Event_FS_MONITIOR_ASC_FLT
          OpEventGetEventExtendedDataRecordEx_GetEventExtendedDataRecordEx_EvtInfo_INV_IAC_V_AMP: RteEventRef=OpEventGetEventExtendedDataRecordEx_GetEventExtendedDataRecordEx_EvtInfo_INV_IAC_V_AMP
          OpEventGetEventExtendedDataRecordEx_GetEventExtendedDataRecordEx_Event_INV_IAC_V_AMP: RteEventRef=OpEventGetEventExtendedDataRecordEx_GetEventExtendedDataRecordEx_Event_INV_IAC_V_AMP
          OpEventGetEventExtendedDataRecordEx_GetEventExtendedDataRecordEx_EvtInfo_INV_IAC_W_ELEC_LO: RteEventRef=OpEventGetEventExtendedDataRecordEx_GetEventExtendedDataRecordEx_EvtInfo_INV_IAC_W_ELEC_LO
          OpEventGetEventExtendedDataRecordEx_GetEventExtendedDataRecordEx_Event_INV_IAC_W_ELEC_LO: RteEventRef=OpEventGetEventExtendedDataRecordEx_GetEventExtendedDataRecordEx_Event_INV_IAC_W_ELEC_LO
          OpEventGetEventExtendedDataRecordEx_GetEventExtendedDataRecordEx_EvtInfo_VCEvVddmPropFr08Tioutd_001: RteEventRef=OpEventGetEventExtendedDataRecordEx_GetEventExtendedDataRecordEx_EvtInfo_VCEvVddmPropFr08Tioutd_001
          OpEventGetEventExtendedDataRecordEx_GetEventExtendedDataRecordEx_Event_VCEvVddmPropFr08Tioutd_001: RteEventRef=OpEventGetEventExtendedDataRecordEx_GetEventExtendedDataRecordEx_Event_VCEvVddmPropFr08Tioutd_001
          OpEventGetEventExtendedDataRecordEx_GetEventExtendedDataRecordEx_EvtInfo_PS_P12_RES_FLT: RteEventRef=OpEventGetEventExtendedDataRecordEx_GetEventExtendedDataRecordEx_EvtInfo_PS_P12_RES_FLT
          OpEventGetEventExtendedDataRecordEx_GetEventExtendedDataRecordEx_Event_PS_P12_RES_FLT: RteEventRef=OpEventGetEventExtendedDataRecordEx_GetEventExtendedDataRecordEx_Event_PS_P12_RES_FLT
          OpEventGetEventExtendedDataRecordEx_GetEventExtendedDataRecordEx_EvtInfo_INV_RSLVR_SIN_RNG_LO: RteEventRef=OpEventGetEventExtendedDataRecordEx_GetEventExtendedDataRecordEx_EvtInfo_INV_RSLVR_SIN_RNG_LO
          OpEventGetEventExtendedDataRecordEx_GetEventExtendedDataRecordEx_Event_INV_RSLVR_SIN_RNG_LO: RteEventRef=OpEventGetEventExtendedDataRecordEx_GetEventExtendedDataRecordEx_Event_INV_RSLVR_SIN_RNG_LO
          OpEventGetEventExtendedDataRecordEx_GetEventExtendedDataRecordEx_EvtInfo_CU_TEMP_HW_FLT: RteEventRef=OpEventGetEventExtendedDataRecordEx_GetEventExtendedDataRecordEx_EvtInfo_CU_TEMP_HW_FLT
          OpEventGetEventExtendedDataRecordEx_GetEventExtendedDataRecordEx_Event_CU_TEMP_HW_FLT: RteEventRef=OpEventGetEventExtendedDataRecordEx_GetEventExtendedDataRecordEx_Event_CU_TEMP_HW_FLT
          OpEventGetEventExtendedDataRecordEx_GetEventExtendedDataRecordEx_EvtInfo_VCEvEcmPropFr02MgmFr00Tioutd: RteEventRef=OpEventGetEventExtendedDataRecordEx_GetEventExtendedDataRecordEx_EvtInfo_VCEvEcmPropFr02MgmFr00Tioutd
          OpEventGetEventExtendedDataRecordEx_GetEventExtendedDataRecordEx_Event_VCEvEcmPropFr02MgmFr00Tioutd: RteEventRef=OpEventGetEventExtendedDataRecordEx_GetEventExtendedDataRecordEx_Event_VCEvEcmPropFr02MgmFr00Tioutd
          OpEventGetEventExtendedDataRecordEx_GetEventExtendedDataRecordEx_EvtInfo_PS_KL15_RNG_HI: RteEventRef=OpEventGetEventExtendedDataRecordEx_GetEventExtendedDataRecordEx_EvtInfo_PS_KL15_RNG_HI
          OpEventGetEventExtendedDataRecordEx_GetEventExtendedDataRecordEx_Event_PS_KL15_RNG_HI: RteEventRef=OpEventGetEventExtendedDataRecordEx_GetEventExtendedDataRecordEx_Event_PS_KL15_RNG_HI
          OpEventGetEventExtendedDataRecordEx_GetEventExtendedDataRecordEx_EvtInfo_VCEvVddmPropFr17Tioutd: RteEventRef=OpEventGetEventExtendedDataRecordEx_GetEventExtendedDataRecordEx_EvtInfo_VCEvVddmPropFr17Tioutd
          OpEventGetEventExtendedDataRecordEx_GetEventExtendedDataRecordEx_Event_VCEvVddmPropFr17Tioutd: RteEventRef=OpEventGetEventExtendedDataRecordEx_GetEventExtendedDataRecordEx_Event_VCEvVddmPropFr17Tioutd
          OpEventGetEventExtendedDataRecordEx_GetEventExtendedDataRecordEx_EvtInfo_VcEvChkSumCrashStsSafe: RteEventRef=OpEventGetEventExtendedDataRecordEx_GetEventExtendedDataRecordEx_EvtInfo_VcEvChkSumCrashStsSafe
          OpEventGetEventExtendedDataRecordEx_GetEventExtendedDataRecordEx_Event_VcEvChkSumCrashStsSafe: RteEventRef=OpEventGetEventExtendedDataRecordEx_GetEventExtendedDataRecordEx_Event_VcEvChkSumCrashStsSafe
          OpEventGetEventExtendedDataRecordEx_GetEventExtendedDataRecordEx_EvtInfo_DiagC_ClutchService: RteEventRef=OpEventGetEventExtendedDataRecordEx_GetEventExtendedDataRecordEx_EvtInfo_DiagC_ClutchService
          OpEventGetEventExtendedDataRecordEx_GetEventExtendedDataRecordEx_Event_DiagC_ClutchService: RteEventRef=OpEventGetEventExtendedDataRecordEx_GetEventExtendedDataRecordEx_Event_DiagC_ClutchService
          OpEventGetEventExtendedDataRecordEx_GetEventExtendedDataRecordEx_EvtInfo_INV_EM_STATOR_TEMP_RNG_HI: RteEventRef=OpEventGetEventExtendedDataRecordEx_GetEventExtendedDataRecordEx_EvtInfo_INV_EM_STATOR_TEMP_RNG_HI
          OpEventGetEventExtendedDataRecordEx_GetEventExtendedDataRecordEx_Event_INV_EM_STATOR_TEMP_RNG_HI: RteEventRef=OpEventGetEventExtendedDataRecordEx_GetEventExtendedDataRecordEx_Event_INV_EM_STATOR_TEMP_RNG_HI
          OpEventGetEventExtendedDataRecordEx_GetEventExtendedDataRecordEx_EvtInfo_INV_RSLVR_OFFS_OUT_RANG: RteEventRef=OpEventGetEventExtendedDataRecordEx_GetEventExtendedDataRecordEx_EvtInfo_INV_RSLVR_OFFS_OUT_RANG
          OpEventGetEventExtendedDataRecordEx_GetEventExtendedDataRecordEx_Event_INV_RSLVR_OFFS_OUT_RANG: RteEventRef=OpEventGetEventExtendedDataRecordEx_GetEventExtendedDataRecordEx_Event_INV_RSLVR_OFFS_OUT_RANG
          OpEventGetEventExtendedDataRecordEx_GetEventExtendedDataRecordEx_EvtInfo_INV_EM_STATOR_TEMP2_RNG_LO: RteEventRef=OpEventGetEventExtendedDataRecordEx_GetEventExtendedDataRecordEx_EvtInfo_INV_EM_STATOR_TEMP2_RNG_LO
          OpEventGetEventExtendedDataRecordEx_GetEventExtendedDataRecordEx_Event_INV_EM_STATOR_TEMP2_RNG_LO: RteEventRef=OpEventGetEventExtendedDataRecordEx_GetEventExtendedDataRecordEx_Event_INV_EM_STATOR_TEMP2_RNG_LO
          OpEventGetEventExtendedDataRecordEx_GetEventExtendedDataRecordEx_EvtInfo_VcEvMonISAR: RteEventRef=OpEventGetEventExtendedDataRecordEx_GetEventExtendedDataRecordEx_EvtInfo_VcEvMonISAR
          OpEventGetEventExtendedDataRecordEx_GetEventExtendedDataRecordEx_Event_VcEvMonISAR: RteEventRef=OpEventGetEventExtendedDataRecordEx_GetEventExtendedDataRecordEx_Event_VcEvMonISAR
          OpEventGetEventExtendedDataRecordEx_GetEventExtendedDataRecordEx_EvtInfo_GA_BLDC_FLT: RteEventRef=OpEventGetEventExtendedDataRecordEx_GetEventExtendedDataRecordEx_EvtInfo_GA_BLDC_FLT
          OpEventGetEventExtendedDataRecordEx_GetEventExtendedDataRecordEx_Event_GA_BLDC_FLT: RteEventRef=OpEventGetEventExtendedDataRecordEx_GetEventExtendedDataRecordEx_Event_GA_BLDC_FLT
          OpEventGetEventExtendedDataRecordEx_GetEventExtendedDataRecordEx_EvtInfo_INV_RSLVR_EXCT_ELEC_OPEN: RteEventRef=OpEventGetEventExtendedDataRecordEx_GetEventExtendedDataRecordEx_EvtInfo_INV_RSLVR_EXCT_ELEC_OPEN
          OpEventGetEventExtendedDataRecordEx_GetEventExtendedDataRecordEx_Event_INV_RSLVR_EXCT_ELEC_OPEN: RteEventRef=OpEventGetEventExtendedDataRecordEx_GetEventExtendedDataRecordEx_Event_INV_RSLVR_EXCT_ELEC_OPEN
          OpEventGetEventExtendedDataRecordEx_GetEventExtendedDataRecordEx_EvtInfo_INV_RSLVR_EXCT_PLAUS: RteEventRef=OpEventGetEventExtendedDataRecordEx_GetEventExtendedDataRecordEx_EvtInfo_INV_RSLVR_EXCT_PLAUS
          OpEventGetEventExtendedDataRecordEx_GetEventExtendedDataRecordEx_Event_INV_RSLVR_EXCT_PLAUS: RteEventRef=OpEventGetEventExtendedDataRecordEx_GetEventExtendedDataRecordEx_Event_INV_RSLVR_EXCT_PLAUS
          OpEventGetEventExtendedDataRecordEx_GetEventExtendedDataRecordEx_EvtInfo_PS_P15_U_FLT: RteEventRef=OpEventGetEventExtendedDataRecordEx_GetEventExtendedDataRecordEx_EvtInfo_PS_P15_U_FLT
          OpEventGetEventExtendedDataRecordEx_GetEventExtendedDataRecordEx_Event_PS_P15_U_FLT: RteEventRef=OpEventGetEventExtendedDataRecordEx_GetEventExtendedDataRecordEx_Event_PS_P15_U_FLT
          OpEventGetEventExtendedDataRecordEx_GetEventExtendedDataRecordEx_EvtInfo_INV_EM_STATOR_TEMP_RNG_SWT: RteEventRef=OpEventGetEventExtendedDataRecordEx_GetEventExtendedDataRecordEx_EvtInfo_INV_EM_STATOR_TEMP_RNG_SWT
          OpEventGetEventExtendedDataRecordEx_GetEventExtendedDataRecordEx_Event_INV_EM_STATOR_TEMP_RNG_SWT: RteEventRef=OpEventGetEventExtendedDataRecordEx_GetEventExtendedDataRecordEx_Event_INV_EM_STATOR_TEMP_RNG_SWT
          OpEventGetEventExtendedDataRecordEx_GetEventExtendedDataRecordEx_EvtInfo_INV_UHVDC_OV_SWP: RteEventRef=OpEventGetEventExtendedDataRecordEx_GetEventExtendedDataRecordEx_EvtInfo_INV_UHVDC_OV_SWP
          OpEventGetEventExtendedDataRecordEx_GetEventExtendedDataRecordEx_Event_INV_UHVDC_OV_SWP: RteEventRef=OpEventGetEventExtendedDataRecordEx_GetEventExtendedDataRecordEx_Event_INV_UHVDC_OV_SWP
          OpEventGetEventExtendedDataRecordEx_GetEventExtendedDataRecordEx_EvtInfo_AURIX_HW_FLT: RteEventRef=OpEventGetEventExtendedDataRecordEx_GetEventExtendedDataRecordEx_EvtInfo_AURIX_HW_FLT
          OpEventGetEventExtendedDataRecordEx_GetEventExtendedDataRecordEx_Event_AURIX_HW_FLT: RteEventRef=OpEventGetEventExtendedDataRecordEx_GetEventExtendedDataRecordEx_Event_AURIX_HW_FLT
          OpEventGetEventExtendedDataRecordEx_GetEventExtendedDataRecordEx_EvtInfo_INV_GATE_DRVR_TOP_HWP: RteEventRef=OpEventGetEventExtendedDataRecordEx_GetEventExtendedDataRecordEx_EvtInfo_INV_GATE_DRVR_TOP_HWP
          OpEventGetEventExtendedDataRecordEx_GetEventExtendedDataRecordEx_Event_INV_GATE_DRVR_TOP_HWP: RteEventRef=OpEventGetEventExtendedDataRecordEx_GetEventExtendedDataRecordEx_Event_INV_GATE_DRVR_TOP_HWP
          OpEventGetEventExtendedDataRecordEx_GetEventExtendedDataRecordEx_EvtInfo_INV_ACTV_DCHA_HW: RteEventRef=OpEventGetEventExtendedDataRecordEx_GetEventExtendedDataRecordEx_EvtInfo_INV_ACTV_DCHA_HW
          OpEventGetEventExtendedDataRecordEx_GetEventExtendedDataRecordEx_Event_INV_ACTV_DCHA_HW: RteEventRef=OpEventGetEventExtendedDataRecordEx_GetEventExtendedDataRecordEx_Event_INV_ACTV_DCHA_HW
          OpEventGetEventExtendedDataRecordEx_GetEventExtendedDataRecordEx_EvtInfo_INV_IGBT_TEMP_HWP: RteEventRef=OpEventGetEventExtendedDataRecordEx_GetEventExtendedDataRecordEx_EvtInfo_INV_IGBT_TEMP_HWP
          OpEventGetEventExtendedDataRecordEx_GetEventExtendedDataRecordEx_Event_INV_IGBT_TEMP_HWP: RteEventRef=OpEventGetEventExtendedDataRecordEx_GetEventExtendedDataRecordEx_Event_INV_IGBT_TEMP_HWP
          OpEventGetEventExtendedDataRecordEx_GetEventExtendedDataRecordEx_EvtInfo_INV_RSLVR_SIN_ELEC_FLT: RteEventRef=OpEventGetEventExtendedDataRecordEx_GetEventExtendedDataRecordEx_EvtInfo_INV_RSLVR_SIN_ELEC_FLT
          OpEventGetEventExtendedDataRecordEx_GetEventExtendedDataRecordEx_Event_INV_RSLVR_SIN_ELEC_FLT: RteEventRef=OpEventGetEventExtendedDataRecordEx_GetEventExtendedDataRecordEx_Event_INV_RSLVR_SIN_ELEC_FLT
          OpEventGetEventExtendedDataRecordEx_GetEventExtendedDataRecordEx_EvtInfo_CU_TEMP2_RNG_HI: RteEventRef=OpEventGetEventExtendedDataRecordEx_GetEventExtendedDataRecordEx_EvtInfo_CU_TEMP2_RNG_HI
          OpEventGetEventExtendedDataRecordEx_GetEventExtendedDataRecordEx_Event_CU_TEMP2_RNG_HI: RteEventRef=OpEventGetEventExtendedDataRecordEx_GetEventExtendedDataRecordEx_Event_CU_TEMP2_RNG_HI
          OpEventGetEventExtendedDataRecordEx_GetEventExtendedDataRecordEx_EvtInfo_INV_IAC_PHA_LOSS_MPL: RteEventRef=OpEventGetEventExtendedDataRecordEx_GetEventExtendedDataRecordEx_EvtInfo_INV_IAC_PHA_LOSS_MPL
          OpEventGetEventExtendedDataRecordEx_GetEventExtendedDataRecordEx_Event_INV_IAC_PHA_LOSS_MPL: RteEventRef=OpEventGetEventExtendedDataRecordEx_GetEventExtendedDataRecordEx_Event_INV_IAC_PHA_LOSS_MPL
          OpEventGetEventExtendedDataRecordEx_GetEventExtendedDataRecordEx_EvtInfo_INV_IAC_U_AMP: RteEventRef=OpEventGetEventExtendedDataRecordEx_GetEventExtendedDataRecordEx_EvtInfo_INV_IAC_U_AMP
          OpEventGetEventExtendedDataRecordEx_GetEventExtendedDataRecordEx_Event_INV_IAC_U_AMP: RteEventRef=OpEventGetEventExtendedDataRecordEx_GetEventExtendedDataRecordEx_Event_INV_IAC_U_AMP
          OpEventGetEventExtendedDataRecordEx_GetEventExtendedDataRecordEx_EvtInfo_PSnsr_GRADT_Flt: RteEventRef=OpEventGetEventExtendedDataRecordEx_GetEventExtendedDataRecordEx_EvtInfo_PSnsr_GRADT_Flt
          OpEventGetEventExtendedDataRecordEx_GetEventExtendedDataRecordEx_Event_PSnsr_GRADT_Flt: RteEventRef=OpEventGetEventExtendedDataRecordEx_GetEventExtendedDataRecordEx_Event_PSnsr_GRADT_Flt
          OpEventGetEventExtendedDataRecordEx_GetEventExtendedDataRecordEx_EvtInfo_AURIX_WATHDOG_FLT: RteEventRef=OpEventGetEventExtendedDataRecordEx_GetEventExtendedDataRecordEx_EvtInfo_AURIX_WATHDOG_FLT
          OpEventGetEventExtendedDataRecordEx_GetEventExtendedDataRecordEx_Event_AURIX_WATHDOG_FLT: RteEventRef=OpEventGetEventExtendedDataRecordEx_GetEventExtendedDataRecordEx_Event_AURIX_WATHDOG_FLT
          OpEventGetEventExtendedDataRecordEx_GetEventExtendedDataRecordEx_EvtInfo_VcEvNodeMisBECM: RteEventRef=OpEventGetEventExtendedDataRecordEx_GetEventExtendedDataRecordEx_EvtInfo_VcEvNodeMisBECM
          OpEventGetEventExtendedDataRecordEx_GetEventExtendedDataRecordEx_Event_VcEvNodeMisBECM: RteEventRef=OpEventGetEventExtendedDataRecordEx_GetEventExtendedDataRecordEx_Event_VcEvNodeMisBECM
          OpEventGetEventExtendedDataRecordEx_GetEventExtendedDataRecordEx_EvtInfo_INV_UHVDC_UV_HWP: RteEventRef=OpEventGetEventExtendedDataRecordEx_GetEventExtendedDataRecordEx_EvtInfo_INV_UHVDC_UV_HWP
          OpEventGetEventExtendedDataRecordEx_GetEventExtendedDataRecordEx_Event_INV_UHVDC_UV_HWP: RteEventRef=OpEventGetEventExtendedDataRecordEx_GetEventExtendedDataRecordEx_Event_INV_UHVDC_UV_HWP
          OpEventGetEventExtendedDataRecordEx_GetEventExtendedDataRecordEx_EvtInfo_VcEvMonESpd: RteEventRef=OpEventGetEventExtendedDataRecordEx_GetEventExtendedDataRecordEx_EvtInfo_VcEvMonESpd
          OpEventGetEventExtendedDataRecordEx_GetEventExtendedDataRecordEx_Event_VcEvMonESpd: RteEventRef=OpEventGetEventExtendedDataRecordEx_GetEventExtendedDataRecordEx_Event_VcEvMonESpd
          OpEventGetEventExtendedDataRecordEx_GetEventExtendedDataRecordEx_EvtInfo_COM_NotConfig: RteEventRef=OpEventGetEventExtendedDataRecordEx_GetEventExtendedDataRecordEx_EvtInfo_COM_NotConfig
          OpEventGetEventExtendedDataRecordEx_GetEventExtendedDataRecordEx_Event_COM_NotConfig: RteEventRef=OpEventGetEventExtendedDataRecordEx_GetEventExtendedDataRecordEx_Event_COM_NotConfig
          OpEventGetEventExtendedDataRecordEx_GetEventExtendedDataRecordEx_EvtInfo_INV_RSLVR_SIN_RNG_HI: RteEventRef=OpEventGetEventExtendedDataRecordEx_GetEventExtendedDataRecordEx_EvtInfo_INV_RSLVR_SIN_RNG_HI
          OpEventGetEventExtendedDataRecordEx_GetEventExtendedDataRecordEx_Event_INV_RSLVR_SIN_RNG_HI: RteEventRef=OpEventGetEventExtendedDataRecordEx_GetEventExtendedDataRecordEx_Event_INV_RSLVR_SIN_RNG_HI
          OpEventGetEventExtendedDataRecordEx_GetEventExtendedDataRecordEx_EvtInfo_INV_IGBT_TEMP_U_RNG_HI: RteEventRef=OpEventGetEventExtendedDataRecordEx_GetEventExtendedDataRecordEx_EvtInfo_INV_IGBT_TEMP_U_RNG_HI
          OpEventGetEventExtendedDataRecordEx_GetEventExtendedDataRecordEx_Event_INV_IGBT_TEMP_U_RNG_HI: RteEventRef=OpEventGetEventExtendedDataRecordEx_GetEventExtendedDataRecordEx_Event_INV_IGBT_TEMP_U_RNG_HI
          OpEventGetEventExtendedDataRecordEx_GetEventExtendedDataRecordEx_EvtInfo_VcEvMonMode_001: RteEventRef=OpEventGetEventExtendedDataRecordEx_GetEventExtendedDataRecordEx_EvtInfo_VcEvMonMode_001
          OpEventGetEventExtendedDataRecordEx_GetEventExtendedDataRecordEx_Event_VcEvMonMode_001: RteEventRef=OpEventGetEventExtendedDataRecordEx_GetEventExtendedDataRecordEx_Event_VcEvMonMode_001
          OpEventGetEventExtendedDataRecordEx_GetEventExtendedDataRecordEx_EvtInfo_PA_ACTION_FLT: RteEventRef=OpEventGetEventExtendedDataRecordEx_GetEventExtendedDataRecordEx_EvtInfo_PA_ACTION_FLT
          OpEventGetEventExtendedDataRecordEx_GetEventExtendedDataRecordEx_Event_PA_ACTION_FLT: RteEventRef=OpEventGetEventExtendedDataRecordEx_GetEventExtendedDataRecordEx_Event_PA_ACTION_FLT
          OpEventGetEventExtendedDataRecordEx_GetEventExtendedDataRecordEx_EvtInfo_INV_IAC_V_ELEC_HWP: RteEventRef=OpEventGetEventExtendedDataRecordEx_GetEventExtendedDataRecordEx_EvtInfo_INV_IAC_V_ELEC_HWP
          OpEventGetEventExtendedDataRecordEx_GetEventExtendedDataRecordEx_Event_INV_IAC_V_ELEC_HWP: RteEventRef=OpEventGetEventExtendedDataRecordEx_GetEventExtendedDataRecordEx_Event_INV_IAC_V_ELEC_HWP
          OpEventGetEventExtendedDataRecordEx_GetEventExtendedDataRecordEx_EvtInfo_CU_TEMP_HW_FLT_001: RteEventRef=OpEventGetEventExtendedDataRecordEx_GetEventExtendedDataRecordEx_EvtInfo_CU_TEMP_HW_FLT_001
          OpEventGetEventExtendedDataRecordEx_GetEventExtendedDataRecordEx_Event_CU_TEMP_HW_FLT_001: RteEventRef=OpEventGetEventExtendedDataRecordEx_GetEventExtendedDataRecordEx_Event_CU_TEMP_HW_FLT_001
          OpEventGetEventExtendedDataRecordEx_GetEventExtendedDataRecordEx_EvtInfo_VCC_UnderVoltage: RteEventRef=OpEventGetEventExtendedDataRecordEx_GetEventExtendedDataRecordEx_EvtInfo_VCC_UnderVoltage
          OpEventGetEventExtendedDataRecordEx_GetEventExtendedDataRecordEx_Event_VCC_UnderVoltage: RteEventRef=OpEventGetEventExtendedDataRecordEx_GetEventExtendedDataRecordEx_Event_VCC_UnderVoltage
          OpEventGetEventExtendedDataRecordEx_GetEventExtendedDataRecordEx_EvtInfo_VcEvTsttrPlaus: RteEventRef=OpEventGetEventExtendedDataRecordEx_GetEventExtendedDataRecordEx_EvtInfo_VcEvTsttrPlaus
          OpEventGetEventExtendedDataRecordEx_GetEventExtendedDataRecordEx_Event_VcEvTsttrPlaus: RteEventRef=OpEventGetEventExtendedDataRecordEx_GetEventExtendedDataRecordEx_Event_VcEvTsttrPlaus
          OpEventGetEventExtendedDataRecordEx_GetEventExtendedDataRecordEx_EvtInfo_INV_RSLVR_EXCT_ELEC_FLT: RteEventRef=OpEventGetEventExtendedDataRecordEx_GetEventExtendedDataRecordEx_EvtInfo_INV_RSLVR_EXCT_ELEC_FLT
          OpEventGetEventExtendedDataRecordEx_GetEventExtendedDataRecordEx_Event_INV_RSLVR_EXCT_ELEC_FLT: RteEventRef=OpEventGetEventExtendedDataRecordEx_GetEventExtendedDataRecordEx_Event_INV_RSLVR_EXCT_ELEC_FLT
          OpEventGetEventExtendedDataRecordEx_GetEventExtendedDataRecordEx_EvtInfo_INV_RSLVR_EXCT_RNG_LO: RteEventRef=OpEventGetEventExtendedDataRecordEx_GetEventExtendedDataRecordEx_EvtInfo_INV_RSLVR_EXCT_RNG_LO
          OpEventGetEventExtendedDataRecordEx_GetEventExtendedDataRecordEx_Event_INV_RSLVR_EXCT_RNG_LO: RteEventRef=OpEventGetEventExtendedDataRecordEx_GetEventExtendedDataRecordEx_Event_INV_RSLVR_EXCT_RNG_LO
          OpEventGetEventExtendedDataRecordEx_GetEventExtendedDataRecordEx_EvtInfo_INV_EM_STATOR_TEMP2_RNG_HI: RteEventRef=OpEventGetEventExtendedDataRecordEx_GetEventExtendedDataRecordEx_EvtInfo_INV_EM_STATOR_TEMP2_RNG_HI
          OpEventGetEventExtendedDataRecordEx_GetEventExtendedDataRecordEx_Event_INV_EM_STATOR_TEMP2_RNG_HI: RteEventRef=OpEventGetEventExtendedDataRecordEx_GetEventExtendedDataRecordEx_Event_INV_EM_STATOR_TEMP2_RNG_HI
          OpEventGetEventExtendedDataRecordEx_GetEventExtendedDataRecordEx_EvtInfo_INV_SHUT_OFF_PAH_START_UP: RteEventRef=OpEventGetEventExtendedDataRecordEx_GetEventExtendedDataRecordEx_EvtInfo_INV_SHUT_OFF_PAH_START_UP
          OpEventGetEventExtendedDataRecordEx_GetEventExtendedDataRecordEx_Event_INV_SHUT_OFF_PAH_START_UP: RteEventRef=OpEventGetEventExtendedDataRecordEx_GetEventExtendedDataRecordEx_Event_INV_SHUT_OFF_PAH_START_UP
          OpEventGetEventExtendedDataRecordEx_GetEventExtendedDataRecordEx_EvtInfo_VCEvVddmPropFr08Tioutd: RteEventRef=OpEventGetEventExtendedDataRecordEx_GetEventExtendedDataRecordEx_EvtInfo_VCEvVddmPropFr08Tioutd
          OpEventGetEventExtendedDataRecordEx_GetEventExtendedDataRecordEx_Event_VCEvVddmPropFr08Tioutd: RteEventRef=OpEventGetEventExtendedDataRecordEx_GetEventExtendedDataRecordEx_Event_VCEvVddmPropFr08Tioutd
          OpEventGetEventExtendedDataRecordEx_GetEventExtendedDataRecordEx_EvtInfo_INV_RSLVR_EXCT_OC_HWP_001: RteEventRef=OpEventGetEventExtendedDataRecordEx_GetEventExtendedDataRecordEx_EvtInfo_INV_RSLVR_EXCT_OC_HWP_001
          OpEventGetEventExtendedDataRecordEx_GetEventExtendedDataRecordEx_Event_INV_RSLVR_EXCT_OC_HWP_001: RteEventRef=OpEventGetEventExtendedDataRecordEx_GetEventExtendedDataRecordEx_Event_INV_RSLVR_EXCT_OC_HWP_001
          OpEventGetEventExtendedDataRecordEx_GetEventExtendedDataRecordEx_EvtInfo_INV_RSLVR_EXCT_OC_HWP_002: RteEventRef=OpEventGetEventExtendedDataRecordEx_GetEventExtendedDataRecordEx_EvtInfo_INV_RSLVR_EXCT_OC_HWP_002
          OpEventGetEventExtendedDataRecordEx_GetEventExtendedDataRecordEx_Event_INV_RSLVR_EXCT_OC_HWP_002: RteEventRef=OpEventGetEventExtendedDataRecordEx_GetEventExtendedDataRecordEx_Event_INV_RSLVR_EXCT_OC_HWP_002
          OpEventGetEventExtendedDataRecordEx_GetEventExtendedDataRecordEx_EvtInfo_INV_EM_STATOR_TEMP_ELE_FLT: RteEventRef=OpEventGetEventExtendedDataRecordEx_GetEventExtendedDataRecordEx_EvtInfo_INV_EM_STATOR_TEMP_ELE_FLT
          OpEventGetEventExtendedDataRecordEx_GetEventExtendedDataRecordEx_Event_INV_EM_STATOR_TEMP_ELE_FLT: RteEventRef=OpEventGetEventExtendedDataRecordEx_GetEventExtendedDataRecordEx_Event_INV_EM_STATOR_TEMP_ELE_FLT
          OpEventGetEventExtendedDataRecordEx_GetEventExtendedDataRecordEx_EvtInfo_INV_INTERLOCK_FLT: RteEventRef=OpEventGetEventExtendedDataRecordEx_GetEventExtendedDataRecordEx_EvtInfo_INV_INTERLOCK_FLT
          OpEventGetEventExtendedDataRecordEx_GetEventExtendedDataRecordEx_Event_INV_INTERLOCK_FLT: RteEventRef=OpEventGetEventExtendedDataRecordEx_GetEventExtendedDataRecordEx_Event_INV_INTERLOCK_FLT
          OpEventGetEventExtendedDataRecordEx_GetEventExtendedDataRecordEx_EvtInfo_Ga_ZeroFindDistanFailure: RteEventRef=OpEventGetEventExtendedDataRecordEx_GetEventExtendedDataRecordEx_EvtInfo_Ga_ZeroFindDistanFailure
          OpEventGetEventExtendedDataRecordEx_GetEventExtendedDataRecordEx_Event_Ga_ZeroFindDistanFailure: RteEventRef=OpEventGetEventExtendedDataRecordEx_GetEventExtendedDataRecordEx_Event_Ga_ZeroFindDistanFailure
          OpEventGetEventExtendedDataRecordEx_GetEventExtendedDataRecordEx_EvtInfo_PLOCK_Current_RNG_OUT: RteEventRef=OpEventGetEventExtendedDataRecordEx_GetEventExtendedDataRecordEx_EvtInfo_PLOCK_Current_RNG_OUT
          OpEventGetEventExtendedDataRecordEx_GetEventExtendedDataRecordEx_Event_PLOCK_Current_RNG_OUT: RteEventRef=OpEventGetEventExtendedDataRecordEx_GetEventExtendedDataRecordEx_Event_PLOCK_Current_RNG_OUT
          OpEventGetEventExtendedDataRecordEx_GetEventExtendedDataRecordEx_EvtInfo_VCEvVddmPropFr05Tioutd: RteEventRef=OpEventGetEventExtendedDataRecordEx_GetEventExtendedDataRecordEx_EvtInfo_VCEvVddmPropFr05Tioutd
          OpEventGetEventExtendedDataRecordEx_GetEventExtendedDataRecordEx_Event_VCEvVddmPropFr05Tioutd: RteEventRef=OpEventGetEventExtendedDataRecordEx_GetEventExtendedDataRecordEx_Event_VCEvVddmPropFr05Tioutd
          OpEventGetEventExtendedDataRecordEx_GetEventExtendedDataRecordEx_EvtInfo_INV_IGBT_TEMP_V_GRDT: RteEventRef=OpEventGetEventExtendedDataRecordEx_GetEventExtendedDataRecordEx_EvtInfo_INV_IGBT_TEMP_V_GRDT
          OpEventGetEventExtendedDataRecordEx_GetEventExtendedDataRecordEx_Event_INV_IGBT_TEMP_V_GRDT: RteEventRef=OpEventGetEventExtendedDataRecordEx_GetEventExtendedDataRecordEx_Event_INV_IGBT_TEMP_V_GRDT
          OpEventGetEventExtendedDataRecordEx_GetEventExtendedDataRecordEx_EvtInfo_PS_5V_Fault: RteEventRef=OpEventGetEventExtendedDataRecordEx_GetEventExtendedDataRecordEx_EvtInfo_PS_5V_Fault
          OpEventGetEventExtendedDataRecordEx_GetEventExtendedDataRecordEx_Event_PS_5V_Fault: RteEventRef=OpEventGetEventExtendedDataRecordEx_GetEventExtendedDataRecordEx_Event_PS_5V_Fault
          OpEventGetEventExtendedDataRecordEx_GetEventExtendedDataRecordEx_EvtInfo_VcEvCntrCrashStsSafe: RteEventRef=OpEventGetEventExtendedDataRecordEx_GetEventExtendedDataRecordEx_EvtInfo_VcEvCntrCrashStsSafe
          OpEventGetEventExtendedDataRecordEx_GetEventExtendedDataRecordEx_Event_VcEvCntrCrashStsSafe: RteEventRef=OpEventGetEventExtendedDataRecordEx_GetEventExtendedDataRecordEx_Event_VcEvCntrCrashStsSafe
          OpEventGetEventExtendedDataRecordEx_GetEventExtendedDataRecordEx_EvtInfo_INV_EM_STATOR_TEMP_GRDT: RteEventRef=OpEventGetEventExtendedDataRecordEx_GetEventExtendedDataRecordEx_EvtInfo_INV_EM_STATOR_TEMP_GRDT
          OpEventGetEventExtendedDataRecordEx_GetEventExtendedDataRecordEx_Event_INV_EM_STATOR_TEMP_GRDT: RteEventRef=OpEventGetEventExtendedDataRecordEx_GetEventExtendedDataRecordEx_Event_INV_EM_STATOR_TEMP_GRDT
          OpEventGetEventExtendedDataRecordEx_GetEventExtendedDataRecordEx_EvtInfo_PS_P15_V_FLT: RteEventRef=OpEventGetEventExtendedDataRecordEx_GetEventExtendedDataRecordEx_EvtInfo_PS_P15_V_FLT
          OpEventGetEventExtendedDataRecordEx_GetEventExtendedDataRecordEx_Event_PS_P15_V_FLT: RteEventRef=OpEventGetEventExtendedDataRecordEx_GetEventExtendedDataRecordEx_Event_PS_P15_V_FLT
          OpEventGetEventExtendedDataRecordEx_GetEventExtendedDataRecordEx_EvtInfo_INV_EM_STATOR_TEMP_RNG_NOK: RteEventRef=OpEventGetEventExtendedDataRecordEx_GetEventExtendedDataRecordEx_EvtInfo_INV_EM_STATOR_TEMP_RNG_NOK
          OpEventGetEventExtendedDataRecordEx_GetEventExtendedDataRecordEx_Event_INV_EM_STATOR_TEMP_RNG_NOK: RteEventRef=OpEventGetEventExtendedDataRecordEx_GetEventExtendedDataRecordEx_Event_INV_EM_STATOR_TEMP_RNG_NOK
          OpEventGetEventExtendedDataRecordEx_GetEventExtendedDataRecordEx_EvtInfo_INV_RSLVR_SIN_RNG_NOK: RteEventRef=OpEventGetEventExtendedDataRecordEx_GetEventExtendedDataRecordEx_EvtInfo_INV_RSLVR_SIN_RNG_NOK
          OpEventGetEventExtendedDataRecordEx_GetEventExtendedDataRecordEx_Event_INV_RSLVR_SIN_RNG_NOK: RteEventRef=OpEventGetEventExtendedDataRecordEx_GetEventExtendedDataRecordEx_Event_INV_RSLVR_SIN_RNG_NOK
          OpEventGetEventExtendedDataRecordEx_GetEventExtendedDataRecordEx_EvtInfo_INV_IAC_U_OFFS: RteEventRef=OpEventGetEventExtendedDataRecordEx_GetEventExtendedDataRecordEx_EvtInfo_INV_IAC_U_OFFS
          OpEventGetEventExtendedDataRecordEx_GetEventExtendedDataRecordEx_Event_INV_IAC_U_OFFS: RteEventRef=OpEventGetEventExtendedDataRecordEx_GetEventExtendedDataRecordEx_Event_INV_IAC_U_OFFS
          OpEventGetEventExtendedDataRecordEx_GetEventExtendedDataRecordEx_EvtInfo_PS_KL30_BACKUP_FLT: RteEventRef=OpEventGetEventExtendedDataRecordEx_GetEventExtendedDataRecordEx_EvtInfo_PS_KL30_BACKUP_FLT
          OpEventGetEventExtendedDataRecordEx_GetEventExtendedDataRecordEx_Event_PS_KL30_BACKUP_FLT: RteEventRef=OpEventGetEventExtendedDataRecordEx_GetEventExtendedDataRecordEx_Event_PS_KL30_BACKUP_FLT
          OpEventGetEventExtendedDataRecordEx_GetEventExtendedDataRecordEx_EvtInfo_INV_IGBT_TEMP_U_RNG_LO: RteEventRef=OpEventGetEventExtendedDataRecordEx_GetEventExtendedDataRecordEx_EvtInfo_INV_IGBT_TEMP_U_RNG_LO
          OpEventGetEventExtendedDataRecordEx_GetEventExtendedDataRecordEx_Event_INV_IGBT_TEMP_U_RNG_LO: RteEventRef=OpEventGetEventExtendedDataRecordEx_GetEventExtendedDataRecordEx_Event_INV_IGBT_TEMP_U_RNG_LO
          OpEventGetEventExtendedDataRecordEx_GetEventExtendedDataRecordEx_EvtInfo_INV_EM_STATOR_TEMP_HWP: RteEventRef=OpEventGetEventExtendedDataRecordEx_GetEventExtendedDataRecordEx_EvtInfo_INV_EM_STATOR_TEMP_HWP
          OpEventGetEventExtendedDataRecordEx_GetEventExtendedDataRecordEx_Event_INV_EM_STATOR_TEMP_HWP: RteEventRef=OpEventGetEventExtendedDataRecordEx_GetEventExtendedDataRecordEx_Event_INV_EM_STATOR_TEMP_HWP
          OpEventGetEventExtendedDataRecordEx_GetEventExtendedDataRecordEx_EvtInfo_CU_TEMP1_RNG_HI: RteEventRef=OpEventGetEventExtendedDataRecordEx_GetEventExtendedDataRecordEx_EvtInfo_CU_TEMP1_RNG_HI
          OpEventGetEventExtendedDataRecordEx_GetEventExtendedDataRecordEx_Event_CU_TEMP1_RNG_HI: RteEventRef=OpEventGetEventExtendedDataRecordEx_GetEventExtendedDataRecordEx_Event_CU_TEMP1_RNG_HI
          OpEventGetEventExtendedDataRecordEx_GetEventExtendedDataRecordEx_EvtInfo_INV_IGBT_TEMP_V_RNG_HI: RteEventRef=OpEventGetEventExtendedDataRecordEx_GetEventExtendedDataRecordEx_EvtInfo_INV_IGBT_TEMP_V_RNG_HI
          OpEventGetEventExtendedDataRecordEx_GetEventExtendedDataRecordEx_Event_INV_IGBT_TEMP_V_RNG_HI: RteEventRef=OpEventGetEventExtendedDataRecordEx_GetEventExtendedDataRecordEx_Event_INV_IGBT_TEMP_V_RNG_HI
          OpEventGetEventExtendedDataRecordEx_GetEventExtendedDataRecordEx_EvtInfo_VcEvNodeMisVDDM: RteEventRef=OpEventGetEventExtendedDataRecordEx_GetEventExtendedDataRecordEx_EvtInfo_VcEvNodeMisVDDM
          OpEventGetEventExtendedDataRecordEx_GetEventExtendedDataRecordEx_Event_VcEvNodeMisVDDM: RteEventRef=OpEventGetEventExtendedDataRecordEx_GetEventExtendedDataRecordEx_Event_VcEvNodeMisVDDM
          OpEventGetEventExtendedDataRecordEx_GetEventExtendedDataRecordEx_EvtInfo_INV_UHVDC_PLAUS: RteEventRef=OpEventGetEventExtendedDataRecordEx_GetEventExtendedDataRecordEx_EvtInfo_INV_UHVDC_PLAUS
          OpEventGetEventExtendedDataRecordEx_GetEventExtendedDataRecordEx_Event_INV_UHVDC_PLAUS: RteEventRef=OpEventGetEventExtendedDataRecordEx_GetEventExtendedDataRecordEx_Event_INV_UHVDC_PLAUS
          OpEventGetEventExtendedDataRecordEx_GetEventExtendedDataRecordEx_EvtInfo_INV_QUIESCENT_FLT: RteEventRef=OpEventGetEventExtendedDataRecordEx_GetEventExtendedDataRecordEx_EvtInfo_INV_QUIESCENT_FLT
          OpEventGetEventExtendedDataRecordEx_GetEventExtendedDataRecordEx_Event_INV_QUIESCENT_FLT: RteEventRef=OpEventGetEventExtendedDataRecordEx_GetEventExtendedDataRecordEx_Event_INV_QUIESCENT_FLT
          OpEventGetEventExtendedDataRecordEx_GetEventExtendedDataRecordEx_EvtInfo_INV_RSLVR_EXCT_RNG_HI: RteEventRef=OpEventGetEventExtendedDataRecordEx_GetEventExtendedDataRecordEx_EvtInfo_INV_RSLVR_EXCT_RNG_HI
          OpEventGetEventExtendedDataRecordEx_GetEventExtendedDataRecordEx_Event_INV_RSLVR_EXCT_RNG_HI: RteEventRef=OpEventGetEventExtendedDataRecordEx_GetEventExtendedDataRecordEx_Event_INV_RSLVR_EXCT_RNG_HI
          OpEventGetEventExtendedDataRecordEx_GetEventExtendedDataRecordEx_GeneralEvtInfo: RteEventRef=OpEventGetEventExtendedDataRecordEx_GetEventExtendedDataRecordEx_GeneralEvtInfo
          OpEventGetEventEnableCondition_GetEventEnableCondition_EvtInfo_VCEvBecmPropFr01Tioutd: RteEventRef=OpEventGetEventEnableCondition_GetEventEnableCondition_EvtInfo_VCEvBecmPropFr01Tioutd
          OpEventGetEventEnableCondition_GetEventEnableCondition_EvtInfo_INV_CU_TEMP2_RNG_NOK: RteEventRef=OpEventGetEventEnableCondition_GetEventEnableCondition_EvtInfo_INV_CU_TEMP2_RNG_NOK
          OpEventGetEventEnableCondition_GetEventEnableCondition_EvtInfo_COM_Busoff: RteEventRef=OpEventGetEventEnableCondition_GetEventEnableCondition_EvtInfo_COM_Busoff
          OpEventGetEventEnableCondition_GetEventEnableCondition_EvtInfo_INV_IMMO_NOKEY: RteEventRef=OpEventGetEventEnableCondition_GetEventEnableCondition_EvtInfo_INV_IMMO_NOKEY
          OpEventGetEventEnableCondition_GetEventEnableCondition_EvtInfo_INV_RSLVR_EXCT_OC_HWP: RteEventRef=OpEventGetEventEnableCondition_GetEventEnableCondition_EvtInfo_INV_RSLVR_EXCT_OC_HWP
          OpEventGetEventEnableCondition_GetEventEnableCondition_EvtInfo_PS_P15_W_FLT: RteEventRef=OpEventGetEventEnableCondition_GetEventEnableCondition_EvtInfo_PS_P15_W_FLT
          OpEventGetEventEnableCondition_GetEventEnableCondition_EvtInfo_INV_IAC_PLAUS_SUM: RteEventRef=OpEventGetEventEnableCondition_GetEventEnableCondition_EvtInfo_INV_IAC_PLAUS_SUM
          OpEventGetEventEnableCondition_GetEventEnableCondition_EvtInfo_PA_ELE_FLT: RteEventRef=OpEventGetEventEnableCondition_GetEventEnableCondition_EvtInfo_PA_ELE_FLT
          OpEventGetEventEnableCondition_GetEventEnableCondition_EvtInfo_CU_TEMP_GRDT: RteEventRef=OpEventGetEventEnableCondition_GetEventEnableCondition_EvtInfo_CU_TEMP_GRDT
          OpEventGetEventEnableCondition_GetEventEnableCondition_EvtInfo_INV_IGBT_TEMP_V_PLAUS: RteEventRef=OpEventGetEventEnableCondition_GetEventEnableCondition_EvtInfo_INV_IGBT_TEMP_V_PLAUS
          OpEventGetEventEnableCondition_GetEventEnableCondition_EvtInfo_Ga_GAEngageFailure: RteEventRef=OpEventGetEventEnableCondition_GetEventEnableCondition_EvtInfo_Ga_GAEngageFailure
          OpEventGetEventEnableCondition_GetEventEnableCondition_EvtInfo_INV_IAC_W_RNG_LO: RteEventRef=OpEventGetEventEnableCondition_GetEventEnableCondition_EvtInfo_INV_IAC_W_RNG_LO
          OpEventGetEventEnableCondition_GetEventEnableCondition_EvtInfo_PS_WhlSnsr_Vltg_FLT: RteEventRef=OpEventGetEventEnableCondition_GetEventEnableCondition_EvtInfo_PS_WhlSnsr_Vltg_FLT
          OpEventGetEventEnableCondition_GetEventEnableCondition_EvtInfo_VCEvEcmPropFr02Tioutd: RteEventRef=OpEventGetEventEnableCondition_GetEventEnableCondition_EvtInfo_VCEvEcmPropFr02Tioutd
          OpEventGetEventEnableCondition_GetEventEnableCondition_EvtInfo_Ga_TmSpdSyncFailed: RteEventRef=OpEventGetEventEnableCondition_GetEventEnableCondition_EvtInfo_Ga_TmSpdSyncFailed
          OpEventGetEventEnableCondition_GetEventEnableCondition_EvtInfo_INV_RSLVR_EXCT_ELEC_LO: RteEventRef=OpEventGetEventEnableCondition_GetEventEnableCondition_EvtInfo_INV_RSLVR_EXCT_ELEC_LO
          OpEventGetEventEnableCondition_GetEventEnableCondition_EvtInfo_VCEvEcmPropXevFr06Tioutd: RteEventRef=OpEventGetEventEnableCondition_GetEventEnableCondition_EvtInfo_VCEvEcmPropXevFr06Tioutd
          OpEventGetEventEnableCondition_GetEventEnableCondition_EvtInfo_VcEvCntrWhlMotSysTqAllwd: RteEventRef=OpEventGetEventEnableCondition_GetEventEnableCondition_EvtInfo_VcEvCntrWhlMotSysTqAllwd
          OpEventGetEventEnableCondition_GetEventEnableCondition_EvtInfo_INV_UHVDC_1_ELEC_HI: RteEventRef=OpEventGetEventEnableCondition_GetEventEnableCondition_EvtInfo_INV_UHVDC_1_ELEC_HI
          OpEventGetEventEnableCondition_GetEventEnableCondition_EvtInfo_INV_EM_STATOR_TEMP2_ELE_FLT: RteEventRef=OpEventGetEventEnableCondition_GetEventEnableCondition_EvtInfo_INV_EM_STATOR_TEMP2_ELE_FLT
          OpEventGetEventEnableCondition_GetEventEnableCondition_EvtInfo_AURIX_RST_SNG: RteEventRef=OpEventGetEventEnableCondition_GetEventEnableCondition_EvtInfo_AURIX_RST_SNG
          OpEventGetEventEnableCondition_GetEventEnableCondition_EvtInfo_VCEvEcmPropFr24MgmFr01Tioutd: RteEventRef=OpEventGetEventEnableCondition_GetEventEnableCondition_EvtInfo_VCEvEcmPropFr24MgmFr01Tioutd
          OpEventGetEventEnableCondition_GetEventEnableCondition_EvtInfo_INV_RSLVR_COS_ELEC_OPEN: RteEventRef=OpEventGetEventEnableCondition_GetEventEnableCondition_EvtInfo_INV_RSLVR_COS_ELEC_OPEN
          OpEventGetEventEnableCondition_GetEventEnableCondition_EvtInfo_INV_IAC_V_ELEC_LO: RteEventRef=OpEventGetEventEnableCondition_GetEventEnableCondition_EvtInfo_INV_IAC_V_ELEC_LO
          OpEventGetEventEnableCondition_GetEventEnableCondition_EvtInfo_INV_IAC_W_OFFS: RteEventRef=OpEventGetEventEnableCondition_GetEventEnableCondition_EvtInfo_INV_IAC_W_OFFS
          OpEventGetEventEnableCondition_GetEventEnableCondition_EvtInfo_INV_EM_STATOR_TEMP2_GRDT: RteEventRef=OpEventGetEventEnableCondition_GetEventEnableCondition_EvtInfo_INV_EM_STATOR_TEMP2_GRDT
          OpEventGetEventEnableCondition_GetEventEnableCondition_EvtInfo_INV_EM_OVRSPD_HWP: RteEventRef=OpEventGetEventEnableCondition_GetEventEnableCondition_EvtInfo_INV_EM_OVRSPD_HWP
          OpEventGetEventEnableCondition_GetEventEnableCondition_EvtInfo_CU_TEMP_HWP: RteEventRef=OpEventGetEventEnableCondition_GetEventEnableCondition_EvtInfo_CU_TEMP_HWP
          OpEventGetEventEnableCondition_GetEventEnableCondition_EvtInfo_INV_UHVDC_1_RNG_HI: RteEventRef=OpEventGetEventEnableCondition_GetEventEnableCondition_EvtInfo_INV_UHVDC_1_RNG_HI
          OpEventGetEventEnableCondition_GetEventEnableCondition_EvtInfo_VcEvEMPerfPlaus: RteEventRef=OpEventGetEventEnableCondition_GetEventEnableCondition_EvtInfo_VcEvEMPerfPlaus
          OpEventGetEventEnableCondition_GetEventEnableCondition_EvtInfo_VCEvVddmPropFr18Tioutd: RteEventRef=OpEventGetEventEnableCondition_GetEventEnableCondition_EvtInfo_VCEvVddmPropFr18Tioutd
          OpEventGetEventEnableCondition_GetEventEnableCondition_EvtInfo_INV_IAC_U_ELEC_HWP: RteEventRef=OpEventGetEventEnableCondition_GetEventEnableCondition_EvtInfo_INV_IAC_U_ELEC_HWP
          OpEventGetEventEnableCondition_GetEventEnableCondition_EvtInfo_VCEvVddmPropFr15Tioutd: RteEventRef=OpEventGetEventEnableCondition_GetEventEnableCondition_EvtInfo_VCEvVddmPropFr15Tioutd
          OpEventGetEventEnableCondition_GetEventEnableCondition_EvtInfo_Ga_GADisengageFailure: RteEventRef=OpEventGetEventEnableCondition_GetEventEnableCondition_EvtInfo_Ga_GADisengageFailure
          OpEventGetEventEnableCondition_GetEventEnableCondition_EvtInfo_CU_TEMP2_RNG_LO: RteEventRef=OpEventGetEventEnableCondition_GetEventEnableCondition_EvtInfo_CU_TEMP2_RNG_LO
          OpEventGetEventEnableCondition_GetEventEnableCondition_EvtInfo_INV_RSLVR_SIN_ELEC_OPEN: RteEventRef=OpEventGetEventEnableCondition_GetEventEnableCondition_EvtInfo_INV_RSLVR_SIN_ELEC_OPEN
          OpEventGetEventEnableCondition_GetEventEnableCondition_EvtInfo_VcEvChkSum: RteEventRef=OpEventGetEventEnableCondition_GetEventEnableCondition_EvtInfo_VcEvChkSum
          OpEventGetEventEnableCondition_GetEventEnableCondition_EvtInfo_PS_P5_UC_FLT: RteEventRef=OpEventGetEventEnableCondition_GetEventEnableCondition_EvtInfo_PS_P5_UC_FLT
          OpEventGetEventEnableCondition_GetEventEnableCondition_EvtInfo_INV_RSLVR_COS_ELEC_FLT: RteEventRef=OpEventGetEventEnableCondition_GetEventEnableCondition_EvtInfo_INV_RSLVR_COS_ELEC_FLT
          OpEventGetEventEnableCondition_GetEventEnableCondition_EvtInfo_INV_IAC_W_RNG_HI: RteEventRef=OpEventGetEventEnableCondition_GetEventEnableCondition_EvtInfo_INV_IAC_W_RNG_HI
          OpEventGetEventEnableCondition_GetEventEnableCondition_EvtInfo_PS_ECUSUPPLY_HIGH: RteEventRef=OpEventGetEventEnableCondition_GetEventEnableCondition_EvtInfo_PS_ECUSUPPLY_HIGH
          OpEventGetEventEnableCondition_GetEventEnableCondition_EvtInfo_VCEvEcmPropFr05Tioutd: RteEventRef=OpEventGetEventEnableCondition_GetEventEnableCondition_EvtInfo_VCEvEcmPropFr05Tioutd
          OpEventGetEventEnableCondition_GetEventEnableCondition_EvtInfo_PS_ECUSUPPLY_LOW: RteEventRef=OpEventGetEventEnableCondition_GetEventEnableCondition_EvtInfo_PS_ECUSUPPLY_LOW
          OpEventGetEventEnableCondition_GetEventEnableCondition_EvtInfo_VcEvChkSumHvSysRlySts: RteEventRef=OpEventGetEventEnableCondition_GetEventEnableCondition_EvtInfo_VcEvChkSumHvSysRlySts
          OpEventGetEventEnableCondition_GetEventEnableCondition_EvtInfo_VcEvMonMode: RteEventRef=OpEventGetEventEnableCondition_GetEventEnableCondition_EvtInfo_VcEvMonMode
          OpEventGetEventEnableCondition_GetEventEnableCondition_EvtInfo_INV_IAC_OC_SWP: RteEventRef=OpEventGetEventEnableCondition_GetEventEnableCondition_EvtInfo_INV_IAC_OC_SWP
          OpEventGetEventEnableCondition_GetEventEnableCondition_EvtInfo_INV_IMMO_AUTHFAIL: RteEventRef=OpEventGetEventEnableCondition_GetEventEnableCondition_EvtInfo_INV_IMMO_AUTHFAIL
          OpEventGetEventEnableCondition_GetEventEnableCondition_EvtInfo_PA_OpenCirc_FLT: RteEventRef=OpEventGetEventEnableCondition_GetEventEnableCondition_EvtInfo_PA_OpenCirc_FLT
          OpEventGetEventEnableCondition_GetEventEnableCondition_EvtInfo_INV_IAC_V_ELEC_HI: RteEventRef=OpEventGetEventEnableCondition_GetEventEnableCondition_EvtInfo_INV_IAC_V_ELEC_HI
          OpEventGetEventEnableCondition_GetEventEnableCondition_EvtInfo_VCEvEcmPropFr04Tioutd: RteEventRef=OpEventGetEventEnableCondition_GetEventEnableCondition_EvtInfo_VCEvEcmPropFr04Tioutd
          OpEventGetEventEnableCondition_GetEventEnableCondition_EvtInfo_VcEvMonTrqActPlaus: RteEventRef=OpEventGetEventEnableCondition_GetEventEnableCondition_EvtInfo_VcEvMonTrqActPlaus
          OpEventGetEventEnableCondition_GetEventEnableCondition_EvtInfo_VcEvMonTrqAct: RteEventRef=OpEventGetEventEnableCondition_GetEventEnableCondition_EvtInfo_VcEvMonTrqAct
          OpEventGetEventEnableCondition_GetEventEnableCondition_EvtInfo_INV_RSLVR_COS_ELEC_LO: RteEventRef=OpEventGetEventEnableCondition_GetEventEnableCondition_EvtInfo_INV_RSLVR_COS_ELEC_LO
          OpEventGetEventEnableCondition_GetEventEnableCondition_EvtInfo_INV_COOLT_INLET_TEMP_HWP: RteEventRef=OpEventGetEventEnableCondition_GetEventEnableCondition_EvtInfo_INV_COOLT_INLET_TEMP_HWP
          OpEventGetEventEnableCondition_GetEventEnableCondition_EvtInfo_VCEvEcmPropFr11Tioutd: RteEventRef=OpEventGetEventEnableCondition_GetEventEnableCondition_EvtInfo_VCEvEcmPropFr11Tioutd
          OpEventGetEventEnableCondition_GetEventEnableCondition_EvtInfo_PS_KL30_RNG_HI: RteEventRef=OpEventGetEventEnableCondition_GetEventEnableCondition_EvtInfo_PS_KL30_RNG_HI
          OpEventGetEventEnableCondition_GetEventEnableCondition_EvtInfo_INV_IAC_OC_HWP: RteEventRef=OpEventGetEventEnableCondition_GetEventEnableCondition_EvtInfo_INV_IAC_OC_HWP
          OpEventGetEventEnableCondition_GetEventEnableCondition_EvtInfo_INV_RSLVR_COS_RNG_HI: RteEventRef=OpEventGetEventEnableCondition_GetEventEnableCondition_EvtInfo_INV_RSLVR_COS_RNG_HI
          OpEventGetEventEnableCondition_GetEventEnableCondition_EvtInfo_INV_IAC_U_ELEC_HI: RteEventRef=OpEventGetEventEnableCondition_GetEventEnableCondition_EvtInfo_INV_IAC_U_ELEC_HI
          OpEventGetEventEnableCondition_GetEventEnableCondition_EvtInfo_INV_IAC_V_RNG_LO: RteEventRef=OpEventGetEventEnableCondition_GetEventEnableCondition_EvtInfo_INV_IAC_V_RNG_LO
          OpEventGetEventEnableCondition_GetEventEnableCondition_EvtInfo_INV_IAC_U_RNG_HI: RteEventRef=OpEventGetEventEnableCondition_GetEventEnableCondition_EvtInfo_INV_IAC_U_RNG_HI
          OpEventGetEventEnableCondition_GetEventEnableCondition_EvtInfo_VCEvEcmPropFr25Tioutd: RteEventRef=OpEventGetEventEnableCondition_GetEventEnableCondition_EvtInfo_VCEvEcmPropFr25Tioutd
          OpEventGetEventEnableCondition_GetEventEnableCondition_EvtInfo_INV_IGBT_TEMP_W_RNG_LO: RteEventRef=OpEventGetEventEnableCondition_GetEventEnableCondition_EvtInfo_INV_IGBT_TEMP_W_RNG_LO
          OpEventGetEventEnableCondition_GetEventEnableCondition_EvtInfo_PSnsr_RNG_NOK: RteEventRef=OpEventGetEventEnableCondition_GetEventEnableCondition_EvtInfo_PSnsr_RNG_NOK
          OpEventGetEventEnableCondition_GetEventEnableCondition_EvtInfo_INV_RSLVR_COS_RNG_NOK: RteEventRef=OpEventGetEventEnableCondition_GetEventEnableCondition_EvtInfo_INV_RSLVR_COS_RNG_NOK
          OpEventGetEventEnableCondition_GetEventEnableCondition_EvtInfo_PS_DRVB_Fault: RteEventRef=OpEventGetEventEnableCondition_GetEventEnableCondition_EvtInfo_PS_DRVB_Fault
          OpEventGetEventEnableCondition_GetEventEnableCondition_EvtInfo_INV_CU_TEMP1_RNG_NOK: RteEventRef=OpEventGetEventEnableCondition_GetEventEnableCondition_EvtInfo_INV_CU_TEMP1_RNG_NOK
          OpEventGetEventEnableCondition_GetEventEnableCondition_EvtInfo_VcEvCntr: RteEventRef=OpEventGetEventEnableCondition_GetEventEnableCondition_EvtInfo_VcEvCntr
          OpEventGetEventEnableCondition_GetEventEnableCondition_EvtInfo_INV_RSLVR_SIN_AMP: RteEventRef=OpEventGetEventEnableCondition_GetEventEnableCondition_EvtInfo_INV_RSLVR_SIN_AMP
          OpEventGetEventEnableCondition_GetEventEnableCondition_EvtInfo_INV_UHVDC_2_RNG_HI: RteEventRef=OpEventGetEventEnableCondition_GetEventEnableCondition_EvtInfo_INV_UHVDC_2_RNG_HI
          OpEventGetEventEnableCondition_GetEventEnableCondition_EvtInfo_INV_IGBT_TEMP_U_GRDT: RteEventRef=OpEventGetEventEnableCondition_GetEventEnableCondition_EvtInfo_INV_IGBT_TEMP_U_GRDT
          OpEventGetEventEnableCondition_GetEventEnableCondition_EvtInfo_MON_TQ_PLAUS_PWR_MDL: RteEventRef=OpEventGetEventEnableCondition_GetEventEnableCondition_EvtInfo_MON_TQ_PLAUS_PWR_MDL
          OpEventGetEventEnableCondition_GetEventEnableCondition_EvtInfo_INV_IGBT_TEMP_W_PLAUS: RteEventRef=OpEventGetEventEnableCondition_GetEventEnableCondition_EvtInfo_INV_IGBT_TEMP_W_PLAUS
          OpEventGetEventEnableCondition_GetEventEnableCondition_EvtInfo_PS_BLDC_UV_FLT: RteEventRef=OpEventGetEventEnableCondition_GetEventEnableCondition_EvtInfo_PS_BLDC_UV_FLT
          OpEventGetEventEnableCondition_GetEventEnableCondition_EvtInfo_INV_IAC_V_OFFS: RteEventRef=OpEventGetEventEnableCondition_GetEventEnableCondition_EvtInfo_INV_IAC_V_OFFS
          OpEventGetEventEnableCondition_GetEventEnableCondition_EvtInfo_INV_RSLVR_EXCT_FREQ_RNG_NOK: RteEventRef=OpEventGetEventEnableCondition_GetEventEnableCondition_EvtInfo_INV_RSLVR_EXCT_FREQ_RNG_NOK
          OpEventGetEventEnableCondition_GetEventEnableCondition_EvtInfo_PS_KL30_RNG_LO: RteEventRef=OpEventGetEventEnableCondition_GetEventEnableCondition_EvtInfo_PS_KL30_RNG_LO
          OpEventGetEventEnableCondition_GetEventEnableCondition_EvtInfo_INV_RSLVR_COS_RNG_LO: RteEventRef=OpEventGetEventEnableCondition_GetEventEnableCondition_EvtInfo_INV_RSLVR_COS_RNG_LO
          OpEventGetEventEnableCondition_GetEventEnableCondition_EvtInfo_PSnsr_ELE_FLT: RteEventRef=OpEventGetEventEnableCondition_GetEventEnableCondition_EvtInfo_PSnsr_ELE_FLT
          OpEventGetEventEnableCondition_GetEventEnableCondition_EvtInfo_INV_RSLVR_SIN_COS_PLAUS_AMP: RteEventRef=OpEventGetEventEnableCondition_GetEventEnableCondition_EvtInfo_INV_RSLVR_SIN_COS_PLAUS_AMP
          OpEventGetEventEnableCondition_GetEventEnableCondition_EvtInfo_INV_IAC_U_ELEC_LO: RteEventRef=OpEventGetEventEnableCondition_GetEventEnableCondition_EvtInfo_INV_IAC_U_ELEC_LO
          OpEventGetEventEnableCondition_GetEventEnableCondition_EvtInfo_INV_RSLVR_EXCT_ELEC_HI: RteEventRef=OpEventGetEventEnableCondition_GetEventEnableCondition_EvtInfo_INV_RSLVR_EXCT_ELEC_HI
          OpEventGetEventEnableCondition_GetEventEnableCondition_EvtInfo_INV_IAC_U_RNG_LO: RteEventRef=OpEventGetEventEnableCondition_GetEventEnableCondition_EvtInfo_INV_IAC_U_RNG_LO
          OpEventGetEventEnableCondition_GetEventEnableCondition_EvtInfo_INV_IAC_V_RNG_HI: RteEventRef=OpEventGetEventEnableCondition_GetEventEnableCondition_EvtInfo_INV_IAC_V_RNG_HI
          OpEventGetEventEnableCondition_GetEventEnableCondition_EvtInfo_INV_IGBT_TEMP_U_PLAUS: RteEventRef=OpEventGetEventEnableCondition_GetEventEnableCondition_EvtInfo_INV_IGBT_TEMP_U_PLAUS
          OpEventGetEventEnableCondition_GetEventEnableCondition_EvtInfo_INV_RSLVR_OFFS_DFT: RteEventRef=OpEventGetEventEnableCondition_GetEventEnableCondition_EvtInfo_INV_RSLVR_OFFS_DFT
          OpEventGetEventEnableCondition_GetEventEnableCondition_EvtInfo_Ga_MoveOverThd: RteEventRef=OpEventGetEventEnableCondition_GetEventEnableCondition_EvtInfo_Ga_MoveOverThd
          OpEventGetEventEnableCondition_GetEventEnableCondition_EvtInfo_VcEvMonIPH: RteEventRef=OpEventGetEventEnableCondition_GetEventEnableCondition_EvtInfo_VcEvMonIPH
          OpEventGetEventEnableCondition_GetEventEnableCondition_EvtInfo_INV_RSLVR_HW_FLT: RteEventRef=OpEventGetEventEnableCondition_GetEventEnableCondition_EvtInfo_INV_RSLVR_HW_FLT
          OpEventGetEventEnableCondition_GetEventEnableCondition_EvtInfo_INV_RSLVR_SIN_ELEC_LO: RteEventRef=OpEventGetEventEnableCondition_GetEventEnableCondition_EvtInfo_INV_RSLVR_SIN_ELEC_LO
          OpEventGetEventEnableCondition_GetEventEnableCondition_EvtInfo_INV_IAC_W_AMP: RteEventRef=OpEventGetEventEnableCondition_GetEventEnableCondition_EvtInfo_INV_IAC_W_AMP
          OpEventGetEventEnableCondition_GetEventEnableCondition_EvtInfo_VCC_OverVoltage: RteEventRef=OpEventGetEventEnableCondition_GetEventEnableCondition_EvtInfo_VCC_OverVoltage
          OpEventGetEventEnableCondition_GetEventEnableCondition_EvtInfo_PS_BLDC_OV_FLT: RteEventRef=OpEventGetEventEnableCondition_GetEventEnableCondition_EvtInfo_PS_BLDC_OV_FLT
          OpEventGetEventEnableCondition_GetEventEnableCondition_EvtInfo_AURIX_EEPROM_FLT: RteEventRef=OpEventGetEventEnableCondition_GetEventEnableCondition_EvtInfo_AURIX_EEPROM_FLT
          OpEventGetEventEnableCondition_GetEventEnableCondition_EvtInfo_FS_MONITIOR_ASC_FW_FLT: RteEventRef=OpEventGetEventEnableCondition_GetEventEnableCondition_EvtInfo_FS_MONITIOR_ASC_FW_FLT
          OpEventGetEventEnableCondition_GetEventEnableCondition_EvtInfo_VCEvSrsPropFr02Tioutd: RteEventRef=OpEventGetEventEnableCondition_GetEventEnableCondition_EvtInfo_VCEvSrsPropFr02Tioutd
          OpEventGetEventEnableCondition_GetEventEnableCondition_EvtInfo_VcEvMonErrMode: RteEventRef=OpEventGetEventEnableCondition_GetEventEnableCondition_EvtInfo_VcEvMonErrMode
          OpEventGetEventEnableCondition_GetEventEnableCondition_EvtInfo_AURIX_RST_MPL: RteEventRef=OpEventGetEventEnableCondition_GetEventEnableCondition_EvtInfo_AURIX_RST_MPL
          OpEventGetEventEnableCondition_GetEventEnableCondition_EvtInfo_VcEvNodeMisECM: RteEventRef=OpEventGetEventEnableCondition_GetEventEnableCondition_EvtInfo_VcEvNodeMisECM
          OpEventGetEventEnableCondition_GetEventEnableCondition_EvtInfo_PS_KL30_PLAUS: RteEventRef=OpEventGetEventEnableCondition_GetEventEnableCondition_EvtInfo_PS_KL30_PLAUS
          OpEventGetEventEnableCondition_GetEventEnableCondition_EvtInfo_INV_IAC_W_ELEC_HI: RteEventRef=OpEventGetEventEnableCondition_GetEventEnableCondition_EvtInfo_INV_IAC_W_ELEC_HI
          OpEventGetEventEnableCondition_GetEventEnableCondition_EvtInfo_VCEvVddmPropFr19Tioutd: RteEventRef=OpEventGetEventEnableCondition_GetEventEnableCondition_EvtInfo_VCEvVddmPropFr19Tioutd
          OpEventGetEventEnableCondition_GetEventEnableCondition_EvtInfo_INV_TEMP_DCHA_HW: RteEventRef=OpEventGetEventEnableCondition_GetEventEnableCondition_EvtInfo_INV_TEMP_DCHA_HW
          OpEventGetEventEnableCondition_GetEventEnableCondition_EvtInfo_VcEvPropCANGlbTiOutd: RteEventRef=OpEventGetEventEnableCondition_GetEventEnableCondition_EvtInfo_VcEvPropCANGlbTiOutd
          OpEventGetEventEnableCondition_GetEventEnableCondition_EvtInfo_INV_EM_STATOR_TEMP2_RNG_NOK: RteEventRef=OpEventGetEventEnableCondition_GetEventEnableCondition_EvtInfo_INV_EM_STATOR_TEMP2_RNG_NOK
          OpEventGetEventEnableCondition_GetEventEnableCondition_EvtInfo_INV_UHVDC_OV_HWP: RteEventRef=OpEventGetEventEnableCondition_GetEventEnableCondition_EvtInfo_INV_UHVDC_OV_HWP
          OpEventGetEventEnableCondition_GetEventEnableCondition_EvtInfo_Ga_FindEngleAngleFailed: RteEventRef=OpEventGetEventEnableCondition_GetEventEnableCondition_EvtInfo_Ga_FindEngleAngleFailed
          OpEventGetEventEnableCondition_GetEventEnableCondition_EvtInfo_VcEvMonTrqCmp: RteEventRef=OpEventGetEventEnableCondition_GetEventEnableCondition_EvtInfo_VcEvMonTrqCmp
          OpEventGetEventEnableCondition_GetEventEnableCondition_EvtInfo_INV_IGBT_TEMP_V_RNG_LO: RteEventRef=OpEventGetEventEnableCondition_GetEventEnableCondition_EvtInfo_INV_IGBT_TEMP_V_RNG_LO
          OpEventGetEventEnableCondition_GetEventEnableCondition_EvtInfo_INV_CONTROL_LIMIT: RteEventRef=OpEventGetEventEnableCondition_GetEventEnableCondition_EvtInfo_INV_CONTROL_LIMIT
          OpEventGetEventEnableCondition_GetEventEnableCondition_EvtInfo_COM_CarConfigErr: RteEventRef=OpEventGetEventEnableCondition_GetEventEnableCondition_EvtInfo_COM_CarConfigErr
          OpEventGetEventEnableCondition_GetEventEnableCondition_EvtInfo_VCEvEcmPropFr08Tioutd: RteEventRef=OpEventGetEventEnableCondition_GetEventEnableCondition_EvtInfo_VCEvEcmPropFr08Tioutd
          OpEventGetEventEnableCondition_GetEventEnableCondition_EvtInfo_CU_TEMP1_RNG_LO: RteEventRef=OpEventGetEventEnableCondition_GetEventEnableCondition_EvtInfo_CU_TEMP1_RNG_LO
          OpEventGetEventEnableCondition_GetEventEnableCondition_EvtInfo_INV_EM_STATOR_TEMP2_RNG_SWT: RteEventRef=OpEventGetEventEnableCondition_GetEventEnableCondition_EvtInfo_INV_EM_STATOR_TEMP2_RNG_SWT
          OpEventGetEventEnableCondition_GetEventEnableCondition_EvtInfo_GA_BLDC_POS_FLT: RteEventRef=OpEventGetEventEnableCondition_GetEventEnableCondition_EvtInfo_GA_BLDC_POS_FLT
          OpEventGetEventEnableCondition_GetEventEnableCondition_EvtInfo_PS_WhlSnsr_FLT: RteEventRef=OpEventGetEventEnableCondition_GetEventEnableCondition_EvtInfo_PS_WhlSnsr_FLT
          OpEventGetEventEnableCondition_GetEventEnableCondition_EvtInfo_INV_EM_STATOR_TEMP_RNG_LO: RteEventRef=OpEventGetEventEnableCondition_GetEventEnableCondition_EvtInfo_INV_EM_STATOR_TEMP_RNG_LO
          OpEventGetEventEnableCondition_GetEventEnableCondition_EvtInfo_INV_RSLVR_SIN_ELEC_HI: RteEventRef=OpEventGetEventEnableCondition_GetEventEnableCondition_EvtInfo_INV_RSLVR_SIN_ELEC_HI
          OpEventGetEventEnableCondition_GetEventEnableCondition_EvtInfo_INV_RSLVR_SIN_COS_PLAUS: RteEventRef=OpEventGetEventEnableCondition_GetEventEnableCondition_EvtInfo_INV_RSLVR_SIN_COS_PLAUS
          OpEventGetEventEnableCondition_GetEventEnableCondition_EvtInfo_INV_RSLVR_COS_AMP: RteEventRef=OpEventGetEventEnableCondition_GetEventEnableCondition_EvtInfo_INV_RSLVR_COS_AMP
          OpEventGetEventEnableCondition_GetEventEnableCondition_EvtInfo_INV_GATE_DRVR_BOT_HWP: RteEventRef=OpEventGetEventEnableCondition_GetEventEnableCondition_EvtInfo_INV_GATE_DRVR_BOT_HWP
          OpEventGetEventEnableCondition_GetEventEnableCondition_EvtInfo_Eg_HallVolWrong: RteEventRef=OpEventGetEventEnableCondition_GetEventEnableCondition_EvtInfo_Eg_HallVolWrong
          OpEventGetEventEnableCondition_GetEventEnableCondition_EvtInfo_INV_RSLVR_EXCT_RNG_NOK: RteEventRef=OpEventGetEventEnableCondition_GetEventEnableCondition_EvtInfo_INV_RSLVR_EXCT_RNG_NOK
          OpEventGetEventEnableCondition_GetEventEnableCondition_EvtInfo_PA_OpenCirc: RteEventRef=OpEventGetEventEnableCondition_GetEventEnableCondition_EvtInfo_PA_OpenCirc
          OpEventGetEventEnableCondition_GetEventEnableCondition_EvtInfo_INV_RSLVR_COS_ELEC_HI: RteEventRef=OpEventGetEventEnableCondition_GetEventEnableCondition_EvtInfo_INV_RSLVR_COS_ELEC_HI
          OpEventGetEventEnableCondition_GetEventEnableCondition_EvtInfo_VcEvCntrHvSysRlySts: RteEventRef=OpEventGetEventEnableCondition_GetEventEnableCondition_EvtInfo_VcEvCntrHvSysRlySts
          OpEventGetEventEnableCondition_GetEventEnableCondition_EvtInfo_CRASH_DTC: RteEventRef=OpEventGetEventEnableCondition_GetEventEnableCondition_EvtInfo_CRASH_DTC
          OpEventGetEventEnableCondition_GetEventEnableCondition_EvtInfo_INV_IGBT_TEMP_W_RNG_HI: RteEventRef=OpEventGetEventEnableCondition_GetEventEnableCondition_EvtInfo_INV_IGBT_TEMP_W_RNG_HI
          OpEventGetEventEnableCondition_GetEventEnableCondition_EvtInfo_VCEvBecmPropFr02Tioutd: RteEventRef=OpEventGetEventEnableCondition_GetEventEnableCondition_EvtInfo_VCEvBecmPropFr02Tioutd
          OpEventGetEventEnableCondition_GetEventEnableCondition_EvtInfo_INV_IGBT_TEMP_W_GRDT: RteEventRef=OpEventGetEventEnableCondition_GetEventEnableCondition_EvtInfo_INV_IGBT_TEMP_W_GRDT
          OpEventGetEventEnableCondition_GetEventEnableCondition_EvtInfo_EXT_UC_SPI_FLT: RteEventRef=OpEventGetEventEnableCondition_GetEventEnableCondition_EvtInfo_EXT_UC_SPI_FLT
          OpEventGetEventEnableCondition_GetEventEnableCondition_EvtInfo_INV_IAC_V_ELEC_HWP_001: RteEventRef=OpEventGetEventEnableCondition_GetEventEnableCondition_EvtInfo_INV_IAC_V_ELEC_HWP_001
          OpEventGetEventEnableCondition_GetEventEnableCondition_EvtInfo_VcEvChkSumWhlMotSysTqAllwd: RteEventRef=OpEventGetEventEnableCondition_GetEventEnableCondition_EvtInfo_VcEvChkSumWhlMotSysTqAllwd
          OpEventGetEventEnableCondition_GetEventEnableCondition_EvtInfo_FS_MONITIOR_ASC_FLT: RteEventRef=OpEventGetEventEnableCondition_GetEventEnableCondition_EvtInfo_FS_MONITIOR_ASC_FLT
          OpEventGetEventEnableCondition_GetEventEnableCondition_EvtInfo_INV_IAC_V_AMP: RteEventRef=OpEventGetEventEnableCondition_GetEventEnableCondition_EvtInfo_INV_IAC_V_AMP
          OpEventGetEventEnableCondition_GetEventEnableCondition_EvtInfo_INV_IAC_W_ELEC_LO: RteEventRef=OpEventGetEventEnableCondition_GetEventEnableCondition_EvtInfo_INV_IAC_W_ELEC_LO
          OpEventGetEventEnableCondition_GetEventEnableCondition_EvtInfo_VCEvVddmPropFr08Tioutd_001: RteEventRef=OpEventGetEventEnableCondition_GetEventEnableCondition_EvtInfo_VCEvVddmPropFr08Tioutd_001
          OpEventGetEventEnableCondition_GetEventEnableCondition_EvtInfo_PS_P12_RES_FLT: RteEventRef=OpEventGetEventEnableCondition_GetEventEnableCondition_EvtInfo_PS_P12_RES_FLT
          OpEventGetEventEnableCondition_GetEventEnableCondition_EvtInfo_INV_RSLVR_SIN_RNG_LO: RteEventRef=OpEventGetEventEnableCondition_GetEventEnableCondition_EvtInfo_INV_RSLVR_SIN_RNG_LO
          OpEventGetEventEnableCondition_GetEventEnableCondition_EvtInfo_CU_TEMP_HW_FLT: RteEventRef=OpEventGetEventEnableCondition_GetEventEnableCondition_EvtInfo_CU_TEMP_HW_FLT
          OpEventGetEventEnableCondition_GetEventEnableCondition_EvtInfo_VCEvEcmPropFr02MgmFr00Tioutd: RteEventRef=OpEventGetEventEnableCondition_GetEventEnableCondition_EvtInfo_VCEvEcmPropFr02MgmFr00Tioutd
          OpEventGetEventEnableCondition_GetEventEnableCondition_EvtInfo_PS_KL15_RNG_HI: RteEventRef=OpEventGetEventEnableCondition_GetEventEnableCondition_EvtInfo_PS_KL15_RNG_HI
          OpEventGetEventEnableCondition_GetEventEnableCondition_EvtInfo_VCEvVddmPropFr17Tioutd: RteEventRef=OpEventGetEventEnableCondition_GetEventEnableCondition_EvtInfo_VCEvVddmPropFr17Tioutd
          OpEventGetEventEnableCondition_GetEventEnableCondition_EvtInfo_VcEvChkSumCrashStsSafe: RteEventRef=OpEventGetEventEnableCondition_GetEventEnableCondition_EvtInfo_VcEvChkSumCrashStsSafe
          OpEventGetEventEnableCondition_GetEventEnableCondition_EvtInfo_DiagC_ClutchService: RteEventRef=OpEventGetEventEnableCondition_GetEventEnableCondition_EvtInfo_DiagC_ClutchService
          OpEventGetEventEnableCondition_GetEventEnableCondition_EvtInfo_INV_EM_STATOR_TEMP_RNG_HI: RteEventRef=OpEventGetEventEnableCondition_GetEventEnableCondition_EvtInfo_INV_EM_STATOR_TEMP_RNG_HI
          OpEventGetEventEnableCondition_GetEventEnableCondition_EvtInfo_INV_RSLVR_OFFS_OUT_RANG: RteEventRef=OpEventGetEventEnableCondition_GetEventEnableCondition_EvtInfo_INV_RSLVR_OFFS_OUT_RANG
          OpEventGetEventEnableCondition_GetEventEnableCondition_EvtInfo_INV_EM_STATOR_TEMP2_RNG_LO: RteEventRef=OpEventGetEventEnableCondition_GetEventEnableCondition_EvtInfo_INV_EM_STATOR_TEMP2_RNG_LO
          OpEventGetEventEnableCondition_GetEventEnableCondition_EvtInfo_VcEvMonISAR: RteEventRef=OpEventGetEventEnableCondition_GetEventEnableCondition_EvtInfo_VcEvMonISAR
          OpEventGetEventEnableCondition_GetEventEnableCondition_EvtInfo_GA_BLDC_FLT: RteEventRef=OpEventGetEventEnableCondition_GetEventEnableCondition_EvtInfo_GA_BLDC_FLT
          OpEventGetEventEnableCondition_GetEventEnableCondition_EvtInfo_INV_RSLVR_EXCT_ELEC_OPEN: RteEventRef=OpEventGetEventEnableCondition_GetEventEnableCondition_EvtInfo_INV_RSLVR_EXCT_ELEC_OPEN
          OpEventGetEventEnableCondition_GetEventEnableCondition_EvtInfo_INV_RSLVR_EXCT_PLAUS: RteEventRef=OpEventGetEventEnableCondition_GetEventEnableCondition_EvtInfo_INV_RSLVR_EXCT_PLAUS
          OpEventGetEventEnableCondition_GetEventEnableCondition_EvtInfo_PS_P15_U_FLT: RteEventRef=OpEventGetEventEnableCondition_GetEventEnableCondition_EvtInfo_PS_P15_U_FLT
          OpEventGetEventEnableCondition_GetEventEnableCondition_EvtInfo_INV_EM_STATOR_TEMP_RNG_SWT: RteEventRef=OpEventGetEventEnableCondition_GetEventEnableCondition_EvtInfo_INV_EM_STATOR_TEMP_RNG_SWT
          OpEventGetEventEnableCondition_GetEventEnableCondition_EvtInfo_INV_UHVDC_OV_SWP: RteEventRef=OpEventGetEventEnableCondition_GetEventEnableCondition_EvtInfo_INV_UHVDC_OV_SWP
          OpEventGetEventEnableCondition_GetEventEnableCondition_EvtInfo_AURIX_HW_FLT: RteEventRef=OpEventGetEventEnableCondition_GetEventEnableCondition_EvtInfo_AURIX_HW_FLT
          OpEventGetEventEnableCondition_GetEventEnableCondition_EvtInfo_INV_GATE_DRVR_TOP_HWP: RteEventRef=OpEventGetEventEnableCondition_GetEventEnableCondition_EvtInfo_INV_GATE_DRVR_TOP_HWP
          OpEventGetEventEnableCondition_GetEventEnableCondition_EvtInfo_INV_ACTV_DCHA_HW: RteEventRef=OpEventGetEventEnableCondition_GetEventEnableCondition_EvtInfo_INV_ACTV_DCHA_HW
          OpEventGetEventEnableCondition_GetEventEnableCondition_EvtInfo_INV_IGBT_TEMP_HWP: RteEventRef=OpEventGetEventEnableCondition_GetEventEnableCondition_EvtInfo_INV_IGBT_TEMP_HWP
          OpEventGetEventEnableCondition_GetEventEnableCondition_EvtInfo_INV_RSLVR_SIN_ELEC_FLT: RteEventRef=OpEventGetEventEnableCondition_GetEventEnableCondition_EvtInfo_INV_RSLVR_SIN_ELEC_FLT
          OpEventGetEventEnableCondition_GetEventEnableCondition_EvtInfo_CU_TEMP2_RNG_HI: RteEventRef=OpEventGetEventEnableCondition_GetEventEnableCondition_EvtInfo_CU_TEMP2_RNG_HI
          OpEventGetEventEnableCondition_GetEventEnableCondition_EvtInfo_INV_IAC_PHA_LOSS_MPL: RteEventRef=OpEventGetEventEnableCondition_GetEventEnableCondition_EvtInfo_INV_IAC_PHA_LOSS_MPL
          OpEventGetEventEnableCondition_GetEventEnableCondition_EvtInfo_INV_IAC_U_AMP: RteEventRef=OpEventGetEventEnableCondition_GetEventEnableCondition_EvtInfo_INV_IAC_U_AMP
          OpEventGetEventEnableCondition_GetEventEnableCondition_EvtInfo_PSnsr_GRADT_Flt: RteEventRef=OpEventGetEventEnableCondition_GetEventEnableCondition_EvtInfo_PSnsr_GRADT_Flt
          OpEventGetEventEnableCondition_GetEventEnableCondition_EvtInfo_AURIX_WATHDOG_FLT: RteEventRef=OpEventGetEventEnableCondition_GetEventEnableCondition_EvtInfo_AURIX_WATHDOG_FLT
          OpEventGetEventEnableCondition_GetEventEnableCondition_EvtInfo_VcEvNodeMisBECM: RteEventRef=OpEventGetEventEnableCondition_GetEventEnableCondition_EvtInfo_VcEvNodeMisBECM
          OpEventGetEventEnableCondition_GetEventEnableCondition_EvtInfo_INV_UHVDC_UV_HWP: RteEventRef=OpEventGetEventEnableCondition_GetEventEnableCondition_EvtInfo_INV_UHVDC_UV_HWP
          OpEventGetEventEnableCondition_GetEventEnableCondition_EvtInfo_VcEvMonESpd: RteEventRef=OpEventGetEventEnableCondition_GetEventEnableCondition_EvtInfo_VcEvMonESpd
          OpEventGetEventEnableCondition_GetEventEnableCondition_EvtInfo_COM_NotConfig: RteEventRef=OpEventGetEventEnableCondition_GetEventEnableCondition_EvtInfo_COM_NotConfig
          OpEventGetEventEnableCondition_GetEventEnableCondition_EvtInfo_INV_RSLVR_SIN_RNG_HI: RteEventRef=OpEventGetEventEnableCondition_GetEventEnableCondition_EvtInfo_INV_RSLVR_SIN_RNG_HI
          OpEventGetEventEnableCondition_GetEventEnableCondition_EvtInfo_INV_IGBT_TEMP_U_RNG_HI: RteEventRef=OpEventGetEventEnableCondition_GetEventEnableCondition_EvtInfo_INV_IGBT_TEMP_U_RNG_HI
          OpEventGetEventEnableCondition_GetEventEnableCondition_EvtInfo_VcEvMonMode_001: RteEventRef=OpEventGetEventEnableCondition_GetEventEnableCondition_EvtInfo_VcEvMonMode_001
          OpEventGetEventEnableCondition_GetEventEnableCondition_EvtInfo_PA_ACTION_FLT: RteEventRef=OpEventGetEventEnableCondition_GetEventEnableCondition_EvtInfo_PA_ACTION_FLT
          OpEventGetEventEnableCondition_GetEventEnableCondition_EvtInfo_INV_IAC_V_ELEC_HWP: RteEventRef=OpEventGetEventEnableCondition_GetEventEnableCondition_EvtInfo_INV_IAC_V_ELEC_HWP
          OpEventGetEventEnableCondition_GetEventEnableCondition_EvtInfo_CU_TEMP_HW_FLT_001: RteEventRef=OpEventGetEventEnableCondition_GetEventEnableCondition_EvtInfo_CU_TEMP_HW_FLT_001
          OpEventGetEventEnableCondition_GetEventEnableCondition_EvtInfo_VCC_UnderVoltage: RteEventRef=OpEventGetEventEnableCondition_GetEventEnableCondition_EvtInfo_VCC_UnderVoltage
          OpEventGetEventEnableCondition_GetEventEnableCondition_EvtInfo_VcEvTsttrPlaus: RteEventRef=OpEventGetEventEnableCondition_GetEventEnableCondition_EvtInfo_VcEvTsttrPlaus
          OpEventGetEventEnableCondition_GetEventEnableCondition_EvtInfo_INV_RSLVR_EXCT_ELEC_FLT: RteEventRef=OpEventGetEventEnableCondition_GetEventEnableCondition_EvtInfo_INV_RSLVR_EXCT_ELEC_FLT
          OpEventGetEventEnableCondition_GetEventEnableCondition_EvtInfo_INV_RSLVR_EXCT_RNG_LO: RteEventRef=OpEventGetEventEnableCondition_GetEventEnableCondition_EvtInfo_INV_RSLVR_EXCT_RNG_LO
          OpEventGetEventEnableCondition_GetEventEnableCondition_EvtInfo_INV_EM_STATOR_TEMP2_RNG_HI: RteEventRef=OpEventGetEventEnableCondition_GetEventEnableCondition_EvtInfo_INV_EM_STATOR_TEMP2_RNG_HI
          OpEventGetEventEnableCondition_GetEventEnableCondition_EvtInfo_INV_SHUT_OFF_PAH_START_UP: RteEventRef=OpEventGetEventEnableCondition_GetEventEnableCondition_EvtInfo_INV_SHUT_OFF_PAH_START_UP
          OpEventGetEventEnableCondition_GetEventEnableCondition_EvtInfo_VCEvVddmPropFr08Tioutd: RteEventRef=OpEventGetEventEnableCondition_GetEventEnableCondition_EvtInfo_VCEvVddmPropFr08Tioutd
          OpEventGetEventEnableCondition_GetEventEnableCondition_EvtInfo_INV_RSLVR_EXCT_OC_HWP_001: RteEventRef=OpEventGetEventEnableCondition_GetEventEnableCondition_EvtInfo_INV_RSLVR_EXCT_OC_HWP_001
          OpEventGetEventEnableCondition_GetEventEnableCondition_EvtInfo_INV_RSLVR_EXCT_OC_HWP_002: RteEventRef=OpEventGetEventEnableCondition_GetEventEnableCondition_EvtInfo_INV_RSLVR_EXCT_OC_HWP_002
          OpEventGetEventEnableCondition_GetEventEnableCondition_EvtInfo_INV_EM_STATOR_TEMP_ELE_FLT: RteEventRef=OpEventGetEventEnableCondition_GetEventEnableCondition_EvtInfo_INV_EM_STATOR_TEMP_ELE_FLT
          OpEventGetEventEnableCondition_GetEventEnableCondition_EvtInfo_INV_INTERLOCK_FLT: RteEventRef=OpEventGetEventEnableCondition_GetEventEnableCondition_EvtInfo_INV_INTERLOCK_FLT
          OpEventGetEventEnableCondition_GetEventEnableCondition_EvtInfo_Ga_ZeroFindDistanFailure: RteEventRef=OpEventGetEventEnableCondition_GetEventEnableCondition_EvtInfo_Ga_ZeroFindDistanFailure
          OpEventGetEventEnableCondition_GetEventEnableCondition_EvtInfo_PLOCK_Current_RNG_OUT: RteEventRef=OpEventGetEventEnableCondition_GetEventEnableCondition_EvtInfo_PLOCK_Current_RNG_OUT
          OpEventGetEventEnableCondition_GetEventEnableCondition_EvtInfo_VCEvVddmPropFr05Tioutd: RteEventRef=OpEventGetEventEnableCondition_GetEventEnableCondition_EvtInfo_VCEvVddmPropFr05Tioutd
          OpEventGetEventEnableCondition_GetEventEnableCondition_EvtInfo_INV_IGBT_TEMP_V_GRDT: RteEventRef=OpEventGetEventEnableCondition_GetEventEnableCondition_EvtInfo_INV_IGBT_TEMP_V_GRDT
          OpEventGetEventEnableCondition_GetEventEnableCondition_EvtInfo_PS_5V_Fault: RteEventRef=OpEventGetEventEnableCondition_GetEventEnableCondition_EvtInfo_PS_5V_Fault
          OpEventGetEventEnableCondition_GetEventEnableCondition_EvtInfo_VcEvCntrCrashStsSafe: RteEventRef=OpEventGetEventEnableCondition_GetEventEnableCondition_EvtInfo_VcEvCntrCrashStsSafe
          OpEventGetEventEnableCondition_GetEventEnableCondition_EvtInfo_INV_EM_STATOR_TEMP_GRDT: RteEventRef=OpEventGetEventEnableCondition_GetEventEnableCondition_EvtInfo_INV_EM_STATOR_TEMP_GRDT
          OpEventGetEventEnableCondition_GetEventEnableCondition_EvtInfo_PS_P15_V_FLT: RteEventRef=OpEventGetEventEnableCondition_GetEventEnableCondition_EvtInfo_PS_P15_V_FLT
          OpEventGetEventEnableCondition_GetEventEnableCondition_EvtInfo_INV_EM_STATOR_TEMP_RNG_NOK: RteEventRef=OpEventGetEventEnableCondition_GetEventEnableCondition_EvtInfo_INV_EM_STATOR_TEMP_RNG_NOK
          OpEventGetEventEnableCondition_GetEventEnableCondition_EvtInfo_INV_RSLVR_SIN_RNG_NOK: RteEventRef=OpEventGetEventEnableCondition_GetEventEnableCondition_EvtInfo_INV_RSLVR_SIN_RNG_NOK
          OpEventGetEventEnableCondition_GetEventEnableCondition_EvtInfo_INV_IAC_U_OFFS: RteEventRef=OpEventGetEventEnableCondition_GetEventEnableCondition_EvtInfo_INV_IAC_U_OFFS
          OpEventGetEventEnableCondition_GetEventEnableCondition_EvtInfo_PS_KL30_BACKUP_FLT: RteEventRef=OpEventGetEventEnableCondition_GetEventEnableCondition_EvtInfo_PS_KL30_BACKUP_FLT
          OpEventGetEventEnableCondition_GetEventEnableCondition_EvtInfo_INV_IGBT_TEMP_U_RNG_LO: RteEventRef=OpEventGetEventEnableCondition_GetEventEnableCondition_EvtInfo_INV_IGBT_TEMP_U_RNG_LO
          OpEventGetEventEnableCondition_GetEventEnableCondition_EvtInfo_INV_EM_STATOR_TEMP_HWP: RteEventRef=OpEventGetEventEnableCondition_GetEventEnableCondition_EvtInfo_INV_EM_STATOR_TEMP_HWP
          OpEventGetEventEnableCondition_GetEventEnableCondition_EvtInfo_CU_TEMP1_RNG_HI: RteEventRef=OpEventGetEventEnableCondition_GetEventEnableCondition_EvtInfo_CU_TEMP1_RNG_HI
          OpEventGetEventEnableCondition_GetEventEnableCondition_EvtInfo_INV_IGBT_TEMP_V_RNG_HI: RteEventRef=OpEventGetEventEnableCondition_GetEventEnableCondition_EvtInfo_INV_IGBT_TEMP_V_RNG_HI
          OpEventGetEventEnableCondition_GetEventEnableCondition_EvtInfo_VcEvNodeMisVDDM: RteEventRef=OpEventGetEventEnableCondition_GetEventEnableCondition_EvtInfo_VcEvNodeMisVDDM
          OpEventGetEventEnableCondition_GetEventEnableCondition_EvtInfo_INV_UHVDC_PLAUS: RteEventRef=OpEventGetEventEnableCondition_GetEventEnableCondition_EvtInfo_INV_UHVDC_PLAUS
          OpEventGetEventEnableCondition_GetEventEnableCondition_EvtInfo_INV_QUIESCENT_FLT: RteEventRef=OpEventGetEventEnableCondition_GetEventEnableCondition_EvtInfo_INV_QUIESCENT_FLT
          OpEventGetEventEnableCondition_GetEventEnableCondition_EvtInfo_INV_RSLVR_EXCT_RNG_HI: RteEventRef=OpEventGetEventEnableCondition_GetEventEnableCondition_EvtInfo_INV_RSLVR_EXCT_RNG_HI
          OpEventGetEventEnableCondition_GetEventEnableCondition_GeneralEvtInfo: RteEventRef=OpEventGetEventEnableCondition_GetEventEnableCondition_GeneralEvtInfo
          OpEventGetDebouncingOfEvent_GetDebouncingOfEvent_EvtInfo_VCEvBecmPropFr01Tioutd: RteEventRef=OpEventGetDebouncingOfEvent_GetDebouncingOfEvent_EvtInfo_VCEvBecmPropFr01Tioutd
          OpEventGetDebouncingOfEvent_GetDebouncingOfEvent_EvtInfo_INV_CU_TEMP2_RNG_NOK: RteEventRef=OpEventGetDebouncingOfEvent_GetDebouncingOfEvent_EvtInfo_INV_CU_TEMP2_RNG_NOK
          OpEventGetDebouncingOfEvent_GetDebouncingOfEvent_EvtInfo_COM_Busoff: RteEventRef=OpEventGetDebouncingOfEvent_GetDebouncingOfEvent_EvtInfo_COM_Busoff
          OpEventGetDebouncingOfEvent_GetDebouncingOfEvent_EvtInfo_INV_IMMO_NOKEY: RteEventRef=OpEventGetDebouncingOfEvent_GetDebouncingOfEvent_EvtInfo_INV_IMMO_NOKEY
          OpEventGetDebouncingOfEvent_GetDebouncingOfEvent_EvtInfo_INV_RSLVR_EXCT_OC_HWP: RteEventRef=OpEventGetDebouncingOfEvent_GetDebouncingOfEvent_EvtInfo_INV_RSLVR_EXCT_OC_HWP
          OpEventGetDebouncingOfEvent_GetDebouncingOfEvent_EvtInfo_PS_P15_W_FLT: RteEventRef=OpEventGetDebouncingOfEvent_GetDebouncingOfEvent_EvtInfo_PS_P15_W_FLT
          OpEventGetDebouncingOfEvent_GetDebouncingOfEvent_EvtInfo_INV_IAC_PLAUS_SUM: RteEventRef=OpEventGetDebouncingOfEvent_GetDebouncingOfEvent_EvtInfo_INV_IAC_PLAUS_SUM
          OpEventGetDebouncingOfEvent_GetDebouncingOfEvent_EvtInfo_PA_ELE_FLT: RteEventRef=OpEventGetDebouncingOfEvent_GetDebouncingOfEvent_EvtInfo_PA_ELE_FLT
          OpEventGetDebouncingOfEvent_GetDebouncingOfEvent_EvtInfo_CU_TEMP_GRDT: RteEventRef=OpEventGetDebouncingOfEvent_GetDebouncingOfEvent_EvtInfo_CU_TEMP_GRDT
          OpEventGetDebouncingOfEvent_GetDebouncingOfEvent_EvtInfo_INV_IGBT_TEMP_V_PLAUS: RteEventRef=OpEventGetDebouncingOfEvent_GetDebouncingOfEvent_EvtInfo_INV_IGBT_TEMP_V_PLAUS
          OpEventGetDebouncingOfEvent_GetDebouncingOfEvent_EvtInfo_Ga_GAEngageFailure: RteEventRef=OpEventGetDebouncingOfEvent_GetDebouncingOfEvent_EvtInfo_Ga_GAEngageFailure
          OpEventGetDebouncingOfEvent_GetDebouncingOfEvent_EvtInfo_INV_IAC_W_RNG_LO: RteEventRef=OpEventGetDebouncingOfEvent_GetDebouncingOfEvent_EvtInfo_INV_IAC_W_RNG_LO
          OpEventGetDebouncingOfEvent_GetDebouncingOfEvent_EvtInfo_PS_WhlSnsr_Vltg_FLT: RteEventRef=OpEventGetDebouncingOfEvent_GetDebouncingOfEvent_EvtInfo_PS_WhlSnsr_Vltg_FLT
          OpEventGetDebouncingOfEvent_GetDebouncingOfEvent_EvtInfo_VCEvEcmPropFr02Tioutd: RteEventRef=OpEventGetDebouncingOfEvent_GetDebouncingOfEvent_EvtInfo_VCEvEcmPropFr02Tioutd
          OpEventGetDebouncingOfEvent_GetDebouncingOfEvent_EvtInfo_Ga_TmSpdSyncFailed: RteEventRef=OpEventGetDebouncingOfEvent_GetDebouncingOfEvent_EvtInfo_Ga_TmSpdSyncFailed
          OpEventGetDebouncingOfEvent_GetDebouncingOfEvent_EvtInfo_INV_RSLVR_EXCT_ELEC_LO: RteEventRef=OpEventGetDebouncingOfEvent_GetDebouncingOfEvent_EvtInfo_INV_RSLVR_EXCT_ELEC_LO
          OpEventGetDebouncingOfEvent_GetDebouncingOfEvent_EvtInfo_VCEvEcmPropXevFr06Tioutd: RteEventRef=OpEventGetDebouncingOfEvent_GetDebouncingOfEvent_EvtInfo_VCEvEcmPropXevFr06Tioutd
          OpEventGetDebouncingOfEvent_GetDebouncingOfEvent_EvtInfo_VcEvCntrWhlMotSysTqAllwd: RteEventRef=OpEventGetDebouncingOfEvent_GetDebouncingOfEvent_EvtInfo_VcEvCntrWhlMotSysTqAllwd
          OpEventGetDebouncingOfEvent_GetDebouncingOfEvent_EvtInfo_INV_UHVDC_1_ELEC_HI: RteEventRef=OpEventGetDebouncingOfEvent_GetDebouncingOfEvent_EvtInfo_INV_UHVDC_1_ELEC_HI
          OpEventGetDebouncingOfEvent_GetDebouncingOfEvent_EvtInfo_INV_EM_STATOR_TEMP2_ELE_FLT: RteEventRef=OpEventGetDebouncingOfEvent_GetDebouncingOfEvent_EvtInfo_INV_EM_STATOR_TEMP2_ELE_FLT
          OpEventGetDebouncingOfEvent_GetDebouncingOfEvent_EvtInfo_AURIX_RST_SNG: RteEventRef=OpEventGetDebouncingOfEvent_GetDebouncingOfEvent_EvtInfo_AURIX_RST_SNG
          OpEventGetDebouncingOfEvent_GetDebouncingOfEvent_EvtInfo_VCEvEcmPropFr24MgmFr01Tioutd: RteEventRef=OpEventGetDebouncingOfEvent_GetDebouncingOfEvent_EvtInfo_VCEvEcmPropFr24MgmFr01Tioutd
          OpEventGetDebouncingOfEvent_GetDebouncingOfEvent_EvtInfo_INV_RSLVR_COS_ELEC_OPEN: RteEventRef=OpEventGetDebouncingOfEvent_GetDebouncingOfEvent_EvtInfo_INV_RSLVR_COS_ELEC_OPEN
          OpEventGetDebouncingOfEvent_GetDebouncingOfEvent_EvtInfo_INV_IAC_V_ELEC_LO: RteEventRef=OpEventGetDebouncingOfEvent_GetDebouncingOfEvent_EvtInfo_INV_IAC_V_ELEC_LO
          OpEventGetDebouncingOfEvent_GetDebouncingOfEvent_EvtInfo_INV_IAC_W_OFFS: RteEventRef=OpEventGetDebouncingOfEvent_GetDebouncingOfEvent_EvtInfo_INV_IAC_W_OFFS
          OpEventGetDebouncingOfEvent_GetDebouncingOfEvent_EvtInfo_INV_EM_STATOR_TEMP2_GRDT: RteEventRef=OpEventGetDebouncingOfEvent_GetDebouncingOfEvent_EvtInfo_INV_EM_STATOR_TEMP2_GRDT
          OpEventGetDebouncingOfEvent_GetDebouncingOfEvent_EvtInfo_INV_EM_OVRSPD_HWP: RteEventRef=OpEventGetDebouncingOfEvent_GetDebouncingOfEvent_EvtInfo_INV_EM_OVRSPD_HWP
          OpEventGetDebouncingOfEvent_GetDebouncingOfEvent_EvtInfo_CU_TEMP_HWP: RteEventRef=OpEventGetDebouncingOfEvent_GetDebouncingOfEvent_EvtInfo_CU_TEMP_HWP
          OpEventGetDebouncingOfEvent_GetDebouncingOfEvent_EvtInfo_INV_UHVDC_1_RNG_HI: RteEventRef=OpEventGetDebouncingOfEvent_GetDebouncingOfEvent_EvtInfo_INV_UHVDC_1_RNG_HI
          OpEventGetDebouncingOfEvent_GetDebouncingOfEvent_EvtInfo_VcEvEMPerfPlaus: RteEventRef=OpEventGetDebouncingOfEvent_GetDebouncingOfEvent_EvtInfo_VcEvEMPerfPlaus
          OpEventGetDebouncingOfEvent_GetDebouncingOfEvent_EvtInfo_VCEvVddmPropFr18Tioutd: RteEventRef=OpEventGetDebouncingOfEvent_GetDebouncingOfEvent_EvtInfo_VCEvVddmPropFr18Tioutd
          OpEventGetDebouncingOfEvent_GetDebouncingOfEvent_EvtInfo_INV_IAC_U_ELEC_HWP: RteEventRef=OpEventGetDebouncingOfEvent_GetDebouncingOfEvent_EvtInfo_INV_IAC_U_ELEC_HWP
          OpEventGetDebouncingOfEvent_GetDebouncingOfEvent_EvtInfo_VCEvVddmPropFr15Tioutd: RteEventRef=OpEventGetDebouncingOfEvent_GetDebouncingOfEvent_EvtInfo_VCEvVddmPropFr15Tioutd
          OpEventGetDebouncingOfEvent_GetDebouncingOfEvent_EvtInfo_Ga_GADisengageFailure: RteEventRef=OpEventGetDebouncingOfEvent_GetDebouncingOfEvent_EvtInfo_Ga_GADisengageFailure
          OpEventGetDebouncingOfEvent_GetDebouncingOfEvent_EvtInfo_CU_TEMP2_RNG_LO: RteEventRef=OpEventGetDebouncingOfEvent_GetDebouncingOfEvent_EvtInfo_CU_TEMP2_RNG_LO
          OpEventGetDebouncingOfEvent_GetDebouncingOfEvent_EvtInfo_INV_RSLVR_SIN_ELEC_OPEN: RteEventRef=OpEventGetDebouncingOfEvent_GetDebouncingOfEvent_EvtInfo_INV_RSLVR_SIN_ELEC_OPEN
          OpEventGetDebouncingOfEvent_GetDebouncingOfEvent_EvtInfo_VcEvChkSum: RteEventRef=OpEventGetDebouncingOfEvent_GetDebouncingOfEvent_EvtInfo_VcEvChkSum
          OpEventGetDebouncingOfEvent_GetDebouncingOfEvent_EvtInfo_PS_P5_UC_FLT: RteEventRef=OpEventGetDebouncingOfEvent_GetDebouncingOfEvent_EvtInfo_PS_P5_UC_FLT
          OpEventGetDebouncingOfEvent_GetDebouncingOfEvent_EvtInfo_INV_RSLVR_COS_ELEC_FLT: RteEventRef=OpEventGetDebouncingOfEvent_GetDebouncingOfEvent_EvtInfo_INV_RSLVR_COS_ELEC_FLT
          OpEventGetDebouncingOfEvent_GetDebouncingOfEvent_EvtInfo_INV_IAC_W_RNG_HI: RteEventRef=OpEventGetDebouncingOfEvent_GetDebouncingOfEvent_EvtInfo_INV_IAC_W_RNG_HI
          OpEventGetDebouncingOfEvent_GetDebouncingOfEvent_EvtInfo_PS_ECUSUPPLY_HIGH: RteEventRef=OpEventGetDebouncingOfEvent_GetDebouncingOfEvent_EvtInfo_PS_ECUSUPPLY_HIGH
          OpEventGetDebouncingOfEvent_GetDebouncingOfEvent_EvtInfo_VCEvEcmPropFr05Tioutd: RteEventRef=OpEventGetDebouncingOfEvent_GetDebouncingOfEvent_EvtInfo_VCEvEcmPropFr05Tioutd
          OpEventGetDebouncingOfEvent_GetDebouncingOfEvent_EvtInfo_PS_ECUSUPPLY_LOW: RteEventRef=OpEventGetDebouncingOfEvent_GetDebouncingOfEvent_EvtInfo_PS_ECUSUPPLY_LOW
          OpEventGetDebouncingOfEvent_GetDebouncingOfEvent_EvtInfo_VcEvChkSumHvSysRlySts: RteEventRef=OpEventGetDebouncingOfEvent_GetDebouncingOfEvent_EvtInfo_VcEvChkSumHvSysRlySts
          OpEventGetDebouncingOfEvent_GetDebouncingOfEvent_EvtInfo_VcEvMonMode: RteEventRef=OpEventGetDebouncingOfEvent_GetDebouncingOfEvent_EvtInfo_VcEvMonMode
          OpEventGetDebouncingOfEvent_GetDebouncingOfEvent_EvtInfo_INV_IAC_OC_SWP: RteEventRef=OpEventGetDebouncingOfEvent_GetDebouncingOfEvent_EvtInfo_INV_IAC_OC_SWP
          OpEventGetDebouncingOfEvent_GetDebouncingOfEvent_EvtInfo_INV_IMMO_AUTHFAIL: RteEventRef=OpEventGetDebouncingOfEvent_GetDebouncingOfEvent_EvtInfo_INV_IMMO_AUTHFAIL
          OpEventGetDebouncingOfEvent_GetDebouncingOfEvent_EvtInfo_PA_OpenCirc_FLT: RteEventRef=OpEventGetDebouncingOfEvent_GetDebouncingOfEvent_EvtInfo_PA_OpenCirc_FLT
          OpEventGetDebouncingOfEvent_GetDebouncingOfEvent_EvtInfo_INV_IAC_V_ELEC_HI: RteEventRef=OpEventGetDebouncingOfEvent_GetDebouncingOfEvent_EvtInfo_INV_IAC_V_ELEC_HI
          OpEventGetDebouncingOfEvent_GetDebouncingOfEvent_EvtInfo_VCEvEcmPropFr04Tioutd: RteEventRef=OpEventGetDebouncingOfEvent_GetDebouncingOfEvent_EvtInfo_VCEvEcmPropFr04Tioutd
          OpEventGetDebouncingOfEvent_GetDebouncingOfEvent_EvtInfo_VcEvMonTrqActPlaus: RteEventRef=OpEventGetDebouncingOfEvent_GetDebouncingOfEvent_EvtInfo_VcEvMonTrqActPlaus
          OpEventGetDebouncingOfEvent_GetDebouncingOfEvent_EvtInfo_VcEvMonTrqAct: RteEventRef=OpEventGetDebouncingOfEvent_GetDebouncingOfEvent_EvtInfo_VcEvMonTrqAct
          OpEventGetDebouncingOfEvent_GetDebouncingOfEvent_EvtInfo_INV_RSLVR_COS_ELEC_LO: RteEventRef=OpEventGetDebouncingOfEvent_GetDebouncingOfEvent_EvtInfo_INV_RSLVR_COS_ELEC_LO
          OpEventGetDebouncingOfEvent_GetDebouncingOfEvent_EvtInfo_INV_COOLT_INLET_TEMP_HWP: RteEventRef=OpEventGetDebouncingOfEvent_GetDebouncingOfEvent_EvtInfo_INV_COOLT_INLET_TEMP_HWP
          OpEventGetDebouncingOfEvent_GetDebouncingOfEvent_EvtInfo_VCEvEcmPropFr11Tioutd: RteEventRef=OpEventGetDebouncingOfEvent_GetDebouncingOfEvent_EvtInfo_VCEvEcmPropFr11Tioutd
          OpEventGetDebouncingOfEvent_GetDebouncingOfEvent_EvtInfo_PS_KL30_RNG_HI: RteEventRef=OpEventGetDebouncingOfEvent_GetDebouncingOfEvent_EvtInfo_PS_KL30_RNG_HI
          OpEventGetDebouncingOfEvent_GetDebouncingOfEvent_EvtInfo_INV_IAC_OC_HWP: RteEventRef=OpEventGetDebouncingOfEvent_GetDebouncingOfEvent_EvtInfo_INV_IAC_OC_HWP
          OpEventGetDebouncingOfEvent_GetDebouncingOfEvent_EvtInfo_INV_RSLVR_COS_RNG_HI: RteEventRef=OpEventGetDebouncingOfEvent_GetDebouncingOfEvent_EvtInfo_INV_RSLVR_COS_RNG_HI
          OpEventGetDebouncingOfEvent_GetDebouncingOfEvent_EvtInfo_INV_IAC_U_ELEC_HI: RteEventRef=OpEventGetDebouncingOfEvent_GetDebouncingOfEvent_EvtInfo_INV_IAC_U_ELEC_HI
          OpEventGetDebouncingOfEvent_GetDebouncingOfEvent_EvtInfo_INV_IAC_V_RNG_LO: RteEventRef=OpEventGetDebouncingOfEvent_GetDebouncingOfEvent_EvtInfo_INV_IAC_V_RNG_LO
          OpEventGetDebouncingOfEvent_GetDebouncingOfEvent_EvtInfo_INV_IAC_U_RNG_HI: RteEventRef=OpEventGetDebouncingOfEvent_GetDebouncingOfEvent_EvtInfo_INV_IAC_U_RNG_HI
          OpEventGetDebouncingOfEvent_GetDebouncingOfEvent_EvtInfo_VCEvEcmPropFr25Tioutd: RteEventRef=OpEventGetDebouncingOfEvent_GetDebouncingOfEvent_EvtInfo_VCEvEcmPropFr25Tioutd
          OpEventGetDebouncingOfEvent_GetDebouncingOfEvent_EvtInfo_INV_IGBT_TEMP_W_RNG_LO: RteEventRef=OpEventGetDebouncingOfEvent_GetDebouncingOfEvent_EvtInfo_INV_IGBT_TEMP_W_RNG_LO
          OpEventGetDebouncingOfEvent_GetDebouncingOfEvent_EvtInfo_PSnsr_RNG_NOK: RteEventRef=OpEventGetDebouncingOfEvent_GetDebouncingOfEvent_EvtInfo_PSnsr_RNG_NOK
          OpEventGetDebouncingOfEvent_GetDebouncingOfEvent_EvtInfo_INV_RSLVR_COS_RNG_NOK: RteEventRef=OpEventGetDebouncingOfEvent_GetDebouncingOfEvent_EvtInfo_INV_RSLVR_COS_RNG_NOK
          OpEventGetDebouncingOfEvent_GetDebouncingOfEvent_EvtInfo_PS_DRVB_Fault: RteEventRef=OpEventGetDebouncingOfEvent_GetDebouncingOfEvent_EvtInfo_PS_DRVB_Fault
          OpEventGetDebouncingOfEvent_GetDebouncingOfEvent_EvtInfo_INV_CU_TEMP1_RNG_NOK: RteEventRef=OpEventGetDebouncingOfEvent_GetDebouncingOfEvent_EvtInfo_INV_CU_TEMP1_RNG_NOK
          OpEventGetDebouncingOfEvent_GetDebouncingOfEvent_EvtInfo_VcEvCntr: RteEventRef=OpEventGetDebouncingOfEvent_GetDebouncingOfEvent_EvtInfo_VcEvCntr
          OpEventGetDebouncingOfEvent_GetDebouncingOfEvent_EvtInfo_INV_RSLVR_SIN_AMP: RteEventRef=OpEventGetDebouncingOfEvent_GetDebouncingOfEvent_EvtInfo_INV_RSLVR_SIN_AMP
          OpEventGetDebouncingOfEvent_GetDebouncingOfEvent_EvtInfo_INV_UHVDC_2_RNG_HI: RteEventRef=OpEventGetDebouncingOfEvent_GetDebouncingOfEvent_EvtInfo_INV_UHVDC_2_RNG_HI
          OpEventGetDebouncingOfEvent_GetDebouncingOfEvent_EvtInfo_INV_IGBT_TEMP_U_GRDT: RteEventRef=OpEventGetDebouncingOfEvent_GetDebouncingOfEvent_EvtInfo_INV_IGBT_TEMP_U_GRDT
          OpEventGetDebouncingOfEvent_GetDebouncingOfEvent_EvtInfo_MON_TQ_PLAUS_PWR_MDL: RteEventRef=OpEventGetDebouncingOfEvent_GetDebouncingOfEvent_EvtInfo_MON_TQ_PLAUS_PWR_MDL
          OpEventGetDebouncingOfEvent_GetDebouncingOfEvent_EvtInfo_INV_IGBT_TEMP_W_PLAUS: RteEventRef=OpEventGetDebouncingOfEvent_GetDebouncingOfEvent_EvtInfo_INV_IGBT_TEMP_W_PLAUS
          OpEventGetDebouncingOfEvent_GetDebouncingOfEvent_EvtInfo_PS_BLDC_UV_FLT: RteEventRef=OpEventGetDebouncingOfEvent_GetDebouncingOfEvent_EvtInfo_PS_BLDC_UV_FLT
          OpEventGetDebouncingOfEvent_GetDebouncingOfEvent_EvtInfo_INV_IAC_V_OFFS: RteEventRef=OpEventGetDebouncingOfEvent_GetDebouncingOfEvent_EvtInfo_INV_IAC_V_OFFS
          OpEventGetDebouncingOfEvent_GetDebouncingOfEvent_EvtInfo_INV_RSLVR_EXCT_FREQ_RNG_NOK: RteEventRef=OpEventGetDebouncingOfEvent_GetDebouncingOfEvent_EvtInfo_INV_RSLVR_EXCT_FREQ_RNG_NOK
          OpEventGetDebouncingOfEvent_GetDebouncingOfEvent_EvtInfo_PS_KL30_RNG_LO: RteEventRef=OpEventGetDebouncingOfEvent_GetDebouncingOfEvent_EvtInfo_PS_KL30_RNG_LO
          OpEventGetDebouncingOfEvent_GetDebouncingOfEvent_EvtInfo_INV_RSLVR_COS_RNG_LO: RteEventRef=OpEventGetDebouncingOfEvent_GetDebouncingOfEvent_EvtInfo_INV_RSLVR_COS_RNG_LO
          OpEventGetDebouncingOfEvent_GetDebouncingOfEvent_EvtInfo_PSnsr_ELE_FLT: RteEventRef=OpEventGetDebouncingOfEvent_GetDebouncingOfEvent_EvtInfo_PSnsr_ELE_FLT
          OpEventGetDebouncingOfEvent_GetDebouncingOfEvent_EvtInfo_INV_RSLVR_SIN_COS_PLAUS_AMP: RteEventRef=OpEventGetDebouncingOfEvent_GetDebouncingOfEvent_EvtInfo_INV_RSLVR_SIN_COS_PLAUS_AMP
          OpEventGetDebouncingOfEvent_GetDebouncingOfEvent_EvtInfo_INV_IAC_U_ELEC_LO: RteEventRef=OpEventGetDebouncingOfEvent_GetDebouncingOfEvent_EvtInfo_INV_IAC_U_ELEC_LO
          OpEventGetDebouncingOfEvent_GetDebouncingOfEvent_EvtInfo_INV_RSLVR_EXCT_ELEC_HI: RteEventRef=OpEventGetDebouncingOfEvent_GetDebouncingOfEvent_EvtInfo_INV_RSLVR_EXCT_ELEC_HI
          OpEventGetDebouncingOfEvent_GetDebouncingOfEvent_EvtInfo_INV_IAC_U_RNG_LO: RteEventRef=OpEventGetDebouncingOfEvent_GetDebouncingOfEvent_EvtInfo_INV_IAC_U_RNG_LO
          OpEventGetDebouncingOfEvent_GetDebouncingOfEvent_EvtInfo_INV_IAC_V_RNG_HI: RteEventRef=OpEventGetDebouncingOfEvent_GetDebouncingOfEvent_EvtInfo_INV_IAC_V_RNG_HI
          OpEventGetDebouncingOfEvent_GetDebouncingOfEvent_EvtInfo_INV_IGBT_TEMP_U_PLAUS: RteEventRef=OpEventGetDebouncingOfEvent_GetDebouncingOfEvent_EvtInfo_INV_IGBT_TEMP_U_PLAUS
          OpEventGetDebouncingOfEvent_GetDebouncingOfEvent_EvtInfo_INV_RSLVR_OFFS_DFT: RteEventRef=OpEventGetDebouncingOfEvent_GetDebouncingOfEvent_EvtInfo_INV_RSLVR_OFFS_DFT
          OpEventGetDebouncingOfEvent_GetDebouncingOfEvent_EvtInfo_Ga_MoveOverThd: RteEventRef=OpEventGetDebouncingOfEvent_GetDebouncingOfEvent_EvtInfo_Ga_MoveOverThd
          OpEventGetDebouncingOfEvent_GetDebouncingOfEvent_EvtInfo_VcEvMonIPH: RteEventRef=OpEventGetDebouncingOfEvent_GetDebouncingOfEvent_EvtInfo_VcEvMonIPH
          OpEventGetDebouncingOfEvent_GetDebouncingOfEvent_EvtInfo_INV_RSLVR_HW_FLT: RteEventRef=OpEventGetDebouncingOfEvent_GetDebouncingOfEvent_EvtInfo_INV_RSLVR_HW_FLT
          OpEventGetDebouncingOfEvent_GetDebouncingOfEvent_EvtInfo_INV_RSLVR_SIN_ELEC_LO: RteEventRef=OpEventGetDebouncingOfEvent_GetDebouncingOfEvent_EvtInfo_INV_RSLVR_SIN_ELEC_LO
          OpEventGetDebouncingOfEvent_GetDebouncingOfEvent_EvtInfo_INV_IAC_W_AMP: RteEventRef=OpEventGetDebouncingOfEvent_GetDebouncingOfEvent_EvtInfo_INV_IAC_W_AMP
          OpEventGetDebouncingOfEvent_GetDebouncingOfEvent_EvtInfo_VCC_OverVoltage: RteEventRef=OpEventGetDebouncingOfEvent_GetDebouncingOfEvent_EvtInfo_VCC_OverVoltage
          OpEventGetDebouncingOfEvent_GetDebouncingOfEvent_EvtInfo_PS_BLDC_OV_FLT: RteEventRef=OpEventGetDebouncingOfEvent_GetDebouncingOfEvent_EvtInfo_PS_BLDC_OV_FLT
          OpEventGetDebouncingOfEvent_GetDebouncingOfEvent_EvtInfo_AURIX_EEPROM_FLT: RteEventRef=OpEventGetDebouncingOfEvent_GetDebouncingOfEvent_EvtInfo_AURIX_EEPROM_FLT
          OpEventGetDebouncingOfEvent_GetDebouncingOfEvent_EvtInfo_FS_MONITIOR_ASC_FW_FLT: RteEventRef=OpEventGetDebouncingOfEvent_GetDebouncingOfEvent_EvtInfo_FS_MONITIOR_ASC_FW_FLT
          OpEventGetDebouncingOfEvent_GetDebouncingOfEvent_EvtInfo_VCEvSrsPropFr02Tioutd: RteEventRef=OpEventGetDebouncingOfEvent_GetDebouncingOfEvent_EvtInfo_VCEvSrsPropFr02Tioutd
          OpEventGetDebouncingOfEvent_GetDebouncingOfEvent_EvtInfo_VcEvMonErrMode: RteEventRef=OpEventGetDebouncingOfEvent_GetDebouncingOfEvent_EvtInfo_VcEvMonErrMode
          OpEventGetDebouncingOfEvent_GetDebouncingOfEvent_EvtInfo_AURIX_RST_MPL: RteEventRef=OpEventGetDebouncingOfEvent_GetDebouncingOfEvent_EvtInfo_AURIX_RST_MPL
          OpEventGetDebouncingOfEvent_GetDebouncingOfEvent_EvtInfo_VcEvNodeMisECM: RteEventRef=OpEventGetDebouncingOfEvent_GetDebouncingOfEvent_EvtInfo_VcEvNodeMisECM
          OpEventGetDebouncingOfEvent_GetDebouncingOfEvent_EvtInfo_PS_KL30_PLAUS: RteEventRef=OpEventGetDebouncingOfEvent_GetDebouncingOfEvent_EvtInfo_PS_KL30_PLAUS
          OpEventGetDebouncingOfEvent_GetDebouncingOfEvent_EvtInfo_INV_IAC_W_ELEC_HI: RteEventRef=OpEventGetDebouncingOfEvent_GetDebouncingOfEvent_EvtInfo_INV_IAC_W_ELEC_HI
          OpEventGetDebouncingOfEvent_GetDebouncingOfEvent_EvtInfo_VCEvVddmPropFr19Tioutd: RteEventRef=OpEventGetDebouncingOfEvent_GetDebouncingOfEvent_EvtInfo_VCEvVddmPropFr19Tioutd
          OpEventGetDebouncingOfEvent_GetDebouncingOfEvent_EvtInfo_INV_TEMP_DCHA_HW: RteEventRef=OpEventGetDebouncingOfEvent_GetDebouncingOfEvent_EvtInfo_INV_TEMP_DCHA_HW
          OpEventGetDebouncingOfEvent_GetDebouncingOfEvent_EvtInfo_VcEvPropCANGlbTiOutd: RteEventRef=OpEventGetDebouncingOfEvent_GetDebouncingOfEvent_EvtInfo_VcEvPropCANGlbTiOutd
          OpEventGetDebouncingOfEvent_GetDebouncingOfEvent_EvtInfo_INV_EM_STATOR_TEMP2_RNG_NOK: RteEventRef=OpEventGetDebouncingOfEvent_GetDebouncingOfEvent_EvtInfo_INV_EM_STATOR_TEMP2_RNG_NOK
          OpEventGetDebouncingOfEvent_GetDebouncingOfEvent_EvtInfo_INV_UHVDC_OV_HWP: RteEventRef=OpEventGetDebouncingOfEvent_GetDebouncingOfEvent_EvtInfo_INV_UHVDC_OV_HWP
          OpEventGetDebouncingOfEvent_GetDebouncingOfEvent_EvtInfo_Ga_FindEngleAngleFailed: RteEventRef=OpEventGetDebouncingOfEvent_GetDebouncingOfEvent_EvtInfo_Ga_FindEngleAngleFailed
          OpEventGetDebouncingOfEvent_GetDebouncingOfEvent_EvtInfo_VcEvMonTrqCmp: RteEventRef=OpEventGetDebouncingOfEvent_GetDebouncingOfEvent_EvtInfo_VcEvMonTrqCmp
          OpEventGetDebouncingOfEvent_GetDebouncingOfEvent_EvtInfo_INV_IGBT_TEMP_V_RNG_LO: RteEventRef=OpEventGetDebouncingOfEvent_GetDebouncingOfEvent_EvtInfo_INV_IGBT_TEMP_V_RNG_LO
          OpEventGetDebouncingOfEvent_GetDebouncingOfEvent_EvtInfo_INV_CONTROL_LIMIT: RteEventRef=OpEventGetDebouncingOfEvent_GetDebouncingOfEvent_EvtInfo_INV_CONTROL_LIMIT
          OpEventGetDebouncingOfEvent_GetDebouncingOfEvent_EvtInfo_COM_CarConfigErr: RteEventRef=OpEventGetDebouncingOfEvent_GetDebouncingOfEvent_EvtInfo_COM_CarConfigErr
          OpEventGetDebouncingOfEvent_GetDebouncingOfEvent_EvtInfo_VCEvEcmPropFr08Tioutd: RteEventRef=OpEventGetDebouncingOfEvent_GetDebouncingOfEvent_EvtInfo_VCEvEcmPropFr08Tioutd
          OpEventGetDebouncingOfEvent_GetDebouncingOfEvent_EvtInfo_CU_TEMP1_RNG_LO: RteEventRef=OpEventGetDebouncingOfEvent_GetDebouncingOfEvent_EvtInfo_CU_TEMP1_RNG_LO
          OpEventGetDebouncingOfEvent_GetDebouncingOfEvent_EvtInfo_INV_EM_STATOR_TEMP2_RNG_SWT: RteEventRef=OpEventGetDebouncingOfEvent_GetDebouncingOfEvent_EvtInfo_INV_EM_STATOR_TEMP2_RNG_SWT
          OpEventGetDebouncingOfEvent_GetDebouncingOfEvent_EvtInfo_GA_BLDC_POS_FLT: RteEventRef=OpEventGetDebouncingOfEvent_GetDebouncingOfEvent_EvtInfo_GA_BLDC_POS_FLT
          OpEventGetDebouncingOfEvent_GetDebouncingOfEvent_EvtInfo_PS_WhlSnsr_FLT: RteEventRef=OpEventGetDebouncingOfEvent_GetDebouncingOfEvent_EvtInfo_PS_WhlSnsr_FLT

AUTOSAR XML (schema 4-2-2)
package /ActiveEcuC
  ecuc value collection ActiveEcuC: ecu-extract=SYSTEM, ecuc-values=[Com, Mcu, Rte, EcuM, CanNm, Os, PduR, Dem, CanSM, Dcm, CanTp, Nm, Can, CanIf, Det, ComM, EcuC, BswM, vSet, McalLib, Port, Spi, ResourceM]

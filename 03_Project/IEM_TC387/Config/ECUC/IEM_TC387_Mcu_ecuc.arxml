AUTOSAR XML (schema 4-2-2)
package /ActiveEcuC
  module config Mcu: implementation-config-variant=VARIANT-POST-BUILD-LOADABLE, module-description=Mcu_Impl
    McuModuleConfiguration: McuClockSrcFailureNotification=DISABLED, McuNumberOfMcuModes=1, McuRamSectors=0
      McuGpt12PrescalerConf: Gpt1BlockPrescalerSel=GPT1_BLOCK_NOT_USED, Gpt2BlockPrescalerSel=GPT2_BLOCK_NOT_USED
      GtmGlobalConfiguration
        McuGtmClockManagementConf: GtmCmuGlobalClockNumerator=1, GtmCmuGlobalClockDenominator=1
          GtmFixedClockSetting: GtmCmuFixedClockEnable=true, GtmCmuFixedClockSel=CMU_GLOBAL_CLOCK_SEL0
          GtmExtClockSetting:
            GtmCmuExtClock0Enable = false
            GtmCmuExtClock0Numerator = 1
            GtmCmuExtClock0Denominator = 1
            GtmCmuExtClock1Enable = false
            GtmCmuExtClock1Numerator = 1
            GtmCmuExtClock1Denominator = 1
            GtmCmuExtClock2Enable = false
            GtmCmuExtClock2Numerator = 1
            GtmCmuExtClock2Denominator = 1
          GtmConfigClockSetting:
            GtmCmuConfigClock0Enable = true
            GtmCmuConfigClock0Div = 0
            GtmCmuConfigClock1Enable = true
            GtmCmuConfigClock1Div = 0
            GtmCmuConfigClock2Enable = true
            GtmCmuConfigClock2Div = 0
            GtmCmuConfigClock3Enable = true
            GtmCmuConfigClock3Div = 0
            GtmCmuConfigClock4Enable = true
            GtmCmuConfigClock4Div = 0
            GtmCmuConfigClock5Enable = true
            GtmCmuConfigClock5Div = 0
            GtmCmuConfigClock6Enable = true
            GtmCmuConfigClock6Div = 0
            GtmCmuConfigClock7Enable = true
            GtmCmuConfigClock7Div = 0
        5 x GtmTomGlobalConf:
          GtmTomGlobalConf_0
            16 x GtmTomChannelConf, all with GtmTomChResetCn0OnTriggerEnable=false, GtmTomChInternalTriggerEnable=false, GtmTimerPortPinSelect=NONE:
              GtmTomChannelConf_{0..15}
            GtmTomGroupConf_0 (GtmTomGroupConf)
              GtmTomActionTimeBaseUnitConf: GtmTomActionTimeBaseSelection=TOM_ACT_TB_TBU_TS0, GtmTomActionTimeBaseValue=1
            GtmTomGroupConf_1 (GtmTomGroupConf)
              GtmTomActionTimeBaseUnitConf: GtmTomActionTimeBaseSelection=TOM_ACT_TB_TBU_TS0, GtmTomActionTimeBaseValue=1
          GtmTomGlobalConf_1
            16 x GtmTomChannelConf, all with GtmTomChResetCn0OnTriggerEnable=false, GtmTomChInternalTriggerEnable=false, GtmTimerPortPinSelect=NONE:
              GtmTomChannelConf_{0..15}
            GtmTomGroupConf_0 (GtmTomGroupConf)
              GtmTomActionTimeBaseUnitConf: GtmTomActionTimeBaseSelection=TOM_ACT_TB_TBU_TS0, GtmTomActionTimeBaseValue=1
            GtmTomGroupConf_1 (GtmTomGroupConf)
              GtmTomActionTimeBaseUnitConf: GtmTomActionTimeBaseSelection=TOM_ACT_TB_TBU_TS0, GtmTomActionTimeBaseValue=1
          GtmTomGlobalConf_2
            16 x GtmTomChannelConf, all with GtmTomChResetCn0OnTriggerEnable=false, GtmTomChInternalTriggerEnable=false, GtmTimerPortPinSelect=NONE:
              GtmTomChannelConf_{0..15}
            GtmTomGroupConf_0 (GtmTomGroupConf)
              GtmTomActionTimeBaseUnitConf: GtmTomActionTimeBaseSelection=TOM_ACT_TB_TBU_TS0, GtmTomActionTimeBaseValue=1
            GtmTomGroupConf_1 (GtmTomGroupConf)
              GtmTomActionTimeBaseUnitConf: GtmTomActionTimeBaseSelection=TOM_ACT_TB_TBU_TS0, GtmTomActionTimeBaseValue=1
          GtmTomGlobalConf_3
            16 x GtmTomChannelConf, all with GtmTomChResetCn0OnTriggerEnable=false, GtmTomChInternalTriggerEnable=false, GtmTimerPortPinSelect=NONE:
              GtmTomChannelConf_{0..15}
            GtmTomGroupConf_0 (GtmTomGroupConf)
              GtmTomActionTimeBaseUnitConf: GtmTomActionTimeBaseSelection=TOM_ACT_TB_TBU_TS0, GtmTomActionTimeBaseValue=1
            GtmTomGroupConf_1 (GtmTomGroupConf)
              GtmTomActionTimeBaseUnitConf: GtmTomActionTimeBaseSelection=TOM_ACT_TB_TBU_TS0, GtmTomActionTimeBaseValue=1
          GtmTomGlobalConf_4
            16 x GtmTomChannelConf, all with GtmTomChResetCn0OnTriggerEnable=false, GtmTomChInternalTriggerEnable=false, GtmTimerPortPinSelect=NONE:
              GtmTomChannelConf_{0..15}
            GtmTomGroupConf_0 (GtmTomGroupConf)
              GtmTomActionTimeBaseUnitConf: GtmTomActionTimeBaseSelection=TOM_ACT_TB_TBU_TS0, GtmTomActionTimeBaseValue=1
            GtmTomGroupConf_1 (GtmTomGroupConf)
              GtmTomActionTimeBaseUnitConf: GtmTomActionTimeBaseSelection=TOM_ACT_TB_TBU_TS0, GtmTomActionTimeBaseValue=1
        9 x GtmAtomGlobalConf:
          GtmAtomGlobalConf_0
            GtmAtomGroupConf
              GtmAtomActionTimeBaseUnitConf: GtmAtomActionTimeBaseSelection=ATOM_ACT_TB_TBU_TS0, GtmAtomActionTimeBaseValue=1
            8 x GtmAtomChannelConf, all with GtmAtomChResetCn0OnTriggerEnable=false, GtmAtomChInternalTriggerEnable=false, GtmTimerPortPinSelect=NONE:
              GtmAtomChannelConf_{0..7}
          GtmAtomGlobalConf_1
            GtmAtomGroupConf
              GtmAtomActionTimeBaseUnitConf: GtmAtomActionTimeBaseSelection=ATOM_ACT_TB_TBU_TS0, GtmAtomActionTimeBaseValue=1
            8 x GtmAtomChannelConf, all with GtmAtomChResetCn0OnTriggerEnable=false, GtmAtomChInternalTriggerEnable=false, GtmTimerPortPinSelect=NONE:
              GtmAtomChannelConf_{0..7}
          GtmAtomGlobalConf_2
            GtmAtomGroupConf
              GtmAtomActionTimeBaseUnitConf: GtmAtomActionTimeBaseSelection=ATOM_ACT_TB_TBU_TS0, GtmAtomActionTimeBaseValue=1
            8 x GtmAtomChannelConf, all with GtmAtomChResetCn0OnTriggerEnable=false, GtmAtomChInternalTriggerEnable=false, GtmTimerPortPinSelect=NONE:
              GtmAtomChannelConf_{0..7}
          GtmAtomGlobalConf_3
            GtmAtomGroupConf
              GtmAtomActionTimeBaseUnitConf: GtmAtomActionTimeBaseSelection=ATOM_ACT_TB_TBU_TS0, GtmAtomActionTimeBaseValue=1
            8 x GtmAtomChannelConf, all with GtmAtomChResetCn0OnTriggerEnable=false, GtmAtomChInternalTriggerEnable=false, GtmTimerPortPinSelect=NONE:
              GtmAtomChannelConf_{0..7}
          GtmAtomGlobalConf_4
            GtmAtomGroupConf
              GtmAtomActionTimeBaseUnitConf: GtmAtomActionTimeBaseSelection=ATOM_ACT_TB_TBU_TS0, GtmAtomActionTimeBaseValue=1
            8 x GtmAtomChannelConf, all with GtmAtomChResetCn0OnTriggerEnable=false, GtmAtomChInternalTriggerEnable=false, GtmTimerPortPinSelect=NONE:
              GtmAtomChannelConf_{0..7}
          GtmAtomGlobalConf_5
            GtmAtomGroupConf
              GtmAtomActionTimeBaseUnitConf: GtmAtomActionTimeBaseSelection=ATOM_ACT_TB_TBU_TS0, GtmAtomActionTimeBaseValue=1
            8 x GtmAtomChannelConf, all with GtmAtomChResetCn0OnTriggerEnable=false, GtmAtomChInternalTriggerEnable=false, GtmTimerPortPinSelect=NONE:
              GtmAtomChannelConf_{0..7}
          GtmAtomGlobalConf_6
            GtmAtomGroupConf
              GtmAtomActionTimeBaseUnitConf: GtmAtomActionTimeBaseSelection=ATOM_ACT_TB_TBU_TS0, GtmAtomActionTimeBaseValue=1
            8 x GtmAtomChannelConf, all with GtmAtomChResetCn0OnTriggerEnable=false, GtmAtomChInternalTriggerEnable=false, GtmTimerPortPinSelect=NONE:
              GtmAtomChannelConf_{0..7}
          GtmAtomGlobalConf_7
            GtmAtomGroupConf
              GtmAtomActionTimeBaseUnitConf: GtmAtomActionTimeBaseSelection=ATOM_ACT_TB_TBU_TS0, GtmAtomActionTimeBaseValue=1
            8 x GtmAtomChannelConf, all with GtmAtomChResetCn0OnTriggerEnable=false, GtmAtomChInternalTriggerEnable=false, GtmTimerPortPinSelect=NONE:
              GtmAtomChannelConf_{0..7}
          GtmAtomGlobalConf_8
            GtmAtomGroupConf
              GtmAtomActionTimeBaseUnitConf: GtmAtomActionTimeBaseSelection=ATOM_ACT_TB_TBU_TS0, GtmAtomActionTimeBaseValue=1
            8 x GtmAtomChannelConf, all with GtmAtomChResetCn0OnTriggerEnable=false, GtmAtomChInternalTriggerEnable=false, GtmTimerPortPinSelect=NONE:
              GtmAtomChannelConf_{0..7}
        7 x GtmTimGlobalConf:
          GtmTimGlobalConf_0
            8 x GtmTimChannelConf, all with GtmTimInpPortPinSel=SEL0_NONE:
              GtmTimChannelConf_{0..7}
          GtmTimGlobalConf_1
            8 x GtmTimChannelConf, all with GtmTimInpPortPinSel=SEL0_NONE:
              GtmTimChannelConf_{0..7}
          GtmTimGlobalConf_2
            8 x GtmTimChannelConf, all with GtmTimInpPortPinSel=SEL0_NONE:
              GtmTimChannelConf_{0..7}
          GtmTimGlobalConf_3
            8 x GtmTimChannelConf, all with GtmTimInpPortPinSel=SEL0_NONE:
              GtmTimChannelConf_{0..7}
          GtmTimGlobalConf_4
            8 x GtmTimChannelConf, all with GtmTimInpPortPinSel=SEL0_NONE:
              GtmTimChannelConf_{0..7}
          GtmTimGlobalConf_5
            8 x GtmTimChannelConf, all with GtmTimInpPortPinSel=SEL0_NONE:
              GtmTimChannelConf_{0..7}
          GtmTimGlobalConf_6
            8 x GtmTimChannelConf, all with GtmTimInpPortPinSel=SEL0_NONE:
              GtmTimChannelConf_{0..7}
        9 x GtmClusterConf, all with GtmCmuClusterInputClockDividerEnable=CLS_CLK_CFG_ENABLED_WITH_DIV_SEL2:
          GtmClusterConf_0
            GtmClusterConfClockSetting:
              GtmClusterConfClock{0..7}Src = CMU_CONF_CLOCK{0..7}_SEL0
            GtmClusterFixedClockSetting: GtmClusterFixedClockSrc=CMU_FIXED_CLOCK0_SEL0
          GtmClusterConf_1
            GtmClusterConfClockSetting:
              GtmClusterConfClock{0..7}Src = CMU_CONF_CLOCK{0..7}_SEL0
            GtmClusterFixedClockSetting: GtmClusterFixedClockSrc=CMU_FIXED_CLOCK0_SEL0
          GtmClusterConf_2
            GtmClusterConfClockSetting:
              GtmClusterConfClock{0..7}Src = CMU_CONF_CLOCK{0..7}_SEL0
            GtmClusterFixedClockSetting: GtmClusterFixedClockSrc=CMU_FIXED_CLOCK0_SEL0
          GtmClusterConf_3
            GtmClusterConfClockSetting:
              GtmClusterConfClock{0..7}Src = CMU_CONF_CLOCK{0..7}_SEL0
            GtmClusterFixedClockSetting: GtmClusterFixedClockSrc=CMU_FIXED_CLOCK0_SEL0
          GtmClusterConf_4
            GtmClusterConfClockSetting:
              GtmClusterConfClock{0..7}Src = CMU_CONF_CLOCK{0..7}_SEL0
            GtmClusterFixedClockSetting: GtmClusterFixedClockSrc=CMU_FIXED_CLOCK0_SEL0
          GtmClusterConf_5
            GtmClusterConfClockSetting:
              GtmClusterConfClock{0..7}Src = CMU_CONF_CLOCK{0..7}_SEL0
            GtmClusterFixedClockSetting: GtmClusterFixedClockSrc=CMU_FIXED_CLOCK0_SEL0
          GtmClusterConf_6
            GtmClusterConfClockSetting:
              GtmClusterConfClock{0..7}Src = CMU_CONF_CLOCK{0..7}_SEL0
            GtmClusterFixedClockSetting: GtmClusterFixedClockSrc=CMU_FIXED_CLOCK0_SEL0
          GtmClusterConf_7
            GtmClusterConfClockSetting:
              GtmClusterConfClock{0..7}Src = CMU_CONF_CLOCK{0..7}_SEL0
            GtmClusterFixedClockSetting: GtmClusterFixedClockSrc=CMU_FIXED_CLOCK0_SEL0
          GtmClusterConf_8
            GtmClusterConfClockSetting:
              GtmClusterConfClock{0..7}Src = CMU_CONF_CLOCK{0..7}_SEL0
            GtmClusterFixedClockSetting: GtmClusterFixedClockSrc=CMU_FIXED_CLOCK0_SEL0
        4 x GtmTbuChannelConf, all with GtmTbuChannelEnable=false, GtmTbuChClockSourceSelection=CMU_CLOCK0_SEL0, GtmTbuChResolutionSel=TBU_CH_LOWER_COUNT_BITS_SEL0, GtmTbuChMode=FREE_RUNNING_COUNTER_SEL0, GtmTbuChModuloCntrSel=TBU_CH1_SEL0:
          GtmTbuChannelConf_{0..3}
        12 x GtmTriggerForAdc, all with GtmAdcTrigger0Select=TRIG_0_NO_TRIGGER, GtmAdcTrigger1Select=TRIG_0_NO_TRIGGER, GtmAdcTrigger2Select=TRIG_0_NO_TRIGGER, GtmAdcTrigger3Select=TRIG_0_NO_TRIGGER, GtmAdcTrigger4Select=TRIG_0_NO_TRIGGER:
          GtmTriggerForAdc_{0..11}
        6 x GtmTriggerForDsadc, all with GtmDsadcTrigger0Select=TRIG_0_NO_TRIGGER, GtmDsadcTrigger1Select=TRIG_0_NO_TRIGGER, GtmDsadcTrigger2Select=TRIG_0_NO_TRIGGER, GtmDsadcTrigger3Select=TRIG_0_NO_TRIGGER:
          GtmTriggerForDsadc_{0..5}
      McuTrapSettingConf:
        McuCPU{0..5}ESR0TrapEnable = false
        McuCPU{0..5}ESR1TrapEnable = false
        McuCPU{0..5}Trap2Enable = false
        McuCPU{0..5}SMUTrapEnable = false
      McuEruGlobalConf: McuEruInputFilterRegVal=0
      McuResetSettingConf:
        McuESR0ResetConf = MCU_ESR0_NO_RESET_SEL0
        McuESR1ResetConf = MCU_ESR1_NO_RESET_SEL0
        McuSWResetConf = MCU_SW_NO_RESET_SEL0
        McuSMUResetConf = MCU_SMU_NO_RESET_SEL0
        McuSTM{0..5}ResetConf = MCU_STM{0..5}_NO_RESET_SEL0
        McuSTM{0..5}ResetOnApplResetEnable = true
      McuModeSettingConf_0 (McuModeSettingConf): McuMode=1, McuEvrcLPMOnSleepReqEnable=false
        McuStdbyModeSettingConf:
          McuStdbyModePortTriStateEnable = false
          McuStdbyModeESR0TriStateEnable = false
          McuStdbyModeWakeupFromPORST = false
          McuStdbyModePORSTFilterEnable = false
          McuStdbyModeWakeupFromEVR = false
          McuStdbyModeWakeupFromSCR = false
          McuStdbyModeClkSelection = SCR_CLOCK_SEL0
          McuStdbyModeBlankingFilterDelay = DELAY_0_MS_SEL0
          McuStdbyModeRamEnable = MCU_STANDBYRAM_DISABLED_SEL0
          McuStdbyModeESR0Conf: McuStdbyModeESR0WakeupEnable=false, McuStdbyModeESR0FltEnable=false, McuStdbyModeESR0EdgeDetection=ESR0_TRIG_RISING_EDGE_SEL1
          McuStdbyModeESR1Conf: McuStdbyModeESR1WakeupEnable=false, McuStdbyModeESR1FltEnable=false, McuStdbyModeESR1EdgeDetection=ESR1_TRIG_RISING_EDGE_SEL1
          McuStdbyModePinAConf: McuStdbyModePinAWakeupEnable=false, McuStdbyModePinAFltEnable=false, McuStdbyModePinAEdgeDetection=PINA_TRIG_RISING_EDGE_SEL1
          McuStdbyModePinBConf: McuStdbyModePinBWakeupEnable=false, McuStdbyModePinBFltEnable=false, McuStdbyModePinBEdgeDetection=PINB_TRIG_RISING_EDGE_SEL1
          McuStdbyModeWakeupTimerConf:
            McuStdbyModeWakeupTimerEnable = false
            McuStdbyModeWakeupTimerValue = 16777215
            McuStdbyModeWakeupTimerClkDiv = WUT_70KHZ_NO_DIV_CLK_SEL0
            McuStdbyModeWakeupTimerMode = WUT_AUTO_RELOAD_MODE_SEL0
          McuStdbyModeVddVextConf:
            McuStdbyModeEntryOnVEXTRampDown = false
            McuStdbyModeEntryOnVDDRampDown = false
            McuStdbyModeVextUVThres = 117
            McuStdbyModeVextUMMonMode = VEXT_UV_MON_MODE_SEL2
            McuStdbyModeVddUVThres = 184
            McuStdbyModeVddUMMonMode = VDD_UV_MON_MODE_SEL2
      McuClockSettingConfig_0 (McuClockSettingConfig): McuClockSettingId=0
        McuClockReferencePointConfig
          McuSystemPllSettingConfig:
            McuPllInputSrcSelection = OSC_CLOCK_SRC_SELECT_SEL1
            McuSystemPllPDivider = 0
            McuSystemPllNDivider = 29
            McuSystemPllK2Divider = 1
            McuSysPllK2DivStepUpChangeDelay = 10
            McuSysPllK2DivStepDownChangeDelay = 10
            McuFmPllEnable = false
            McuFMPllModAmp = 1.25
            McuClockReferencePointFrequency0 = 300000000
          McuPeripheralPllSettingConfig:
            McuPeripheralPllPDivider = 0
            McuPeripheralPllNDivider = 31
            McuPeripheralPllK2Divider = 1
            McuPerPllK2DivStepUpChangeDelay = 10
            McuPerPllK2DivStepDownChangeDelay = 10
            McuPeripheralPllK3Divider = 1
            McuPerPllK3DivStepUpChangeDelay = 10
            McuPerPllK3DivStepDownChangeDelay = 10
            McuFreqSource1ClockDivSelect = DIV_FACTOR_2_NOT_BYPASSED_SEL0
            McuPll2DivSelect = MCU_K3_DIV_FACTOR_NOT_BYPASSED_SEL0
            McuClockReferencePointFrequency1 = 160000000
            McuClockReferencePointFrequency2 = 200000000
          McuPllDistributionSettingConfig:
            McuClockDistributionInpClockSel = PLL_INPUT_CLOCK_SRC_SELECT_SEL1
            McuLowPowerDivValue = LOW_POWER_DIVIDER_DISABLE_SEL0
            McuSRIFrequency = 300000000
            McuCPU{0..3}Frequency = 300000000
            McuCPU4Frequency = 0
            McuCPU5Frequency = 0
            McuSPBFrequency = 100000000
            McuFSIFrequency = 100000000
            McuFSI2Frequency = 300000000
            McuReferenceFrequency1 = 12500000
            McuReferenceFrequency2 = 6666667
            McuBBBFrequency = 150000000
            McuErayClkEnable = false
            McuErayFrequency = 80000000
            McuGTMFrequency = 200000000
            McuSTMFrequency = 100000000
            McuMscClockSourceSelection = MSC_CLOCK_SOURCE_DISABLED_SEL0
            McuMscFrequency = 200000000
            McuMCanClockSourceSelection = MCAN_CLOCK_SOURCE_DISABLED_SEL0
            McuMCanFrequency = 80000000
            McuAscLinFastFrequency = 200000000
            McuAscLinSlowClockSourceSelection = ASCLINS_CLOCK_SOURCE_DISABLED_SEL0
            McuAscLinSlowFrequency = 80000000
            McuQspiClockSourceSelection = QSPI_CLOCK_SOURCE_DISABLED_SEL0
            McuQspiFrequency = 100000000
            McuAdcFrequency = 160000000
            McuConvCtrlPhaseSynchConf = PHASE_SYNCH_CONST_ACTIVE_SEL0
            McuI2CFrequency = 100000000
            McuEbuClkEnable = false
            McuEbuFrequency = 0
            McuHsctFrequency = 320000000
            McuHspdmClkEnable = false
            McuHspdm160Frequency = 0
            McuHspdm320Frequency = 0
            McuAdasFrequency = 0
            McuGEthFrequency = 150000000
            McuMcanHFrequency = 100000000
          McuExternalClockOutputConfig:
            McuExtClock0Enable = false
            McuExtClockOutSel0 = FOUT_EXT_CLOCK0_SEL0
            McuExtClock1Enable = false
            McuExtClock1Inverted = false
            McuExtClockOutSel1 = FOUT_EXT_CLOCK1_SEL0
            McuFoutClockDiv = 1
          McuClockMonitorConfig:
            McuPll{0..2}ClockMonEnable = false
            McuSpbClockMonEnable = false
            McuBackupClockMonEnable = false
            McuBackupClockRangeMonEnable = false
        McuClockReferencePoint_0 (McuClockReferencePoint): McuClockRefSelection=MCU_USER_DEFINED_FREQUENCY, McuClockReferencePointFrequency=20000000
    CommonPublishedInformation:
      ArMajorVersion = 4
      ArMinorVersion = 2
      ArPatchVersion = 2
      SwMajorVersion = 20
      SwMinorVersion = 0
      SwPatchVersion = 2
      ModuleId = 101
      VendorId = 17
      Release = _TRICORE_TC387
    McuHardwareResourceAllocationConf
      McuEruAllocationConf
        McuEruChannelInputLineConf_0 (McuEruChannelInputLineConf): McuEruChannelInputLineConf=ERU_CHANNEL_INP_NOT_USED
        McuEruChannelOutputUnitConf_0 (McuEruChannelOutputUnitConf): McuEruChannelOutputUnitConf=ERU_CHANNEL_OUT_NOT_USED
        McuEruChannelInputLineConf_1 (McuEruChannelInputLineConf): McuEruChannelInputLineConf=ERU_CHANNEL_INP_NOT_USED
        McuEruChannelOutputUnitConf_1 (McuEruChannelOutputUnitConf): McuEruChannelOutputUnitConf=ERU_CHANNEL_OUT_NOT_USED
        McuEruChannelInputLineConf_2 (McuEruChannelInputLineConf): McuEruChannelInputLineConf=ERU_CHANNEL_INP_NOT_USED
        McuEruChannelOutputUnitConf_2 (McuEruChannelOutputUnitConf): McuEruChannelOutputUnitConf=ERU_CHANNEL_OUT_NOT_USED
        McuEruChannelInputLineConf_3 (McuEruChannelInputLineConf): McuEruChannelInputLineConf=ERU_CHANNEL_INP_NOT_USED
        McuEruChannelOutputUnitConf_3 (McuEruChannelOutputUnitConf): McuEruChannelOutputUnitConf=ERU_CHANNEL_OUT_NOT_USED
        McuEruChannelInputLineConf_4 (McuEruChannelInputLineConf): McuEruChannelInputLineConf=ERU_CHANNEL_INP_NOT_USED
        McuEruChannelOutputUnitConf_4 (McuEruChannelOutputUnitConf): McuEruChannelOutputUnitConf=ERU_CHANNEL_OUT_NOT_USED
        McuEruChannelInputLineConf_5 (McuEruChannelInputLineConf): McuEruChannelInputLineConf=ERU_CHANNEL_INP_NOT_USED
        McuEruChannelOutputUnitConf_5 (McuEruChannelOutputUnitConf): McuEruChannelOutputUnitConf=ERU_CHANNEL_OUT_NOT_USED
        McuEruChannelInputLineConf_6 (McuEruChannelInputLineConf): McuEruChannelInputLineConf=ERU_CHANNEL_INP_NOT_USED
        McuEruChannelOutputUnitConf_6 (McuEruChannelOutputUnitConf): McuEruChannelOutputUnitConf=ERU_CHANNEL_OUT_NOT_USED
        McuEruChannelInputLineConf_7 (McuEruChannelInputLineConf): McuEruChannelInputLineConf=ERU_CHANNEL_INP_NOT_USED
        McuEruChannelOutputUnitConf_7 (McuEruChannelOutputUnitConf): McuEruChannelOutputUnitConf=ERU_CHANNEL_OUT_NOT_USED
      McuGtmAllocationConf
        5 x McuGtmTomAllocationConf:
          McuGtmTom0
            16 x McuGtmTomChannelAllocationConf, all with McuGtmTomChannelAllocationConf=GTM_TOM_CHANNEL_NOT_USED, McuTomChannelEventHandledByDsadc=false:
              McuGtmTom0_Ch{0..15}
          McuGtmTom1
            16 x McuGtmTomChannelAllocationConf, all with McuGtmTomChannelAllocationConf=GTM_TOM_CHANNEL_NOT_USED, McuTomChannelEventHandledByDsadc=false:
              McuGtmTom1_Ch{0..15}
          McuGtmTom2
            16 x McuGtmTomChannelAllocationConf, all with McuGtmTomChannelAllocationConf=GTM_TOM_CHANNEL_NOT_USED, McuTomChannelEventHandledByDsadc=false:
              McuGtmTom2_Ch{0..15}
          McuGtmTom3
            16 x McuGtmTomChannelAllocationConf, all with McuGtmTomChannelAllocationConf=GTM_TOM_CHANNEL_NOT_USED, McuTomChannelEventHandledByDsadc=false:
              McuGtmTom3_Ch{0..15}
          McuGtmTom4
            16 x McuGtmTomChannelAllocationConf, all with McuGtmTomChannelAllocationConf=GTM_TOM_CHANNEL_NOT_USED, McuTomChannelEventHandledByDsadc=false:
              McuGtmTom4_Ch{0..15}
        7 x McuGtmTimAllocationConf:
          McuGtmTim0
            8 x McuGtmTimChannelAllocationConf, all with McuGtmTimChannelAllocationConf=GTM_TIM_CHANNEL_NOT_USED:
              McuGtmTim0_Ch{0..7}
          McuGtmTim1
            8 x McuGtmTimChannelAllocationConf, all with McuGtmTimChannelAllocationConf=GTM_TIM_CHANNEL_NOT_USED:
              McuGtmTim1_Ch{0..7}
          McuGtmTim2
            8 x McuGtmTimChannelAllocationConf, all with McuGtmTimChannelAllocationConf=GTM_TIM_CHANNEL_NOT_USED:
              McuGtmTim2_Ch{0..7}
          McuGtmTim3
            8 x McuGtmTimChannelAllocationConf, all with McuGtmTimChannelAllocationConf=GTM_TIM_CHANNEL_NOT_USED:
              McuGtmTim3_Ch{0..7}
          McuGtmTim4
            8 x McuGtmTimChannelAllocationConf, all with McuGtmTimChannelAllocationConf=GTM_TIM_CHANNEL_NOT_USED:
              McuGtmTim4_Ch{0..7}
          McuGtmTim5
            8 x McuGtmTimChannelAllocationConf, all with McuGtmTimChannelAllocationConf=GTM_TIM_CHANNEL_NOT_USED:
              McuGtmTim5_Ch{0..7}
          McuGtmTim6
            8 x McuGtmTimChannelAllocationConf, all with McuGtmTimChannelAllocationConf=GTM_TIM_CHANNEL_NOT_USED:
              McuGtmTim6_Ch{0..7}
        9 x McuGtmAtomAllocationConf:
          McuGtmAtom0
            8 x McuGtmAtomChannelAllocationConf, all with McuGtmAtomChannelAllocationConf=GTM_ATOM_CHANNEL_NOT_USED, McuAtomChannelEventHandledByDsadc=false:
              McuGtmAtom0_Ch{0..7}
          McuGtmAtom1
            8 x McuGtmAtomChannelAllocationConf, all with McuGtmAtomChannelAllocationConf=GTM_ATOM_CHANNEL_NOT_USED, McuAtomChannelEventHandledByDsadc=false:
              McuGtmAtom1_Ch{0..7}
          McuGtmAtom2
            8 x McuGtmAtomChannelAllocationConf, all with McuGtmAtomChannelAllocationConf=GTM_ATOM_CHANNEL_NOT_USED, McuAtomChannelEventHandledByDsadc=false:
              McuGtmAtom2_Ch{0..7}
          McuGtmAtom3
            8 x McuGtmAtomChannelAllocationConf, all with McuGtmAtomChannelAllocationConf=GTM_ATOM_CHANNEL_NOT_USED, McuAtomChannelEventHandledByDsadc=false:
              McuGtmAtom3_Ch{0..7}
          McuGtmAtom4
            8 x McuGtmAtomChannelAllocationConf, all with McuGtmAtomChannelAllocationConf=GTM_ATOM_CHANNEL_NOT_USED, McuAtomChannelEventHandledByDsadc=false:
              McuGtmAtom4_Ch{0..7}
          McuGtmAtom5
            8 x McuGtmAtomChannelAllocationConf, all with McuGtmAtomChannelAllocationConf=GTM_ATOM_CHANNEL_NOT_USED, McuAtomChannelEventHandledByDsadc=false:
              McuGtmAtom5_Ch{0..7}
          McuGtmAtom6
            8 x McuGtmAtomChannelAllocationConf, all with McuGtmAtomChannelAllocationConf=GTM_ATOM_CHANNEL_NOT_USED, McuAtomChannelEventHandledByDsadc=false:
              McuGtmAtom6_Ch{0..7}
          McuGtmAtom7
            8 x McuGtmAtomChannelAllocationConf, all with McuGtmAtomChannelAllocationConf=GTM_ATOM_CHANNEL_NOT_USED, McuAtomChannelEventHandledByDsadc=false:
              McuGtmAtom7_Ch{0..7}
          McuGtmAtom8
            8 x McuGtmAtomChannelAllocationConf, all with McuGtmAtomChannelAllocationConf=GTM_ATOM_CHANNEL_NOT_USED, McuAtomChannelEventHandledByDsadc=false:
              McuGtmAtom8_Ch{0..7}
      24 x McuAscLinAllocationConf:
        McuAscLinAllocationConf_0
          McuAscLinChannelAllocationConf: McuAscLinChannelAllocationConf=ASCLIN_CH_NOT_USED, McuAscLinKernelId=ASCLIN0
        McuAscLinAllocationConf_1
          McuAscLinChannelAllocationConf: McuAscLinChannelAllocationConf=ASCLIN_CH_NOT_USED, McuAscLinKernelId=ASCLIN1
        McuAscLinAllocationConf_2
          McuAscLinChannelAllocationConf: McuAscLinChannelAllocationConf=ASCLIN_CH_NOT_USED, McuAscLinKernelId=ASCLIN2
        McuAscLinAllocationConf_3
          McuAscLinChannelAllocationConf: McuAscLinChannelAllocationConf=ASCLIN_CH_NOT_USED, McuAscLinKernelId=ASCLIN3
        McuAscLinAllocationConf_4
          McuAscLinChannelAllocationConf: McuAscLinChannelAllocationConf=ASCLIN_CH_NOT_USED, McuAscLinKernelId=ASCLIN4
        McuAscLinAllocationConf_5
          McuAscLinChannelAllocationConf: McuAscLinChannelAllocationConf=ASCLIN_CH_NOT_USED, McuAscLinKernelId=ASCLIN5
        McuAscLinAllocationConf_6
          McuAscLinChannelAllocationConf: McuAscLinChannelAllocationConf=ASCLIN_CH_NOT_USED, McuAscLinKernelId=ASCLIN6
        McuAscLinAllocationConf_7
          McuAscLinChannelAllocationConf: McuAscLinChannelAllocationConf=ASCLIN_CH_NOT_USED, McuAscLinKernelId=ASCLIN7
        McuAscLinAllocationConf_8
          McuAscLinChannelAllocationConf: McuAscLinChannelAllocationConf=ASCLIN_CH_NOT_USED, McuAscLinKernelId=ASCLIN8
        McuAscLinAllocationConf_9
          McuAscLinChannelAllocationConf: McuAscLinChannelAllocationConf=ASCLIN_CH_NOT_USED, McuAscLinKernelId=ASCLIN9
        McuAscLinAllocationConf_10
          McuAscLinChannelAllocationConf: McuAscLinChannelAllocationConf=ASCLIN_CH_NOT_USED, McuAscLinKernelId=ASCLIN10
        McuAscLinAllocationConf_11
          McuAscLinChannelAllocationConf: McuAscLinChannelAllocationConf=ASCLIN_CH_NOT_USED, McuAscLinKernelId=ASCLIN11
        McuAscLinAllocationConf_12
          McuAscLinChannelAllocationConf: McuAscLinChannelAllocationConf=ASCLIN_CH_NOT_USED, McuAscLinKernelId=ASCLIN12
        McuAscLinAllocationConf_13
          McuAscLinChannelAllocationConf: McuAscLinChannelAllocationConf=ASCLIN_CH_NOT_USED, McuAscLinKernelId=ASCLIN13
        McuAscLinAllocationConf_14
          McuAscLinChannelAllocationConf: McuAscLinChannelAllocationConf=ASCLIN_CH_NOT_USED, McuAscLinKernelId=ASCLIN14
        McuAscLinAllocationConf_15
          McuAscLinChannelAllocationConf: McuAscLinChannelAllocationConf=ASCLIN_CH_NOT_USED, McuAscLinKernelId=ASCLIN15
        McuAscLinAllocationConf_16
          McuAscLinChannelAllocationConf: McuAscLinChannelAllocationConf=ASCLIN_CH_NOT_USED, McuAscLinKernelId=ASCLIN16
        McuAscLinAllocationConf_17
          McuAscLinChannelAllocationConf: McuAscLinChannelAllocationConf=ASCLIN_CH_NOT_USED, McuAscLinKernelId=ASCLIN17
        McuAscLinAllocationConf_18
          McuAscLinChannelAllocationConf: McuAscLinChannelAllocationConf=ASCLIN_CH_NOT_USED, McuAscLinKernelId=ASCLIN18
        McuAscLinAllocationConf_19
          McuAscLinChannelAllocationConf: McuAscLinChannelAllocationConf=ASCLIN_CH_NOT_USED, McuAscLinKernelId=ASCLIN19
        McuAscLinAllocationConf_20
          McuAscLinChannelAllocationConf: McuAscLinChannelAllocationConf=ASCLIN_CH_NOT_USED, McuAscLinKernelId=ASCLIN20
        McuAscLinAllocationConf_21
          McuAscLinChannelAllocationConf: McuAscLinChannelAllocationConf=ASCLIN_CH_NOT_USED, McuAscLinKernelId=ASCLIN21
        McuAscLinAllocationConf_22
          McuAscLinChannelAllocationConf: McuAscLinChannelAllocationConf=ASCLIN_CH_NOT_USED, McuAscLinKernelId=ASCLIN22
        McuAscLinAllocationConf_23
          McuAscLinChannelAllocationConf: McuAscLinChannelAllocationConf=ASCLIN_CH_NOT_USED, McuAscLinKernelId=ASCLIN23
      McuCcu6ModuleAllocationConf_0 (McuCcu6ModuleAllocationConf): McuCcu6ModuleAllocationConf=CCU6_MODULE_NOT_USED
      McuCcu6ModuleAllocationConf_1 (McuCcu6ModuleAllocationConf): McuCcu6ModuleAllocationConf=CCU6_MODULE_NOT_USED
      5 x McuGpt12ModuleAllocationConf, all with McuGpt12ModuleAllocationConf=GPT_TIMER_NOT_USED:
        McuGpt12ModuleAllocationConf_0: McuGpt12TimerAllocation=GPT_TIMER_2
        McuGpt12ModuleAllocationConf_1: McuGpt12TimerAllocation=GPT_TIMER_3
        McuGpt12ModuleAllocationConf_2: McuGpt12TimerAllocation=GPT_TIMER_4
        McuGpt12ModuleAllocationConf_3: McuGpt12TimerAllocation=GPT_TIMER_5
        McuGpt12ModuleAllocationConf_4: McuGpt12TimerAllocation=GPT_TIMER_6
      4 x McuStmAllocationConf, all with McuStmCmp0RegAllocationConf=STM_CMP0_NOT_USED, McuStmCmp1RegAllocationConf=STM_CMP1_NOT_USED:
        McuStmAllocationConf_{0..3}
    McuGeneralConfiguration:
      McuDevErrorDetect = false
      McuMultiCoreErrorDetect = false
      McuGetRamStateApi = false
      McuInitClock = true
      McuNoPll = false
      McuPerformResetApi = false
      McuVersionInfoApi = false
      McuClearColdResetStatusApi = false
      McuGpt12SleepModeEnabled = false
      McuGtmSleepModeEnabled = false
      McuCcu60SleepModeEnabled = false
      McuCcu61SleepModeEnabled = false
      McuIfxLpmApi = false
      McuIfxTrapApi = false
      McuIfxCpuCcuconApi = false
      McuIfxDeInitApi = false
      McuClockSourceFailureNotification = false
      McuSafetyEnable = false
      McuInitCheckApi = false
      McuOscAmpRegulationEnable = false
      McuOscCapacitance{0..3}Enable = false
      McuMainOscillatorFrequency = 20
      McuSysClkFrequency = 20
      McuSystemModeCpuCore = CPU_SYSTEM_CORE0_SEL0
      McuIdleModeCpuCore = INDIVIDUAL_IDLE_CORES_SEL0
      McuStandbyEntryMode = STANDBY_ENTRY_REQ_SLEEP_SEL0
      McuOscillatorMode = EXT_CRYSTAL_CERAMIC_RES_MODE_SEL0
      McuInitDeInitApiMode = MCU_MCAL_SUPERVISOR
      McuRuntimeApiMode = MCU_MCAL_SUPERVISOR
    McuPublishedInformation
      21 x McuResetReasonConf:
        MCU_ESR0_RESET: McuResetReason=0
        MCU_ESR1_RESET: McuResetReason=1
        MCU_SMU_RESET: McuResetReason=2
        MCU_SW_RESET: McuResetReason=3
        MCU_STM0_RESET: McuResetReason=4
        MCU_STM1_RESET: McuResetReason=5
        MCU_STM2_RESET: McuResetReason=6
        MCU_STM3_RESET: McuResetReason=7
        MCU_STM4_RESET: McuResetReason=8
        MCU_STM5_RESET: McuResetReason=9
        MCU_POWER_ON_RESET: McuResetReason=10
        MCU_CB0_RESET: McuResetReason=11
        MCU_CB1_RESET: McuResetReason=12
        MCU_CB3_RESET: McuResetReason=13
        MCU_EVRC_RESET: McuResetReason=14
        MCU_EVR33_RESET: McuResetReason=15
        MCU_SUPPLY_WDOG_RESET: McuResetReason=16
        MCU_STBYR_RESET: McuResetReason=17
        MCU_LBIST_RESET: McuResetReason=18
        MCU_RESET_MULTIPLE: McuResetReason=19
        MCU_RESET_UNDEFINED: McuResetReason=20

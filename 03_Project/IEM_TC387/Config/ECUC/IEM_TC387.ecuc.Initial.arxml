[part 4 of 5: package /InitialEcuC]
AUTOSAR XML (schema 4-2-2)
package /InitialEcuC  (continued)
  module config Dem  (continued)
    DemConfigSet  (continued)
      VcEvChkSumCrashStsSafe (DemEventParameter):  # Diagnostics Data Import
        DemEventKind = DEM_EVENT_KIND_SWC
        DemMaxNumberFreezeFrameRecords = 2
        DemDTCClassRef = DTCClass_VcEvChkSumCrashStsSafe
        DemExtendedDataClassRef = ExtendedDataClass_5ecd55b9
        DemFreezeFrameClassRef = FreezeFrameClass_c3111450
        DemEventClass:  # Diagnostics Data Import
          DemAgingAllowed = true
          DemAgingCycleCounterThreshold = 40
          DemEventDestination = DEM_DTC_ORIGIN_PRIMARY_MEMORY
          DemEventPriority = 1
          DemEventFailureCycleCounterThreshold = 0
          DemAgingCycleRef = PowerCycle
          DemEnableConditionGroupRef = EnableConditionGroup_06a6aa19
          DemOperationCycleRef = PowerCycle
          IndicatorAttribute_WarningIndicator (DemIndicatorAttribute): DemIndicatorFailureCycleSource=DEM_FAILURE_CYCLE_EVENT, DemIndicatorHealingCycleRef=PowerCycle, DemIndicatorRef=WarningIndicator  # Diagnostics Data Import
          DemDebounceAlgorithmClass  # Diagnostics Data Import
            DemDebounceCounterBased: DemDebounceCounterDecrementStepSize=128, DemDebounceCounterIncrementStepSize=127, DemDebounceCounterJumpDown=true, DemDebounceCounterJumpUp=true  # Diagnostics Data Import
      DTCClass_VcEvChkSumCrashStsSafe (DemDTCClass): DemDTCSeverity=DEM_DTC_SEV_IMMEDIATELY, DemUdsDTC=15671939  # Diagnostics Data Import
      VcEvCntrCrashStsSafe (DemEventParameter):  # Diagnostics Data Import
        DemEventKind = DEM_EVENT_KIND_SWC
        DemMaxNumberFreezeFrameRecords = 2
        DemDTCClassRef = DTCClass_VcEvCntrCrashStsSafe
        DemExtendedDataClassRef = ExtendedDataClass_5ecd55b9
        DemFreezeFrameClassRef = FreezeFrameClass_c3111450
        DemEventClass:  # Diagnostics Data Import
          DemAgingAllowed = true
          DemAgingCycleCounterThreshold = 40
          DemEventDestination = DEM_DTC_ORIGIN_PRIMARY_MEMORY
          DemEventPriority = 1
          DemEventFailureCycleCounterThreshold = 0
          DemAgingCycleRef = PowerCycle
          DemEnableConditionGroupRef = EnableConditionGroup_06a6aa19
          DemOperationCycleRef = PowerCycle
          IndicatorAttribute_WarningIndicator (DemIndicatorAttribute): DemIndicatorFailureCycleSource=DEM_FAILURE_CYCLE_EVENT, DemIndicatorHealingCycleRef=PowerCycle, DemIndicatorRef=WarningIndicator  # Diagnostics Data Import
          DemDebounceAlgorithmClass  # Diagnostics Data Import
            DemDebounceCounterBased: DemDebounceCounterDecrementStepSize=128, DemDebounceCounterIncrementStepSize=127, DemDebounceCounterJumpDown=true, DemDebounceCounterJumpUp=true  # Diagnostics Data Import
      DTCClass_VcEvCntrCrashStsSafe (DemDTCClass): DemDTCSeverity=DEM_DTC_SEV_IMMEDIATELY, DemUdsDTC=15671938  # Diagnostics Data Import
      VcEvChkSumWhlMotSysTqAllwd (DemEventParameter):  # Diagnostics Data Import
        DemEventKind = DEM_EVENT_KIND_SWC
        DemMaxNumberFreezeFrameRecords = 2
        DemDTCClassRef = DTCClass_VcEvChkSumWhlMotSysTqAllwd
        DemExtendedDataClassRef = ExtendedDataClass_5ecd55b9
        DemFreezeFrameClassRef = FreezeFrameClass_c3111450
        DemEventClass:  # Diagnostics Data Import
          DemAgingAllowed = true
          DemAgingCycleCounterThreshold = 40
          DemEventDestination = DEM_DTC_ORIGIN_PRIMARY_MEMORY
          DemEventPriority = 1
          DemEventFailureCycleCounterThreshold = 0
          DemAgingCycleRef = PowerCycle
          DemEnableConditionGroupRef = EnableConditionGroup_06a6aa19
          DemOperationCycleRef = PowerCycle
          IndicatorAttribute_WarningIndicator (DemIndicatorAttribute): DemIndicatorFailureCycleSource=DEM_FAILURE_CYCLE_EVENT, DemIndicatorHealingCycleRef=PowerCycle, DemIndicatorRef=WarningIndicator  # Diagnostics Data Import
          DemDebounceAlgorithmClass  # Diagnostics Data Import
            DemDebounceCounterBased: DemDebounceCounterDecrementStepSize=128, DemDebounceCounterIncrementStepSize=127, DemDebounceCounterJumpDown=true, DemDebounceCounterJumpUp=true  # Diagnostics Data Import
      DTCClass_VcEvChkSumWhlMotSysTqAllwd (DemDTCClass): DemDTCSeverity=DEM_DTC_SEV_IMMEDIATELY, DemUdsDTC=15671683  # Diagnostics Data Import
      VcEvCntrWhlMotSysTqAllwd (DemEventParameter):  # Diagnostics Data Import
        DemEventKind = DEM_EVENT_KIND_SWC
        DemMaxNumberFreezeFrameRecords = 2
        DemDTCClassRef = DTCClass_VcEvCntrWhlMotSysTqAllwd
        DemExtendedDataClassRef = ExtendedDataClass_5ecd55b9
        DemFreezeFrameClassRef = FreezeFrameClass_c3111450
        DemEventClass:  # Diagnostics Data Import
          DemAgingAllowed = true
          DemAgingCycleCounterThreshold = 40
          DemEventDestination = DEM_DTC_ORIGIN_PRIMARY_MEMORY
          DemEventPriority = 1
          DemEventFailureCycleCounterThreshold = 0
          DemAgingCycleRef = PowerCycle
          DemEnableConditionGroupRef = EnableConditionGroup_06a6aa19
          DemOperationCycleRef = PowerCycle
          IndicatorAttribute_WarningIndicator (DemIndicatorAttribute): DemIndicatorFailureCycleSource=DEM_FAILURE_CYCLE_EVENT, DemIndicatorHealingCycleRef=PowerCycle, DemIndicatorRef=WarningIndicator  # Diagnostics Data Import
          DemDebounceAlgorithmClass  # Diagnostics Data Import
            DemDebounceCounterBased: DemDebounceCounterDecrementStepSize=128, DemDebounceCounterIncrementStepSize=127, DemDebounceCounterJumpDown=true, DemDebounceCounterJumpUp=true  # Diagnostics Data Import
      DTCClass_VcEvCntrWhlMotSysTqAllwd (DemDTCClass): DemDTCSeverity=DEM_DTC_SEV_MAINTENANCE_ONLY, DemUdsDTC=15671682  # Diagnostics Data Import
      VCEvEcmPropFr02Tioutd (DemEventParameter):  # Diagnostics Data Import
        DemEventKind = DEM_EVENT_KIND_SWC
        DemMaxNumberFreezeFrameRecords = 2
        DemDTCClassRef = DTCClass_VCEvEcmPropFr02Tioutd
        DemExtendedDataClassRef = ExtendedDataClass_5ecd55b9
        DemFreezeFrameClassRef = FreezeFrameClass_c3111450
        DemEventClass:  # Diagnostics Data Import
          DemAgingAllowed = true
          DemAgingCycleCounterThreshold = 40
          DemEventDestination = DEM_DTC_ORIGIN_PRIMARY_MEMORY
          DemEventPriority = 1
          DemEventFailureCycleCounterThreshold = 0
          DemAgingCycleRef = PowerCycle
          DemEnableConditionGroupRef = EnableConditionGroup_6f8868bd
          DemOperationCycleRef = PowerCycle
          IndicatorAttribute_WarningIndicator (DemIndicatorAttribute): DemIndicatorFailureCycleSource=DEM_FAILURE_CYCLE_EVENT, DemIndicatorHealingCycleRef=PowerCycle, DemIndicatorRef=WarningIndicator  # Diagnostics Data Import
          DemDebounceAlgorithmClass  # Diagnostics Data Import
            DemDebounceCounterBased: DemDebounceCounterDecrementStepSize=128, DemDebounceCounterIncrementStepSize=127, DemDebounceCounterJumpDown=true, DemDebounceCounterJumpUp=true  # Diagnostics Data Import
      DTCClass_VCEvEcmPropFr02Tioutd (DemDTCClass): DemDTCSeverity=DEM_DTC_SEV_MAINTENANCE_ONLY, DemUdsDTC=15669504  # Diagnostics Data Import
      VCEvVddmPropFr08Tioutd_001 (DemEventParameter):  # Diagnostics Data Import
        DemEventKind = DEM_EVENT_KIND_SWC
        DemMaxNumberFreezeFrameRecords = 2
        DemDTCClassRef = DTCClass_VCEvVddmPropFr08Tioutd_001
        DemExtendedDataClassRef = ExtendedDataClass_5ecd55b9
        DemFreezeFrameClassRef = FreezeFrameClass_c3111450
        DemEventClass:  # Diagnostics Data Import
          DemAgingAllowed = true
          DemAgingCycleCounterThreshold = 40
          DemEventDestination = DEM_DTC_ORIGIN_PRIMARY_MEMORY
          DemEventPriority = 1
          DemEventFailureCycleCounterThreshold = 0
          DemAgingCycleRef = PowerCycle
          DemEnableConditionGroupRef = EnableConditionGroup_6f8868bd
          DemOperationCycleRef = PowerCycle
          IndicatorAttribute_WarningIndicator (DemIndicatorAttribute): DemIndicatorFailureCycleSource=DEM_FAILURE_CYCLE_EVENT, DemIndicatorHealingCycleRef=PowerCycle, DemIndicatorRef=WarningIndicator  # Diagnostics Data Import
          DemDebounceAlgorithmClass  # Diagnostics Data Import
            DemDebounceCounterBased: DemDebounceCounterDecrementStepSize=128, DemDebounceCounterIncrementStepSize=127, DemDebounceCounterJumpDown=true, DemDebounceCounterJumpUp=true  # Diagnostics Data Import
      DTCClass_VCEvVddmPropFr08Tioutd_001 (DemDTCClass): DemDTCSeverity=DEM_DTC_SEV_MAINTENANCE_ONLY, DemUdsDTC=15669248  # Diagnostics Data Import
      VCEvVddmPropFr15Tioutd (DemEventParameter):  # Diagnostics Data Import
        DemEventKind = DEM_EVENT_KIND_SWC
        DemMaxNumberFreezeFrameRecords = 2
        DemDTCClassRef = DTCClass_VCEvVddmPropFr15Tioutd
        DemExtendedDataClassRef = ExtendedDataClass_5ecd55b9
        DemFreezeFrameClassRef = FreezeFrameClass_c3111450
        DemEventClass:  # Diagnostics Data Import
          DemAgingAllowed = true
          DemAgingCycleCounterThreshold = 40
          DemEventDestination = DEM_DTC_ORIGIN_PRIMARY_MEMORY
          DemEventPriority = 1
          DemEventFailureCycleCounterThreshold = 0
          DemAgingCycleRef = PowerCycle
          DemEnableConditionGroupRef = EnableConditionGroup_6f8868bd
          DemOperationCycleRef = PowerCycle
          IndicatorAttribute_WarningIndicator (DemIndicatorAttribute): DemIndicatorFailureCycleSource=DEM_FAILURE_CYCLE_EVENT, DemIndicatorHealingCycleRef=PowerCycle, DemIndicatorRef=WarningIndicator  # Diagnostics Data Import
          DemDebounceAlgorithmClass  # Diagnostics Data Import
            DemDebounceCounterBased: DemDebounceCounterDecrementStepSize=128, DemDebounceCounterIncrementStepSize=127, DemDebounceCounterJumpDown=true, DemDebounceCounterJumpUp=true  # Diagnostics Data Import
      DTCClass_VCEvVddmPropFr15Tioutd (DemDTCClass): DemDTCSeverity=DEM_DTC_SEV_MAINTENANCE_ONLY, DemUdsDTC=15668992  # Diagnostics Data Import
      VCEvEcmPropFr02MgmFr00Tioutd (DemEventParameter):  # Diagnostics Data Import
        DemEventKind = DEM_EVENT_KIND_SWC
        DemMaxNumberFreezeFrameRecords = 2
        DemDTCClassRef = DTCClass_VCEvEcmPropFr02MgmFr00Tioutd
        DemExtendedDataClassRef = ExtendedDataClass_5ecd55b9
        DemFreezeFrameClassRef = FreezeFrameClass_c3111450
        DemEventClass:  # Diagnostics Data Import
          DemAgingAllowed = true
          DemAgingCycleCounterThreshold = 40
          DemEventDestination = DEM_DTC_ORIGIN_PRIMARY_MEMORY
          DemEventPriority = 1
          DemEventFailureCycleCounterThreshold = 0
          DemAgingCycleRef = PowerCycle
          DemOperationCycleRef = PowerCycle
          IndicatorAttribute_WarningIndicator (DemIndicatorAttribute): DemIndicatorFailureCycleSource=DEM_FAILURE_CYCLE_EVENT, DemIndicatorHealingCycleRef=PowerCycle, DemIndicatorRef=WarningIndicator  # Diagnostics Data Import
          DemDebounceAlgorithmClass  # Diagnostics Data Import
            DemDebounceCounterBased: DemDebounceCounterDecrementStepSize=128, DemDebounceCounterIncrementStepSize=127, DemDebounceCounterJumpDown=true, DemDebounceCounterJumpUp=true  # Diagnostics Data Import
      DTCClass_VCEvEcmPropFr02MgmFr00Tioutd (DemDTCClass): DemDTCSeverity=DEM_DTC_SEV_IMMEDIATELY, DemUdsDTC=15668480  # Diagnostics Data Import
      VCEvVddmPropFr08Tioutd (DemEventParameter):  # Diagnostics Data Import
        DemEventKind = DEM_EVENT_KIND_SWC
        DemMaxNumberFreezeFrameRecords = 2
        DemDTCClassRef = DTCClass_VCEvVddmPropFr08Tioutd
        DemExtendedDataClassRef = ExtendedDataClass_5ecd55b9
        DemFreezeFrameClassRef = FreezeFrameClass_c3111450
        DemEventClass:  # Diagnostics Data Import
          DemAgingAllowed = true
          DemAgingCycleCounterThreshold = 40
          DemEventDestination = DEM_DTC_ORIGIN_PRIMARY_MEMORY
          DemEventPriority = 1
          DemEventFailureCycleCounterThreshold = 0
          DemAgingCycleRef = PowerCycle
          DemOperationCycleRef = PowerCycle
          IndicatorAttribute_WarningIndicator (DemIndicatorAttribute): DemIndicatorFailureCycleSource=DEM_FAILURE_CYCLE_EVENT, DemIndicatorHealingCycleRef=PowerCycle, DemIndicatorRef=WarningIndicator  # Diagnostics Data Import
          DemDebounceAlgorithmClass  # Diagnostics Data Import
            DemDebounceCounterBased: DemDebounceCounterDecrementStepSize=128, DemDebounceCounterIncrementStepSize=127, DemDebounceCounterJumpDown=true, DemDebounceCounterJumpUp=true  # Diagnostics Data Import
      DTCClass_VCEvVddmPropFr08Tioutd (DemDTCClass): DemDTCSeverity=DEM_DTC_SEV_IMMEDIATELY, DemUdsDTC=15668224  # Diagnostics Data Import
      VCEvEcmPropFr25Tioutd (DemEventParameter):  # Diagnostics Data Import
        DemEventKind = DEM_EVENT_KIND_SWC
        DemMaxNumberFreezeFrameRecords = 2
        DemDTCClassRef = DTCClass_VCEvEcmPropFr25Tioutd
        DemExtendedDataClassRef = ExtendedDataClass_5ecd55b9
        DemFreezeFrameClassRef = FreezeFrameClass_c3111450
        DemEventClass:  # Diagnostics Data Import
          DemAgingAllowed = true
          DemAgingCycleCounterThreshold = 40
          DemEventDestination = DEM_DTC_ORIGIN_PRIMARY_MEMORY
          DemEventPriority = 1
          DemEventFailureCycleCounterThreshold = 0
          DemAgingCycleRef = PowerCycle
          DemEnableConditionGroupRef = EnableConditionGroup_6f8868bd
          DemOperationCycleRef = PowerCycle
          IndicatorAttribute_WarningIndicator (DemIndicatorAttribute): DemIndicatorFailureCycleSource=DEM_FAILURE_CYCLE_EVENT, DemIndicatorHealingCycleRef=PowerCycle, DemIndicatorRef=WarningIndicator  # Diagnostics Data Import
          DemDebounceAlgorithmClass  # Diagnostics Data Import
            DemDebounceCounterBased: DemDebounceCounterDecrementStepSize=128, DemDebounceCounterIncrementStepSize=127, DemDebounceCounterJumpDown=true, DemDebounceCounterJumpUp=true  # Diagnostics Data Import
      DTCClass_VCEvEcmPropFr25Tioutd (DemDTCClass): DemDTCSeverity=DEM_DTC_SEV_MAINTENANCE_ONLY, DemUdsDTC=15667968  # Diagnostics Data Import
      VCEvEcmPropFr24MgmFr01Tioutd (DemEventParameter):  # Diagnostics Data Import
        DemEventKind = DEM_EVENT_KIND_SWC
        DemMaxNumberFreezeFrameRecords = 2
        DemDTCClassRef = DTCClass_VCEvEcmPropFr24MgmFr01Tioutd
        DemExtendedDataClassRef = ExtendedDataClass_5ecd55b9
        DemFreezeFrameClassRef = FreezeFrameClass_c3111450
        DemEventClass:  # Diagnostics Data Import
          DemAgingAllowed = true
          DemAgingCycleCounterThreshold = 40
          DemEventDestination = DEM_DTC_ORIGIN_PRIMARY_MEMORY
          DemEventPriority = 1
          DemEventFailureCycleCounterThreshold = 0
          DemAgingCycleRef = PowerCycle
          DemOperationCycleRef = PowerCycle
          IndicatorAttribute_WarningIndicator (DemIndicatorAttribute): DemIndicatorFailureCycleSource=DEM_FAILURE_CYCLE_EVENT, DemIndicatorHealingCycleRef=PowerCycle, DemIndicatorRef=WarningIndicator  # Diagnostics Data Import
          DemDebounceAlgorithmClass  # Diagnostics Data Import
            DemDebounceCounterBased: DemDebounceCounterDecrementStepSize=128, DemDebounceCounterIncrementStepSize=127, DemDebounceCounterJumpDown=true, DemDebounceCounterJumpUp=true  # Diagnostics Data Import
      DTCClass_VCEvEcmPropFr24MgmFr01Tioutd (DemDTCClass): DemDTCSeverity=DEM_DTC_SEV_IMMEDIATELY, DemUdsDTC=15667712  # Diagnostics Data Import
      VCEvVddmPropFr19Tioutd (DemEventParameter):  # Diagnostics Data Import
        DemEventKind = DEM_EVENT_KIND_SWC
        DemMaxNumberFreezeFrameRecords = 2
        DemDTCClassRef = DTCClass_VCEvVddmPropFr19Tioutd
        DemExtendedDataClassRef = ExtendedDataClass_5ecd55b9
        DemFreezeFrameClassRef = FreezeFrameClass_c3111450
        DemEventClass:  # Diagnostics Data Import
          DemAgingAllowed = true
          DemAgingCycleCounterThreshold = 40
          DemEventDestination = DEM_DTC_ORIGIN_PRIMARY_MEMORY
          DemEventPriority = 1
          DemEventFailureCycleCounterThreshold = 0
          DemAgingCycleRef = PowerCycle
          DemEnableConditionGroupRef = EnableConditionGroup_6f8868bd
          DemOperationCycleRef = PowerCycle
          IndicatorAttribute_WarningIndicator (DemIndicatorAttribute): DemIndicatorFailureCycleSource=DEM_FAILURE_CYCLE_EVENT, DemIndicatorHealingCycleRef=PowerCycle, DemIndicatorRef=WarningIndicator  # Diagnostics Data Import
          DemDebounceAlgorithmClass  # Diagnostics Data Import
            DemDebounceCounterBased: DemDebounceCounterDecrementStepSize=128, DemDebounceCounterIncrementStepSize=127, DemDebounceCounterJumpDown=true, DemDebounceCounterJumpUp=true  # Diagnostics Data Import
      DTCClass_VCEvVddmPropFr19Tioutd (DemDTCClass): DemDTCSeverity=DEM_DTC_SEV_IMMEDIATELY, DemUdsDTC=15667456  # Diagnostics Data Import
      VCEvVddmPropFr18Tioutd (DemEventParameter):  # Diagnostics Data Import
        DemEventKind = DEM_EVENT_KIND_SWC
        DemMaxNumberFreezeFrameRecords = 2
        DemDTCClassRef = DTCClass_VCEvVddmPropFr18Tioutd
        DemExtendedDataClassRef = ExtendedDataClass_5ecd55b9
        DemFreezeFrameClassRef = FreezeFrameClass_c3111450
        DemEventClass:  # Diagnostics Data Import
          DemAgingAllowed = true
          DemAgingCycleCounterThreshold = 40
          DemEventDestination = DEM_DTC_ORIGIN_PRIMARY_MEMORY
          DemEventPriority = 1
          DemEventFailureCycleCounterThreshold = 0
          DemAgingCycleRef = PowerCycle
          DemEnableConditionGroupRef = EnableConditionGroup_6f8868bd
          DemOperationCycleRef = PowerCycle
          IndicatorAttribute_WarningIndicator (DemIndicatorAttribute): DemIndicatorFailureCycleSource=DEM_FAILURE_CYCLE_EVENT, DemIndicatorHealingCycleRef=PowerCycle, DemIndicatorRef=WarningIndicator  # Diagnostics Data Import
          DemDebounceAlgorithmClass  # Diagnostics Data Import
            DemDebounceCounterBased: DemDebounceCounterDecrementStepSize=128, DemDebounceCounterIncrementStepSize=127, DemDebounceCounterJumpDown=true, DemDebounceCounterJumpUp=true  # Diagnostics Data Import
      DTCClass_VCEvVddmPropFr18Tioutd (DemDTCClass): DemDTCSeverity=DEM_DTC_SEV_IMMEDIATELY, DemUdsDTC=15667200  # Diagnostics Data Import
      VCEvVddmPropFr17Tioutd (DemEventParameter):  # Diagnostics Data Import
        DemEventKind = DEM_EVENT_KIND_SWC
        DemMaxNumberFreezeFrameRecords = 2
        DemDTCClassRef = DTCClass_VCEvVddmPropFr17Tioutd
        DemExtendedDataClassRef = ExtendedDataClass_5ecd55b9
        DemFreezeFrameClassRef = FreezeFrameClass_c3111450
        DemEventClass:  # Diagnostics Data Import
          DemAgingAllowed = true
          DemAgingCycleCounterThreshold = 40
          DemEventDestination = DEM_DTC_ORIGIN_PRIMARY_MEMORY
          DemEventPriority = 1
          DemEventFailureCycleCounterThreshold = 0
          DemAgingCycleRef = PowerCycle
          DemEnableConditionGroupRef = EnableConditionGroup_6f8868bd
          DemOperationCycleRef = PowerCycle
          IndicatorAttribute_WarningIndicator (DemIndicatorAttribute): DemIndicatorFailureCycleSource=DEM_FAILURE_CYCLE_EVENT, DemIndicatorHealingCycleRef=PowerCycle, DemIndicatorRef=WarningIndicator  # Diagnostics Data Import
          DemDebounceAlgorithmClass  # Diagnostics Data Import
            DemDebounceCounterBased: DemDebounceCounterDecrementStepSize=128, DemDebounceCounterIncrementStepSize=127, DemDebounceCounterJumpDown=true, DemDebounceCounterJumpUp=true  # Diagnostics Data Import
      DTCClass_VCEvVddmPropFr17Tioutd (DemDTCClass): DemDTCSeverity=DEM_DTC_SEV_IMMEDIATELY, DemUdsDTC=15665408  # Diagnostics Data Import
      VCEvVddmPropFr05Tioutd (DemEventParameter):  # Diagnostics Data Import
        DemEventKind = DEM_EVENT_KIND_SWC
        DemMaxNumberFreezeFrameRecords = 2
        DemDTCClassRef = DTCClass_VCEvVddmPropFr05Tioutd
        DemExtendedDataClassRef = ExtendedDataClass_5ecd55b9
        DemFreezeFrameClassRef = FreezeFrameClass_c3111450
        DemEventClass:  # Diagnostics Data Import
          DemAgingAllowed = true
          DemAgingCycleCounterThreshold = 40
          DemEventDestination = DEM_DTC_ORIGIN_PRIMARY_MEMORY
          DemEventPriority = 1
          DemEventFailureCycleCounterThreshold = 0
          DemAgingCycleRef = PowerCycle
          DemEnableConditionGroupRef = EnableConditionGroup_6f8868bd
          DemOperationCycleRef = PowerCycle
          IndicatorAttribute_WarningIndicator (DemIndicatorAttribute): DemIndicatorFailureCycleSource=DEM_FAILURE_CYCLE_EVENT, DemIndicatorHealingCycleRef=PowerCycle, DemIndicatorRef=WarningIndicator  # Diagnostics Data Import
          DemDebounceAlgorithmClass  # Diagnostics Data Import
            DemDebounceCounterBased: DemDebounceCounterDecrementStepSize=128, DemDebounceCounterIncrementStepSize=127, DemDebounceCounterJumpDown=true, DemDebounceCounterJumpUp=true  # Diagnostics Data Import
      DTCClass_VCEvVddmPropFr05Tioutd (DemDTCClass): DemDTCSeverity=DEM_DTC_SEV_IMMEDIATELY, DemUdsDTC=15665152  # Diagnostics Data Import
      VCEvEcmPropFr04Tioutd (DemEventParameter):  # Diagnostics Data Import
        DemEventKind = DEM_EVENT_KIND_SWC
        DemMaxNumberFreezeFrameRecords = 2
        DemDTCClassRef = DTCClass_VCEvEcmPropFr04Tioutd
        DemExtendedDataClassRef = ExtendedDataClass_5ecd55b9
        DemFreezeFrameClassRef = FreezeFrameClass_c3111450
        DemEventClass:  # Diagnostics Data Import
          DemAgingAllowed = true
          DemAgingCycleCounterThreshold = 40
          DemEventDestination = DEM_DTC_ORIGIN_PRIMARY_MEMORY
          DemEventPriority = 1
          DemEventFailureCycleCounterThreshold = 0
          DemAgingCycleRef = PowerCycle
          DemOperationCycleRef = PowerCycle
          IndicatorAttribute_WarningIndicator (DemIndicatorAttribute): DemIndicatorFailureCycleSource=DEM_FAILURE_CYCLE_EVENT, DemIndicatorHealingCycleRef=PowerCycle, DemIndicatorRef=WarningIndicator  # Diagnostics Data Import
          DemDebounceAlgorithmClass  # Diagnostics Data Import
            DemDebounceCounterBased: DemDebounceCounterDecrementStepSize=128, DemDebounceCounterIncrementStepSize=127, DemDebounceCounterJumpDown=true, DemDebounceCounterJumpUp=true  # Diagnostics Data Import
      DTCClass_VCEvEcmPropFr04Tioutd (DemDTCClass): DemDTCSeverity=DEM_DTC_SEV_IMMEDIATELY, DemUdsDTC=15664896  # Diagnostics Data Import
      VCEvBecmPropFr01Tioutd (DemEventParameter):  # Diagnostics Data Import
        DemEventKind = DEM_EVENT_KIND_SWC
        DemMaxNumberFreezeFrameRecords = 2
        DemDTCClassRef = DTCClass_VCEvBecmPropFr01Tioutd
        DemExtendedDataClassRef = ExtendedDataClass_5ecd55b9
        DemFreezeFrameClassRef = FreezeFrameClass_c3111450
        DemEventClass:  # Diagnostics Data Import
          DemAgingAllowed = true
          DemAgingCycleCounterThreshold = 40
          DemEventDestination = DEM_DTC_ORIGIN_PRIMARY_MEMORY
          DemEventPriority = 1
          DemEventFailureCycleCounterThreshold = 0
          DemAgingCycleRef = PowerCycle
          DemEnableConditionGroupRef = EnableConditionGroup_6f8868bd
          DemOperationCycleRef = PowerCycle
          IndicatorAttribute_WarningIndicator (DemIndicatorAttribute): DemIndicatorFailureCycleSource=DEM_FAILURE_CYCLE_EVENT, DemIndicatorHealingCycleRef=PowerCycle, DemIndicatorRef=WarningIndicator  # Diagnostics Data Import
          DemDebounceAlgorithmClass  # Diagnostics Data Import
            DemDebounceCounterBased: DemDebounceCounterDecrementStepSize=128, DemDebounceCounterIncrementStepSize=127, DemDebounceCounterJumpDown=true, DemDebounceCounterJumpUp=true  # Diagnostics Data Import
      DTCClass_VCEvBecmPropFr01Tioutd (DemDTCClass): DemDTCSeverity=DEM_DTC_SEV_IMMEDIATELY, DemUdsDTC=15664640  # Diagnostics Data Import
      VCEvEcmPropFr11Tioutd (DemEventParameter):  # Diagnostics Data Import
        DemEventKind = DEM_EVENT_KIND_SWC
        DemMaxNumberFreezeFrameRecords = 2
        DemDTCClassRef = DTCClass_VCEvEcmPropFr11Tioutd
        DemExtendedDataClassRef = ExtendedDataClass_5ecd55b9
        DemFreezeFrameClassRef = FreezeFrameClass_c3111450
        DemEventClass:  # Diagnostics Data Import
          DemAgingAllowed = true
          DemAgingCycleCounterThreshold = 40
          DemEventDestination = DEM_DTC_ORIGIN_PRIMARY_MEMORY
          DemEventPriority = 1
          DemEventFailureCycleCounterThreshold = 0
          DemAgingCycleRef = PowerCycle
          DemEnableConditionGroupRef = EnableConditionGroup_6f8868bd
          DemOperationCycleRef = PowerCycle
          IndicatorAttribute_WarningIndicator (DemIndicatorAttribute): DemIndicatorFailureCycleSource=DEM_FAILURE_CYCLE_EVENT, DemIndicatorHealingCycleRef=PowerCycle, DemIndicatorRef=WarningIndicator  # Diagnostics Data Import
          DemDebounceAlgorithmClass  # Diagnostics Data Import
            DemDebounceCounterBased: DemDebounceCounterDecrementStepSize=128, DemDebounceCounterIncrementStepSize=127, DemDebounceCounterJumpDown=true, DemDebounceCounterJumpUp=true  # Diagnostics Data Import
      DTCClass_VCEvEcmPropFr11Tioutd (DemDTCClass): DemDTCSeverity=DEM_DTC_SEV_IMMEDIATELY, DemUdsDTC=15664384  # Diagnostics Data Import
      VCEvEcmPropFr08Tioutd (DemEventParameter):  # Diagnostics Data Import
        DemEventKind = DEM_EVENT_KIND_SWC
        DemMaxNumberFreezeFrameRecords = 2
        DemDTCClassRef = DTCClass_VCEvEcmPropFr08Tioutd
        DemExtendedDataClassRef = ExtendedDataClass_5ecd55b9
        DemFreezeFrameClassRef = FreezeFrameClass_c3111450
        DemEventClass:  # Diagnostics Data Import
          DemAgingAllowed = true
          DemAgingCycleCounterThreshold = 40
          DemEventDestination = DEM_DTC_ORIGIN_PRIMARY_MEMORY
          DemEventPriority = 1
          DemEventFailureCycleCounterThreshold = 0
          DemAgingCycleRef = PowerCycle
          DemEnableConditionGroupRef = EnableConditionGroup_6f8868bd
          DemOperationCycleRef = PowerCycle
          IndicatorAttribute_WarningIndicator (DemIndicatorAttribute): DemIndicatorFailureCycleSource=DEM_FAILURE_CYCLE_EVENT, DemIndicatorHealingCycleRef=PowerCycle, DemIndicatorRef=WarningIndicator  # Diagnostics Data Import
          DemDebounceAlgorithmClass  # Diagnostics Data Import
            DemDebounceCounterBased: DemDebounceCounterDecrementStepSize=128, DemDebounceCounterIncrementStepSize=127, DemDebounceCounterJumpDown=true, DemDebounceCounterJumpUp=true  # Diagnostics Data Import
      DTCClass_VCEvEcmPropFr08Tioutd (DemDTCClass): DemDTCSeverity=DEM_DTC_SEV_IMMEDIATELY, DemUdsDTC=15664128  # Diagnostics Data Import
      VCEvEcmPropXevFr06Tioutd (DemEventParameter):  # Diagnostics Data Import
        DemEventKind = DEM_EVENT_KIND_SWC
        DemMaxNumberFreezeFrameRecords = 2
        DemDTCClassRef = DTCClass_VCEvEcmPropXevFr06Tioutd
        DemExtendedDataClassRef = ExtendedDataClass_5ecd55b9
        DemFreezeFrameClassRef = FreezeFrameClass_c3111450
        DemEventClass:  # Diagnostics Data Import
          DemAgingAllowed = true
          DemAgingCycleCounterThreshold = 40
          DemEventDestination = DEM_DTC_ORIGIN_PRIMARY_MEMORY
          DemEventPriority = 1
          DemEventFailureCycleCounterThreshold = 0
          DemAgingCycleRef = PowerCycle
          DemEnableConditionGroupRef = EnableConditionGroup_6f8868bd
          DemOperationCycleRef = PowerCycle
          IndicatorAttribute_WarningIndicator (DemIndicatorAttribute): DemIndicatorFailureCycleSource=DEM_FAILURE_CYCLE_EVENT, DemIndicatorHealingCycleRef=PowerCycle, DemIndicatorRef=WarningIndicator  # Diagnostics Data Import
          DemDebounceAlgorithmClass  # Diagnostics Data Import
            DemDebounceCounterBased: DemDebounceCounterDecrementStepSize=128, DemDebounceCounterIncrementStepSize=127, DemDebounceCounterJumpDown=true, DemDebounceCounterJumpUp=true  # Diagnostics Data Import
      DTCClass_VCEvEcmPropXevFr06Tioutd (DemDTCClass): DemDTCSeverity=DEM_DTC_SEV_IMMEDIATELY, DemUdsDTC=15663872  # Diagnostics Data Import
      VCEvEcmPropFr05Tioutd (DemEventParameter):  # Diagnostics Data Import
        DemEventKind = DEM_EVENT_KIND_SWC
        DemMaxNumberFreezeFrameRecords = 2
        DemDTCClassRef = DTCClass_VCEvEcmPropFr05Tioutd
        DemExtendedDataClassRef = ExtendedDataClass_5ecd55b9
        DemFreezeFrameClassRef = FreezeFrameClass_c3111450
        DemEventClass:  # Diagnostics Data Import
          DemAgingAllowed = true
          DemAgingCycleCounterThreshold = 40
          DemEventDestination = DEM_DTC_ORIGIN_PRIMARY_MEMORY
          DemEventPriority = 1
          DemEventFailureCycleCounterThreshold = 0
          DemAgingCycleRef = PowerCycle
          DemEnableConditionGroupRef = EnableConditionGroup_6f8868bd
          DemOperationCycleRef = PowerCycle
          IndicatorAttribute_WarningIndicator (DemIndicatorAttribute): DemIndicatorFailureCycleSource=DEM_FAILURE_CYCLE_EVENT, DemIndicatorHealingCycleRef=PowerCycle, DemIndicatorRef=WarningIndicator  # Diagnostics Data Import
          DemDebounceAlgorithmClass  # Diagnostics Data Import
            DemDebounceCounterBased: DemDebounceCounterDecrementStepSize=128, DemDebounceCounterIncrementStepSize=127, DemDebounceCounterJumpDown=true, DemDebounceCounterJumpUp=true  # Diagnostics Data Import
      DTCClass_VCEvEcmPropFr05Tioutd (DemDTCClass): DemDTCSeverity=DEM_DTC_SEV_IMMEDIATELY, DemUdsDTC=15663616  # Diagnostics Data Import
      VCEvBecmPropFr02Tioutd (DemEventParameter):  # Diagnostics Data Import
        DemEventKind = DEM_EVENT_KIND_SWC
        DemMaxNumberFreezeFrameRecords = 2
        DemDTCClassRef = DTCClass_VCEvBecmPropFr02Tioutd
        DemExtendedDataClassRef = ExtendedDataClass_5ecd55b9
        DemFreezeFrameClassRef = FreezeFrameClass_c3111450
        DemEventClass:  # Diagnostics Data Import
          DemAgingAllowed = true
          DemAgingCycleCounterThreshold = 40
          DemEventDestination = DEM_DTC_ORIGIN_PRIMARY_MEMORY
          DemEventPriority = 1
          DemEventFailureCycleCounterThreshold = 0
          DemAgingCycleRef = PowerCycle
          DemEnableConditionGroupRef = EnableConditionGroup_6f8868bd
          DemOperationCycleRef = PowerCycle
          IndicatorAttribute_WarningIndicator (DemIndicatorAttribute): DemIndicatorFailureCycleSource=DEM_FAILURE_CYCLE_EVENT, DemIndicatorHealingCycleRef=PowerCycle, DemIndicatorRef=WarningIndicator  # Diagnostics Data Import
          DemDebounceAlgorithmClass  # Diagnostics Data Import
            DemDebounceCounterBased: DemDebounceCounterDecrementStepSize=128, DemDebounceCounterIncrementStepSize=127, DemDebounceCounterJumpDown=true, DemDebounceCounterJumpUp=true  # Diagnostics Data Import
      DTCClass_VCEvBecmPropFr02Tioutd (DemDTCClass): DemDTCSeverity=DEM_DTC_SEV_IMMEDIATELY, DemUdsDTC=15663360  # Diagnostics Data Import
      PS_ECUSUPPLY_LOW (DemEventParameter):  # Diagnostics Data Import
        DemEventKind = DEM_EVENT_KIND_SWC
        DemMaxNumberFreezeFrameRecords = 2
        DemDTCClassRef = DTCClass_PS_ECUSUPPLY_LOW
        DemExtendedDataClassRef = ExtendedDataClass_5ecd55b9
        DemFreezeFrameClassRef = FreezeFrameClass_c3111450
        DemEventClass:  # Diagnostics Data Import
          DemAgingAllowed = true
          DemAgingCycleCounterThreshold = 40
          DemEventDestination = DEM_DTC_ORIGIN_PRIMARY_MEMORY
          DemEventPriority = 1
          DemEventFailureCycleCounterThreshold = 0
          DemAgingCycleRef = PowerCycle
          DemEnableConditionGroupRef = EnableConditionGroup_14eabb2c
          DemOperationCycleRef = PowerCycle
          IndicatorAttribute_WarningIndicator (DemIndicatorAttribute): DemIndicatorFailureCycleSource=DEM_FAILURE_CYCLE_EVENT, DemIndicatorHealingCycleRef=PowerCycle, DemIndicatorRef=WarningIndicator  # Diagnostics Data Import
          DemDebounceAlgorithmClass  # Diagnostics Data Import
            DemDebounceCounterBased: DemDebounceCounterDecrementStepSize=128, DemDebounceCounterIncrementStepSize=127, DemDebounceCounterJumpDown=true, DemDebounceCounterJumpUp=true  # Diagnostics Data Import
      DTCClass_PS_ECUSUPPLY_LOW (DemDTCClass): DemDTCSeverity=DEM_DTC_SEV_MAINTENANCE_ONLY, DemUdsDTC=15598696  # Diagnostics Data Import
      PS_ECUSUPPLY_HIGH (DemEventParameter):  # Diagnostics Data Import
        DemEventKind = DEM_EVENT_KIND_SWC
        DemMaxNumberFreezeFrameRecords = 2
        DemDTCClassRef = DTCClass_PS_ECUSUPPLY_HIGH
        DemExtendedDataClassRef = ExtendedDataClass_5ecd55b9
        DemFreezeFrameClassRef = FreezeFrameClass_c3111450
        DemEventClass:  # Diagnostics Data Import
          DemAgingAllowed = true
          DemAgingCycleCounterThreshold = 40
          DemEventDestination = DEM_DTC_ORIGIN_PRIMARY_MEMORY
          DemEventPriority = 1
          DemEventFailureCycleCounterThreshold = 0
          DemAgingCycleRef = PowerCycle
          DemEnableConditionGroupRef = EnableConditionGroup_14eabb2c
          DemOperationCycleRef = PowerCycle
          IndicatorAttribute_WarningIndicator (DemIndicatorAttribute): DemIndicatorFailureCycleSource=DEM_FAILURE_CYCLE_EVENT, DemIndicatorHealingCycleRef=PowerCycle, DemIndicatorRef=WarningIndicator  # Diagnostics Data Import
          DemDebounceAlgorithmClass  # Diagnostics Data Import
            DemDebounceCounterBased: DemDebounceCounterDecrementStepSize=128, DemDebounceCounterIncrementStepSize=127, DemDebounceCounterJumpDown=true, DemDebounceCounterJumpUp=true  # Diagnostics Data Import
      DTCClass_PS_ECUSUPPLY_HIGH (DemDTCClass): DemDTCSeverity=DEM_DTC_SEV_IMMEDIATELY, DemUdsDTC=15598440  # Diagnostics Data Import
      COM_CarConfigErr (DemEventParameter):  # Diagnostics Data Import
        DemEventKind = DEM_EVENT_KIND_SWC
        DemMaxNumberFreezeFrameRecords = 2
        DemDTCClassRef = DTCClass_COM_CarConfigErr
        DemExtendedDataClassRef = ExtendedDataClass_5ecd55b9
        DemFreezeFrameClassRef = FreezeFrameClass_c3111450
        DemEventClass:  # Diagnostics Data Import
          DemAgingAllowed = true
          DemAgingCycleCounterThreshold = 1
          DemEventDestination = DEM_DTC_ORIGIN_PRIMARY_MEMORY
          DemEventPriority = 2
          DemEventFailureCycleCounterThreshold = 0
          DemAgingCycleRef = PowerCycle
          DemEnableConditionGroupRef = EnableConditionGroup_16bf7de5
          DemOperationCycleRef = PowerCycle
          IndicatorAttribute_WarningIndicator (DemIndicatorAttribute): DemIndicatorFailureCycleSource=DEM_FAILURE_CYCLE_EVENT, DemIndicatorHealingCycleRef=PowerCycle, DemIndicatorRef=WarningIndicator  # Diagnostics Data Import
          DemDebounceAlgorithmClass  # Diagnostics Data Import
            DemDebounceCounterBased: DemDebounceCounterDecrementStepSize=128, DemDebounceCounterIncrementStepSize=127, DemDebounceCounterJumpDown=true, DemDebounceCounterJumpUp=true  # Diagnostics Data Import
      DTCClass_COM_CarConfigErr (DemDTCClass): DemDTCSeverity=DEM_DTC_SEV_IMMEDIATELY, DemUdsDTC=14876758  # Diagnostics Data Import
      COM_NotConfig (DemEventParameter):  # Diagnostics Data Import
        DemEventKind = DEM_EVENT_KIND_SWC
        DemMaxNumberFreezeFrameRecords = 2
        DemDTCClassRef = DTCClass_COM_NotConfig
        DemExtendedDataClassRef = ExtendedDataClass_5ecd55b9
        DemFreezeFrameClassRef = FreezeFrameClass_c3111450
        DemEventClass:  # Diagnostics Data Import
          DemAgingAllowed = true
          DemAgingCycleCounterThreshold = 1
          DemEventDestination = DEM_DTC_ORIGIN_PRIMARY_MEMORY
          DemEventPriority = 2
          DemEventFailureCycleCounterThreshold = 0
          DemAgingCycleRef = PowerCycle
          DemEnableConditionGroupRef = EnableConditionGroup_b321d2d1
          DemOperationCycleRef = PowerCycle
          IndicatorAttribute_WarningIndicator (DemIndicatorAttribute): DemIndicatorFailureCycleSource=DEM_FAILURE_CYCLE_EVENT, DemIndicatorHealingCycleRef=PowerCycle, DemIndicatorRef=WarningIndicator  # Diagnostics Data Import
          DemDebounceAlgorithmClass  # Diagnostics Data Import
            DemDebounceCounterBased: DemDebounceCounterDecrementStepSize=128, DemDebounceCounterIncrementStepSize=127, DemDebounceCounterJumpDown=true, DemDebounceCounterJumpUp=true  # Diagnostics Data Import
      DTCClass_COM_NotConfig (DemDTCClass): DemDTCSeverity=DEM_DTC_SEV_IMMEDIATELY, DemUdsDTC=14876757  # Diagnostics Data Import
      VcEvTsttrPlaus (DemEventParameter):  # Diagnostics Data Import
        DemEventKind = DEM_EVENT_KIND_SWC
        DemMaxNumberFreezeFrameRecords = 2
        DemDTCClassRef = DTCClass_VcEvTsttrPlaus
        DemExtendedDataClassRef = ExtendedDataClass_5ecd55b9
        DemFreezeFrameClassRef = FreezeFrameClass_c3111450
        DemEventClass:  # Diagnostics Data Import
          DemAgingAllowed = true
          DemAgingCycleCounterThreshold = 40
          DemEventDestination = DEM_DTC_ORIGIN_PRIMARY_MEMORY
          DemEventPriority = 2
          DemEventFailureCycleCounterThreshold = 0
          DemAgingCycleRef = PowerCycle
          DemEnableConditionGroupRef = EnableConditionGroup_7ab46a93
          DemOperationCycleRef = PowerCycle
          IndicatorAttribute_WarningIndicator (DemIndicatorAttribute): DemIndicatorFailureCycleSource=DEM_FAILURE_CYCLE_EVENT, DemIndicatorHealingCycleRef=PowerCycle, DemIndicatorRef=WarningIndicator  # Diagnostics Data Import
          DemDebounceAlgorithmClass  # Diagnostics Data Import
            DemDebounceCounterBased: DemDebounceCounterDecrementStepSize=128, DemDebounceCounterIncrementStepSize=127, DemDebounceCounterJumpDown=true, DemDebounceCounterJumpUp=true  # Diagnostics Data Import
      DTCClass_VcEvTsttrPlaus (DemDTCClass): DemDTCSeverity=DEM_DTC_SEV_MAINTENANCE_ONLY, DemUdsDTC=14680164  # Diagnostics Data Import
      COM_Busoff (DemEventParameter):  # Diagnostics Data Import
        DemEventKind = DEM_EVENT_KIND_SWC
        DemMaxNumberFreezeFrameRecords = 2
        DemDTCClassRef = DTCClass_COM_Busoff
        DemExtendedDataClassRef = ExtendedDataClass_5ecd55b9
        DemFreezeFrameClassRef = FreezeFrameClass_c3111450
        DemEventClass:  # Diagnostics Data Import
          DemAgingAllowed = true
          DemAgingCycleCounterThreshold = 1
          DemEventDestination = DEM_DTC_ORIGIN_PRIMARY_MEMORY
          DemEventPriority = 1
          DemEventFailureCycleCounterThreshold = 0
          DemAgingCycleRef = PowerCycle
          DemEnableConditionGroupRef = EnableConditionGroup_377893c9
          DemOperationCycleRef = PowerCycle
          IndicatorAttribute_WarningIndicator (DemIndicatorAttribute): DemIndicatorFailureCycleSource=DEM_FAILURE_CYCLE_EVENT, DemIndicatorHealingCycleRef=PowerCycle, DemIndicatorRef=WarningIndicator  # Diagnostics Data Import
          DemDebounceAlgorithmClass  # Diagnostics Data Import
            DemDebounceCounterBased: DemDebounceCounterDecrementStepSize=128, DemDebounceCounterIncrementStepSize=127, DemDebounceCounterJumpDown=true, DemDebounceCounterJumpUp=true  # Diagnostics Data Import
      DTCClass_COM_Busoff (DemDTCClass): DemDTCSeverity=DEM_DTC_SEV_IMMEDIATELY, DemUdsDTC=14435720  # Diagnostics Data Import
      VcEvChkSum (DemEventParameter):  # Diagnostics Data Import
        DemEventKind = DEM_EVENT_KIND_SWC
        DemMaxNumberFreezeFrameRecords = 2
        DemDTCClassRef = DTCClass_VcEvChkSum
        DemExtendedDataClassRef = ExtendedDataClass_5ecd55b9
        DemFreezeFrameClassRef = FreezeFrameClass_c3111450
        DemEventClass:  # Diagnostics Data Import
          DemAgingAllowed = true
          DemAgingCycleCounterThreshold = 40
          DemEventDestination = DEM_DTC_ORIGIN_PRIMARY_MEMORY
          DemEventPriority = 1
          DemEventFailureCycleCounterThreshold = 0
          DemAgingCycleRef = PowerCycle
          DemEnableConditionGroupRef = EnableConditionGroup_06a6aa19
          DemOperationCycleRef = PowerCycle
          IndicatorAttribute_WarningIndicator (DemIndicatorAttribute): DemIndicatorFailureCycleSource=DEM_FAILURE_CYCLE_EVENT, DemIndicatorHealingCycleRef=PowerCycle, DemIndicatorRef=WarningIndicator  # Diagnostics Data Import
          DemDebounceAlgorithmClass  # Diagnostics Data Import
            DemDebounceCounterBased: DemDebounceCounterDecrementStepSize=128, DemDebounceCounterIncrementStepSize=127, DemDebounceCounterJumpDown=true, DemDebounceCounterJumpUp=true  # Diagnostics Data Import
      DTCClass_VcEvChkSum (DemDTCClass): DemDTCSeverity=DEM_DTC_SEV_MAINTENANCE_ONLY, DemUdsDTC=13916035  # Diagnostics Data Import
      VcEvCntr (DemEventParameter):  # Diagnostics Data Import
        DemEventKind = DEM_EVENT_KIND_SWC
        DemMaxNumberFreezeFrameRecords = 2
        DemDTCClassRef = DTCClass_VcEvCntr
        DemExtendedDataClassRef = ExtendedDataClass_5ecd55b9
        DemFreezeFrameClassRef = FreezeFrameClass_c3111450
        DemEventClass:  # Diagnostics Data Import
          DemAgingAllowed = true
          DemAgingCycleCounterThreshold = 40
          DemEventDestination = DEM_DTC_ORIGIN_PRIMARY_MEMORY
          DemEventPriority = 1
          DemEventFailureCycleCounterThreshold = 0
          DemAgingCycleRef = PowerCycle
          DemEnableConditionGroupRef = EnableConditionGroup_06a6aa19
          DemOperationCycleRef = PowerCycle
          IndicatorAttribute_WarningIndicator (DemIndicatorAttribute): DemIndicatorFailureCycleSource=DEM_FAILURE_CYCLE_EVENT, DemIndicatorHealingCycleRef=PowerCycle, DemIndicatorRef=WarningIndicator  # Diagnostics Data Import
          DemDebounceAlgorithmClass  # Diagnostics Data Import
            DemDebounceCounterBased: DemDebounceCounterDecrementStepSize=128, DemDebounceCounterIncrementStepSize=127, DemDebounceCounterJumpDown=true, DemDebounceCounterJumpUp=true  # Diagnostics Data Import
      DTCClass_VcEvCntr (DemDTCClass): DemDTCSeverity=DEM_DTC_SEV_MAINTENANCE_ONLY, DemUdsDTC=13916034  # Diagnostics Data Import
      INV_IMMO_NOKEY (DemEventParameter):  # Diagnostics Data Import
        DemEventKind = DEM_EVENT_KIND_SWC
        DemMaxNumberFreezeFrameRecords = 2
        DemDTCClassRef = DTCClass_INV_IMMO_NOKEY
        DemExtendedDataClassRef = ExtendedDataClass_5ecd55b9
        DemFreezeFrameClassRef = FreezeFrameClass_c3111450
        DemEventClass:  # Diagnostics Data Import
          DemAgingAllowed = true
          DemAgingCycleCounterThreshold = 40
          DemEventDestination = DEM_DTC_ORIGIN_PRIMARY_MEMORY
          DemEventPriority = 2
          DemEventFailureCycleCounterThreshold = 0
          DemAgingCycleRef = PowerCycle
          DemEnableConditionGroupRef = EnableConditionGroup_f496e085
          DemOperationCycleRef = PowerCycle
          IndicatorAttribute_WarningIndicator (DemIndicatorAttribute): DemIndicatorFailureCycleSource=DEM_FAILURE_CYCLE_EVENT, DemIndicatorHealingCycleRef=PowerCycle, DemIndicatorRef=WarningIndicator  # Diagnostics Data Import
          DemDebounceAlgorithmClass  # Diagnostics Data Import
            DemDebounceCounterBased: DemDebounceCounterDecrementStepSize=128, DemDebounceCounterIncrementStepSize=127, DemDebounceCounterJumpDown=true, DemDebounceCounterJumpUp=true  # Diagnostics Data Import
      DTCClass_INV_IMMO_NOKEY (DemDTCClass): DemDTCSeverity=DEM_DTC_SEV_MAINTENANCE_ONLY, DemUdsDTC=13676881  # Diagnostics Data Import
      INV_QUIESCENT_FLT (DemEventParameter):  # Diagnostics Data Import
        DemEventKind = DEM_EVENT_KIND_SWC
        DemMaxNumberFreezeFrameRecords = 2
        DemDTCClassRef = DTCClass_INV_QUIESCENT_FLT
        DemExtendedDataClassRef = ExtendedDataClass_5ecd55b9
        DemFreezeFrameClassRef = FreezeFrameClass_c3111450
        DemEventClass:  # Diagnostics Data Import
          DemAgingAllowed = true
          DemAgingCycleCounterThreshold = 40
          DemEventDestination = DEM_DTC_ORIGIN_PRIMARY_MEMORY
          DemEventPriority = 2
          DemEventFailureCycleCounterThreshold = 0
          DemAgingCycleRef = PowerCycle
          DemEnableConditionGroupRef = EnableConditionGroup_f496e085
          DemOperationCycleRef = PowerCycle
          DemDebounceAlgorithmClass  # Diagnostics Data Import
            DemDebounceCounterBased: DemDebounceCounterDecrementStepSize=128, DemDebounceCounterIncrementStepSize=127, DemDebounceCounterJumpDown=true, DemDebounceCounterJumpUp=true  # Diagnostics Data Import
      DTCClass_INV_QUIESCENT_FLT (DemDTCClass): DemDTCSeverity=DEM_DTC_SEV_MAINTENANCE_ONLY, DemUdsDTC=13640296  # Diagnostics Data Import
      VcEvPropCANGlbTiOutd (DemEventParameter):  # Diagnostics Data Import
        DemEventKind = DEM_EVENT_KIND_SWC
        DemMaxNumberFreezeFrameRecords = 2
        DemDTCClassRef = DTCClass_VcEvPropCANGlbTiOutd
        DemExtendedDataClassRef = ExtendedDataClass_5ecd55b9
        DemFreezeFrameClassRef = FreezeFrameClass_c3111450
        DemEventClass:  # Diagnostics Data Import
          DemAgingAllowed = true
          DemAgingCycleCounterThreshold = 40
          DemEventDestination = DEM_DTC_ORIGIN_PRIMARY_MEMORY
          DemEventPriority = 1
          DemEventFailureCycleCounterThreshold = 0
          DemAgingCycleRef = PowerCycle
          DemEnableConditionGroupRef = EnableConditionGroup_06a6aa19
          DemOperationCycleRef = PowerCycle
          IndicatorAttribute_WarningIndicator (DemIndicatorAttribute): DemIndicatorFailureCycleSource=DEM_FAILURE_CYCLE_EVENT, DemIndicatorHealingCycleRef=PowerCycle, DemIndicatorRef=WarningIndicator  # Diagnostics Data Import
          DemDebounceAlgorithmClass  # Diagnostics Data Import
            DemDebounceCounterBased: DemDebounceCounterDecrementStepSize=128, DemDebounceCounterIncrementStepSize=127, DemDebounceCounterJumpDown=true, DemDebounceCounterJumpUp=true  # Diagnostics Data Import
      DTCClass_VcEvPropCANGlbTiOutd (DemDTCClass): DemDTCSeverity=DEM_DTC_SEV_IMMEDIATELY, DemUdsDTC=13633671  # Diagnostics Data Import
      VCEvSrsPropFr02Tioutd (DemEventParameter):  # Diagnostics Data Import
        DemEventKind = DEM_EVENT_KIND_SWC
        DemMaxNumberFreezeFrameRecords = 2
        DemDTCClassRef = DTCClass_VCEvSrsPropFr02Tioutd
        DemExtendedDataClassRef = ExtendedDataClass_5ecd55b9
        DemFreezeFrameClassRef = FreezeFrameClass_c3111450
        DemEventClass:  # Diagnostics Data Import
          DemAgingAllowed = true
          DemAgingCycleCounterThreshold = 40
          DemEventDestination = DEM_DTC_ORIGIN_PRIMARY_MEMORY
          DemEventPriority = 1
          DemEventFailureCycleCounterThreshold = 0
          DemAgingCycleRef = PowerCycle
          DemEnableConditionGroupRef = EnableConditionGroup_6f8868bd
          DemOperationCycleRef = PowerCycle
          IndicatorAttribute_WarningIndicator (DemIndicatorAttribute): DemIndicatorFailureCycleSource=DEM_FAILURE_CYCLE_EVENT, DemIndicatorHealingCycleRef=PowerCycle, DemIndicatorRef=WarningIndicator  # Diagnostics Data Import
          DemDebounceAlgorithmClass  # Diagnostics Data Import
            DemDebounceCounterBased: DemDebounceCounterDecrementStepSize=128, DemDebounceCounterIncrementStepSize=127, DemDebounceCounterJumpDown=true, DemDebounceCounterJumpUp=true  # Diagnostics Data Import
      DTCClass_VCEvSrsPropFr02Tioutd (DemDTCClass): DemDTCSeverity=DEM_DTC_SEV_MAINTENANCE_ONLY, DemUdsDTC=12669184  # Diagnostics Data Import
      VcEvNodeMisVDDM (DemEventParameter):  # Diagnostics Data Import
        DemEventKind = DEM_EVENT_KIND_SWC
        DemMaxNumberFreezeFrameRecords = 2
        DemDTCClassRef = DTCClass_VcEvNodeMisVDDM
        DemExtendedDataClassRef = ExtendedDataClass_5ecd55b9
        DemFreezeFrameClassRef = FreezeFrameClass_c3111450
        DemEventClass:  # Diagnostics Data Import
          DemAgingAllowed = true
          DemAgingCycleCounterThreshold = 40
          DemEventDestination = DEM_DTC_ORIGIN_PRIMARY_MEMORY
          DemEventPriority = 1
          DemEventFailureCycleCounterThreshold = 0
          DemAgingCycleRef = PowerCycle
          DemEnableConditionGroupRef = EnableConditionGroup_6f8868bd
          DemOperationCycleRef = PowerCycle
          IndicatorAttribute_WarningIndicator (DemIndicatorAttribute): DemIndicatorFailureCycleSource=DEM_FAILURE_CYCLE_EVENT, DemIndicatorHealingCycleRef=PowerCycle, DemIndicatorRef=WarningIndicator  # Diagnostics Data Import
          DemDebounceAlgorithmClass  # Diagnostics Data Import
            DemDebounceCounterBased: DemDebounceCounterDecrementStepSize=128, DemDebounceCounterIncrementStepSize=127, DemDebounceCounterJumpDown=true, DemDebounceCounterJumpUp=true  # Diagnostics Data Import
      DTCClass_VcEvNodeMisVDDM (DemDTCClass): DemDTCSeverity=DEM_DTC_SEV_IMMEDIATELY, DemUdsDTC=12659200  # Diagnostics Data Import
      VcEvNodeMisBECM (DemEventParameter):  # Diagnostics Data Import
        DemEventKind = DEM_EVENT_KIND_SWC
        DemMaxNumberFreezeFrameRecords = 2
        DemDTCClassRef = DTCClass_VcEvNodeMisBECM
        DemExtendedDataClassRef = ExtendedDataClass_5ecd55b9
        DemFreezeFrameClassRef = FreezeFrameClass_c3111450
        DemEventClass:  # Diagnostics Data Import
          DemAgingAllowed = true
          DemAgingCycleCounterThreshold = 40
          DemEventDestination = DEM_DTC_ORIGIN_PRIMARY_MEMORY
          DemEventPriority = 1
          DemEventFailureCycleCounterThreshold = 0
          DemAgingCycleRef = PowerCycle
          DemEnableConditionGroupRef = EnableConditionGroup_6f8868bd
          DemOperationCycleRef = PowerCycle
          IndicatorAttribute_WarningIndicator (DemIndicatorAttribute): DemIndicatorFailureCycleSource=DEM_FAILURE_CYCLE_EVENT, DemIndicatorHealingCycleRef=PowerCycle, DemIndicatorRef=WarningIndicator  # Diagnostics Data Import
          DemDebounceAlgorithmClass  # Diagnostics Data Import
            DemDebounceCounterBased: DemDebounceCounterDecrementStepSize=128, DemDebounceCounterIncrementStepSize=127, DemDebounceCounterJumpDown=true, DemDebounceCounterJumpUp=true  # Diagnostics Data Import
      DTCClass_VcEvNodeMisBECM (DemDTCClass): DemDTCSeverity=DEM_DTC_SEV_IMMEDIATELY, DemUdsDTC=12652800  # Diagnostics Data Import
      VcEvNodeMisECM (DemEventParameter):  # Diagnostics Data Import
        DemEventKind = DEM_EVENT_KIND_SWC
        DemMaxNumberFreezeFrameRecords = 2
        DemDTCClassRef = DTCClass_VcEvNodeMisECM
        DemExtendedDataClassRef = ExtendedDataClass_5ecd55b9
        DemFreezeFrameClassRef = FreezeFrameClass_c3111450
        DemEventClass:  # Diagnostics Data Import
          DemAgingAllowed = true
          DemAgingCycleCounterThreshold = 40
          DemEventDestination = DEM_DTC_ORIGIN_PRIMARY_MEMORY
          DemEventPriority = 1
          DemEventFailureCycleCounterThreshold = 0
          DemAgingCycleRef = PowerCycle
          DemEnableConditionGroupRef = EnableConditionGroup_6f8868bd
          DemOperationCycleRef = PowerCycle
          IndicatorAttribute_WarningIndicator (DemIndicatorAttribute): DemIndicatorFailureCycleSource=DEM_FAILURE_CYCLE_EVENT, DemIndicatorHealingCycleRef=PowerCycle, DemIndicatorRef=WarningIndicator  # Diagnostics Data Import
          DemDebounceAlgorithmClass  # Diagnostics Data Import
            DemDebounceCounterBased: DemDebounceCounterDecrementStepSize=128, DemDebounceCounterIncrementStepSize=127, DemDebounceCounterJumpDown=true, DemDebounceCounterJumpUp=true  # Diagnostics Data Import
      DTCClass_VcEvNodeMisECM (DemDTCClass): DemDTCSeverity=DEM_DTC_SEV_IMMEDIATELY, DemUdsDTC=12648448  # Diagnostics Data Import
      PS_KL15_RNG_HI (DemEventParameter):  # Diagnostics Data Import
        DemEventKind = DEM_EVENT_KIND_SWC
        DemMaxNumberFreezeFrameRecords = 2
        DemDTCClassRef = DTCClass_PS_KL15_RNG_HI
        DemExtendedDataClassRef = ExtendedDataClass_5ecd55b9
        DemFreezeFrameClassRef = FreezeFrameClass_c3111450
        DemEventClass:  # Diagnostics Data Import
          DemAgingAllowed = true
          DemAgingCycleCounterThreshold = 40
          DemEventDestination = DEM_DTC_ORIGIN_PRIMARY_MEMORY
          DemEventPriority = 2
          DemEventFailureCycleCounterThreshold = 0
          DemAgingCycleRef = PowerCycle
          DemEnableConditionGroupRef = EnableConditionGroup_830522f7
          DemOperationCycleRef = PowerCycle
          IndicatorAttribute_WarningIndicator (DemIndicatorAttribute): DemIndicatorFailureCycleSource=DEM_FAILURE_CYCLE_EVENT, DemIndicatorHealingCycleRef=PowerCycle, DemIndicatorRef=WarningIndicator  # Diagnostics Data Import
          DemDebounceAlgorithmClass  # Diagnostics Data Import
            DemDebounceCounterBased: DemDebounceCounterDecrementStepSize=128, DemDebounceCounterIncrementStepSize=127, DemDebounceCounterJumpDown=true, DemDebounceCounterJumpUp=true  # Diagnostics Data Import
      DTCClass_PS_KL15_RNG_HI (DemDTCClass): DemDTCSeverity=DEM_DTC_SEV_MAINTENANCE_ONLY, DemUdsDTC=10491555  # Diagnostics Data Import
      INV_SHUT_OFF_PAH_START_UP (DemEventParameter):  # Diagnostics Data Import
        DemEventKind = DEM_EVENT_KIND_SWC
        DemMaxNumberFreezeFrameRecords = 2
        DemDTCClassRef = DTCClass_INV_SHUT_OFF_PAH_START_UP
        DemExtendedDataClassRef = ExtendedDataClass_5ecd55b9
        DemFreezeFrameClassRef = FreezeFrameClass_c3111450
        DemEventClass:  # Diagnostics Data Import
          DemAgingAllowed = true
          DemAgingCycleCounterThreshold = 40
          DemEventDestination = DEM_DTC_ORIGIN_PRIMARY_MEMORY
          DemEventPriority = 1
          DemEventFailureCycleCounterThreshold = 0
          DemAgingCycleRef = PowerCycle
          DemEnableConditionGroupRef = EnableConditionGroup_1027fc3a
          DemOperationCycleRef = PowerCycle
          IndicatorAttribute_WarningIndicator (DemIndicatorAttribute): DemIndicatorFailureCycleSource=DEM_FAILURE_CYCLE_EVENT, DemIndicatorHealingCycleRef=PowerCycle, DemIndicatorRef=WarningIndicator  # Diagnostics Data Import
          DemDebounceAlgorithmClass  # Diagnostics Data Import
            DemDebounceCounterBased: DemDebounceCounterDecrementStepSize=128, DemDebounceCounterIncrementStepSize=127, DemDebounceCounterJumpDown=true, DemDebounceCounterJumpUp=true  # Diagnostics Data Import
      DTCClass_INV_SHUT_OFF_PAH_START_UP (DemDTCClass): DemDTCSeverity=DEM_DTC_SEV_IMMEDIATELY, DemUdsDTC=10491282  # Diagnostics Data Import
      Eg_HallVolWrong (DemEventParameter):  # Diagnostics Data Import
        DemEventKind = DEM_EVENT_KIND_SWC
        DemMaxNumberFreezeFrameRecords = 2
        DemDTCClassRef = DTCClass_Eg_HallVolWrong
        DemExtendedDataClassRef = ExtendedDataClass_5ecd55b9
        DemFreezeFrameClassRef = FreezeFrameClass_dc4c3f47
        DemEventClass:  # Diagnostics Data Import
          DemAgingAllowed = true
          DemAgingCycleCounterThreshold = 40
          DemEventDestination = DEM_DTC_ORIGIN_PRIMARY_MEMORY
          DemEventPriority = 1
          DemEventFailureCycleCounterThreshold = 0
          DemAgingCycleRef = PowerCycle
          DemEnableConditionGroupRef = EnableConditionGroup_06a6aa19
          DemOperationCycleRef = PowerCycle
          IndicatorAttribute_WarningIndicator (DemIndicatorAttribute): DemIndicatorFailureCycleSource=DEM_FAILURE_CYCLE_EVENT, DemIndicatorHealingCycleRef=PowerCycle, DemIndicatorRef=WarningIndicator  # Diagnostics Data Import
          DemDebounceAlgorithmClass  # Diagnostics Data Import
            DemDebounceCounterBased: DemDebounceCounterDecrementStepSize=128, DemDebounceCounterIncrementStepSize=127, DemDebounceCounterJumpDown=true, DemDebounceCounterJumpUp=true  # Diagnostics Data Import
      DTCClass_Eg_HallVolWrong (DemDTCClass): DemDTCSeverity=DEM_DTC_SEV_IMMEDIATELY, DemUdsDTC=9876626  # Diagnostics Data Import
      INV_INTERLOCK_FLT (DemEventParameter):  # Diagnostics Data Import
        DemEventKind = DEM_EVENT_KIND_SWC
        DemMaxNumberFreezeFrameRecords = 2
        DemDTCClassRef = DTCClass_INV_INTERLOCK_FLT
        DemExtendedDataClassRef = ExtendedDataClass_5ecd55b9
        DemFreezeFrameClassRef = FreezeFrameClass_c3111450
        DemEventClass:  # Diagnostics Data Import
          DemAgingAllowed = true
          DemAgingCycleCounterThreshold = 40
          DemEventDestination = DEM_DTC_ORIGIN_PRIMARY_MEMORY
          DemEventPriority = 1
          DemEventFailureCycleCounterThreshold = 0
          DemAgingCycleRef = PowerCycle
          DemEnableConditionGroupRef = EnableConditionGroup_7ab46a93
          DemOperationCycleRef = PowerCycle
          IndicatorAttribute_WarningIndicator (DemIndicatorAttribute): DemIndicatorFailureCycleSource=DEM_FAILURE_CYCLE_EVENT, DemIndicatorHealingCycleRef=PowerCycle, DemIndicatorRef=WarningIndicator  # Diagnostics Data Import
          DemDebounceAlgorithmClass  # Diagnostics Data Import
            DemDebounceCounterBased: DemDebounceCounterDecrementStepSize=128, DemDebounceCounterIncrementStepSize=127, DemDebounceCounterJumpDown=true, DemDebounceCounterJumpUp=true  # Diagnostics Data Import
      DTCClass_INV_INTERLOCK_FLT (DemDTCClass): DemDTCSeverity=DEM_DTC_SEV_MAINTENANCE_ONLY, DemUdsDTC=9867924  # Diagnostics Data Import
      CRASH_DTC (DemEventParameter):  # Diagnostics Data Import
        DemEventKind = DEM_EVENT_KIND_SWC
        DemMaxNumberFreezeFrameRecords = 2
        DemDTCClassRef = DTCClass_CRASH_DTC
        DemExtendedDataClassRef = ExtendedDataClass_5ecd55b9
        DemFreezeFrameClassRef = FreezeFrameClass_c3111450
        DemEventClass:  # Diagnostics Data Import
          DemAgingAllowed = true
          DemAgingCycleCounterThreshold = 40
          DemEventDestination = DEM_DTC_ORIGIN_PRIMARY_MEMORY
          DemEventPriority = 1
          DemEventFailureCycleCounterThreshold = 0
          DemAgingCycleRef = PowerCycle
          DemEnableConditionGroupRef = EnableConditionGroup_7ab46a93
          DemOperationCycleRef = PowerCycle
          IndicatorAttribute_WarningIndicator (DemIndicatorAttribute): DemIndicatorFailureCycleSource=DEM_FAILURE_CYCLE_EVENT, DemIndicatorHealingCycleRef=PowerCycle, DemIndicatorRef=WarningIndicator  # Diagnostics Data Import
          DemDebounceAlgorithmClass  # Diagnostics Data Import
            DemDebounceCounterBased: DemDebounceCounterDecrementStepSize=128, DemDebounceCounterIncrementStepSize=127, DemDebounceCounterJumpDown=true, DemDebounceCounterJumpUp=true  # Diagnostics Data Import
      DTCClass_CRASH_DTC (DemDTCClass): DemDTCSeverity=DEM_DTC_SEV_IMMEDIATELY, DemUdsDTC=9851392  # Diagnostics Data Import
      PS_5V_Fault (DemEventParameter):  # Diagnostics Data Import
        DemEventKind = DEM_EVENT_KIND_SWC
        DemMaxNumberFreezeFrameRecords = 2
        DemDTCClassRef = DTCClass_PS_5V_Fault
        DemExtendedDataClassRef = ExtendedDataClass_5ecd55b9
        DemFreezeFrameClassRef = FreezeFrameClass_c3111450
        DemEventClass:  # Diagnostics Data Import
          DemAgingAllowed = true
          DemAgingCycleCounterThreshold = 40
          DemEventDestination = DEM_DTC_ORIGIN_PRIMARY_MEMORY
          DemEventPriority = 1
          DemEventFailureCycleCounterThreshold = 0
          DemAgingCycleRef = PowerCycle
          DemEnableConditionGroupRef = EnableConditionGroup_7ab46a93
          DemOperationCycleRef = PowerCycle
          IndicatorAttribute_WarningIndicator (DemIndicatorAttribute): DemIndicatorFailureCycleSource=DEM_FAILURE_CYCLE_EVENT, DemIndicatorHealingCycleRef=PowerCycle, DemIndicatorRef=WarningIndicator  # Diagnostics Data Import
          DemDebounceAlgorithmClass  # Diagnostics Data Import
            DemDebounceCounterBased: DemDebounceCounterDecrementStepSize=128, DemDebounceCounterIncrementStepSize=127, DemDebounceCounterJumpDown=true, DemDebounceCounterJumpUp=true  # Diagnostics Data Import
        DemCallbackInitMForE  # Diagnostics Data Import
      DTCClass_PS_5V_Fault (DemDTCClass): DemDTCSeverity=DEM_DTC_SEV_IMMEDIATELY, DemUdsDTC=9850368  # Diagnostics Data Import
      AURIX_HW_FLT (DemEventParameter):  # Diagnostics Data Import
        DemEventKind = DEM_EVENT_KIND_SWC
        DemMaxNumberFreezeFrameRecords = 2
        DemDTCClassRef = DTCClass_AURIX_HW_FLT
        DemExtendedDataClassRef = ExtendedDataClass_5ecd55b9
        DemFreezeFrameClassRef = FreezeFrameClass_c3111450
        DemEventClass:  # Diagnostics Data Import
          DemAgingAllowed = true
          DemAgingCycleCounterThreshold = 40
          DemEventDestination = DEM_DTC_ORIGIN_PRIMARY_MEMORY
          DemEventPriority = 1
          DemEventFailureCycleCounterThreshold = 0
          DemAgingCycleRef = PowerCycle
          DemEnableConditionGroupRef = EnableConditionGroup_f496e085
          DemOperationCycleRef = PowerCycle
          IndicatorAttribute_WarningIndicator (DemIndicatorAttribute): DemIndicatorFailureCycleSource=DEM_FAILURE_CYCLE_EVENT, DemIndicatorHealingCycleRef=PowerCycle, DemIndicatorRef=WarningIndicator  # Diagnostics Data Import
          DemDebounceAlgorithmClass  # Diagnostics Data Import
            DemDebounceCounterBased: DemDebounceCounterDecrementStepSize=128, DemDebounceCounterIncrementStepSize=127, DemDebounceCounterJumpDown=true, DemDebounceCounterJumpUp=true  # Diagnostics Data Import
      DTCClass_AURIX_HW_FLT (DemDTCClass): DemDTCSeverity=DEM_DTC_SEV_IMMEDIATELY, DemUdsDTC=9849856  # Diagnostics Data Import
      EXT_UC_SPI_FLT (DemEventParameter):  # Diagnostics Data Import
        DemEventKind = DEM_EVENT_KIND_SWC
        DemMaxNumberFreezeFrameRecords = 2
        DemDTCClassRef = DTCClass_EXT_UC_SPI_FLT
        DemExtendedDataClassRef = ExtendedDataClass_5ecd55b9
        DemFreezeFrameClassRef = FreezeFrameClass_c3111450
        DemEventClass:  # Diagnostics Data Import
          DemAgingAllowed = true
          DemAgingCycleCounterThreshold = 40
          DemEventDestination = DEM_DTC_ORIGIN_PRIMARY_MEMORY
          DemEventPriority = 1
          DemEventFailureCycleCounterThreshold = 0
          DemAgingCycleRef = PowerCycle
          DemEnableConditionGroupRef = EnableConditionGroup_5ab64ab8
          DemOperationCycleRef = PowerCycle
          IndicatorAttribute_WarningIndicator (DemIndicatorAttribute): DemIndicatorFailureCycleSource=DEM_FAILURE_CYCLE_EVENT, DemIndicatorHealingCycleRef=PowerCycle, DemIndicatorRef=WarningIndicator  # Diagnostics Data Import
          DemDebounceAlgorithmClass  # Diagnostics Data Import
            DemDebounceCounterBased: DemDebounceCounterDecrementStepSize=128, DemDebounceCounterIncrementStepSize=127, DemDebounceCounterJumpDown=true, DemDebounceCounterJumpUp=true  # Diagnostics Data Import
      DTCClass_EXT_UC_SPI_FLT (DemDTCClass): DemDTCSeverity=DEM_DTC_SEV_IMMEDIATELY, DemUdsDTC=9849600  # Diagnostics Data Import
      AURIX_EEPROM_FLT (DemEventParameter):  # Diagnostics Data Import
        DemEventKind = DEM_EVENT_KIND_SWC
        DemMaxNumberFreezeFrameRecords = 2
        DemDTCClassRef = DTCClass_AURIX_EEPROM_FLT
        DemExtendedDataClassRef = ExtendedDataClass_5ecd55b9
        DemFreezeFrameClassRef = FreezeFrameClass_c3111450
        DemEventClass:  # Diagnostics Data Import
          DemAgingAllowed = true
          DemAgingCycleCounterThreshold = 40
          DemEventDestination = DEM_DTC_ORIGIN_PRIMARY_MEMORY
          DemEventPriority = 1
          DemEventFailureCycleCounterThreshold = 0
          DemAgingCycleRef = PowerCycle
          DemEnableConditionGroupRef = EnableConditionGroup_c56dc4a6
          DemOperationCycleRef = PowerCycle
          IndicatorAttribute_WarningIndicator (DemIndicatorAttribute): DemIndicatorFailureCycleSource=DEM_FAILURE_CYCLE_EVENT, DemIndicatorHealingCycleRef=PowerCycle, DemIndicatorRef=WarningIndicator  # Diagnostics Data Import
          DemDebounceAlgorithmClass  # Diagnostics Data Import
            DemDebounceCounterBased: DemDebounceCounterDecrementStepSize=128, DemDebounceCounterIncrementStepSize=127, DemDebounceCounterJumpDown=true, DemDebounceCounterJumpUp=true  # Diagnostics Data Import
      DTCClass_AURIX_EEPROM_FLT (DemDTCClass): DemDTCSeverity=DEM_DTC_SEV_IMMEDIATELY, DemUdsDTC=9849088  # Diagnostics Data Import
      VcEvMonISAR (DemEventParameter):  # Diagnostics Data Import
        DemEventKind = DEM_EVENT_KIND_SWC
        DemMaxNumberFreezeFrameRecords = 2
        DemDTCClassRef = DTCClass_VcEvMonISAR
        DemExtendedDataClassRef = ExtendedDataClass_5ecd55b9
        DemFreezeFrameClassRef = FreezeFrameClass_c3111450
        DemEventClass:  # Diagnostics Data Import
          DemAgingAllowed = true
          DemAgingCycleCounterThreshold = 40
          DemEventDestination = DEM_DTC_ORIGIN_PRIMARY_MEMORY
          DemEventPriority = 1
          DemEventFailureCycleCounterThreshold = 0
          DemAgingCycleRef = PowerCycle
          DemOperationCycleRef = PowerCycle
          IndicatorAttribute_WarningIndicator (DemIndicatorAttribute): DemIndicatorFailureCycleSource=DEM_FAILURE_CYCLE_EVENT, DemIndicatorHealingCycleRef=PowerCycle, DemIndicatorRef=WarningIndicator  # Diagnostics Data Import
          DemDebounceAlgorithmClass  # Diagnostics Data Import
            DemDebounceCounterBased: DemDebounceCounterDecrementStepSize=128, DemDebounceCounterIncrementStepSize=127, DemDebounceCounterJumpDown=true, DemDebounceCounterJumpUp=true  # Diagnostics Data Import
      DTCClass_VcEvMonISAR (DemDTCClass): DemDTCSeverity=DEM_DTC_SEV_IMMEDIATELY, DemUdsDTC=9848320  # Diagnostics Data Import
      PS_WhlSnsr_Vltg_FLT (DemEventParameter):  # Diagnostics Data Import
        DemEventKind = DEM_EVENT_KIND_SWC
        DemMaxNumberFreezeFrameRecords = 2
        DemDTCClassRef = DTCClass_PS_WhlSnsr_Vltg_FLT
        DemExtendedDataClassRef = ExtendedDataClass_5ecd55b9
        DemFreezeFrameClassRef = FreezeFrameClass_dc4c3f47
        DemEventClass:  # Diagnostics Data Import
          DemAgingAllowed = true
          DemAgingCycleCounterThreshold = 40
          DemEventDestination = DEM_DTC_ORIGIN_PRIMARY_MEMORY
          DemEventPriority = 1
          DemEventFailureCycleCounterThreshold = 0
          DemAgingCycleRef = PowerCycle
          DemEnableConditionGroupRef = EnableConditionGroup_06a6aa19
          DemOperationCycleRef = PowerCycle
          IndicatorAttribute_WarningIndicator (DemIndicatorAttribute): DemIndicatorFailureCycleSource=DEM_FAILURE_CYCLE_EVENT, DemIndicatorHealingCycleRef=PowerCycle, DemIndicatorRef=WarningIndicator  # Diagnostics Data Import
          DemDebounceAlgorithmClass  # Diagnostics Data Import
            DemDebounceCounterBased: DemDebounceCounterDecrementStepSize=128, DemDebounceCounterIncrementStepSize=127, DemDebounceCounterJumpDown=true, DemDebounceCounterJumpUp=true  # Diagnostics Data Import
      DTCClass_PS_WhlSnsr_Vltg_FLT (DemDTCClass): DemDTCSeverity=DEM_DTC_SEV_IMMEDIATELY, DemUdsDTC=5935132  # Diagnostics Data Import
      PLOCK_Current_RNG_OUT (DemEventParameter):  # Diagnostics Data Import
        DemEventKind = DEM_EVENT_KIND_SWC
        DemMaxNumberFreezeFrameRecords = 2
        DemDTCClassRef = DTCClass_PLOCK_Current_RNG_OUT
        DemExtendedDataClassRef = ExtendedDataClass_5ecd55b9
        DemFreezeFrameClassRef = FreezeFrameClass_c3111450
        DemEventClass:  # Diagnostics Data Import
          DemAgingAllowed = true
          DemAgingCycleCounterThreshold = 40
          DemEventDestination = DEM_DTC_ORIGIN_PRIMARY_MEMORY
          DemEventPriority = 1
          DemEventFailureCycleCounterThreshold = 0
          DemAgingCycleRef = PowerCycle
          DemOperationCycleRef = PowerCycle
          DemDebounceAlgorithmClass  # Diagnostics Data Import
            DemDebounceCounterBased: DemDebounceCounterDecrementStepSize=128, DemDebounceCounterIncrementStepSize=127, DemDebounceCounterJumpDown=true, DemDebounceCounterJumpUp=true  # Diagnostics Data Import
      DTCClass_PLOCK_Current_RNG_OUT (DemDTCClass): DemDTCSeverity=DEM_DTC_SEV_IMMEDIATELY, DemUdsDTC=5290009  # Diagnostics Data Import
      VCC_UnderVoltage (DemEventParameter):  # Diagnostics Data Import
        DemEventKind = DEM_EVENT_KIND_SWC
        DemMaxNumberFreezeFrameRecords = 2
        DemDTCClassRef = DTCClass_VCC_UnderVoltage
        DemExtendedDataClassRef = ExtendedDataClass_5ecd55b9
        DemFreezeFrameClassRef = FreezeFrameClass_c3111450
        DemEventClass:  # Diagnostics Data Import
          DemAgingAllowed = true
          DemAgingCycleCounterThreshold = 40
          DemEventDestination = DEM_DTC_ORIGIN_PRIMARY_MEMORY
          DemEventPriority = 1
          DemEventFailureCycleCounterThreshold = 0
          DemAgingCycleRef = PowerCycle
          DemOperationCycleRef = PowerCycle
          DemDebounceAlgorithmClass  # Diagnostics Data Import
            DemDebounceCounterBased: DemDebounceCounterDecrementStepSize=128, DemDebounceCounterIncrementStepSize=127, DemDebounceCounterJumpDown=true, DemDebounceCounterJumpUp=true  # Diagnostics Data Import
      DTCClass_VCC_UnderVoltage (DemDTCClass): DemDTCSeverity=DEM_DTC_SEV_IMMEDIATELY, DemUdsDTC=5290008  # Diagnostics Data Import
      VCC_OverVoltage (DemEventParameter):  # Diagnostics Data Import
        DemEventKind = DEM_EVENT_KIND_SWC
        DemMaxNumberFreezeFrameRecords = 2
        DemDTCClassRef = DTCClass_VCC_OverVoltage
        DemExtendedDataClassRef = ExtendedDataClass_5ecd55b9
        DemFreezeFrameClassRef = FreezeFrameClass_c3111450
        DemEventClass:  # Diagnostics Data Import
          DemAgingAllowed = true
          DemAgingCycleCounterThreshold = 40
          DemEventDestination = DEM_DTC_ORIGIN_PRIMARY_MEMORY
          DemEventPriority = 1
          DemEventFailureCycleCounterThreshold = 0
          DemAgingCycleRef = PowerCycle
          DemOperationCycleRef = PowerCycle
          DemDebounceAlgorithmClass  # Diagnostics Data Import
            DemDebounceCounterBased: DemDebounceCounterDecrementStepSize=128, DemDebounceCounterIncrementStepSize=127, DemDebounceCounterJumpDown=true, DemDebounceCounterJumpUp=true  # Diagnostics Data Import
      DTCClass_VCC_OverVoltage (DemDTCClass): DemDTCSeverity=DEM_DTC_SEV_IMMEDIATELY, DemUdsDTC=5290007  # Diagnostics Data Import
      PSnsr_GRADT_Flt (DemEventParameter):  # Diagnostics Data Import
        DemEventKind = DEM_EVENT_KIND_SWC
        DemMaxNumberFreezeFrameRecords = 2
        DemDTCClassRef = DTCClass_PSnsr_GRADT_Flt
        DemExtendedDataClassRef = ExtendedDataClass_5ecd55b9
        DemFreezeFrameClassRef = FreezeFrameClass_c3111450
        DemEventClass:  # Diagnostics Data Import
          DemAgingAllowed = true
          DemAgingCycleCounterThreshold = 40
          DemEventDestination = DEM_DTC_ORIGIN_PRIMARY_MEMORY
          DemEventPriority = 1
          DemEventFailureCycleCounterThreshold = 0
          DemAgingCycleRef = PowerCycle
          DemOperationCycleRef = PowerCycle
          DemDebounceAlgorithmClass  # Diagnostics Data Import
            DemDebounceCounterBased: DemDebounceCounterDecrementStepSize=128, DemDebounceCounterIncrementStepSize=127, DemDebounceCounterJumpDown=true, DemDebounceCounterJumpUp=true  # Diagnostics Data Import
      DTCClass_PSnsr_GRADT_Flt (DemDTCClass): DemDTCSeverity=DEM_DTC_SEV_IMMEDIATELY, DemUdsDTC=5286951  # Diagnostics Data Import
      PSnsr_RNG_NOK (DemEventParameter):  # Diagnostics Data Import
        DemEventKind = DEM_EVENT_KIND_SWC
        DemMaxNumberFreezeFrameRecords = 2
        DemDTCClassRef = DTCClass_PSnsr_RNG_NOK
        DemExtendedDataClassRef = ExtendedDataClass_5ecd55b9
        DemFreezeFrameClassRef = FreezeFrameClass_c3111450
        DemEventClass:  # Diagnostics Data Import
          DemAgingAllowed = true
          DemAgingCycleCounterThreshold = 40
          DemEventDestination = DEM_DTC_ORIGIN_PRIMARY_MEMORY
          DemEventPriority = 1
          DemEventFailureCycleCounterThreshold = 0
          DemAgingCycleRef = PowerCycle
          DemOperationCycleRef = PowerCycle
          DemDebounceAlgorithmClass  # Diagnostics Data Import
            DemDebounceCounterBased: DemDebounceCounterDecrementStepSize=128, DemDebounceCounterIncrementStepSize=127, DemDebounceCounterJumpDown=true, DemDebounceCounterJumpUp=true  # Diagnostics Data Import
      DTCClass_PSnsr_RNG_NOK (DemDTCClass): DemDTCSeverity=DEM_DTC_SEV_IMMEDIATELY, DemUdsDTC=5286940  # Diagnostics Data Import
      PSnsr_ELE_FLT (DemEventParameter):  # Diagnostics Data Import
        DemEventKind = DEM_EVENT_KIND_SWC
        DemMaxNumberFreezeFrameRecords = 2
        DemDTCClassRef = DTCClass_PSnsr_ELE_FLT
        DemExtendedDataClassRef = ExtendedDataClass_5ecd55b9
        DemFreezeFrameClassRef = FreezeFrameClass_c3111450
        DemEventClass:  # Diagnostics Data Import
          DemAgingAllowed = true
          DemAgingCycleCounterThreshold = 40
          DemEventDestination = DEM_DTC_ORIGIN_PRIMARY_MEMORY
          DemEventPriority = 1
          DemEventFailureCycleCounterThreshold = 0
          DemAgingCycleRef = PowerCycle
          DemOperationCycleRef = PowerCycle
          DemDebounceAlgorithmClass  # Diagnostics Data Import
            DemDebounceCounterBased: DemDebounceCounterDecrementStepSize=128, DemDebounceCounterIncrementStepSize=127, DemDebounceCounterJumpDown=true, DemDebounceCounterJumpUp=true  # Diagnostics Data Import
      DTCClass_PSnsr_ELE_FLT (DemDTCClass): DemDTCSeverity=DEM_DTC_SEV_IMMEDIATELY, DemUdsDTC=5286913  # Diagnostics Data Import
      PA_ACTION_FLT (DemEventParameter):  # Diagnostics Data Import
        DemEventKind = DEM_EVENT_KIND_SWC
        DemMaxNumberFreezeFrameRecords = 2
        DemDTCClassRef = DTCClass_PA_ACTION_FLT
        DemExtendedDataClassRef = ExtendedDataClass_5ecd55b9
        DemFreezeFrameClassRef = FreezeFrameClass_c3111450
        DemEventClass:  # Diagnostics Data Import
          DemAgingAllowed = true
          DemAgingCycleCounterThreshold = 40
          DemEventDestination = DEM_DTC_ORIGIN_PRIMARY_MEMORY
          DemEventPriority = 1
          DemEventFailureCycleCounterThreshold = 0
          DemAgingCycleRef = PowerCycle
          DemOperationCycleRef = PowerCycle
          DemDebounceAlgorithmClass  # Diagnostics Data Import
            DemDebounceCounterBased: DemDebounceCounterDecrementStepSize=128, DemDebounceCounterIncrementStepSize=127, DemDebounceCounterJumpDown=true, DemDebounceCounterJumpUp=true  # Diagnostics Data Import
      DTCClass_PA_ACTION_FLT (DemDTCClass): DemDTCSeverity=DEM_DTC_SEV_IMMEDIATELY, DemUdsDTC=5283441  # Diagnostics Data Import
      PA_OpenCirc_FLT (DemEventParameter):  # Diagnostics Data Import
        DemEventKind = DEM_EVENT_KIND_SWC
        DemMaxNumberFreezeFrameRecords = 2
        DemDTCClassRef = DTCClass_PA_OpenCirc_FLT
        DemExtendedDataClassRef = ExtendedDataClass_5ecd55b9
        DemFreezeFrameClassRef = FreezeFrameClass_c3111450
        DemEventClass:  # Diagnostics Data Import
          DemAgingAllowed = true
          DemAgingCycleCounterThreshold = 40
          DemEventDestination = DEM_DTC_ORIGIN_PRIMARY_MEMORY
          DemEventPriority = 1
          DemEventFailureCycleCounterThreshold = 0
          DemAgingCycleRef = PowerCycle
          DemOperationCycleRef = PowerCycle
          DemDebounceAlgorithmClass  # Diagnostics Data Import
            DemDebounceCounterBased: DemDebounceCounterDecrementStepSize=128, DemDebounceCounterIncrementStepSize=127, DemDebounceCounterJumpDown=true, DemDebounceCounterJumpUp=true  # Diagnostics Data Import
      DTCClass_PA_OpenCirc_FLT (DemDTCClass): DemDTCSeverity=DEM_DTC_SEV_IMMEDIATELY, DemUdsDTC=5282069  # Diagnostics Data Import
      PA_ELE_FLT (DemEventParameter):  # Diagnostics Data Import
        DemEventKind = DEM_EVENT_KIND_SWC
        DemMaxNumberFreezeFrameRecords = 2
        DemDTCClassRef = DTCClass_PA_ELE_FLT
        DemExtendedDataClassRef = ExtendedDataClass_5ecd55b9
        DemFreezeFrameClassRef = FreezeFrameClass_c3111450
        DemEventClass:  # Diagnostics Data Import
          DemAgingAllowed = true
          DemAgingCycleCounterThreshold = 40
          DemEventDestination = DEM_DTC_ORIGIN_PRIMARY_MEMORY
          DemEventPriority = 1
          DemEventFailureCycleCounterThreshold = 0
          DemAgingCycleRef = PowerCycle
          DemOperationCycleRef = PowerCycle
          DemDebounceAlgorithmClass  # Diagnostics Data Import
            DemDebounceCounterBased: DemDebounceCounterDecrementStepSize=128, DemDebounceCounterIncrementStepSize=127, DemDebounceCounterJumpDown=true, DemDebounceCounterJumpUp=true  # Diagnostics Data Import
      DTCClass_PA_ELE_FLT (DemDTCClass): DemDTCSeverity=DEM_DTC_SEV_IMMEDIATELY, DemUdsDTC=5282068  # Diagnostics Data Import
      PA_OpenCirc (DemEventParameter):  # Diagnostics Data Import
        DemEventKind = DEM_EVENT_KIND_SWC
        DemMaxNumberFreezeFrameRecords = 2
        DemDTCClassRef = DTCClass_PA_OpenCirc
        DemExtendedDataClassRef = ExtendedDataClass_5ecd55b9
        DemFreezeFrameClassRef = FreezeFrameClass_c3111450
        DemEventClass:  # Diagnostics Data Import
          DemAgingAllowed = true
          DemAgingCycleCounterThreshold = 40
          DemEventDestination = DEM_DTC_ORIGIN_PRIMARY_MEMORY
          DemEventPriority = 1
          DemEventFailureCycleCounterThreshold = 0
          DemAgingCycleRef = PowerCycle
          DemOperationCycleRef = PowerCycle
          DemDebounceAlgorithmClass  # Diagnostics Data Import
            DemDebounceCounterBased: DemDebounceCounterDecrementStepSize=128, DemDebounceCounterIncrementStepSize=127, DemDebounceCounterJumpDown=true, DemDebounceCounterJumpUp=true  # Diagnostics Data Import
      DTCClass_PA_OpenCirc (DemDTCClass): DemDTCSeverity=DEM_DTC_SEV_IMMEDIATELY, DemUdsDTC=5282067  # Diagnostics Data Import
      PS_P5_UC_FLT (DemEventParameter):  # Diagnostics Data Import
        DemEventKind = DEM_EVENT_KIND_SWC
        DemMaxNumberFreezeFrameRecords = 2
        DemDTCClassRef = DTCClass_PS_P5_UC_FLT
        DemExtendedDataClassRef = ExtendedDataClass_5ecd55b9
        DemFreezeFrameClassRef = FreezeFrameClass_c3111450
        DemEventClass:  # Diagnostics Data Import
          DemAgingAllowed = true
          DemAgingCycleCounterThreshold = 40
          DemEventDestination = DEM_DTC_ORIGIN_PRIMARY_MEMORY
          DemEventPriority = 1
          DemEventFailureCycleCounterThreshold = 0
          DemAgingCycleRef = PowerCycle
          DemEnableConditionGroupRef = EnableConditionGroup_7ab46a93
          DemOperationCycleRef = PowerCycle
          IndicatorAttribute_WarningIndicator (DemIndicatorAttribute): DemIndicatorFailureCycleSource=DEM_FAILURE_CYCLE_EVENT, DemIndicatorHealingCycleRef=PowerCycle, DemIndicatorRef=WarningIndicator  # Diagnostics Data Import
          DemDebounceAlgorithmClass  # Diagnostics Data Import
            DemDebounceCounterBased: DemDebounceCounterDecrementStepSize=128, DemDebounceCounterIncrementStepSize=127, DemDebounceCounterJumpDown=true, DemDebounceCounterJumpUp=true  # Diagnostics Data Import
      DTCClass_PS_P5_UC_FLT (DemDTCClass): DemDTCSeverity=DEM_DTC_SEV_IMMEDIATELY, DemUdsDTC=5281052  # Diagnostics Data Import
      AURIX_RST_MPL (DemEventParameter):  # Diagnostics Data Import
        DemEventKind = DEM_EVENT_KIND_SWC
        DemMaxNumberFreezeFrameRecords = 2
        DemDTCClassRef = DTCClass_AURIX_RST_MPL
        DemExtendedDataClassRef = ExtendedDataClass_5ecd55b9
        DemFreezeFrameClassRef = FreezeFrameClass_c3111450
        DemEventClass:  # Diagnostics Data Import
          DemAgingAllowed = true
          DemAgingCycleCounterThreshold = 40
          DemEventDestination = DEM_DTC_ORIGIN_PRIMARY_MEMORY
          DemEventPriority = 1
          DemEventFailureCycleCounterThreshold = 0
          DemAgingCycleRef = PowerCycle
          DemEnableConditionGroupRef = EnableConditionGroup_0cc796ea
          DemOperationCycleRef = PowerCycle
          IndicatorAttribute_WarningIndicator (DemIndicatorAttribute): DemIndicatorFailureCycleSource=DEM_FAILURE_CYCLE_EVENT, DemIndicatorHealingCycleRef=PowerCycle, DemIndicatorRef=WarningIndicator  # Diagnostics Data Import
          DemDebounceAlgorithmClass  # Diagnostics Data Import
            DemDebounceCounterBased: DemDebounceCounterDecrementStepSize=128, DemDebounceCounterIncrementStepSize=127, DemDebounceCounterJumpDown=true, DemDebounceCounterJumpUp=true  # Diagnostics Data Import
      DTCClass_AURIX_RST_MPL (DemDTCClass): DemDTCSeverity=DEM_DTC_SEV_IMMEDIATELY, DemUdsDTC=5264790  # Diagnostics Data Import
      AURIX_RST_SNG (DemEventParameter):  # Diagnostics Data Import
        DemEventKind = DEM_EVENT_KIND_SWC
        DemMaxNumberFreezeFrameRecords = 2
        DemDTCClassRef = DTCClass_AURIX_RST_SNG
        DemExtendedDataClassRef = ExtendedDataClass_5ecd55b9
        DemFreezeFrameClassRef = FreezeFrameClass_c3111450
        DemEventClass:  # Diagnostics Data Import
          DemAgingAllowed = true
          DemAgingCycleCounterThreshold = 40
          DemEventDestination = DEM_DTC_ORIGIN_PRIMARY_MEMORY
          DemEventPriority = 1
          DemEventFailureCycleCounterThreshold = 0
          DemAgingCycleRef = PowerCycle
          DemEnableConditionGroupRef = EnableConditionGroup_830522f7
          DemOperationCycleRef = PowerCycle
          IndicatorAttribute_WarningIndicator (DemIndicatorAttribute): DemIndicatorFailureCycleSource=DEM_FAILURE_CYCLE_EVENT, DemIndicatorHealingCycleRef=PowerCycle, DemIndicatorRef=WarningIndicator  # Diagnostics Data Import
          DemDebounceAlgorithmClass  # Diagnostics Data Import
            DemDebounceCounterBased: DemDebounceCounterDecrementStepSize=128, DemDebounceCounterIncrementStepSize=127, DemDebounceCounterJumpDown=true, DemDebounceCounterJumpUp=true  # Diagnostics Data Import
      DTCClass_AURIX_RST_SNG (DemDTCClass): DemDTCSeverity=DEM_DTC_SEV_MAINTENANCE_ONLY, DemUdsDTC=5264788  # Diagnostics Data Import
      INV_RSLVR_OFFS_OUT_RANG (DemEventParameter):  # Diagnostics Data Import
        DemEventKind = DEM_EVENT_KIND_SWC
        DemMaxNumberFreezeFrameRecords = 2
        DemDTCClassRef = DTCClass_INV_RSLVR_OFFS_OUT_RANG
        DemExtendedDataClassRef = ExtendedDataClass_5ecd55b9
        DemFreezeFrameClassRef = FreezeFrameClass_c3111450
        DemEventClass:  # Diagnostics Data Import
          DemAgingAllowed = true
          DemAgingCycleCounterThreshold = 40
          DemEventDestination = DEM_DTC_ORIGIN_PRIMARY_MEMORY
          DemEventPriority = 1
          DemEventFailureCycleCounterThreshold = 0
          DemAgingCycleRef = PowerCycle
          DemEnableConditionGroupRef = EnableConditionGroup_830522f7
          DemOperationCycleRef = PowerCycle
          IndicatorAttribute_WarningIndicator (DemIndicatorAttribute): DemIndicatorFailureCycleSource=DEM_FAILURE_CYCLE_EVENT, DemIndicatorHealingCycleRef=PowerCycle, DemIndicatorRef=WarningIndicator  # Diagnostics Data Import
          DemDebounceAlgorithmClass  # Diagnostics Data Import
            DemDebounceCounterBased: DemDebounceCounterDecrementStepSize=128, DemDebounceCounterIncrementStepSize=127, DemDebounceCounterJumpDown=true, DemDebounceCounterJumpUp=true  # Diagnostics Data Import
      DTCClass_INV_RSLVR_OFFS_OUT_RANG (DemDTCClass): DemDTCSeverity=DEM_DTC_SEV_MAINTENANCE_ONLY, DemUdsDTC=3147653  # Diagnostics Data Import
      INV_RSLVR_OFFS_DFT (DemEventParameter):  # Diagnostics Data Import
        DemEventKind = DEM_EVENT_KIND_SWC
        DemMaxNumberFreezeFrameRecords = 2
        DemDTCClassRef = DTCClass_INV_RSLVR_OFFS_DFT
        DemExtendedDataClassRef = ExtendedDataClass_5ecd55b9
        DemFreezeFrameClassRef = FreezeFrameClass_c3111450
        DemEventClass:  # Diagnostics Data Import
          DemAgingAllowed = true
          DemAgingCycleCounterThreshold = 40
          DemEventDestination = DEM_DTC_ORIGIN_PRIMARY_MEMORY
          DemEventPriority = 1
          DemEventFailureCycleCounterThreshold = 0
          DemAgingCycleRef = PowerCycle
          DemEnableConditionGroupRef = EnableConditionGroup_30df4d87
          DemOperationCycleRef = PowerCycle
          IndicatorAttribute_WarningIndicator (DemIndicatorAttribute): DemIndicatorFailureCycleSource=DEM_FAILURE_CYCLE_EVENT, DemIndicatorHealingCycleRef=PowerCycle, DemIndicatorRef=WarningIndicator  # Diagnostics Data Import
          DemDebounceAlgorithmClass  # Diagnostics Data Import
            DemDebounceCounterBased: DemDebounceCounterDecrementStepSize=128, DemDebounceCounterIncrementStepSize=127, DemDebounceCounterJumpDown=true, DemDebounceCounterJumpUp=true  # Diagnostics Data Import
      DTCClass_INV_RSLVR_OFFS_DFT (DemDTCClass): DemDTCSeverity=DEM_DTC_SEV_IMMEDIATELY, DemUdsDTC=3147606  # Diagnostics Data Import
      GA_BLDC_POS_FLT (DemEventParameter):  # Diagnostics Data Import
        DemEventKind = DEM_EVENT_KIND_SWC
        DemMaxNumberFreezeFrameRecords = 2
        DemDTCClassRef = DTCClass_GA_BLDC_POS_FLT
        DemExtendedDataClassRef = ExtendedDataClass_5ecd55b9
        DemFreezeFrameClassRef = FreezeFrameClass_dc4c3f47
        DemEventClass:  # Diagnostics Data Import
          DemAgingAllowed = true
          DemAgingCycleCounterThreshold = 40
          DemEventDestination = DEM_DTC_ORIGIN_PRIMARY_MEMORY
          DemEventPriority = 1
          DemEventFailureCycleCounterThreshold = 0
          DemAgingCycleRef = PowerCycle
          DemEnableConditionGroupRef = EnableConditionGroup_06a6aa19
          DemOperationCycleRef = PowerCycle
          IndicatorAttribute_WarningIndicator (DemIndicatorAttribute): DemIndicatorFailureCycleSource=DEM_FAILURE_CYCLE_EVENT, DemIndicatorHealingCycleRef=PowerCycle, DemIndicatorRef=WarningIndicator  # Diagnostics Data Import
          DemDebounceAlgorithmClass  # Diagnostics Data Import
            DemDebounceCounterBased: DemDebounceCounterDecrementStepSize=128, DemDebounceCounterIncrementStepSize=127, DemDebounceCounterJumpDown=true, DemDebounceCounterJumpUp=true  # Diagnostics Data Import
      DTCClass_GA_BLDC_POS_FLT (DemDTCClass): DemDTCSeverity=DEM_DTC_SEV_IMMEDIATELY, DemUdsDTC=2673665  # Diagnostics Data Import
      GA_BLDC_FLT (DemEventParameter):  # Diagnostics Data Import
        DemEventKind = DEM_EVENT_KIND_SWC
        DemMaxNumberFreezeFrameRecords = 2
        DemDTCClassRef = DTCClass_GA_BLDC_FLT
        DemExtendedDataClassRef = ExtendedDataClass_5ecd55b9
        DemFreezeFrameClassRef = FreezeFrameClass_dc4c3f47
        DemEventClass:  # Diagnostics Data Import
          DemAgingAllowed = true
          DemAgingCycleCounterThreshold = 40
          DemEventDestination = DEM_DTC_ORIGIN_PRIMARY_MEMORY
          DemEventPriority = 1
          DemEventFailureCycleCounterThreshold = 0
          DemAgingCycleRef = PowerCycle
          DemEnableConditionGroupRef = EnableConditionGroup_06a6aa19
          DemOperationCycleRef = PowerCycle
          IndicatorAttribute_WarningIndicator (DemIndicatorAttribute): DemIndicatorFailureCycleSource=DEM_FAILURE_CYCLE_EVENT, DemIndicatorHealingCycleRef=PowerCycle, DemIndicatorRef=WarningIndicator  # Diagnostics Data Import
          DemDebounceAlgorithmClass  # Diagnostics Data Import
            DemDebounceCounterBased: DemDebounceCounterDecrementStepSize=128, DemDebounceCounterIncrementStepSize=127, DemDebounceCounterJumpDown=true, DemDebounceCounterJumpUp=true  # Diagnostics Data Import
      DTCClass_GA_BLDC_FLT (DemDTCClass): DemDTCSeverity=DEM_DTC_SEV_IMMEDIATELY, DemUdsDTC=2672787  # Diagnostics Data Import
      Ga_FindEngleAngleFailed (DemEventParameter):  # Diagnostics Data Import
        DemEventKind = DEM_EVENT_KIND_SWC
        DemMaxNumberFreezeFrameRecords = 2
        DemDTCClassRef = DTCClass_Ga_FindEngleAngleFailed
        DemExtendedDataClassRef = ExtendedDataClass_5ecd55b9
        DemFreezeFrameClassRef = FreezeFrameClass_dc4c3f47
        DemEventClass:  # Diagnostics Data Import
          DemAgingAllowed = true
          DemAgingCycleCounterThreshold = 40
          DemEventDestination = DEM_DTC_ORIGIN_PRIMARY_MEMORY
          DemEventPriority = 1
          DemEventFailureCycleCounterThreshold = 0
          DemAgingCycleRef = PowerCycle
          DemEnableConditionGroupRef = EnableConditionGroup_06a6aa19
          DemOperationCycleRef = PowerCycle
          IndicatorAttribute_WarningIndicator (DemIndicatorAttribute): DemIndicatorFailureCycleSource=DEM_FAILURE_CYCLE_EVENT, DemIndicatorHealingCycleRef=PowerCycle, DemIndicatorRef=WarningIndicator  # Diagnostics Data Import
          DemDebounceAlgorithmClass  # Diagnostics Data Import
            DemDebounceCounterBased: DemDebounceCounterDecrementStepSize=128, DemDebounceCounterIncrementStepSize=127, DemDebounceCounterJumpDown=true, DemDebounceCounterJumpUp=true  # Diagnostics Data Import
      DTCClass_Ga_FindEngleAngleFailed (DemDTCClass): DemDTCSeverity=DEM_DTC_SEV_IMMEDIATELY, DemUdsDTC=2672760  # Diagnostics Data Import
      Ga_GADisengageFailure (DemEventParameter):  # Diagnostics Data Import
        DemEventKind = DEM_EVENT_KIND_SWC
        DemMaxNumberFreezeFrameRecords = 2
        DemDTCClassRef = DTCClass_Ga_GADisengageFailure
        DemExtendedDataClassRef = ExtendedDataClass_5ecd55b9
        DemFreezeFrameClassRef = FreezeFrameClass_dc4c3f47
        DemEventClass:  # Diagnostics Data Import
          DemAgingAllowed = true
          DemAgingCycleCounterThreshold = 40
          DemEventDestination = DEM_DTC_ORIGIN_PRIMARY_MEMORY
          DemEventPriority = 1
          DemEventFailureCycleCounterThreshold = 0
          DemAgingCycleRef = PowerCycle
          DemEnableConditionGroupRef = EnableConditionGroup_06a6aa19
          DemOperationCycleRef = PowerCycle
          IndicatorAttribute_WarningIndicator (DemIndicatorAttribute): DemIndicatorFailureCycleSource=DEM_FAILURE_CYCLE_EVENT, DemIndicatorHealingCycleRef=PowerCycle, DemIndicatorRef=WarningIndicator  # Diagnostics Data Import
          DemDebounceAlgorithmClass  # Diagnostics Data Import
            DemDebounceCounterBased: DemDebounceCounterDecrementStepSize=128, DemDebounceCounterIncrementStepSize=127, DemDebounceCounterJumpDown=true, DemDebounceCounterJumpUp=true  # Diagnostics Data Import
      DTCClass_Ga_GADisengageFailure (DemDTCClass): DemDTCSeverity=DEM_DTC_SEV_IMMEDIATELY, DemUdsDTC=2644370  # Diagnostics Data Import
      Ga_GAEngageFailure (DemEventParameter):  # Diagnostics Data Import
        DemEventKind = DEM_EVENT_KIND_SWC
        DemMaxNumberFreezeFrameRecords = 2
        DemDTCClassRef = DTCClass_Ga_GAEngageFailure
        DemExtendedDataClassRef = ExtendedDataClass_5ecd55b9
        DemFreezeFrameClassRef = FreezeFrameClass_dc4c3f47
        DemEventClass:  # Diagnostics Data Import
          DemAgingAllowed = true
          DemAgingCycleCounterThreshold = 40
          DemEventDestination = DEM_DTC_ORIGIN_PRIMARY_MEMORY
          DemEventPriority = 1
          DemEventFailureCycleCounterThreshold = 0
          DemAgingCycleRef = PowerCycle
          DemEnableConditionGroupRef = EnableConditionGroup_06a6aa19
          DemOperationCycleRef = PowerCycle
          IndicatorAttribute_WarningIndicator (DemIndicatorAttribute): DemIndicatorFailureCycleSource=DEM_FAILURE_CYCLE_EVENT, DemIndicatorHealingCycleRef=PowerCycle, DemIndicatorRef=WarningIndicator  # Diagnostics Data Import
          DemDebounceAlgorithmClass  # Diagnostics Data Import
            DemDebounceCounterBased: DemDebounceCounterDecrementStepSize=128, DemDebounceCounterIncrementStepSize=127, DemDebounceCounterJumpDown=true, DemDebounceCounterJumpUp=true  # Diagnostics Data Import
      DTCClass_Ga_GAEngageFailure (DemDTCClass): DemDTCSeverity=DEM_DTC_SEV_IMMEDIATELY, DemUdsDTC=2643858  # Diagnostics Data Import
      VcEvMonMode_001 (DemEventParameter):  # Diagnostics Data Import
        DemEventKind = DEM_EVENT_KIND_SWC
        DemMaxNumberFreezeFrameRecords = 2
        DemDTCClassRef = DTCClass_VcEvMonMode_001
        DemExtendedDataClassRef = ExtendedDataClass_5ecd55b9
        DemFreezeFrameClassRef = FreezeFrameClass_c3111450
        DemEventClass:  # Diagnostics Data Import
          DemAgingAllowed = true
          DemAgingCycleCounterThreshold = 40
          DemEventDestination = DEM_DTC_ORIGIN_PRIMARY_MEMORY
          DemEventPriority = 1
          DemEventFailureCycleCounterThreshold = 0
          DemAgingCycleRef = PowerCycle
          DemEnableConditionGroupRef = EnableConditionGroup_7ab46a93
          DemOperationCycleRef = PowerCycle
          IndicatorAttribute_WarningIndicator (DemIndicatorAttribute): DemIndicatorFailureCycleSource=DEM_FAILURE_CYCLE_EVENT, DemIndicatorHealingCycleRef=PowerCycle, DemIndicatorRef=WarningIndicator  # Diagnostics Data Import
          DemDebounceAlgorithmClass  # Diagnostics Data Import
            DemDebounceCounterBased: DemDebounceCounterDecrementStepSize=128, DemDebounceCounterIncrementStepSize=127, DemDebounceCounterJumpDown=true, DemDebounceCounterJumpUp=true  # Diagnostics Data Import
      DTCClass_VcEvMonMode_001 (DemDTCClass): DemDTCSeverity=DEM_DTC_SEV_IMMEDIATELY, DemUdsDTC=1706133  # Diagnostics Data Import
      VcEvMonMode (DemEventParameter):  # Diagnostics Data Import
        DemEventKind = DEM_EVENT_KIND_SWC
        DemMaxNumberFreezeFrameRecords = 2
        DemDTCClassRef = DTCClass_VcEvMonMode
        DemExtendedDataClassRef = ExtendedDataClass_5ecd55b9
        DemFreezeFrameClassRef = FreezeFrameClass_c3111450
        DemEventClass:  # Diagnostics Data Import
          DemAgingAllowed = true
          DemAgingCycleCounterThreshold = 40
          DemEventDestination = DEM_DTC_ORIGIN_PRIMARY_MEMORY
          DemEventPriority = 1
          DemEventFailureCycleCounterThreshold = 0
          DemAgingCycleRef = PowerCycle
          DemEnableConditionGroupRef = EnableConditionGroup_14eabb2c
          DemOperationCycleRef = PowerCycle
          IndicatorAttribute_WarningIndicator (DemIndicatorAttribute): DemIndicatorFailureCycleSource=DEM_FAILURE_CYCLE_EVENT, DemIndicatorHealingCycleRef=PowerCycle, DemIndicatorRef=WarningIndicator  # Diagnostics Data Import
          DemDebounceAlgorithmClass  # Diagnostics Data Import
            DemDebounceCounterBased: DemDebounceCounterDecrementStepSize=128, DemDebounceCounterIncrementStepSize=127, DemDebounceCounterJumpDown=true, DemDebounceCounterJumpUp=true  # Diagnostics Data Import
      DTCClass_VcEvMonMode (DemDTCClass): DemDTCSeverity=DEM_DTC_SEV_IMMEDIATELY, DemUdsDTC=1706132  # Diagnostics Data Import
      Ga_TmSpdSyncFailed (DemEventParameter):  # Diagnostics Data Import
        DemEventKind = DEM_EVENT_KIND_SWC
        DemMaxNumberFreezeFrameRecords = 2
        DemDTCClassRef = DTCClass_Ga_TmSpdSyncFailed
        DemExtendedDataClassRef = ExtendedDataClass_5ecd55b9
        DemFreezeFrameClassRef = FreezeFrameClass_dc4c3f47
        DemEventClass:  # Diagnostics Data Import
          DemAgingAllowed = true
          DemAgingCycleCounterThreshold = 40
          DemEventDestination = DEM_DTC_ORIGIN_PRIMARY_MEMORY
          DemEventPriority = 1
          DemEventFailureCycleCounterThreshold = 0
          DemAgingCycleRef = PowerCycle
          DemEnableConditionGroupRef = EnableConditionGroup_06a6aa19
          DemOperationCycleRef = PowerCycle
          IndicatorAttribute_WarningIndicator (DemIndicatorAttribute): DemIndicatorFailureCycleSource=DEM_FAILURE_CYCLE_EVENT, DemIndicatorHealingCycleRef=PowerCycle, DemIndicatorRef=WarningIndicator  # Diagnostics Data Import
          DemDebounceAlgorithmClass  # Diagnostics Data Import
            DemDebounceCounterBased: DemDebounceCounterDecrementStepSize=128, DemDebounceCounterIncrementStepSize=127, DemDebounceCounterJumpDown=true, DemDebounceCounterJumpUp=true  # Diagnostics Data Import
      DTCClass_Ga_TmSpdSyncFailed (DemDTCClass): DemDTCSeverity=DEM_DTC_SEV_IMMEDIATELY, DemUdsDTC=1580690  # Diagnostics Data Import
      INV_IMMO_AUTHFAIL (DemEventParameter):  # Diagnostics Data Import
        DemEventKind = DEM_EVENT_KIND_SWC
        DemMaxNumberFreezeFrameRecords = 2
        DemDTCClassRef = DTCClass_INV_IMMO_AUTHFAIL
        DemExtendedDataClassRef = ExtendedDataClass_5ecd55b9
        DemFreezeFrameClassRef = FreezeFrameClass_c3111450
        DemEventClass:  # Diagnostics Data Import
          DemAgingAllowed = true
          DemAgingCycleCounterThreshold = 40
          DemEventDestination = DEM_DTC_ORIGIN_PRIMARY_MEMORY
          DemEventPriority = 2
          DemEventFailureCycleCounterThreshold = 0
          DemAgingCycleRef = PowerCycle
          DemEnableConditionGroupRef = EnableConditionGroup_f496e085
          DemOperationCycleRef = PowerCycle
          IndicatorAttribute_WarningIndicator (DemIndicatorAttribute): DemIndicatorFailureCycleSource=DEM_FAILURE_CYCLE_EVENT, DemIndicatorHealingCycleRef=PowerCycle, DemIndicatorRef=WarningIndicator  # Diagnostics Data Import
          DemDebounceAlgorithmClass  # Diagnostics Data Import
            DemDebounceCounterBased: DemDebounceCounterDecrementStepSize=128, DemDebounceCounterIncrementStepSize=127, DemDebounceCounterJumpDown=true, DemDebounceCounterJumpUp=true  # Diagnostics Data Import
      DTCClass_INV_IMMO_AUTHFAIL (DemDTCClass): DemDTCSeverity=DEM_DTC_SEV_MAINTENANCE_ONLY, DemUdsDTC=1448582  # Diagnostics Data Import
      AURIX_WATHDOG_FLT (DemEventParameter):  # Diagnostics Data Import
        DemEventKind = DEM_EVENT_KIND_SWC
        DemMaxNumberFreezeFrameRecords = 2
        DemDTCClassRef = DTCClass_AURIX_WATHDOG_FLT
        DemExtendedDataClassRef = ExtendedDataClass_5ecd55b9
        DemFreezeFrameClassRef = FreezeFrameClass_c3111450
        DemEventClass:  # Diagnostics Data Import
          DemAgingAllowed = true
          DemAgingCycleCounterThreshold = 40
          DemEventDestination = DEM_DTC_ORIGIN_PRIMARY_MEMORY
          DemEventPriority = 1
          DemEventFailureCycleCounterThreshold = 0
          DemAgingCycleRef = PowerCycle
          DemOperationCycleRef = PowerCycle
          IndicatorAttribute_WarningIndicator (DemIndicatorAttribute): DemIndicatorFailureCycleSource=DEM_FAILURE_CYCLE_EVENT, DemIndicatorHealingCycleRef=PowerCycle, DemIndicatorRef=WarningIndicator  # Diagnostics Data Import
          DemDebounceAlgorithmClass  # Diagnostics Data Import
            DemDebounceCounterBased: DemDebounceCounterDecrementStepSize=128, DemDebounceCounterIncrementStepSize=127, DemDebounceCounterJumpDown=true, DemDebounceCounterJumpUp=true  # Diagnostics Data Import
      DTCClass_AURIX_WATHDOG_FLT (DemDTCClass): DemDTCSeverity=DEM_DTC_SEV_IMMEDIATELY, DemUdsDTC=1443840  # Diagnostics Data Import
      PS_P12_RES_FLT (DemEventParameter):  # Diagnostics Data Import
        DemEventKind = DEM_EVENT_KIND_SWC
        DemMaxNumberFreezeFrameRecords = 2
        DemDTCClassRef = DTCClass_PS_P12_RES_FLT
        DemExtendedDataClassRef = ExtendedDataClass_5ecd55b9
        DemFreezeFrameClassRef = FreezeFrameClass_c3111450
        DemEventClass:  # Diagnostics Data Import
          DemAgingAllowed = true
          DemAgingCycleCounterThreshold = 40
          DemEventDestination = DEM_DTC_ORIGIN_PRIMARY_MEMORY
          DemEventPriority = 1
          DemEventFailureCycleCounterThreshold = 0
          DemAgingCycleRef = PowerCycle
          DemEnableConditionGroupRef = EnableConditionGroup_830522f7
          DemOperationCycleRef = PowerCycle
          IndicatorAttribute_WarningIndicator (DemIndicatorAttribute): DemIndicatorFailureCycleSource=DEM_FAILURE_CYCLE_EVENT, DemIndicatorHealingCycleRef=PowerCycle, DemIndicatorRef=WarningIndicator  # Diagnostics Data Import
          DemDebounceAlgorithmClass  # Diagnostics Data Import
            DemDebounceCounterBased: DemDebounceCounterDecrementStepSize=128, DemDebounceCounterIncrementStepSize=127, DemDebounceCounterJumpDown=true, DemDebounceCounterJumpUp=true  # Diagnostics Data Import
      DTCClass_PS_P12_RES_FLT (DemDTCClass): DemDTCSeverity=DEM_DTC_SEV_MAINTENANCE_ONLY, DemUdsDTC=1196060  # Diagnostics Data Import
      INV_GATE_DRVR_BOT_HWP (DemEventParameter):  # Diagnostics Data Import
        DemEventKind = DEM_EVENT_KIND_SWC
        DemMaxNumberFreezeFrameRecords = 2
        DemDTCClassRef = DTCClass_INV_GATE_DRVR_BOT_HWP
        DemExtendedDataClassRef = ExtendedDataClass_5ecd55b9
        DemFreezeFrameClassRef = FreezeFrameClass_c3111450
        DemEventClass:  # Diagnostics Data Import
          DemAgingAllowed = true
          DemAgingCycleCounterThreshold = 40
          DemEventDestination = DEM_DTC_ORIGIN_PRIMARY_MEMORY
          DemEventPriority = 1
          DemEventFailureCycleCounterThreshold = 0
          DemAgingCycleRef = PowerCycle
          DemEnableConditionGroupRef = EnableConditionGroup_830522f7
          DemOperationCycleRef = PowerCycle
          IndicatorAttribute_WarningIndicator (DemIndicatorAttribute): DemIndicatorFailureCycleSource=DEM_FAILURE_CYCLE_EVENT, DemIndicatorHealingCycleRef=PowerCycle, DemIndicatorRef=WarningIndicator  # Diagnostics Data Import
          DemDebounceAlgorithmClass  # Diagnostics Data Import
            DemDebounceCounterBased: DemDebounceCounterDecrementStepSize=128, DemDebounceCounterIncrementStepSize=127, DemDebounceCounterJumpDown=true, DemDebounceCounterJumpUp=true  # Diagnostics Data Import
      DTCClass_INV_GATE_DRVR_BOT_HWP (DemDTCClass): DemDTCSeverity=DEM_DTC_SEV_MAINTENANCE_ONLY, DemUdsDTC=1068617  # Diagnostics Data Import
      INV_GATE_DRVR_TOP_HWP (DemEventParameter):  # Diagnostics Data Import
        DemEventKind = DEM_EVENT_KIND_SWC
        DemMaxNumberFreezeFrameRecords = 2
        DemDTCClassRef = DTCClass_INV_GATE_DRVR_TOP_HWP
        DemExtendedDataClassRef = ExtendedDataClass_5ecd55b9
        DemFreezeFrameClassRef = FreezeFrameClass_c3111450
        DemEventClass:  # Diagnostics Data Import
          DemAgingAllowed = true
          DemAgingCycleCounterThreshold = 40
          DemEventDestination = DEM_DTC_ORIGIN_PRIMARY_MEMORY
          DemEventPriority = 1
          DemEventFailureCycleCounterThreshold = 0
          DemAgingCycleRef = PowerCycle
          DemEnableConditionGroupRef = EnableConditionGroup_830522f7
          DemOperationCycleRef = PowerCycle
          IndicatorAttribute_WarningIndicator (DemIndicatorAttribute): DemIndicatorFailureCycleSource=DEM_FAILURE_CYCLE_EVENT, DemIndicatorHealingCycleRef=PowerCycle, DemIndicatorRef=WarningIndicator  # Diagnostics Data Import
          DemDebounceAlgorithmClass  # Diagnostics Data Import
            DemDebounceCounterBased: DemDebounceCounterDecrementStepSize=128, DemDebounceCounterIncrementStepSize=127, DemDebounceCounterJumpDown=true, DemDebounceCounterJumpUp=true  # Diagnostics Data Import
      DTCClass_INV_GATE_DRVR_TOP_HWP (DemDTCClass): DemDTCSeverity=DEM_DTC_SEV_MAINTENANCE_ONLY, DemUdsDTC=1068361  # Diagnostics Data Import
      INV_IGBT_TEMP_W_PLAUS (DemEventParameter):  # Diagnostics Data Import
        DemEventKind = DEM_EVENT_KIND_SWC
        DemMaxNumberFreezeFrameRecords = 2
        DemDTCClassRef = DTCClass_INV_IGBT_TEMP_W_PLAUS
        DemExtendedDataClassRef = ExtendedDataClass_5ecd55b9
        DemFreezeFrameClassRef = FreezeFrameClass_c3111450
        DemEventClass:  # Diagnostics Data Import
          DemAgingAllowed = true
          DemAgingCycleCounterThreshold = 40
          DemEventDestination = DEM_DTC_ORIGIN_PRIMARY_MEMORY
          DemEventPriority = 2
          DemEventFailureCycleCounterThreshold = 0
          DemAgingCycleRef = PowerCycle
          DemEnableConditionGroupRef = EnableConditionGroup_830522f7
          DemOperationCycleRef = PowerCycle
          IndicatorAttribute_WarningIndicator (DemIndicatorAttribute): DemIndicatorFailureCycleSource=DEM_FAILURE_CYCLE_EVENT, DemIndicatorHealingCycleRef=PowerCycle, DemIndicatorRef=WarningIndicator  # Diagnostics Data Import
          DemDebounceAlgorithmClass  # Diagnostics Data Import
            DemDebounceCounterBased: DemDebounceCounterDecrementStepSize=128, DemDebounceCounterIncrementStepSize=127, DemDebounceCounterJumpDown=true, DemDebounceCounterJumpUp=true  # Diagnostics Data Import
      DTCClass_INV_IGBT_TEMP_W_PLAUS (DemDTCClass): DemDTCSeverity=DEM_DTC_SEV_MAINTENANCE_ONLY, DemUdsDTC=1067106  # Diagnostics Data Import
      INV_IGBT_TEMP_W_GRDT (DemEventParameter):  # Diagnostics Data Import
        DemEventKind = DEM_EVENT_KIND_SWC
        DemMaxNumberFreezeFrameRecords = 2
        DemDTCClassRef = DTCClass_INV_IGBT_TEMP_W_GRDT
        DemExtendedDataClassRef = ExtendedDataClass_5ecd55b9
        DemFreezeFrameClassRef = FreezeFrameClass_c3111450
        DemEventClass:  # Diagnostics Data Import
          DemAgingAllowed = true
          DemAgingCycleCounterThreshold = 40
          DemEventDestination = DEM_DTC_ORIGIN_PRIMARY_MEMORY
          DemEventPriority = 1
          DemEventFailureCycleCounterThreshold = 0
          DemAgingCycleRef = PowerCycle
          DemEnableConditionGroupRef = EnableConditionGroup_7ab46a93
          DemOperationCycleRef = PowerCycle
          IndicatorAttribute_WarningIndicator (DemIndicatorAttribute): DemIndicatorFailureCycleSource=DEM_FAILURE_CYCLE_EVENT, DemIndicatorHealingCycleRef=PowerCycle, DemIndicatorRef=WarningIndicator  # Diagnostics Data Import
          DemDebounceAlgorithmClass  # Diagnostics Data Import
            DemDebounceCounterBased: DemDebounceCounterDecrementStepSize=128, DemDebounceCounterIncrementStepSize=127, DemDebounceCounterJumpDown=true, DemDebounceCounterJumpUp=true  # Diagnostics Data Import
      DTCClass_INV_IGBT_TEMP_W_GRDT (DemDTCClass): DemDTCSeverity=DEM_DTC_SEV_IMMEDIATELY, DemUdsDTC=1067047  # Diagnostics Data Import
      INV_IGBT_TEMP_W_RNG_LO (DemEventParameter):  # Diagnostics Data Import
        DemEventKind = DEM_EVENT_KIND_SWC
        DemMaxNumberFreezeFrameRecords = 2
        DemDTCClassRef = DTCClass_INV_IGBT_TEMP_W_RNG_LO
        DemExtendedDataClassRef = ExtendedDataClass_5ecd55b9
        DemFreezeFrameClassRef = FreezeFrameClass_c3111450
        DemEventClass:  # Diagnostics Data Import
          DemAgingAllowed = true
          DemAgingCycleCounterThreshold = 40
          DemEventDestination = DEM_DTC_ORIGIN_PRIMARY_MEMORY
          DemEventPriority = 2
          DemEventFailureCycleCounterThreshold = 0
          DemAgingCycleRef = PowerCycle
          DemEnableConditionGroupRef = EnableConditionGroup_7ab46a93
          DemOperationCycleRef = PowerCycle
          IndicatorAttribute_WarningIndicator (DemIndicatorAttribute): DemIndicatorFailureCycleSource=DEM_FAILURE_CYCLE_EVENT, DemIndicatorHealingCycleRef=PowerCycle, DemIndicatorRef=WarningIndicator  # Diagnostics Data Import
          DemDebounceAlgorithmClass  # Diagnostics Data Import
            DemDebounceCounterBased: DemDebounceCounterDecrementStepSize=128, DemDebounceCounterIncrementStepSize=127, DemDebounceCounterJumpDown=true, DemDebounceCounterJumpUp=true  # Diagnostics Data Import
      DTCClass_INV_IGBT_TEMP_W_RNG_LO (DemDTCClass): DemDTCSeverity=DEM_DTC_SEV_IMMEDIATELY, DemUdsDTC=1067026  # Diagnostics Data Import
      INV_IGBT_TEMP_W_RNG_HI (DemEventParameter):  # Diagnostics Data Import
        DemEventKind = DEM_EVENT_KIND_SWC
        DemMaxNumberFreezeFrameRecords = 2
        DemDTCClassRef = DTCClass_INV_IGBT_TEMP_W_RNG_HI
        DemExtendedDataClassRef = ExtendedDataClass_5ecd55b9
        DemFreezeFrameClassRef = FreezeFrameClass_c3111450
        DemEventClass:  # Diagnostics Data Import
          DemAgingAllowed = true
          DemAgingCycleCounterThreshold = 40
          DemEventDestination = DEM_DTC_ORIGIN_PRIMARY_MEMORY
          DemEventPriority = 2
          DemEventFailureCycleCounterThreshold = 0
          DemAgingCycleRef = PowerCycle
          DemEnableConditionGroupRef = EnableConditionGroup_7ab46a93
          DemOperationCycleRef = PowerCycle
          IndicatorAttribute_WarningIndicator (DemIndicatorAttribute): DemIndicatorFailureCycleSource=DEM_FAILURE_CYCLE_EVENT, DemIndicatorHealingCycleRef=PowerCycle, DemIndicatorRef=WarningIndicator  # Diagnostics Data Import
          DemDebounceAlgorithmClass  # Diagnostics Data Import
            DemDebounceCounterBased: DemDebounceCounterDecrementStepSize=128, DemDebounceCounterIncrementStepSize=127, DemDebounceCounterJumpDown=true, DemDebounceCounterJumpUp=true  # Diagnostics Data Import
      DTCClass_INV_IGBT_TEMP_W_RNG_HI (DemDTCClass): DemDTCSeverity=DEM_DTC_SEV_IMMEDIATELY, DemUdsDTC=1067025  # Diagnostics Data Import
      INV_IGBT_TEMP_V_PLAUS (DemEventParameter):  # Diagnostics Data Import
        DemEventKind = DEM_EVENT_KIND_SWC
        DemMaxNumberFreezeFrameRecords = 2
        DemDTCClassRef = DTCClass_INV_IGBT_TEMP_V_PLAUS
        DemExtendedDataClassRef = ExtendedDataClass_5ecd55b9
        DemFreezeFrameClassRef = FreezeFrameClass_c3111450
        DemEventClass:  # Diagnostics Data Import
          DemAgingAllowed = true
          DemAgingCycleCounterThreshold = 40
          DemEventDestination = DEM_DTC_ORIGIN_PRIMARY_MEMORY
          DemEventPriority = 2
          DemEventFailureCycleCounterThreshold = 0
          DemAgingCycleRef = PowerCycle
          DemEnableConditionGroupRef = EnableConditionGroup_7ab46a93
          DemOperationCycleRef = PowerCycle
          IndicatorAttribute_WarningIndicator (DemIndicatorAttribute): DemIndicatorFailureCycleSource=DEM_FAILURE_CYCLE_EVENT, DemIndicatorHealingCycleRef=PowerCycle, DemIndicatorRef=WarningIndicator  # Diagnostics Data Import
          DemDebounceAlgorithmClass  # Diagnostics Data Import
            DemDebounceCounterBased: DemDebounceCounterDecrementStepSize=128, DemDebounceCounterIncrementStepSize=127, DemDebounceCounterJumpDown=true, DemDebounceCounterJumpUp=true  # Diagnostics Data Import
      DTCClass_INV_IGBT_TEMP_V_PLAUS (DemDTCClass): DemDTCSeverity=DEM_DTC_SEV_IMMEDIATELY, DemUdsDTC=1066850  # Diagnostics Data Import
      INV_IGBT_TEMP_V_GRDT (DemEventParameter):  # Diagnostics Data Import
        DemEventKind = DEM_EVENT_KIND_SWC
        DemMaxNumberFreezeFrameRecords = 2
        DemDTCClassRef = DTCClass_INV_IGBT_TEMP_V_GRDT
        DemExtendedDataClassRef = ExtendedDataClass_5ecd55b9
        DemFreezeFrameClassRef = FreezeFrameClass_c3111450
        DemEventClass:  # Diagnostics Data Import
          DemAgingAllowed = true
          DemAgingCycleCounterThreshold = 40
          DemEventDestination = DEM_DTC_ORIGIN_PRIMARY_MEMORY
          DemEventPriority = 1
          DemEventFailureCycleCounterThreshold = 0
          DemAgingCycleRef = PowerCycle
          DemEnableConditionGroupRef = EnableConditionGroup_7ab46a93
          DemOperationCycleRef = PowerCycle
          IndicatorAttribute_WarningIndicator (DemIndicatorAttribute): DemIndicatorFailureCycleSource=DEM_FAILURE_CYCLE_EVENT, DemIndicatorHealingCycleRef=PowerCycle, DemIndicatorRef=WarningIndicator  # Diagnostics Data Import
          DemDebounceAlgorithmClass  # Diagnostics Data Import
            DemDebounceCounterBased: DemDebounceCounterDecrementStepSize=128, DemDebounceCounterIncrementStepSize=127, DemDebounceCounterJumpDown=true, DemDebounceCounterJumpUp=true  # Diagnostics Data Import
      DTCClass_INV_IGBT_TEMP_V_GRDT (DemDTCClass): DemDTCSeverity=DEM_DTC_SEV_IMMEDIATELY, DemUdsDTC=1066791  # Diagnostics Data Import
      INV_IGBT_TEMP_V_RNG_LO (DemEventParameter):  # Diagnostics Data Import
        DemEventKind = DEM_EVENT_KIND_SWC
        DemMaxNumberFreezeFrameRecords = 2
        DemDTCClassRef = DTCClass_INV_IGBT_TEMP_V_RNG_LO
        DemExtendedDataClassRef = ExtendedDataClass_5ecd55b9
        DemFreezeFrameClassRef = FreezeFrameClass_c3111450
        DemEventClass:  # Diagnostics Data Import
          DemAgingAllowed = true
          DemAgingCycleCounterThreshold = 40
          DemEventDestination = DEM_DTC_ORIGIN_PRIMARY_MEMORY
          DemEventPriority = 2
          DemEventFailureCycleCounterThreshold = 0
          DemAgingCycleRef = PowerCycle
          DemEnableConditionGroupRef = EnableConditionGroup_7ab46a93
          DemOperationCycleRef = PowerCycle
          IndicatorAttribute_WarningIndicator (DemIndicatorAttribute): DemIndicatorFailureCycleSource=DEM_FAILURE_CYCLE_EVENT, DemIndicatorHealingCycleRef=PowerCycle, DemIndicatorRef=WarningIndicator  # Diagnostics Data Import
          DemDebounceAlgorithmClass  # Diagnostics Data Import
            DemDebounceCounterBased: DemDebounceCounterDecrementStepSize=128, DemDebounceCounterIncrementStepSize=127, DemDebounceCounterJumpDown=true, DemDebounceCounterJumpUp=true  # Diagnostics Data Import
      DTCClass_INV_IGBT_TEMP_V_RNG_LO (DemDTCClass): DemDTCSeverity=DEM_DTC_SEV_IMMEDIATELY, DemUdsDTC=1066770  # Diagnostics Data Import
      INV_IGBT_TEMP_V_RNG_HI (DemEventParameter):  # Diagnostics Data Import
        DemEventKind = DEM_EVENT_KIND_SWC
        DemMaxNumberFreezeFrameRecords = 2
        DemDTCClassRef = DTCClass_INV_IGBT_TEMP_V_RNG_HI
        DemExtendedDataClassRef = ExtendedDataClass_5ecd55b9
        DemFreezeFrameClassRef = FreezeFrameClass_c3111450
        DemEventClass:  # Diagnostics Data Import
          DemAgingAllowed = true
          DemAgingCycleCounterThreshold = 40
          DemEventDestination = DEM_DTC_ORIGIN_PRIMARY_MEMORY
          DemEventPriority = 2
          DemEventFailureCycleCounterThreshold = 0
          DemAgingCycleRef = PowerCycle
          DemEnableConditionGroupRef = EnableConditionGroup_7ab46a93
          DemOperationCycleRef = PowerCycle
          IndicatorAttribute_WarningIndicator (DemIndicatorAttribute): DemIndicatorFailureCycleSource=DEM_FAILURE_CYCLE_EVENT, DemIndicatorHealingCycleRef=PowerCycle, DemIndicatorRef=WarningIndicator  # Diagnostics Data Import
          DemDebounceAlgorithmClass  # Diagnostics Data Import
            DemDebounceCounterBased: DemDebounceCounterDecrementStepSize=128, DemDebounceCounterIncrementStepSize=127, DemDebounceCounterJumpDown=true, DemDebounceCounterJumpUp=true  # Diagnostics Data Import
      DTCClass_INV_IGBT_TEMP_V_RNG_HI (DemDTCClass): DemDTCSeverity=DEM_DTC_SEV_IMMEDIATELY, DemUdsDTC=1066769  # Diagnostics Data Import
      INV_IGBT_TEMP_U_PLAUS (DemEventParameter):  # Diagnostics Data Import
        DemEventKind = DEM_EVENT_KIND_SWC
        DemMaxNumberFreezeFrameRecords = 2
        DemDTCClassRef = DTCClass_INV_IGBT_TEMP_U_PLAUS
        DemExtendedDataClassRef = ExtendedDataClass_5ecd55b9
        DemFreezeFrameClassRef = FreezeFrameClass_c3111450
        DemEventClass:  # Diagnostics Data Import
          DemAgingAllowed = true
          DemAgingCycleCounterThreshold = 40
          DemEventDestination = DEM_DTC_ORIGIN_PRIMARY_MEMORY
          DemEventPriority = 2
          DemEventFailureCycleCounterThreshold = 0
          DemAgingCycleRef = PowerCycle
          DemEnableConditionGroupRef = EnableConditionGroup_7ab46a93
          DemOperationCycleRef = PowerCycle
          IndicatorAttribute_WarningIndicator (DemIndicatorAttribute): DemIndicatorFailureCycleSource=DEM_FAILURE_CYCLE_EVENT, DemIndicatorHealingCycleRef=PowerCycle, DemIndicatorRef=WarningIndicator  # Diagnostics Data Import
          DemDebounceAlgorithmClass  # Diagnostics Data Import
            DemDebounceCounterBased: DemDebounceCounterDecrementStepSize=128, DemDebounceCounterIncrementStepSize=127, DemDebounceCounterJumpDown=true, DemDebounceCounterJumpUp=true  # Diagnostics Data Import
      DTCClass_INV_IGBT_TEMP_U_PLAUS (DemDTCClass): DemDTCSeverity=DEM_DTC_SEV_IMMEDIATELY, DemUdsDTC=1066594  # Diagnostics Data Import
      INV_IGBT_TEMP_U_GRDT (DemEventParameter):  # Diagnostics Data Import
        DemEventKind = DEM_EVENT_KIND_SWC
        DemMaxNumberFreezeFrameRecords = 2
        DemDTCClassRef = DTCClass_INV_IGBT_TEMP_U_GRDT
        DemExtendedDataClassRef = ExtendedDataClass_5ecd55b9
        DemFreezeFrameClassRef = FreezeFrameClass_c3111450
        DemEventClass:  # Diagnostics Data Import
          DemAgingAllowed = true
          DemAgingCycleCounterThreshold = 40
          DemEventDestination = DEM_DTC_ORIGIN_PRIMARY_MEMORY
          DemEventPriority = 1
          DemEventFailureCycleCounterThreshold = 0
          DemAgingCycleRef = PowerCycle
          DemEnableConditionGroupRef = EnableConditionGroup_7ab46a93
          DemOperationCycleRef = PowerCycle
          IndicatorAttribute_WarningIndicator (DemIndicatorAttribute): DemIndicatorFailureCycleSource=DEM_FAILURE_CYCLE_EVENT, DemIndicatorHealingCycleRef=PowerCycle, DemIndicatorRef=WarningIndicator  # Diagnostics Data Import
          DemDebounceAlgorithmClass  # Diagnostics Data Import
            DemDebounceCounterBased: DemDebounceCounterDecrementStepSize=128, DemDebounceCounterIncrementStepSize=127, DemDebounceCounterJumpDown=true, DemDebounceCounterJumpUp=true  # Diagnostics Data Import
      DTCClass_INV_IGBT_TEMP_U_GRDT (DemDTCClass): DemDTCSeverity=DEM_DTC_SEV_IMMEDIATELY, DemUdsDTC=1066535  # Diagnostics Data Import
      INV_IGBT_TEMP_U_RNG_LO (DemEventParameter):  # Diagnostics Data Import
        DemEventKind = DEM_EVENT_KIND_SWC
        DemMaxNumberFreezeFrameRecords = 2
        DemDTCClassRef = DTCClass_INV_IGBT_TEMP_U_RNG_LO
        DemExtendedDataClassRef = ExtendedDataClass_5ecd55b9
        DemFreezeFrameClassRef = FreezeFrameClass_c3111450
        DemEventClass:  # Diagnostics Data Import
          DemAgingAllowed = true
          DemAgingCycleCounterThreshold = 40
          DemEventDestination = DEM_DTC_ORIGIN_PRIMARY_MEMORY
          DemEventPriority = 2
          DemEventFailureCycleCounterThreshold = 0
          DemAgingCycleRef = PowerCycle
          DemEnableConditionGroupRef = EnableConditionGroup_7ab46a93
          DemOperationCycleRef = PowerCycle
          IndicatorAttribute_WarningIndicator (DemIndicatorAttribute): DemIndicatorFailureCycleSource=DEM_FAILURE_CYCLE_EVENT, DemIndicatorHealingCycleRef=PowerCycle, DemIndicatorRef=WarningIndicator  # Diagnostics Data Import
          DemDebounceAlgorithmClass  # Diagnostics Data Import
            DemDebounceCounterBased: DemDebounceCounterDecrementStepSize=128, DemDebounceCounterIncrementStepSize=127, DemDebounceCounterJumpDown=true, DemDebounceCounterJumpUp=true  # Diagnostics Data Import
      DTCClass_INV_IGBT_TEMP_U_RNG_LO (DemDTCClass): DemDTCSeverity=DEM_DTC_SEV_IMMEDIATELY, DemUdsDTC=1066514  # Diagnostics Data Import
      INV_IGBT_TEMP_U_RNG_HI (DemEventParameter):  # Diagnostics Data Import
        DemEventKind = DEM_EVENT_KIND_SWC
        DemMaxNumberFreezeFrameRecords = 2
        DemDTCClassRef = DTCClass_INV_IGBT_TEMP_U_RNG_HI
        DemExtendedDataClassRef = ExtendedDataClass_5ecd55b9
        DemFreezeFrameClassRef = FreezeFrameClass_c3111450
        DemEventClass:  # Diagnostics Data Import
          DemAgingAllowed = true
          DemAgingCycleCounterThreshold = 40
          DemEventDestination = DEM_DTC_ORIGIN_PRIMARY_MEMORY
          DemEventPriority = 2
          DemEventFailureCycleCounterThreshold = 0
          DemAgingCycleRef = PowerCycle
          DemEnableConditionGroupRef = EnableConditionGroup_7ab46a93
          DemOperationCycleRef = PowerCycle
          IndicatorAttribute_WarningIndicator (DemIndicatorAttribute): DemIndicatorFailureCycleSource=DEM_FAILURE_CYCLE_EVENT, DemIndicatorHealingCycleRef=PowerCycle, DemIndicatorRef=WarningIndicator  # Diagnostics Data Import
          DemDebounceAlgorithmClass  # Diagnostics Data Import
            DemDebounceCounterBased: DemDebounceCounterDecrementStepSize=128, DemDebounceCounterIncrementStepSize=127, DemDebounceCounterJumpDown=true, DemDebounceCounterJumpUp=true  # Diagnostics Data Import
      DTCClass_INV_IGBT_TEMP_U_RNG_HI (DemDTCClass): DemDTCSeverity=DEM_DTC_SEV_IMMEDIATELY, DemUdsDTC=1066513  # Diagnostics Data Import
      INV_IAC_W_OFFS (DemEventParameter):  # Diagnostics Data Import
        DemEventKind = DEM_EVENT_KIND_SWC
        DemMaxNumberFreezeFrameRecords = 2
        DemDTCClassRef = DTCClass_INV_IAC_W_OFFS
        DemExtendedDataClassRef = ExtendedDataClass_5ecd55b9
        DemFreezeFrameClassRef = FreezeFrameClass_c3111450
        DemEventClass:  # Diagnostics Data Import
          DemAgingAllowed = true
          DemAgingCycleCounterThreshold = 40
          DemEventDestination = DEM_DTC_ORIGIN_PRIMARY_MEMORY
          DemEventPriority = 1
          DemEventFailureCycleCounterThreshold = 0
          DemAgingCycleRef = PowerCycle
          DemEnableConditionGroupRef = EnableConditionGroup_d8c05f30
          DemOperationCycleRef = PowerCycle
          IndicatorAttribute_WarningIndicator (DemIndicatorAttribute): DemIndicatorFailureCycleSource=DEM_FAILURE_CYCLE_EVENT, DemIndicatorHealingCycleRef=PowerCycle, DemIndicatorRef=WarningIndicator  # Diagnostics Data Import
          DemDebounceAlgorithmClass  # Diagnostics Data Import
            DemDebounceCounterBased: DemDebounceCounterDecrementStepSize=128, DemDebounceCounterIncrementStepSize=127, DemDebounceCounterJumpDown=true, DemDebounceCounterJumpUp=true  # Diagnostics Data Import
      DTCClass_INV_IAC_W_OFFS (DemDTCClass): DemDTCSeverity=DEM_DTC_SEV_IMMEDIATELY, DemUdsDTC=1065239  # Diagnostics Data Import
      INV_IAC_V_OFFS (DemEventParameter):  # Diagnostics Data Import
        DemEventKind = DEM_EVENT_KIND_SWC
        DemMaxNumberFreezeFrameRecords = 2
        DemDTCClassRef = DTCClass_INV_IAC_V_OFFS
        DemExtendedDataClassRef = ExtendedDataClass_5ecd55b9
        DemFreezeFrameClassRef = FreezeFrameClass_c3111450
        DemEventClass:  # Diagnostics Data Import
          DemAgingAllowed = true
          DemAgingCycleCounterThreshold = 40
          DemEventDestination = DEM_DTC_ORIGIN_PRIMARY_MEMORY
          DemEventPriority = 1
          DemEventFailureCycleCounterThreshold = 0
          DemAgingCycleRef = PowerCycle
          DemEnableConditionGroupRef = EnableConditionGroup_d8c05f30
          DemOperationCycleRef = PowerCycle
          IndicatorAttribute_WarningIndicator (DemIndicatorAttribute): DemIndicatorFailureCycleSource=DEM_FAILURE_CYCLE_EVENT, DemIndicatorHealingCycleRef=PowerCycle, DemIndicatorRef=WarningIndicator  # Diagnostics Data Import
          DemDebounceAlgorithmClass  # Diagnostics Data Import
            DemDebounceCounterBased: DemDebounceCounterDecrementStepSize=128, DemDebounceCounterIncrementStepSize=127, DemDebounceCounterJumpDown=true, DemDebounceCounterJumpUp=true  # Diagnostics Data Import
      DTCClass_INV_IAC_V_OFFS (DemDTCClass): DemDTCSeverity=DEM_DTC_SEV_IMMEDIATELY, DemUdsDTC=1064983  # Diagnostics Data Import
      INV_IAC_U_OFFS (DemEventParameter):  # Diagnostics Data Import
        DemEventKind = DEM_EVENT_KIND_SWC
        DemMaxNumberFreezeFrameRecords = 2
        DemDTCClassRef = DTCClass_INV_IAC_U_OFFS
        DemExtendedDataClassRef = ExtendedDataClass_5ecd55b9
        DemFreezeFrameClassRef = FreezeFrameClass_c3111450
        DemEventClass:  # Diagnostics Data Import
          DemAgingAllowed = true
          DemAgingCycleCounterThreshold = 40
          DemEventDestination = DEM_DTC_ORIGIN_PRIMARY_MEMORY
          DemEventPriority = 1
          DemEventFailureCycleCounterThreshold = 0
          DemAgingCycleRef = PowerCycle
          DemEnableConditionGroupRef = EnableConditionGroup_d8c05f30
          DemOperationCycleRef = PowerCycle
          IndicatorAttribute_WarningIndicator (DemIndicatorAttribute): DemIndicatorFailureCycleSource=DEM_FAILURE_CYCLE_EVENT, DemIndicatorHealingCycleRef=PowerCycle, DemIndicatorRef=WarningIndicator  # Diagnostics Data Import
          DemDebounceAlgorithmClass  # Diagnostics Data Import
            DemDebounceCounterBased: DemDebounceCounterDecrementStepSize=128, DemDebounceCounterIncrementStepSize=127, DemDebounceCounterJumpDown=true, DemDebounceCounterJumpUp=true  # Diagnostics Data Import
      DTCClass_INV_IAC_U_OFFS (DemDTCClass): DemDTCSeverity=DEM_DTC_SEV_IMMEDIATELY, DemUdsDTC=1064727  # Diagnostics Data Import
      INV_IAC_PLAUS_SUM (DemEventParameter):  # Diagnostics Data Import
        DemEventKind = DEM_EVENT_KIND_SWC
        DemMaxNumberFreezeFrameRecords = 2
        DemDTCClassRef = DTCClass_INV_IAC_PLAUS_SUM
        DemExtendedDataClassRef = ExtendedDataClass_5ecd55b9
        DemFreezeFrameClassRef = FreezeFrameClass_c3111450
        DemEventClass:  # Diagnostics Data Import
          DemAgingAllowed = true
          DemAgingCycleCounterThreshold = 40
          DemEventDestination = DEM_DTC_ORIGIN_PRIMARY_MEMORY
          DemEventPriority = 1
          DemEventFailureCycleCounterThreshold = 0
          DemAgingCycleRef = PowerCycle
          DemEnableConditionGroupRef = EnableConditionGroup_9e78dd86
          DemOperationCycleRef = PowerCycle
          IndicatorAttribute_WarningIndicator (DemIndicatorAttribute): DemIndicatorFailureCycleSource=DEM_FAILURE_CYCLE_EVENT, DemIndicatorHealingCycleRef=PowerCycle, DemIndicatorRef=WarningIndicator  # Diagnostics Data Import
          DemDebounceAlgorithmClass  # Diagnostics Data Import
            DemDebounceCounterBased: DemDebounceCounterDecrementStepSize=128, DemDebounceCounterIncrementStepSize=127, DemDebounceCounterJumpDown=true, DemDebounceCounterJumpUp=true  # Diagnostics Data Import
      DTCClass_INV_IAC_PLAUS_SUM (DemDTCClass): DemDTCSeverity=DEM_DTC_SEV_IMMEDIATELY, DemUdsDTC=1064473  # Diagnostics Data Import
      VcEvMonESpd (DemEventParameter):  # Diagnostics Data Import
        DemEventKind = DEM_EVENT_KIND_SWC
        DemMaxNumberFreezeFrameRecords = 2
        DemDTCClassRef = DTCClass_VcEvMonESpd
        DemExtendedDataClassRef = ExtendedDataClass_5ecd55b9
        DemFreezeFrameClassRef = FreezeFrameClass_c3111450
        DemEventClass:  # Diagnostics Data Import
          DemAgingAllowed = true
          DemAgingCycleCounterThreshold = 40
          DemEventDestination = DEM_DTC_ORIGIN_PRIMARY_MEMORY
          DemEventPriority = 1
          DemEventFailureCycleCounterThreshold = 0
          DemAgingCycleRef = PowerCycle
          DemEnableConditionGroupRef = EnableConditionGroup_6698c395
          DemOperationCycleRef = PowerCycle
          IndicatorAttribute_WarningIndicator (DemIndicatorAttribute): DemIndicatorFailureCycleSource=DEM_FAILURE_CYCLE_EVENT, DemIndicatorHealingCycleRef=PowerCycle, DemIndicatorRef=WarningIndicator  # Diagnostics Data Import
          DemDebounceAlgorithmClass  # Diagnostics Data Import
            DemDebounceCounterBased: DemDebounceCounterDecrementStepSize=128, DemDebounceCounterIncrementStepSize=127, DemDebounceCounterJumpDown=true, DemDebounceCounterJumpUp=true  # Diagnostics Data Import
      DTCClass_VcEvMonESpd (DemDTCClass): DemDTCSeverity=DEM_DTC_SEV_MAINTENANCE_ONLY, DemUdsDTC=1063522  # Diagnostics Data Import
      INV_ACTV_DCHA_HW (DemEventParameter):  # Diagnostics Data Import
        DemEventKind = DEM_EVENT_KIND_SWC
        DemMaxNumberFreezeFrameRecords = 2
        DemDTCClassRef = DTCClass_INV_ACTV_DCHA_HW
        DemExtendedDataClassRef = ExtendedDataClass_5ecd55b9
        DemFreezeFrameClassRef = FreezeFrameClass_c3111450
        DemEventClass:  # Diagnostics Data Import
          DemAgingAllowed = true
          DemAgingCycleCounterThreshold = 40
          DemEventDestination = DEM_DTC_ORIGIN_PRIMARY_MEMORY
          DemEventPriority = 1
          DemEventFailureCycleCounterThreshold = 0
          DemAgingCycleRef = PowerCycle
          DemEnableConditionGroupRef = EnableConditionGroup_3b30fb61
          DemOperationCycleRef = PowerCycle
          IndicatorAttribute_WarningIndicator (DemIndicatorAttribute): DemIndicatorFailureCycleSource=DEM_FAILURE_CYCLE_EVENT, DemIndicatorHealingCycleRef=PowerCycle, DemIndicatorRef=WarningIndicator  # Diagnostics Data Import
          DemDebounceAlgorithmClass  # Diagnostics Data Import
            DemDebounceCounterBased: DemDebounceCounterDecrementStepSize=128, DemDebounceCounterIncrementStepSize=127, DemDebounceCounterJumpDown=true, DemDebounceCounterJumpUp=true  # Diagnostics Data Import
      DTCClass_INV_ACTV_DCHA_HW (DemDTCClass): DemDTCSeverity=DEM_DTC_SEV_IMMEDIATELY, DemUdsDTC=1060963  # Diagnostics Data Import
      INV_TEMP_DCHA_HW (DemEventParameter):  # Diagnostics Data Import
        DemEventKind = DEM_EVENT_KIND_SWC
        DemMaxNumberFreezeFrameRecords = 2
        DemDTCClassRef = DTCClass_INV_TEMP_DCHA_HW
        DemExtendedDataClassRef = ExtendedDataClass_5ecd55b9
        DemFreezeFrameClassRef = FreezeFrameClass_c3111450
        DemEventClass:  # Diagnostics Data Import
          DemAgingAllowed = true
          DemAgingCycleCounterThreshold = 40
          DemEventDestination = DEM_DTC_ORIGIN_PRIMARY_MEMORY
          DemEventPriority = 1
          DemEventFailureCycleCounterThreshold = 0
          DemAgingCycleRef = PowerCycle
          DemEnableConditionGroupRef = EnableConditionGroup_7cfce1b1
          DemOperationCycleRef = PowerCycle
          IndicatorAttribute_WarningIndicator (DemIndicatorAttribute): DemIndicatorFailureCycleSource=DEM_FAILURE_CYCLE_EVENT, DemIndicatorHealingCycleRef=PowerCycle, DemIndicatorRef=WarningIndicator  # Diagnostics Data Import
          DemDebounceAlgorithmClass  # Diagnostics Data Import
            DemDebounceCounterBased: DemDebounceCounterDecrementStepSize=128, DemDebounceCounterIncrementStepSize=127, DemDebounceCounterJumpDown=true, DemDebounceCounterJumpUp=true  # Diagnostics Data Import
      DTCClass_INV_TEMP_DCHA_HW (DemDTCClass): DemDTCSeverity=DEM_DTC_SEV_MAINTENANCE_ONLY, DemUdsDTC=1060939  # Diagnostics Data Import
      PS_DRVB_Fault (DemEventParameter):  # Diagnostics Data Import
        DemEventKind = DEM_EVENT_KIND_SWC
        DemMaxNumberFreezeFrameRecords = 2
        DemDTCClassRef = DTCClass_PS_DRVB_Fault
        DemExtendedDataClassRef = ExtendedDataClass_5ecd55b9
        DemFreezeFrameClassRef = FreezeFrameClass_c3111450
        DemEventClass:  # Diagnostics Data Import
          DemAgingAllowed = true
          DemAgingCycleCounterThreshold = 40
          DemEventDestination = DEM_DTC_ORIGIN_PRIMARY_MEMORY
          DemEventPriority = 1
          DemEventFailureCycleCounterThreshold = 0
          DemAgingCycleRef = PowerCycle
          DemOperationCycleRef = PowerCycle
          IndicatorAttribute_WarningIndicator (DemIndicatorAttribute): DemIndicatorFailureCycleSource=DEM_FAILURE_CYCLE_EVENT, DemIndicatorHealingCycleRef=PowerCycle, DemIndicatorRef=WarningIndicator  # Diagnostics Data Import
          DemDebounceAlgorithmClass  # Diagnostics Data Import
            DemDebounceCounterBased: DemDebounceCounterDecrementStepSize=128, DemDebounceCounterIncrementStepSize=127, DemDebounceCounterJumpDown=true, DemDebounceCounterJumpUp=true  # Diagnostics Data Import
      DTCClass_PS_DRVB_Fault (DemDTCClass): DemDTCSeverity=DEM_DTC_SEV_IMMEDIATELY, DemUdsDTC=1060124  # Diagnostics Data Import
      PS_BLDC_OV_FLT (DemEventParameter):  # Diagnostics Data Import
        DemEventKind = DEM_EVENT_KIND_SWC
        DemMaxNumberFreezeFrameRecords = 2
        DemDTCClassRef = DTCClass_PS_BLDC_OV_FLT
        DemExtendedDataClassRef = ExtendedDataClass_5ecd55b9
        DemFreezeFrameClassRef = FreezeFrameClass_dc4c3f47
        DemEventClass:  # Diagnostics Data Import
          DemAgingAllowed = true
          DemAgingCycleCounterThreshold = 40
          DemEventDestination = DEM_DTC_ORIGIN_PRIMARY_MEMORY
          DemEventPriority = 1
          DemEventFailureCycleCounterThreshold = 0
          DemAgingCycleRef = PowerCycle
          DemEnableConditionGroupRef = EnableConditionGroup_06a6aa19
          DemOperationCycleRef = PowerCycle
          IndicatorAttribute_WarningIndicator (DemIndicatorAttribute): DemIndicatorFailureCycleSource=DEM_FAILURE_CYCLE_EVENT, DemIndicatorHealingCycleRef=PowerCycle, DemIndicatorRef=WarningIndicator  # Diagnostics Data Import
          DemDebounceAlgorithmClass  # Diagnostics Data Import
            DemDebounceCounterBased: DemDebounceCounterDecrementStepSize=128, DemDebounceCounterIncrementStepSize=127, DemDebounceCounterJumpDown=true, DemDebounceCounterJumpUp=true  # Diagnostics Data Import
      DTCClass_PS_BLDC_OV_FLT (DemDTCClass): DemDTCSeverity=DEM_DTC_SEV_IMMEDIATELY, DemUdsDTC=1058583  # Diagnostics Data Import
      PS_BLDC_UV_FLT (DemEventParameter):  # Diagnostics Data Import
        DemEventKind = DEM_EVENT_KIND_SWC
        DemMaxNumberFreezeFrameRecords = 2
        DemDTCClassRef = DTCClass_PS_BLDC_UV_FLT
        DemExtendedDataClassRef = ExtendedDataClass_5ecd55b9
        DemFreezeFrameClassRef = FreezeFrameClass_dc4c3f47
        DemEventClass:  # Diagnostics Data Import
          DemAgingAllowed = true
          DemAgingCycleCounterThreshold = 40
          DemEventDestination = DEM_DTC_ORIGIN_PRIMARY_MEMORY
          DemEventPriority = 1
          DemEventFailureCycleCounterThreshold = 0
          DemAgingCycleRef = PowerCycle
          DemEnableConditionGroupRef = EnableConditionGroup_06a6aa19
          DemOperationCycleRef = PowerCycle
          IndicatorAttribute_WarningIndicator (DemIndicatorAttribute): DemIndicatorFailureCycleSource=DEM_FAILURE_CYCLE_EVENT, DemIndicatorHealingCycleRef=PowerCycle, DemIndicatorRef=WarningIndicator  # Diagnostics Data Import
          DemDebounceAlgorithmClass  # Diagnostics Data Import
            DemDebounceCounterBased: DemDebounceCounterDecrementStepSize=128, DemDebounceCounterIncrementStepSize=127, DemDebounceCounterJumpDown=true, DemDebounceCounterJumpUp=true  # Diagnostics Data Import
      DTCClass_PS_BLDC_UV_FLT (DemDTCClass): DemDTCSeverity=DEM_DTC_SEV_IMMEDIATELY, DemUdsDTC=1058582  # Diagnostics Data Import
      INV_RSLVR_EXCT_OC_HWP_002 (DemEventParameter):  # Diagnostics Data Import
        DemEventKind = DEM_EVENT_KIND_SWC
        DemMaxNumberFreezeFrameRecords = 2
        DemDTCClassRef = DTCClass_INV_RSLVR_EXCT_OC_HWP_002
        DemExtendedDataClassRef = ExtendedDataClass_5ecd55b9
        DemFreezeFrameClassRef = FreezeFrameClass_c3111450
        DemEventClass:  # Diagnostics Data Import
          DemAgingAllowed = true
          DemAgingCycleCounterThreshold = 40
          DemEventDestination = DEM_DTC_ORIGIN_PRIMARY_MEMORY
          DemEventPriority = 1
          DemEventFailureCycleCounterThreshold = 0
          DemAgingCycleRef = PowerCycle
          DemEnableConditionGroupRef = EnableConditionGroup_830522f7
          DemOperationCycleRef = PowerCycle
          IndicatorAttribute_WarningIndicator (DemIndicatorAttribute): DemIndicatorFailureCycleSource=DEM_FAILURE_CYCLE_EVENT, DemIndicatorHealingCycleRef=PowerCycle, DemIndicatorRef=WarningIndicator  # Diagnostics Data Import
          DemDebounceAlgorithmClass  # Diagnostics Data Import
            DemDebounceCounterBased: DemDebounceCounterDecrementStepSize=128, DemDebounceCounterIncrementStepSize=127, DemDebounceCounterJumpDown=true, DemDebounceCounterJumpUp=true  # Diagnostics Data Import
      DTCClass_INV_RSLVR_EXCT_OC_HWP_002 (DemDTCClass): DemDTCSeverity=DEM_DTC_SEV_MAINTENANCE_ONLY, DemUdsDTC=1057305  # Diagnostics Data Import
      INV_RSLVR_SIN_COS_PLAUS_AMP (DemEventParameter):  # Diagnostics Data Import
        DemEventKind = DEM_EVENT_KIND_SWC
        DemMaxNumberFreezeFrameRecords = 2
        DemDTCClassRef = DTCClass_INV_RSLVR_SIN_COS_PLAUS_AMP
        DemExtendedDataClassRef = ExtendedDataClass_5ecd55b9
        DemFreezeFrameClassRef = FreezeFrameClass_c3111450
        DemEventClass:  # Diagnostics Data Import
          DemAgingAllowed = true
          DemAgingCycleCounterThreshold = 40
          DemEventDestination = DEM_DTC_ORIGIN_PRIMARY_MEMORY
          DemEventPriority = 1
          DemEventFailureCycleCounterThreshold = 0
          DemAgingCycleRef = PowerCycle
          DemEnableConditionGroupRef = EnableConditionGroup_830522f7
          DemOperationCycleRef = PowerCycle
          IndicatorAttribute_WarningIndicator (DemIndicatorAttribute): DemIndicatorFailureCycleSource=DEM_FAILURE_CYCLE_EVENT, DemIndicatorHealingCycleRef=PowerCycle, DemIndicatorRef=WarningIndicator  # Diagnostics Data Import
          DemDebounceAlgorithmClass  # Diagnostics Data Import
            DemDebounceCounterBased: DemDebounceCounterDecrementStepSize=128, DemDebounceCounterIncrementStepSize=127, DemDebounceCounterJumpDown=true, DemDebounceCounterJumpUp=true  # Diagnostics Data Import
      DTCClass_INV_RSLVR_SIN_COS_PLAUS_AMP (DemDTCClass): DemDTCSeverity=DEM_DTC_SEV_MAINTENANCE_ONLY, DemUdsDTC=1057122  # Diagnostics Data Import
      INV_RSLVR_SIN_COS_PLAUS (DemEventParameter):  # Diagnostics Data Import
        DemEventKind = DEM_EVENT_KIND_SWC
        DemMaxNumberFreezeFrameRecords = 2
        DemDTCClassRef = DTCClass_INV_RSLVR_SIN_COS_PLAUS
        DemExtendedDataClassRef = ExtendedDataClass_5ecd55b9
        DemFreezeFrameClassRef = FreezeFrameClass_c3111450
        DemEventClass:  # Diagnostics Data Import
          DemAgingAllowed = true
          DemAgingCycleCounterThreshold = 40
          DemEventDestination = DEM_DTC_ORIGIN_PRIMARY_MEMORY
          DemEventPriority = 1
          DemEventFailureCycleCounterThreshold = 0
          DemAgingCycleRef = PowerCycle
          DemEnableConditionGroupRef = EnableConditionGroup_1027fc3a
          DemOperationCycleRef = PowerCycle
          IndicatorAttribute_WarningIndicator (DemIndicatorAttribute): DemIndicatorFailureCycleSource=DEM_FAILURE_CYCLE_EVENT, DemIndicatorHealingCycleRef=PowerCycle, DemIndicatorRef=WarningIndicator  # Diagnostics Data Import
          DemDebounceAlgorithmClass  # Diagnostics Data Import
            DemDebounceCounterBased: DemDebounceCounterDecrementStepSize=128, DemDebounceCounterIncrementStepSize=127, DemDebounceCounterJumpDown=true, DemDebounceCounterJumpUp=true  # Diagnostics Data Import
      DTCClass_INV_RSLVR_SIN_COS_PLAUS (DemDTCClass): DemDTCSeverity=DEM_DTC_SEV_IMMEDIATELY, DemUdsDTC=1057121  # Diagnostics Data Import
      INV_RSLVR_HW_FLT (DemEventParameter):  # Diagnostics Data Import
        DemEventKind = DEM_EVENT_KIND_SWC
        DemMaxNumberFreezeFrameRecords = 2
        DemDTCClassRef = DTCClass_INV_RSLVR_HW_FLT
        DemExtendedDataClassRef = ExtendedDataClass_5ecd55b9
        DemFreezeFrameClassRef = FreezeFrameClass_c3111450
        DemEventClass:  # Diagnostics Data Import
          DemAgingAllowed = true
          DemAgingCycleCounterThreshold = 40
          DemEventDestination = DEM_DTC_ORIGIN_PRIMARY_MEMORY
          DemEventPriority = 1
          DemEventFailureCycleCounterThreshold = 0
          DemAgingCycleRef = PowerCycle
          DemEnableConditionGroupRef = EnableConditionGroup_830522f7
          DemOperationCycleRef = PowerCycle
          IndicatorAttribute_WarningIndicator (DemIndicatorAttribute): DemIndicatorFailureCycleSource=DEM_FAILURE_CYCLE_EVENT, DemIndicatorHealingCycleRef=PowerCycle, DemIndicatorRef=WarningIndicator  # Diagnostics Data Import
          DemDebounceAlgorithmClass  # Diagnostics Data Import
            DemDebounceCounterBased: DemDebounceCounterDecrementStepSize=128, DemDebounceCounterIncrementStepSize=127, DemDebounceCounterJumpDown=true, DemDebounceCounterJumpUp=true  # Diagnostics Data Import
      DTCClass_INV_RSLVR_HW_FLT (DemDTCClass): DemDTCSeverity=DEM_DTC_SEV_MAINTENANCE_ONLY, DemUdsDTC=1057028  # Diagnostics Data Import
      INV_EM_OVRSPD_HWP (DemEventParameter):  # Diagnostics Data Import
        DemEventKind = DEM_EVENT_KIND_SWC
        DemMaxNumberFreezeFrameRecords = 2
        DemDTCClassRef = DTCClass_INV_EM_OVRSPD_HWP
        DemExtendedDataClassRef = ExtendedDataClass_5ecd55b9
        DemFreezeFrameClassRef = FreezeFrameClass_c3111450
        DemEventClass:  # Diagnostics Data Import
          DemAgingAllowed = true
          DemAgingCycleCounterThreshold = 40
          DemEventDestination = DEM_DTC_ORIGIN_PRIMARY_MEMORY
          DemEventPriority = 2
          DemEventFailureCycleCounterThreshold = 0
          DemAgingCycleRef = PowerCycle
          DemEnableConditionGroupRef = EnableConditionGroup_830522f7
          DemOperationCycleRef = PowerCycle
          IndicatorAttribute_WarningIndicator (DemIndicatorAttribute): DemIndicatorFailureCycleSource=DEM_FAILURE_CYCLE_EVENT, DemIndicatorHealingCycleRef=PowerCycle, DemIndicatorRef=WarningIndicator  # Diagnostics Data Import
          DemDebounceAlgorithmClass  # Diagnostics Data Import
            DemDebounceCounterBased: DemDebounceCounterDecrementStepSize=128, DemDebounceCounterIncrementStepSize=127, DemDebounceCounterJumpDown=true, DemDebounceCounterJumpUp=true  # Diagnostics Data Import
      DTCClass_INV_EM_OVRSPD_HWP (DemDTCClass): DemDTCSeverity=DEM_DTC_SEV_MAINTENANCE_ONLY, DemUdsDTC=1056768  # Diagnostics Data Import
      INV_RSLVR_EXCT_OC_HWP_001 (DemEventParameter):  # Diagnostics Data Import
        DemEventKind = DEM_EVENT_KIND_SWC
        DemMaxNumberFreezeFrameRecords = 2
        DemDTCClassRef = DTCClass_INV_RSLVR_EXCT_OC_HWP_001
        DemExtendedDataClassRef = ExtendedDataClass_5ecd55b9
        DemFreezeFrameClassRef = FreezeFrameClass_c3111450
        DemEventClass:  # Diagnostics Data Import
          DemAgingAllowed = true
          DemAgingCycleCounterThreshold = 40
          DemEventDestination = DEM_DTC_ORIGIN_PRIMARY_MEMORY
          DemEventPriority = 1
          DemEventFailureCycleCounterThreshold = 0
          DemAgingCycleRef = PowerCycle
          DemEnableConditionGroupRef = EnableConditionGroup_830522f7
          DemOperationCycleRef = PowerCycle
          IndicatorAttribute_WarningIndicator (DemIndicatorAttribute): DemIndicatorFailureCycleSource=DEM_FAILURE_CYCLE_EVENT, DemIndicatorHealingCycleRef=PowerCycle, DemIndicatorRef=WarningIndicator  # Diagnostics Data Import
          DemDebounceAlgorithmClass  # Diagnostics Data Import
            DemDebounceCounterBased: DemDebounceCounterDecrementStepSize=128, DemDebounceCounterIncrementStepSize=127, DemDebounceCounterJumpDown=true, DemDebounceCounterJumpUp=true  # Diagnostics Data Import
      DTCClass_INV_RSLVR_EXCT_OC_HWP_001 (DemDTCClass): DemDTCSeverity=DEM_DTC_SEV_MAINTENANCE_ONLY, DemUdsDTC=1056587  # Diagnostics Data Import
      INV_IGBT_TEMP_HWP (DemEventParameter):  # Diagnostics Data Import
        DemEventKind = DEM_EVENT_KIND_SWC
        DemMaxNumberFreezeFrameRecords = 2
        DemDTCClassRef = DTCClass_INV_IGBT_TEMP_HWP
        DemExtendedDataClassRef = ExtendedDataClass_5ecd55b9
        DemFreezeFrameClassRef = FreezeFrameClass_c3111450
        DemEventClass:  # Diagnostics Data Import
          DemAgingAllowed = true
          DemAgingCycleCounterThreshold = 40
          DemEventDestination = DEM_DTC_ORIGIN_PRIMARY_MEMORY
          DemEventPriority = 2
          DemEventFailureCycleCounterThreshold = 0
          DemAgingCycleRef = PowerCycle
          DemEnableConditionGroupRef = EnableConditionGroup_4c1ef766
          DemOperationCycleRef = PowerCycle
          IndicatorAttribute_WarningIndicator (DemIndicatorAttribute): DemIndicatorFailureCycleSource=DEM_FAILURE_CYCLE_EVENT, DemIndicatorHealingCycleRef=PowerCycle, DemIndicatorRef=WarningIndicator  # Diagnostics Data Import
          DemDebounceAlgorithmClass  # Diagnostics Data Import
            DemDebounceCounterBased: DemDebounceCounterDecrementStepSize=128, DemDebounceCounterIncrementStepSize=127, DemDebounceCounterJumpDown=true, DemDebounceCounterJumpUp=true  # Diagnostics Data Import
      DTCClass_INV_IGBT_TEMP_HWP (DemDTCClass): DemDTCSeverity=DEM_DTC_SEV_MAINTENANCE_ONLY, DemUdsDTC=1056512  # Diagnostics Data Import
      CU_TEMP_HWP (DemEventParameter):  # Diagnostics Data Import
        DemEventKind = DEM_EVENT_KIND_SWC
        DemMaxNumberFreezeFrameRecords = 2
        DemDTCClassRef = DTCClass_CU_TEMP_HWP
        DemExtendedDataClassRef = ExtendedDataClass_5ecd55b9
        DemFreezeFrameClassRef = FreezeFrameClass_c3111450
        DemEventClass:  # Diagnostics Data Import
          DemAgingAllowed = true
          DemAgingCycleCounterThreshold = 40
          DemEventDestination = DEM_DTC_ORIGIN_PRIMARY_MEMORY
          DemEventPriority = 1
          DemEventFailureCycleCounterThreshold = 0
          DemAgingCycleRef = PowerCycle
          DemEnableConditionGroupRef = EnableConditionGroup_87177a06
          DemOperationCycleRef = PowerCycle
          IndicatorAttribute_WarningIndicator (DemIndicatorAttribute): DemIndicatorFailureCycleSource=DEM_FAILURE_CYCLE_EVENT, DemIndicatorHealingCycleRef=PowerCycle, DemIndicatorRef=WarningIndicator  # Diagnostics Data Import
          DemDebounceAlgorithmClass  # Diagnostics Data Import
            DemDebounceCounterBased: DemDebounceCounterDecrementStepSize=128, DemDebounceCounterIncrementStepSize=127, DemDebounceCounterJumpDown=true, DemDebounceCounterJumpUp=true  # Diagnostics Data Import
      DTCClass_CU_TEMP_HWP (DemDTCClass): DemDTCSeverity=DEM_DTC_SEV_MAINTENANCE_ONLY, DemUdsDTC=1056000  # Diagnostics Data Import
      CU_TEMP_HW_FLT_001 (DemEventParameter):  # Diagnostics Data Import
        DemEventKind = DEM_EVENT_KIND_SWC
        DemMaxNumberFreezeFrameRecords = 2
        DemDTCClassRef = DTCClass_CU_TEMP_HW_FLT_001
        DemExtendedDataClassRef = ExtendedDataClass_5ecd55b9
        DemFreezeFrameClassRef = FreezeFrameClass_c3111450
        DemEventClass:  # Diagnostics Data Import
          DemAgingAllowed = true
          DemAgingCycleCounterThreshold = 40
          DemEventDestination = DEM_DTC_ORIGIN_PRIMARY_MEMORY
          DemEventPriority = 2
          DemEventFailureCycleCounterThreshold = 0
          DemAgingCycleRef = PowerCycle
          DemOperationCycleRef = PowerCycle
          IndicatorAttribute_WarningIndicator (DemIndicatorAttribute): DemIndicatorFailureCycleSource=DEM_FAILURE_CYCLE_EVENT, DemIndicatorHealingCycleRef=PowerCycle, DemIndicatorRef=WarningIndicator  # Diagnostics Data Import
          DemDebounceAlgorithmClass  # Diagnostics Data Import
            DemDebounceCounterBased: DemDebounceCounterDecrementStepSize=128, DemDebounceCounterIncrementStepSize=127, DemDebounceCounterJumpDown=true, DemDebounceCounterJumpUp=true  # Diagnostics Data Import
      DTCClass_CU_TEMP_HW_FLT_001 (DemDTCClass): DemDTCSeverity=DEM_DTC_SEV_IMMEDIATELY, DemUdsDTC=1055896  # Diagnostics Data Import
      CU_TEMP_HW_FLT (DemEventParameter):  # Diagnostics Data Import
        DemEventKind = DEM_EVENT_KIND_SWC
        DemMaxNumberFreezeFrameRecords = 2
        DemDTCClassRef = DTCClass_CU_TEMP_HW_FLT
        DemExtendedDataClassRef = ExtendedDataClass_5ecd55b9
        DemFreezeFrameClassRef = FreezeFrameClass_c3111450
        DemEventClass:  # Diagnostics Data Import
          DemAgingAllowed = true
          DemAgingCycleCounterThreshold = 40
          DemEventDestination = DEM_DTC_ORIGIN_PRIMARY_MEMORY
          DemEventPriority = 1
          DemEventFailureCycleCounterThreshold = 0
          DemAgingCycleRef = PowerCycle
          DemEnableConditionGroupRef = EnableConditionGroup_57b85250
          DemOperationCycleRef = PowerCycle
          IndicatorAttribute_WarningIndicator (DemIndicatorAttribute): DemIndicatorFailureCycleSource=DEM_FAILURE_CYCLE_EVENT, DemIndicatorHealingCycleRef=PowerCycle, DemIndicatorRef=WarningIndicator  # Diagnostics Data Import
          DemDebounceAlgorithmClass  # Diagnostics Data Import
            DemDebounceCounterBased: DemDebounceCounterDecrementStepSize=128, DemDebounceCounterIncrementStepSize=127, DemDebounceCounterJumpDown=true, DemDebounceCounterJumpUp=true  # Diagnostics Data Import
      DTCClass_CU_TEMP_HW_FLT (DemDTCClass): DemDTCSeverity=DEM_DTC_SEV_MAINTENANCE_ONLY, DemUdsDTC=1055894  # Diagnostics Data Import
      CU_TEMP_GRDT (DemEventParameter):  # Diagnostics Data Import
        DemEventKind = DEM_EVENT_KIND_SWC
        DemMaxNumberFreezeFrameRecords = 2
        DemDTCClassRef = DTCClass_CU_TEMP_GRDT
        DemExtendedDataClassRef = ExtendedDataClass_5ecd55b9
        DemFreezeFrameClassRef = FreezeFrameClass_c3111450
        DemEventClass:  # Diagnostics Data Import
          DemAgingAllowed = true
          DemAgingCycleCounterThreshold = 40
          DemEventDestination = DEM_DTC_ORIGIN_PRIMARY_MEMORY
          DemEventPriority = 1
          DemEventFailureCycleCounterThreshold = 0
          DemAgingCycleRef = PowerCycle
          DemEnableConditionGroupRef = EnableConditionGroup_f2368ecb
          DemOperationCycleRef = PowerCycle
          IndicatorAttribute_WarningIndicator (DemIndicatorAttribute): DemIndicatorFailureCycleSource=DEM_FAILURE_CYCLE_EVENT, DemIndicatorHealingCycleRef=PowerCycle, DemIndicatorRef=WarningIndicator  # Diagnostics Data Import
          DemDebounceAlgorithmClass  # Diagnostics Data Import
            DemDebounceCounterBased: DemDebounceCounterDecrementStepSize=128, DemDebounceCounterIncrementStepSize=127, DemDebounceCounterJumpDown=true, DemDebounceCounterJumpUp=true  # Diagnostics Data Import
      DTCClass_CU_TEMP_GRDT (DemDTCClass): DemDTCSeverity=DEM_DTC_SEV_MAINTENANCE_ONLY, DemUdsDTC=1055783  # Diagnostics Data Import
      INV_CU_TEMP1_RNG_NOK (DemEventParameter):  # Diagnostics Data Import
        DemEventKind = DEM_EVENT_KIND_SWC
        DemMaxNumberFreezeFrameRecords = 2
        DemDTCClassRef = DTCClass_INV_CU_TEMP1_RNG_NOK
        DemExtendedDataClassRef = ExtendedDataClass_5ecd55b9
        DemFreezeFrameClassRef = FreezeFrameClass_c3111450
        DemEventClass:  # Diagnostics Data Import
          DemAgingAllowed = true
          DemAgingCycleCounterThreshold = 40
          DemEventDestination = DEM_DTC_ORIGIN_PRIMARY_MEMORY
          DemEventPriority = 1
          DemEventFailureCycleCounterThreshold = 0
          DemAgingCycleRef = PowerCycle
          DemOperationCycleRef = PowerCycle
          IndicatorAttribute_WarningIndicator (DemIndicatorAttribute): DemIndicatorFailureCycleSource=DEM_FAILURE_CYCLE_EVENT, DemIndicatorHealingCycleRef=PowerCycle, DemIndicatorRef=WarningIndicator  # Diagnostics Data Import
          DemDebounceAlgorithmClass  # Diagnostics Data Import
            DemDebounceCounterBased: DemDebounceCounterDecrementStepSize=128, DemDebounceCounterIncrementStepSize=127, DemDebounceCounterJumpDown=true, DemDebounceCounterJumpUp=true  # Diagnostics Data Import
      DTCClass_INV_CU_TEMP1_RNG_NOK (DemDTCClass): DemDTCSeverity=DEM_DTC_SEV_IMMEDIATELY, DemUdsDTC=1055772  # Diagnostics Data Import
      CU_TEMP1_RNG_LO (DemEventParameter):  # Diagnostics Data Import
        DemEventKind = DEM_EVENT_KIND_SWC
        DemMaxNumberFreezeFrameRecords = 2
        DemDTCClassRef = DTCClass_CU_TEMP1_RNG_LO
        DemExtendedDataClassRef = ExtendedDataClass_5ecd55b9
        DemFreezeFrameClassRef = FreezeFrameClass_c3111450
        DemEventClass:  # Diagnostics Data Import
          DemAgingAllowed = true
          DemAgingCycleCounterThreshold = 40
          DemEventDestination = DEM_DTC_ORIGIN_PRIMARY_MEMORY
          DemEventPriority = 1
          DemEventFailureCycleCounterThreshold = 0
          DemAgingCycleRef = PowerCycle
          DemEnableConditionGroupRef = EnableConditionGroup_7ab46a93
          DemOperationCycleRef = PowerCycle
          IndicatorAttribute_WarningIndicator (DemIndicatorAttribute): DemIndicatorFailureCycleSource=DEM_FAILURE_CYCLE_EVENT, DemIndicatorHealingCycleRef=PowerCycle, DemIndicatorRef=WarningIndicator  # Diagnostics Data Import
          DemDebounceAlgorithmClass  # Diagnostics Data Import
            DemDebounceCounterBased: DemDebounceCounterDecrementStepSize=128, DemDebounceCounterIncrementStepSize=127, DemDebounceCounterJumpDown=true, DemDebounceCounterJumpUp=true  # Diagnostics Data Import
      DTCClass_CU_TEMP1_RNG_LO (DemDTCClass): DemDTCSeverity=DEM_DTC_SEV_MAINTENANCE_ONLY, DemUdsDTC=1055762  # Diagnostics Data Import
      CU_TEMP1_RNG_HI (DemEventParameter):  # Diagnostics Data Import
        DemEventKind = DEM_EVENT_KIND_SWC
        DemMaxNumberFreezeFrameRecords = 2
        DemDTCClassRef = DTCClass_CU_TEMP1_RNG_HI
        DemExtendedDataClassRef = ExtendedDataClass_5ecd55b9
        DemFreezeFrameClassRef = FreezeFrameClass_c3111450
        DemEventClass:  # Diagnostics Data Import
          DemAgingAllowed = true
          DemAgingCycleCounterThreshold = 40
          DemEventDestination = DEM_DTC_ORIGIN_PRIMARY_MEMORY
          DemEventPriority = 1
          DemEventFailureCycleCounterThreshold = 0
          DemAgingCycleRef = PowerCycle
          DemEnableConditionGroupRef = EnableConditionGroup_7ab46a93
          DemOperationCycleRef = PowerCycle
          IndicatorAttribute_WarningIndicator (DemIndicatorAttribute): DemIndicatorFailureCycleSource=DEM_FAILURE_CYCLE_EVENT, DemIndicatorHealingCycleRef=PowerCycle, DemIndicatorRef=WarningIndicator  # Diagnostics Data Import
          DemDebounceAlgorithmClass  # Diagnostics Data Import
            DemDebounceCounterBased: DemDebounceCounterDecrementStepSize=128, DemDebounceCounterIncrementStepSize=127, DemDebounceCounterJumpDown=true, DemDebounceCounterJumpUp=true  # Diagnostics Data Import
      DTCClass_CU_TEMP1_RNG_HI (DemDTCClass): DemDTCSeverity=DEM_DTC_SEV_MAINTENANCE_ONLY, DemUdsDTC=1055761  # Diagnostics Data Import
      INV_EM_STATOR_TEMP_HWP (DemEventParameter):  # Diagnostics Data Import
        DemEventKind = DEM_EVENT_KIND_SWC
        DemMaxNumberFreezeFrameRecords = 2
        DemDTCClassRef = DTCClass_INV_EM_STATOR_TEMP_HWP
        DemExtendedDataClassRef = ExtendedDataClass_5ecd55b9
        DemFreezeFrameClassRef = FreezeFrameClass_c3111450
        DemEventClass:  # Diagnostics Data Import
          DemAgingAllowed = true
          DemAgingCycleCounterThreshold = 40
          DemEventDestination = DEM_DTC_ORIGIN_PRIMARY_MEMORY
          DemEventPriority = 2
          DemEventFailureCycleCounterThreshold = 0
          DemAgingCycleRef = PowerCycle
          DemEnableConditionGroupRef = EnableConditionGroup_d13c1487
          DemOperationCycleRef = PowerCycle
          IndicatorAttribute_WarningIndicator (DemIndicatorAttribute): DemIndicatorFailureCycleSource=DEM_FAILURE_CYCLE_EVENT, DemIndicatorHealingCycleRef=PowerCycle, DemIndicatorRef=WarningIndicator  # Diagnostics Data Import
          DemDebounceAlgorithmClass  # Diagnostics Data Import
            DemDebounceCounterBased: DemDebounceCounterDecrementStepSize=128, DemDebounceCounterIncrementStepSize=127, DemDebounceCounterJumpDown=true, DemDebounceCounterJumpUp=true  # Diagnostics Data Import
      DTCClass_INV_EM_STATOR_TEMP_HWP (DemDTCClass): DemDTCSeverity=DEM_DTC_SEV_MAINTENANCE_ONLY, DemUdsDTC=1055488  # Diagnostics Data Import

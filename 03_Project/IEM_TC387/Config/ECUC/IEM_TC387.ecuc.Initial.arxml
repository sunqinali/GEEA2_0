[part 2 of 5: package /InitialEcuC]
AUTOSAR XML (schema 4-2-2)
package /InitialEcuC  (continued)
  module config Dcm  (continued)
    DcmConfigSet  (continued)
      DcmDsp: DcmDspMaxDidToRead=5  (continued)
        96 x DcmDspDid:
          DID_F1AF_ECU_Software_Extended_Part_Numbers_Geely: DcmDspDidIdentifier=61871, DcmDspDidInfoRef=DidInfo_DID_F1AF_ECU_Software_Extended_Part_Numbers_Geely  # Diagnostics Data Import
            9 x DcmDspDidSignal:
              ASCII_part_003: DcmDspDidDataPos=240, DcmDspDidDataRef=DID_F1AF_ECU_Software_Extended_Part_Numbers_Geely_ASCII_part_003  # Diagnostics Data Import
              BCD_part_003: DcmDspDidDataPos=200, DcmDspDidDataRef=DID_F1AF_ECU_Software_Extended_Part_Numbers_Geely_BCD_part_003  # Diagnostics Data Import
              ASCII_part_002: DcmDspDidDataPos=176, DcmDspDidDataRef=DID_F1AF_ECU_Software_Extended_Part_Numbers_Geely_ASCII_part_002  # Diagnostics Data Import
              BCD_part_002: DcmDspDidDataPos=136, DcmDspDidDataRef=DID_F1AF_ECU_Software_Extended_Part_Numbers_Geely_BCD_part_002  # Diagnostics Data Import
              ASCII_part_001: DcmDspDidDataPos=112, DcmDspDidDataRef=DID_F1AF_ECU_Software_Extended_Part_Numbers_Geely_ASCII_part_001  # Diagnostics Data Import
              BCD_part_001: DcmDspDidDataPos=72, DcmDspDidDataRef=DID_F1AF_ECU_Software_Extended_Part_Numbers_Geely_BCD_part_001  # Diagnostics Data Import
              ASCII_part: DcmDspDidDataPos=48, DcmDspDidDataRef=DID_F1AF_ECU_Software_Extended_Part_Numbers_Geely_ASCII_part  # Diagnostics Data Import
              BCD_part: DcmDspDidDataPos=8, DcmDspDidDataRef=DID_F1AF_ECU_Software_Extended_Part_Numbers_Geely_BCD_part  # Diagnostics Data Import
              DID_F1AF_1_Total_number_of_ECU_Software_Part_Numbers: DcmDspDidDataPos=0, DcmDspDidDataRef=DID_F1AF_ECU_Software_Extended_Part_Numbers_Geely_DID_F1AF_1_Total_number_of_ECU_Software_Part_Numbers  # Diagnostics Data Import
          DID_F1AE_ECU_Software_Part_Numbers_Geely: DcmDspDidIdentifier=61870, DcmDspDidInfoRef=DidInfo_DID_F1AE_ECU_Software_Part_Numbers_Geely  # Diagnostics Data Import
            3 x DcmDspDidSignal:
              ASCII_part: DcmDspDidDataPos=48, DcmDspDidDataRef=DID_F1AE_ECU_Software_Part_Numbers_Geely_ASCII_part  # Diagnostics Data Import
              BCD_part: DcmDspDidDataPos=8, DcmDspDidDataRef=DID_F1AE_ECU_Software_Part_Numbers_Geely_BCD_part  # Diagnostics Data Import
              DID_F1AE_1_Total_number_of_ECU_Software_Part_Numbers: DcmDspDidDataPos=0, DcmDspDidDataRef=DID_F1AE_ECU_Software_Part_Numbers_Geely_DID_F1AE_1_Total_number_of_ECU_Software_Part_Numbers  # Diagnostics Data Import
          DID_F1AB_ECU_Delivery_Assembly_Part_Number_Geely: DcmDspDidIdentifier=61867, DcmDspDidInfoRef=DidInfo_DID_F1AB_ECU_Delivery_Assembly_Part_Number_Geely  # Diagnostics Data Import
            ASCII_part (DcmDspDidSignal): DcmDspDidDataPos=40, DcmDspDidDataRef=DID_F1AB_ECU_Delivery_Assembly_Part_Number_Geely_ASCII_part  # Diagnostics Data Import
            BCD_part (DcmDspDidSignal): DcmDspDidDataPos=0, DcmDspDidDataRef=DID_F1AB_ECU_Delivery_Assembly_Part_Number_Geely_BCD_part  # Diagnostics Data Import
          DID_F1AA_ECU_Core_Assembly_Part_Number_Geely: DcmDspDidIdentifier=61866, DcmDspDidInfoRef=DidInfo_DID_F1AA_ECU_Core_Assembly_Part_Number_Geely  # Diagnostics Data Import
            ASCII_part (DcmDspDidSignal): DcmDspDidDataPos=40, DcmDspDidDataRef=DID_F1AA_ECU_Core_Assembly_Part_Number_Geely_ASCII_part  # Diagnostics Data Import
            BCD_part (DcmDspDidSignal): DcmDspDidDataPos=0, DcmDspDidDataRef=DID_F1AA_ECU_Core_Assembly_Part_Number_Geely_BCD_part  # Diagnostics Data Import
          DID_F1A5_Primary_Bootloader_Software_Part_Number_Geely: DcmDspDidIdentifier=61861, DcmDspDidInfoRef=DidInfo_DID_F1A5_Primary_Bootloader_Software_Part_Number_Geely  # Diagnostics Data Import
            ASCII_part (DcmDspDidSignal): DcmDspDidDataPos=40, DcmDspDidDataRef=DID_F1A5_Primary_Bootloader_Software_Part_Number_Geely_ASCII_part  # Diagnostics Data Import
            BCD_part (DcmDspDidSignal): DcmDspDidDataPos=0, DcmDspDidDataRef=DID_F1A5_Primary_Bootloader_Software_Part_Number_Geely_BCD_part  # Diagnostics Data Import
          DID_F1A1_Primary_Bootloader_Diagnostic_Database_Part_Number_Geely: DcmDspDidIdentifier=61857, DcmDspDidInfoRef=DidInfo_DID_F1A1_Primary_Bootloader_Diagnostic_Database_Part_Number_Geely  # Diagnostics Data Import
            ASCII_part (DcmDspDidSignal): DcmDspDidDataPos=40, DcmDspDidDataRef=DID_F1A1_Primary_Bootloader_Diagnostic_Database_Part_Number_Geely_ASCII_part  # Diagnostics Data Import
            BCD_part (DcmDspDidSignal): DcmDspDidDataPos=0, DcmDspDidDataRef=DID_F1A1_Primary_Bootloader_Diagnostic_Database_Part_Number_Geely_BCD_part  # Diagnostics Data Import
          DID_F1A0_Application_Diagnostic_Database_Part_Number_Geely: DcmDspDidIdentifier=61856, DcmDspDidInfoRef=DidInfo_DID_F1A0_Application_Diagnostic_Database_Part_Number_Geely  # Diagnostics Data Import
            ASCII_part (DcmDspDidSignal): DcmDspDidDataPos=40, DcmDspDidDataRef=DID_F1A0_Application_Diagnostic_Database_Part_Number_Geely_ASCII_part  # Diagnostics Data Import
            BCD_part (DcmDspDidSignal): DcmDspDidDataPos=0, DcmDspDidDataRef=DID_F1A0_Application_Diagnostic_Database_Part_Number_Geely_BCD_part  # Diagnostics Data Import
          DID_F18C_ECU_Serial_Number: DcmDspDidIdentifier=61836, DcmDspDidInfoRef=DidInfo_DID_F18C_ECU_Serial_Number  # Diagnostics Data Import
            DID_F18C_ECU_Serial_Number (DcmDspDidSignal): DcmDspDidDataPos=0, DcmDspDidDataRef=DID_F18C_ECU_Serial_Number_DID_F18C_ECU_Serial_Number  # Diagnostics Data Import
          DID_F186_Active_Diagnostic_Session: DcmDspDidIdentifier=61830, DcmDspDidInfoRef=DidInfo_DID_F186_Active_Diagnostic_Session  # Diagnostics Data Import
            DID_F186_Active_Diagnostic_Session (DcmDspDidSignal): DcmDspDidDataPos=0, DcmDspDidDataRef=DID_F186_Active_Diagnostic_Session_DID_F186_Active_Diagnostic_Session  # Diagnostics Data Import
          DID_F12F_ECU_Software_Extended_Part_Numbers: DcmDspDidIdentifier=61743, DcmDspDidInfoRef=DidInfo_DID_F12F_ECU_Software_Extended_Part_Numbers  # Diagnostics Data Import
            21 x DcmDspDidSignal:
              ASCII_part_009: DcmDspDidDataPos=544, DcmDspDidDataRef=DID_F12F_ECU_Software_Extended_Part_Numbers_ASCII_part_009  # Diagnostics Data Import
              BCD_part_009: DcmDspDidDataPos=512, DcmDspDidDataRef=DID_F12F_ECU_Software_Extended_Part_Numbers_BCD_part_009  # Diagnostics Data Import
              ASCII_part_008: DcmDspDidDataPos=488, DcmDspDidDataRef=DID_F12F_ECU_Software_Extended_Part_Numbers_ASCII_part_008  # Diagnostics Data Import
              BCD_part_008: DcmDspDidDataPos=456, DcmDspDidDataRef=DID_F12F_ECU_Software_Extended_Part_Numbers_BCD_part_008  # Diagnostics Data Import
              ASCII_part_007: DcmDspDidDataPos=432, DcmDspDidDataRef=DID_F12F_ECU_Software_Extended_Part_Numbers_ASCII_part_007  # Diagnostics Data Import
              BCD_part_007: DcmDspDidDataPos=400, DcmDspDidDataRef=DID_F12F_ECU_Software_Extended_Part_Numbers_BCD_part_007  # Diagnostics Data Import
              ASCII_part_006: DcmDspDidDataPos=376, DcmDspDidDataRef=DID_F12F_ECU_Software_Extended_Part_Numbers_ASCII_part_006  # Diagnostics Data Import
              BCD_part_006: DcmDspDidDataPos=344, DcmDspDidDataRef=DID_F12F_ECU_Software_Extended_Part_Numbers_BCD_part_006  # Diagnostics Data Import
              ASCII_part_005: DcmDspDidDataPos=320, DcmDspDidDataRef=DID_F12F_ECU_Software_Extended_Part_Numbers_ASCII_part_005  # Diagnostics Data Import
              BCD_part_005: DcmDspDidDataPos=288, DcmDspDidDataRef=DID_F12F_ECU_Software_Extended_Part_Numbers_BCD_part_005  # Diagnostics Data Import
              ASCII_part_004: DcmDspDidDataPos=264, DcmDspDidDataRef=DID_F12F_ECU_Software_Extended_Part_Numbers_ASCII_part_004  # Diagnostics Data Import
              BCD_part_004: DcmDspDidDataPos=232, DcmDspDidDataRef=DID_F12F_ECU_Software_Extended_Part_Numbers_BCD_part_004  # Diagnostics Data Import
              ASCII_part_003: DcmDspDidDataPos=208, DcmDspDidDataRef=DID_F12F_ECU_Software_Extended_Part_Numbers_ASCII_part_003  # Diagnostics Data Import
              BCD_part_003: DcmDspDidDataPos=176, DcmDspDidDataRef=DID_F12F_ECU_Software_Extended_Part_Numbers_BCD_part_003  # Diagnostics Data Import
              ASCII_part_002: DcmDspDidDataPos=152, DcmDspDidDataRef=DID_F12F_ECU_Software_Extended_Part_Numbers_ASCII_part_002  # Diagnostics Data Import
              BCD_part_002: DcmDspDidDataPos=120, DcmDspDidDataRef=DID_F12F_ECU_Software_Extended_Part_Numbers_BCD_part_002  # Diagnostics Data Import
              ASCII_part_001: DcmDspDidDataPos=96, DcmDspDidDataRef=DID_F12F_ECU_Software_Extended_Part_Numbers_ASCII_part_001  # Diagnostics Data Import
              BCD_part_001: DcmDspDidDataPos=64, DcmDspDidDataRef=DID_F12F_ECU_Software_Extended_Part_Numbers_BCD_part_001  # Diagnostics Data Import
              ASCII_part: DcmDspDidDataPos=40, DcmDspDidDataRef=DID_F12F_ECU_Software_Extended_Part_Numbers_ASCII_part  # Diagnostics Data Import
              BCD_part: DcmDspDidDataPos=8, DcmDspDidDataRef=DID_F12F_ECU_Software_Extended_Part_Numbers_BCD_part  # Diagnostics Data Import
              DID_F12F_1_Total_number_of_ECU_Software_Part_Numbers: DcmDspDidDataPos=0, DcmDspDidDataRef=DID_F12F_ECU_Software_Extended_Part_Numbers_DID_F12F_1_Total_number_of_ECU_Software_Part_Numbers  # Diagnostics Data Import
          DID_F12E_ECU_Software_Part_Numbers: DcmDspDidIdentifier=61742, DcmDspDidInfoRef=DidInfo_DID_F12E_ECU_Software_Part_Numbers  # Diagnostics Data Import
            3 x DcmDspDidSignal:
              ASCII_part: DcmDspDidDataPos=40, DcmDspDidDataRef=DID_F12E_ECU_Software_Part_Numbers_ASCII_part  # Diagnostics Data Import
              BCD_part: DcmDspDidDataPos=8, DcmDspDidDataRef=DID_F12E_ECU_Software_Part_Numbers_BCD_part  # Diagnostics Data Import
              DID_F12E_1_ECU_Software: DcmDspDidDataPos=0, DcmDspDidDataRef=DID_F12E_ECU_Software_Part_Numbers_DID_F12E_1_ECU_Software  # Diagnostics Data Import
          DID_F12B_ECU_Delivery_Assembly_Part_Number: DcmDspDidIdentifier=61739, DcmDspDidInfoRef=DidInfo_DID_F12B_ECU_Delivery_Assembly_Part_Number  # Diagnostics Data Import
            ASCII_part (DcmDspDidSignal): DcmDspDidDataPos=32, DcmDspDidDataRef=DID_F12B_ECU_Delivery_Assembly_Part_Number_ASCII_part  # Diagnostics Data Import
            BCD_part (DcmDspDidSignal): DcmDspDidDataPos=0, DcmDspDidDataRef=DID_F12B_ECU_Delivery_Assembly_Part_Number_BCD_part  # Diagnostics Data Import
          DID_F12A_ECU_Core_Assembly_Part_Number: DcmDspDidIdentifier=61738, DcmDspDidInfoRef=DidInfo_DID_F12A_ECU_Core_Assembly_Part_Number  # Diagnostics Data Import
            ASCII_part (DcmDspDidSignal): DcmDspDidDataPos=32, DcmDspDidDataRef=DID_F12A_ECU_Core_Assembly_Part_Number_ASCII_part  # Diagnostics Data Import
            BCD_part (DcmDspDidSignal): DcmDspDidDataPos=0, DcmDspDidDataRef=DID_F12A_ECU_Core_Assembly_Part_Number_BCD_part  # Diagnostics Data Import
          DID_F126_Autosar_BSW_Cluster_Versions: DcmDspDidIdentifier=61734, DcmDspDidInfoRef=DidInfo_DID_F126_Autosar_BSW_Cluster_Versions  # Diagnostics Data Import
            45 x DcmDspDidSignal:
              DID_F126_45_LIN_CLUSTER_AR_RELEASE_REVISION_VERSION: DcmDspDidDataPos=400, DcmDspDidDataRef=DID_F126_Autosar_BSW_Cluster_Versions_DID_F126_45_LIN_CLUSTER_AR_RELEASE_REVISION_VERSION  # Diagnostics Data Import
              DID_F126_44_LIN_CLUSTER_AR_RELEASE_MINOR_VERSION: DcmDspDidDataPos=392, DcmDspDidDataRef=DID_F126_Autosar_BSW_Cluster_Versions_DID_F126_44_LIN_CLUSTER_AR_RELEASE_MINOR_VERSION  # Diagnostics Data Import
              DID_F126_43_LIN_CLUSTER_AR_RELEASE_MAJOR_VERSION: DcmDspDidDataPos=384, DcmDspDidDataRef=DID_F126_Autosar_BSW_Cluster_Versions_DID_F126_43_LIN_CLUSTER_AR_RELEASE_MAJOR_VERSION  # Diagnostics Data Import
              DID_F126_42_LIN_CLUSTER_SW_PATCH_VERSION: DcmDspDidDataPos=376, DcmDspDidDataRef=DID_F126_Autosar_BSW_Cluster_Versions_DID_F126_42_LIN_CLUSTER_SW_PATCH_VERSION  # Diagnostics Data Import
              DID_F126_41_LIN_CLUSTER_SW_MINOR_VERSION: DcmDspDidDataPos=368, DcmDspDidDataRef=DID_F126_Autosar_BSW_Cluster_Versions_DID_F126_41_LIN_CLUSTER_SW_MINOR_VERSION  # Diagnostics Data Import
              DID_F126_40_LIN_CLUSTER_SW_MAJOR_VERSION: DcmDspDidDataPos=360, DcmDspDidDataRef=DID_F126_Autosar_BSW_Cluster_Versions_DID_F126_40_LIN_CLUSTER_SW_MAJOR_VERSION  # Diagnostics Data Import
              DID_F126_39_LIN_CLUSTER_VENDOR_ID: DcmDspDidDataPos=344, DcmDspDidDataRef=DID_F126_Autosar_BSW_Cluster_Versions_DID_F126_39_LIN_CLUSTER_VENDOR_ID  # Diagnostics Data Import
              DID_F126_38_FLEXRAY_CLUSTER_AR_RELEASE_REVISION_VERSION: DcmDspDidDataPos=336, DcmDspDidDataRef=DID_F126_Autosar_BSW_Cluster_Versions_DID_F126_38_FLEXRAY_CLUSTER_AR_RELEASE_REVISION_VERSION  # Diagnostics Data Import
              DID_F126_37_FLEXRAY_CLUSTER_AR_RELEASE_MINOR_VERSION: DcmDspDidDataPos=328, DcmDspDidDataRef=DID_F126_Autosar_BSW_Cluster_Versions_DID_F126_37_FLEXRAY_CLUSTER_AR_RELEASE_MINOR_VERSION  # Diagnostics Data Import
              DID_F126_36_FLEXRAY_CLUSTER_AR_RELEASE_MAJOR_VERSION: DcmDspDidDataPos=320, DcmDspDidDataRef=DID_F126_Autosar_BSW_Cluster_Versions_DID_F126_36_FLEXRAY_CLUSTER_AR_RELEASE_MAJOR_VERSION  # Diagnostics Data Import
              DID_F126_35_FLEXRAY_CLUSTER_SW_PATCH_VERSION: DcmDspDidDataPos=312, DcmDspDidDataRef=DID_F126_Autosar_BSW_Cluster_Versions_DID_F126_35_FLEXRAY_CLUSTER_SW_PATCH_VERSION  # Diagnostics Data Import
              DID_F126_34_FLEXRAY_CLUSTER_SW_MINOR_VERSION: DcmDspDidDataPos=304, DcmDspDidDataRef=DID_F126_Autosar_BSW_Cluster_Versions_DID_F126_34_FLEXRAY_CLUSTER_SW_MINOR_VERSION  # Diagnostics Data Import
              DID_F126_33_FLEXRAY_CLUSTER_SW_MAJOR_VERSION: DcmDspDidDataPos=296, DcmDspDidDataRef=DID_F126_Autosar_BSW_Cluster_Versions_DID_F126_33_FLEXRAY_CLUSTER_SW_MAJOR_VERSION  # Diagnostics Data Import
              DID_F126_32_FLEXRAY_CLUSTER_VENDOR_ID: DcmDspDidDataPos=280, DcmDspDidDataRef=DID_F126_Autosar_BSW_Cluster_Versions_DID_F126_32_FLEXRAY_CLUSTER_VENDOR_ID  # Diagnostics Data Import
              DID_F126_31_CAN_CLUSTER_AR_RELEASE_REVISION_VERSION: DcmDspDidDataPos=272, DcmDspDidDataRef=DID_F126_Autosar_BSW_Cluster_Versions_DID_F126_31_CAN_CLUSTER_AR_RELEASE_REVISION_VERSION  # Diagnostics Data Import
              DID_F126_30_CAN_CLUSTER_AR_RELEASE_MINOR_VERSION: DcmDspDidDataPos=264, DcmDspDidDataRef=DID_F126_Autosar_BSW_Cluster_Versions_DID_F126_30_CAN_CLUSTER_AR_RELEASE_MINOR_VERSION  # Diagnostics Data Import
              DID_F126_29_CAN_CLUSTER_AR_RELEASE_MAJOR_VERSION: DcmDspDidDataPos=256, DcmDspDidDataRef=DID_F126_Autosar_BSW_Cluster_Versions_DID_F126_29_CAN_CLUSTER_AR_RELEASE_MAJOR_VERSION  # Diagnostics Data Import
              DID_F126_28_CAN_CLUSTER_SW_PATCH_VERSION: DcmDspDidDataPos=248, DcmDspDidDataRef=DID_F126_Autosar_BSW_Cluster_Versions_DID_F126_28_CAN_CLUSTER_SW_PATCH_VERSION  # Diagnostics Data Import
              DID_F126_27_CAN_CLUSTER_SW_MINOR_VERSION: DcmDspDidDataPos=240, DcmDspDidDataRef=DID_F126_Autosar_BSW_Cluster_Versions_DID_F126_27_CAN_CLUSTER_SW_MINOR_VERSION  # Diagnostics Data Import
              DID_F126_26_CAN_CLUSTER_SW_MAJOR_VERSION: DcmDspDidDataPos=232, DcmDspDidDataRef=DID_F126_Autosar_BSW_Cluster_Versions_DID_F126_26_CAN_CLUSTER_SW_MAJOR_VERSION  # Diagnostics Data Import
              DID_F126_25_CAN_CLUSTER_VENDOR_ID: DcmDspDidDataPos=216, DcmDspDidDataRef=DID_F126_Autosar_BSW_Cluster_Versions_DID_F126_25_CAN_CLUSTER_VENDOR_ID  # Diagnostics Data Import
              DID_F126_24_COM_CLUSTER_AR_RELEASE_REVISION_VERSION: DcmDspDidDataPos=208, DcmDspDidDataRef=DID_F126_Autosar_BSW_Cluster_Versions_DID_F126_24_COM_CLUSTER_AR_RELEASE_REVISION_VERSION  # Diagnostics Data Import
              DID_F126_23_COM_CLUSTER_AR_RELEASE_MINOR_VERSION: DcmDspDidDataPos=200, DcmDspDidDataRef=DID_F126_Autosar_BSW_Cluster_Versions_DID_F126_23_COM_CLUSTER_AR_RELEASE_MINOR_VERSION  # Diagnostics Data Import
              DID_F126_22_COM_CLUSTER_AR_RELEASE_MAJOR_VERSION: DcmDspDidDataPos=192, DcmDspDidDataRef=DID_F126_Autosar_BSW_Cluster_Versions_DID_F126_22_COM_CLUSTER_AR_RELEASE_MAJOR_VERSION  # Diagnostics Data Import
              DID_F126_21_COM_CLUSTER_SW_PATCH_VERSION: DcmDspDidDataPos=184, DcmDspDidDataRef=DID_F126_Autosar_BSW_Cluster_Versions_DID_F126_21_COM_CLUSTER_SW_PATCH_VERSION  # Diagnostics Data Import
              DID_F126_20_COM_CLUSTER_SW_MINOR_VERSION: DcmDspDidDataPos=176, DcmDspDidDataRef=DID_F126_Autosar_BSW_Cluster_Versions_DID_F126_20_COM_CLUSTER_SW_MINOR_VERSION  # Diagnostics Data Import
              DID_F126_19_COM_CLUSTER_SW_MAJOR_VERSION: DcmDspDidDataPos=168, DcmDspDidDataRef=DID_F126_Autosar_BSW_Cluster_Versions_DID_F126_19_COM_CLUSTER_SW_MAJOR_VERSION  # Diagnostics Data Import
              DID_F126_18_COM_CLUSTER_VENDOR_ID: DcmDspDidDataPos=152, DcmDspDidDataRef=DID_F126_Autosar_BSW_Cluster_Versions_DID_F126_18_COM_CLUSTER_VENDOR_ID  # Diagnostics Data Import
              DID_F126_17_MODEMGMT_CLUSTER_AR_RELEASE_REVISION_VERSION: DcmDspDidDataPos=144, DcmDspDidDataRef=DID_F126_Autosar_BSW_Cluster_Versions_DID_F126_17_MODEMGMT_CLUSTER_AR_RELEASE_REVISION_VERSION  # Diagnostics Data Import
              DID_F126_16_MODEMGMT_CLUSTER_AR_RELEASE_MINOR_VERSION: DcmDspDidDataPos=136, DcmDspDidDataRef=DID_F126_Autosar_BSW_Cluster_Versions_DID_F126_16_MODEMGMT_CLUSTER_AR_RELEASE_MINOR_VERSION  # Diagnostics Data Import
              DID_F126_15_MODEMGMT_CLUSTER_AR_RELEASE_MAJOR_VERSION: DcmDspDidDataPos=128, DcmDspDidDataRef=DID_F126_Autosar_BSW_Cluster_Versions_DID_F126_15_MODEMGMT_CLUSTER_AR_RELEASE_MAJOR_VERSION  # Diagnostics Data Import
              DID_F126_14_MODEMGMT_CLUSTER_SW_PATCH_VERSION: DcmDspDidDataPos=120, DcmDspDidDataRef=DID_F126_Autosar_BSW_Cluster_Versions_DID_F126_14_MODEMGMT_CLUSTER_SW_PATCH_VERSION  # Diagnostics Data Import
              DID_F126_13_MODEMGMT_CLUSTER_SW_MINOR_VERSION: DcmDspDidDataPos=112, DcmDspDidDataRef=DID_F126_Autosar_BSW_Cluster_Versions_DID_F126_13_MODEMGMT_CLUSTER_SW_MINOR_VERSION  # Diagnostics Data Import
              DID_F126_12_MODEMGMT_CLUSTER_SW_MAJOR_VERSION: DcmDspDidDataPos=104, DcmDspDidDataRef=DID_F126_Autosar_BSW_Cluster_Versions_DID_F126_12_MODEMGMT_CLUSTER_SW_MAJOR_VERSION  # Diagnostics Data Import
              DID_F126_11_MODEMGMT_CLUSTER_VENDOR_ID: DcmDspDidDataPos=88, DcmDspDidDataRef=DID_F126_Autosar_BSW_Cluster_Versions_DID_F126_11_MODEMGMT_CLUSTER_VENDOR_ID  # Diagnostics Data Import
              DID_F126_10_DIAG_CLUSTER_VCC_FIM_VERSION: DcmDspDidDataPos=80, DcmDspDidDataRef=DID_F126_Autosar_BSW_Cluster_Versions_DID_F126_10_DIAG_CLUSTER_VCC_FIM_VERSION  # Diagnostics Data Import
              DID_F126_9_DIAG_CLUSTER_VCC_DCM_VERSION: DcmDspDidDataPos=72, DcmDspDidDataRef=DID_F126_Autosar_BSW_Cluster_Versions_DID_F126_9_DIAG_CLUSTER_VCC_DCM_VERSION  # Diagnostics Data Import
              DID_F126_8_DIAG_CLUSTER_VCC_DEM_VERSION: DcmDspDidDataPos=64, DcmDspDidDataRef=DID_F126_Autosar_BSW_Cluster_Versions_DID_F126_8_DIAG_CLUSTER_VCC_DEM_VERSION  # Diagnostics Data Import
              DID_F126_7_DIAG_CLUSTER_AR_RELEASE_REVISION_VERSION: DcmDspDidDataPos=56, DcmDspDidDataRef=DID_F126_Autosar_BSW_Cluster_Versions_DID_F126_7_DIAG_CLUSTER_AR_RELEASE_REVISION_VERSION  # Diagnostics Data Import
              DID_F126_6_DIAG_CLUSTER_AR_RELEASE_MINOR_VERSION: DcmDspDidDataPos=48, DcmDspDidDataRef=DID_F126_Autosar_BSW_Cluster_Versions_DID_F126_6_DIAG_CLUSTER_AR_RELEASE_MINOR_VERSION  # Diagnostics Data Import
              DID_F126_5_DIAG_CLUSTER_AR_RELEASE_MAJOR_VERSION: DcmDspDidDataPos=40, DcmDspDidDataRef=DID_F126_Autosar_BSW_Cluster_Versions_DID_F126_5_DIAG_CLUSTER_AR_RELEASE_MAJOR_VERSION  # Diagnostics Data Import
              DID_F126_4_DIAG_CLUSTER_SW_PATCH_VERSION: DcmDspDidDataPos=32, DcmDspDidDataRef=DID_F126_Autosar_BSW_Cluster_Versions_DID_F126_4_DIAG_CLUSTER_SW_PATCH_VERSION  # Diagnostics Data Import
              DID_F126_3_DIAG_CLUSTER_SW_MINOR_VERSION: DcmDspDidDataPos=24, DcmDspDidDataRef=DID_F126_Autosar_BSW_Cluster_Versions_DID_F126_3_DIAG_CLUSTER_SW_MINOR_VERSION  # Diagnostics Data Import
              DID_F126_2_DIAG_CLUSTER_SW_MAJOR_VERSION: DcmDspDidDataPos=16, DcmDspDidDataRef=DID_F126_Autosar_BSW_Cluster_Versions_DID_F126_2_DIAG_CLUSTER_SW_MAJOR_VERSION  # Diagnostics Data Import
              DID_F126_1_DIAG_CLUSTER_VENDOR_ID: DcmDspDidDataPos=0, DcmDspDidDataRef=DID_F126_Autosar_BSW_Cluster_Versions_DID_F126_1_DIAG_CLUSTER_VENDOR_ID  # Diagnostics Data Import
          DID_F125_Primary_Bootloader_Software_Part_Number: DcmDspDidIdentifier=61733, DcmDspDidInfoRef=DidInfo_DID_F125_Primary_Bootloader_Software_Part_Number  # Diagnostics Data Import
            ASCII_part (DcmDspDidSignal): DcmDspDidDataPos=32, DcmDspDidDataRef=DID_F125_Primary_Bootloader_Software_Part_Number_ASCII_part  # Diagnostics Data Import
            BCD_part (DcmDspDidSignal): DcmDspDidDataPos=0, DcmDspDidDataRef=DID_F125_Primary_Bootloader_Software_Part_Number_BCD_part  # Diagnostics Data Import
          DID_F121_Primary_Bootloader_Diagnostic_Database_Part_Number: DcmDspDidIdentifier=61729, DcmDspDidInfoRef=DidInfo_DID_F121_Primary_Bootloader_Diagnostic_Database_Part_Number  # Diagnostics Data Import
            ASCII_part (DcmDspDidSignal): DcmDspDidDataPos=32, DcmDspDidDataRef=DID_F121_Primary_Bootloader_Diagnostic_Database_Part_Number_ASCII_part  # Diagnostics Data Import
            BCD_part (DcmDspDidSignal): DcmDspDidDataPos=0, DcmDspDidDataRef=DID_F121_Primary_Bootloader_Diagnostic_Database_Part_Number_BCD_part  # Diagnostics Data Import
          Application_Diagnostic_Database_Part_Number: DcmDspDidIdentifier=61728, DcmDspDidInfoRef=DidInfo_Application_Diagnostic_Database_Part_Number  # Diagnostics Data Import
            Partnumber_Variant (DcmDspDidSignal): DcmDspDidDataPos=32, DcmDspDidDataRef=Application_Diagnostic_Database_Part_Number_Partnumber_Variant  # Diagnostics Data Import
            Partnumber_Main (DcmDspDidSignal): DcmDspDidDataPos=0, DcmDspDidDataRef=Application_Diagnostic_Database_Part_Number_Partnumber_Main  # Diagnostics Data Import
          DID_EF1D_EOL_config_word_C: DcmDspDidIdentifier=61213, DcmDspDidInfoRef=DidInfo_DID_EF1D_EOL_config_word_C  # Diagnostics Data Import
            DID_EF1D_EOL_config_word_C (DcmDspDidSignal): DcmDspDidDataPos=0, DcmDspDidDataRef=DID_EF1D_EOL_config_word_C_DID_EF1D_EOL_config_word_C  # Diagnostics Data Import
          DID_EF1C_EOL_config_word_B: DcmDspDidIdentifier=61212, DcmDspDidInfoRef=DidInfo_DID_EF1C_EOL_config_word_B  # Diagnostics Data Import
            DID_EF1C_EOL_config_word_B (DcmDspDidSignal): DcmDspDidDataPos=0, DcmDspDidDataRef=DID_EF1C_EOL_config_word_B_DID_EF1C_EOL_config_word_B  # Diagnostics Data Import
          DID_EF1B_EOL_config_word_A: DcmDspDidIdentifier=61211, DcmDspDidInfoRef=DidInfo_DID_EF1B_EOL_config_word_A  # Diagnostics Data Import
            DID_EF1B_EOL_config_word_A (DcmDspDidSignal): DcmDspDidDataPos=0, DcmDspDidDataRef=DID_EF1B_EOL_config_word_A_DID_EF1B_EOL_config_word_A  # Diagnostics Data Import
          DID_EF0A_Active_Discharge_Time: DcmDspDidIdentifier=61194, DcmDspDidInfoRef=DidInfo_DID_EF0A_Active_Discharge_Time  # Diagnostics Data Import
            DID_EF0A_Active_Discharge_Time (DcmDspDidSignal): DcmDspDidDataPos=0, DcmDspDidDataRef=DID_EF0A_Active_Discharge_Time_DID_EF0A_Active_Discharge_Time  # Diagnostics Data Import
          DID_EEFD_Sofware_Project_Version: DcmDspDidIdentifier=61181, DcmDspDidInfoRef=DidInfo_DID_EEFD_Sofware_Project_Version  # Diagnostics Data Import
            DID_EEFD_Clutch_Control_Fault_Indication (DcmDspDidSignal): DcmDspDidDataPos=0, DcmDspDidDataRef=DID_EEFD_Sofware_Project_Version_DID_EEFD_Clutch_Control_Fault_Indication  # Diagnostics Data Import
          DID_EED5_Safety_Torque_QF_factor: DcmDspDidIdentifier=61141, DcmDspDidInfoRef=DidInfo_DID_EED5_Safety_Torque_QF_factor  # Diagnostics Data Import
            EED5_Safety_Torque_Quality_factor (DcmDspDidSignal): DcmDspDidDataPos=0, DcmDspDidDataRef=DID_EED5_Safety_Torque_QF_factor_EED5_Safety_Torque_Quality_factor  # Diagnostics Data Import
          DID_EED4_Safty_Function_Mode: DcmDspDidIdentifier=61140, DcmDspDidInfoRef=DidInfo_DID_EED4_Safty_Function_Mode  # Diagnostics Data Import
            DID_EED4_Safty_Function_Mode (DcmDspDidSignal): DcmDspDidDataPos=0, DcmDspDidDataRef=DID_EED4_Safty_Function_Mode_DID_EED4_Safty_Function_Mode  # Diagnostics Data Import
          DID_EED3_Safety_speed: DcmDspDidIdentifier=61139, DcmDspDidInfoRef=DidInfo_DID_EED3_Safety_speed  # Diagnostics Data Import
            DID_EED3_Safety_speed (DcmDspDidSignal): DcmDspDidDataPos=0, DcmDspDidDataRef=DID_EED3_Safety_speed_DID_EED3_Safety_speed  # Diagnostics Data Import
          DID_0xEEC7_1: DcmDspDidIdentifier=61138, DcmDspDidInfoRef=DidInfo_DID_0xEEC7_1  # Diagnostics Data Import
            DID_EED2_SaftyTorque (DcmDspDidSignal): DcmDspDidDataPos=0, DcmDspDidDataRef=DID_0xEEC7_1_DID_EED2_SaftyTorque  # Diagnostics Data Import
          DID_EED1_Safty_monitor_Fault_Indication: DcmDspDidIdentifier=61137, DcmDspDidInfoRef=DidInfo_DID_EED1_Safty_monitor_Fault_Indication  # Diagnostics Data Import
            4 x DcmDspDidSignal:
              EED1_3: DcmDspDidDataPos=24, DcmDspDidDataRef=DID_EED1_Safty_monitor_Fault_Indication_EED1_3  # Diagnostics Data Import
              EED1_2: DcmDspDidDataPos=16, DcmDspDidDataRef=DID_EED1_Safty_monitor_Fault_Indication_EED1_2  # Diagnostics Data Import
              EED1_1: DcmDspDidDataPos=8, DcmDspDidDataRef=DID_EED1_Safty_monitor_Fault_Indication_EED1_1  # Diagnostics Data Import
              EED1_0: DcmDspDidDataPos=0, DcmDspDidDataRef=DID_EED1_Safty_monitor_Fault_Indication_EED1_0  # Diagnostics Data Import
          DID_EEC5_ImobEng2_node_status: DcmDspDidIdentifier=61125, DcmDspDidInfoRef=DidInfo_DID_EEC5_ImobEng2_node_status  # Diagnostics Data Import
            DID_EEC5_ImobEng2_node_status (DcmDspDidSignal): DcmDspDidDataPos=0, DcmDspDidDataRef=DID_EEC5_ImobEng2_node_status_DID_EEC5_ImobEng2_node_status  # Diagnostics Data Import
          DID_EEC4_Charging_Power_Sustain_Relay_CPSR_Voltage: DcmDspDidIdentifier=61124, DcmDspDidInfoRef=DidInfo_DID_EEC4_Charging_Power_Sustain_Relay_CPSR_Voltage  # Diagnostics Data Import
            DID_EEC4_Charging_Power_Sustain_RelayCPSR_Voltage (DcmDspDidSignal): DcmDspDidDataPos=0, DcmDspDidDataRef=DID_EEC4_Charging_Power_Sustain_Relay_CPSR_Voltage_DID_EEC4_Charging_Power_Sustain_RelayCPSR_Voltage  # Diagnostics Data Import
          DID_EEC3_ECU_power_supply_Voltage: DcmDspDidIdentifier=61123, DcmDspDidInfoRef=DidInfo_DID_EEC3_ECU_power_supply_Voltage  # Diagnostics Data Import
            DID_EEC3_ECU_power_supply_Voltage (DcmDspDidSignal): DcmDspDidDataPos=0, DcmDspDidDataRef=DID_EEC3_ECU_power_supply_Voltage_DID_EEC3_ECU_power_supply_Voltage  # Diagnostics Data Import
          DID_EEBF_HV_Main_Relay_Status: DcmDspDidIdentifier=61119, DcmDspDidInfoRef=DidInfo_DID_EEBF_HV_Main_Relay_Status  # Diagnostics Data Import
            DID_EEBF_HV_Main_Relay_Status (DcmDspDidSignal): DcmDspDidDataPos=0, DcmDspDidDataRef=DID_EEBF_HV_Main_Relay_Status_DID_EEBF_HV_Main_Relay_Status  # Diagnostics Data Import
          DID_EEBE_Offset_angle_status: DcmDspDidIdentifier=61118, DcmDspDidInfoRef=DidInfo_DID_EEBE_Offset_angle_status  # Diagnostics Data Import
            DID_EEBE_Offset_angle_status (DcmDspDidSignal): DcmDspDidDataPos=0, DcmDspDidDataRef=DID_EEBE_Offset_angle_status_DID_EEBE_Offset_angle_status  # Diagnostics Data Import
          DID_EEBD_IEM_MGM_rotor_offset_angle: DcmDspDidIdentifier=61117, DcmDspDidInfoRef=DidInfo_DID_EEBD_IEM_MGM_rotor_offset_angle  # Diagnostics Data Import
            DID_EEBD_IEMMGM_rotor_offset_angle (DcmDspDidSignal): DcmDspDidDataPos=0, DcmDspDidDataRef=DID_EEBD_IEM_MGM_rotor_offset_angle_DID_EEBD_IEMMGM_rotor_offset_angle  # Diagnostics Data Import
          DID_EEB8_HV_voltage_received_from_BECM: DcmDspDidIdentifier=61112, DcmDspDidInfoRef=DidInfo_DID_EEB8_HV_voltage_received_from_BECM  # Diagnostics Data Import
            DID_EEB8_HV_voltage_received_from_BECM (DcmDspDidSignal): DcmDspDidDataPos=0, DcmDspDidDataRef=DID_EEB8_HV_voltage_received_from_BECM_DID_EEB8_HV_voltage_received_from_BECM  # Diagnostics Data Import
          DID_EEB7_ECM_Power_Limitation_minimum: DcmDspDidIdentifier=61111, DcmDspDidInfoRef=DidInfo_DID_EEB7_ECM_Power_Limitation_minimum  # Diagnostics Data Import
            DID_EEB7_ECM_Power_Limitation_minimum (DcmDspDidSignal): DcmDspDidDataPos=0, DcmDspDidDataRef=DID_EEB7_ECM_Power_Limitation_minimum_DID_EEB7_ECM_Power_Limitation_minimum  # Diagnostics Data Import
          DID_EEB6_ECM_Power_Limitation_maximum: DcmDspDidIdentifier=61110, DcmDspDidInfoRef=DidInfo_DID_EEB6_ECM_Power_Limitation_maximum  # Diagnostics Data Import
            DID_EEB6_ECM_Power_Limitation_maximum (DcmDspDidSignal): DcmDspDidDataPos=0, DcmDspDidDataRef=DID_EEB6_ECM_Power_Limitation_maximum_DID_EEB6_ECM_Power_Limitation_maximum  # Diagnostics Data Import
          DID_EEB5_IEM_MGM_current_torque: DcmDspDidIdentifier=61109, DcmDspDidInfoRef=DidInfo_DID_EEB5_IEM_MGM_current_torque  # Diagnostics Data Import
            DID_EEB5_IEMMGM_current_torque (DcmDspDidSignal): DcmDspDidDataPos=0, DcmDspDidDataRef=DID_EEB5_IEM_MGM_current_torque_DID_EEB5_IEMMGM_current_torque  # Diagnostics Data Import
          DID_EEB2_Three_Phase_Motor_Current_RMS_Current: DcmDspDidIdentifier=61106, DcmDspDidInfoRef=DidInfo_DID_EEB2_Three_Phase_Motor_Current_RMS_Current  # Diagnostics Data Import
            DID_EEB2_Three_Phase_Motor_Current_RMS_Current (DcmDspDidSignal): DcmDspDidDataPos=0, DcmDspDidDataRef=DID_EEB2_Three_Phase_Motor_Current_RMS_Current_DID_EEB2_Three_Phase_Motor_Current_RMS_Current  # Diagnostics Data Import
          DID_EE9F_Gate_Status: DcmDspDidIdentifier=61087, DcmDspDidInfoRef=DidInfo_DID_EE9F_Gate_Status  # Diagnostics Data Import
            DID_EE9F_Gate_Status (DcmDspDidSignal): DcmDspDidDataPos=0, DcmDspDidDataRef=DID_EE9F_Gate_Status_DID_EE9F_Gate_Status  # Diagnostics Data Import
          DID_EE9E_Transient_Phase_Current_C: DcmDspDidIdentifier=61086, DcmDspDidInfoRef=DidInfo_DID_EE9E_Transient_Phase_Current_C  # Diagnostics Data Import
            DID_EE9E_Transient_Phase_Current_C (DcmDspDidSignal): DcmDspDidDataPos=0, DcmDspDidDataRef=DID_EE9E_Transient_Phase_Current_C_DID_EE9E_Transient_Phase_Current_C  # Diagnostics Data Import
          DID_EE9D_Transient_Phase_Current_B: DcmDspDidIdentifier=61085, DcmDspDidInfoRef=DidInfo_DID_EE9D_Transient_Phase_Current_B  # Diagnostics Data Import
            DID_EE9D_Transient_Phase_Current_B (DcmDspDidSignal): DcmDspDidDataPos=0, DcmDspDidDataRef=DID_EE9D_Transient_Phase_Current_B_DID_EE9D_Transient_Phase_Current_B  # Diagnostics Data Import
          DID_EE9C_Transient_Phase_Current_A: DcmDspDidIdentifier=61084, DcmDspDidInfoRef=DidInfo_DID_EE9C_Transient_Phase_Current_A  # Diagnostics Data Import
            DID_EE9C_Transient_Phase_Current_A (DcmDspDidSignal): DcmDspDidDataPos=0, DcmDspDidDataRef=DID_EE9C_Transient_Phase_Current_A_DID_EE9C_Transient_Phase_Current_A  # Diagnostics Data Import
          DID_EE9A_Inverter_Coolant_Temperature: DcmDspDidIdentifier=61082, DcmDspDidInfoRef=DidInfo_DID_EE9A_Inverter_Coolant_Temperature  # Diagnostics Data Import
            DID_EE9A_Inverter_Coolant_Temperature (DcmDspDidSignal): DcmDspDidDataPos=0, DcmDspDidDataRef=DID_EE9A_Inverter_Coolant_Temperature_DID_EE9A_Inverter_Coolant_Temperature  # Diagnostics Data Import
          DID_EDA0_Complete_ECU_Part_Serial_Number_s: DcmDspDidIdentifier=60832, DcmDspDidInfoRef=DidInfo_DID_EDA0_Complete_ECU_Part_Serial_Number_s  # Diagnostics Data Import
            11 x DcmDspDidSignal:
              Reserved: DcmDspDidDataPos=264, DcmDspDidDataRef=DID_EDA0_Complete_ECU_Part_Serial_Number_s_Reserved  # Diagnostics Data Import
              ASCII_part: DcmDspDidDataPos=240, DcmDspDidDataRef=DID_EDA0_Complete_ECU_Part_Serial_Number_s_ASCII_part  # Diagnostics Data Import
              BCD_part: DcmDspDidDataPos=208, DcmDspDidDataRef=DID_EDA0_Complete_ECU_Part_Serial_Number_s_BCD_part  # Diagnostics Data Import
              DID_F12E_1_Total_number_of_ECU_Software_Part_Numbers: DcmDspDidDataPos=200, DcmDspDidDataRef=DID_EDA0_Complete_ECU_Part_Serial_Number_s_DID_F12E_1_Total_number_of_ECU_Software_Part_Numbers  # Diagnostics Data Import
              DID_F18C_ECU_Serial_Number: DcmDspDidDataPos=168, DcmDspDidDataRef=DID_EDA0_Complete_ECU_Part_Serial_Number_s_DID_F18C_ECU_Serial_Number  # Diagnostics Data Import
              DID_F12B_ECU_Delivery_Assembly_Part_Number1: DcmDspDidDataPos=144, DcmDspDidDataRef=DID_EDA0_Complete_ECU_Part_Serial_Number_s_DID_F12B_ECU_Delivery_Assembly_Part_Number1  # Diagnostics Data Import
              DID_F12B_ECU_Delivery_Assembly_Part_Number: DcmDspDidDataPos=112, DcmDspDidDataRef=DID_EDA0_Complete_ECU_Part_Serial_Number_s_DID_F12B_ECU_Delivery_Assembly_Part_Number  # Diagnostics Data Import
              DID_F12A_ECU_Delivery_Assembly_Part_Number1_1: DcmDspDidDataPos=88, DcmDspDidDataRef=DID_EDA0_Complete_ECU_Part_Serial_Number_s_DID_F12A_ECU_Delivery_Assembly_Part_Number1_1  # Diagnostics Data Import
              DID_F12A_ECU_Delivery_Assembly_Part_Number_1: DcmDspDidDataPos=56, DcmDspDidDataRef=DID_EDA0_Complete_ECU_Part_Serial_Number_s_DID_F12A_ECU_Delivery_Assembly_Part_Number_1  # Diagnostics Data Import
              F120_Application_Diagnostic_Database_Part_Number1: DcmDspDidDataPos=32, DcmDspDidDataRef=DID_EDA0_Complete_ECU_Part_Serial_Number_s_F120_Application_Diagnostic_Database_Part_Number1  # Diagnostics Data Import
              F120_Application_Diagnostic_Database_Part_Number: DcmDspDidDataPos=0, DcmDspDidDataRef=DID_EDA0_Complete_ECU_Part_Serial_Number_s_F120_Application_Diagnostic_Database_Part_Number  # Diagnostics Data Import
          DID_ED20_Complete_set_of_ECU_part_serial_numbers_Geely: DcmDspDidIdentifier=60704, DcmDspDidInfoRef=DidInfo_DID_ED20_Complete_set_of_ECU_part_serial_numbers_Geely  # Diagnostics Data Import
            11 x DcmDspDidSignal:
              Reserved: DcmDspDidDataPos=296, DcmDspDidDataRef=DID_ED20_Complete_set_of_ECU_part_serial_numbers_Geely_Reserved  # Diagnostics Data Import
              ASCII_part_003: DcmDspDidDataPos=272, DcmDspDidDataRef=DID_ED20_Complete_set_of_ECU_part_serial_numbers_Geely_ASCII_part_003  # Diagnostics Data Import
              BCD_part_003: DcmDspDidDataPos=232, DcmDspDidDataRef=DID_ED20_Complete_set_of_ECU_part_serial_numbers_Geely_BCD_part_003  # Diagnostics Data Import
              DID_F1AE_1_Total_number_of_ECU_Software_Part_Numbers: DcmDspDidDataPos=224, DcmDspDidDataRef=DID_ED20_Complete_set_of_ECU_part_serial_numbers_Geely_DID_F1AE_1_Total_number_of_ECU_Software_Part_Numbers  # Diagnostics Data Import
              DID_F18C_ECU_Serial_Number: DcmDspDidDataPos=192, DcmDspDidDataRef=DID_ED20_Complete_set_of_ECU_part_serial_numbers_Geely_DID_F18C_ECU_Serial_Number  # Diagnostics Data Import
              ASCII_part_002: DcmDspDidDataPos=168, DcmDspDidDataRef=DID_ED20_Complete_set_of_ECU_part_serial_numbers_Geely_ASCII_part_002  # Diagnostics Data Import
              BCD_part_002: DcmDspDidDataPos=128, DcmDspDidDataRef=DID_ED20_Complete_set_of_ECU_part_serial_numbers_Geely_BCD_part_002  # Diagnostics Data Import
              ASCII_part_001: DcmDspDidDataPos=104, DcmDspDidDataRef=DID_ED20_Complete_set_of_ECU_part_serial_numbers_Geely_ASCII_part_001  # Diagnostics Data Import
              BCD_part_001: DcmDspDidDataPos=64, DcmDspDidDataRef=DID_ED20_Complete_set_of_ECU_part_serial_numbers_Geely_BCD_part_001  # Diagnostics Data Import
              ASCII_part: DcmDspDidDataPos=40, DcmDspDidDataRef=DID_ED20_Complete_set_of_ECU_part_serial_numbers_Geely_ASCII_part  # Diagnostics Data Import
              BCD_part: DcmDspDidDataPos=0, DcmDspDidDataRef=DID_ED20_Complete_set_of_ECU_part_serial_numbers_Geely_BCD_part  # Diagnostics Data Import
          DID_E364_AURIX_Fault_Indication: DcmDspDidIdentifier=58212, DcmDspDidInfoRef=DidInfo_DID_E364_AURIX_Fault_Indication  # Diagnostics Data Import
            DID_E364_AURIX_Fault_Indication (DcmDspDidSignal): DcmDspDidDataPos=0, DcmDspDidDataRef=DID_E364_AURIX_Fault_Indication_DID_E364_AURIX_Fault_Indication  # Diagnostics Data Import
          DID_E363_Modulation_index: DcmDspDidIdentifier=58211, DcmDspDidInfoRef=DidInfo_DID_E363_Modulation_index  # Diagnostics Data Import
            DID_E363_Modulation_index (DcmDspDidSignal): DcmDspDidDataPos=0, DcmDspDidDataRef=DID_E363_Modulation_index_DID_E363_Modulation_index  # Diagnostics Data Import
          DID_E358_Resolve_angle: DcmDspDidIdentifier=58200, DcmDspDidInfoRef=DidInfo_DID_E358_Resolve_angle  # Diagnostics Data Import
            DID_E358_Resolve_angle (DcmDspDidSignal): DcmDspDidDataPos=0, DcmDspDidDataRef=DID_E358_Resolve_angle_DID_E358_Resolve_angle  # Diagnostics Data Import
          DID_E357_Resolve_compensated_angle: DcmDspDidIdentifier=58199, DcmDspDidInfoRef=DidInfo_DID_E357_Resolve_compensated_angle  # Diagnostics Data Import
            DID_E357_Resolve_compensated_angle (DcmDspDidSignal): DcmDspDidDataPos=0, DcmDspDidDataRef=DID_E357_Resolve_compensated_angle_DID_E357_Resolve_compensated_angle  # Diagnostics Data Import
          DID_E353_Flux_weakening_correction_factor: DcmDspDidIdentifier=58195, DcmDspDidInfoRef=DidInfo_DID_E353_Flux_weakening_correction_factor  # Diagnostics Data Import
            DID_E353_Flux_weakening_correction_factor (DcmDspDidSignal): DcmDspDidDataPos=0, DcmDspDidDataRef=DID_E353_Flux_weakening_correction_factor_DID_E353_Flux_weakening_correction_factor  # Diagnostics Data Import
          DID_E350_Phase_W_PWM_duty: DcmDspDidIdentifier=58192, DcmDspDidInfoRef=DidInfo_DID_E350_Phase_W_PWM_duty  # Diagnostics Data Import
            DID_E350_Phase_W_PWM_duty (DcmDspDidSignal): DcmDspDidDataPos=0, DcmDspDidDataRef=DID_E350_Phase_W_PWM_duty_DID_E350_Phase_W_PWM_duty  # Diagnostics Data Import
          DID_E349_Phase_V_PWM_duty: DcmDspDidIdentifier=58185, DcmDspDidInfoRef=DidInfo_DID_E349_Phase_V_PWM_duty  # Diagnostics Data Import
            DID_E349_Phase_V_PWM_duty (DcmDspDidSignal): DcmDspDidDataPos=0, DcmDspDidDataRef=DID_E349_Phase_V_PWM_duty_DID_E349_Phase_V_PWM_duty  # Diagnostics Data Import
          DID_E348_Phase_U_PWM_duty: DcmDspDidIdentifier=58184, DcmDspDidInfoRef=DidInfo_DID_E348_Phase_U_PWM_duty  # Diagnostics Data Import
            DID_E348_Phase_U_PWM_duty (DcmDspDidSignal): DcmDspDidDataPos=0, DcmDspDidDataRef=DID_E348_Phase_U_PWM_duty_DID_E348_Phase_U_PWM_duty  # Diagnostics Data Import
          DID_E347_IGBT_Max_Temperature: DcmDspDidIdentifier=58183, DcmDspDidInfoRef=DidInfo_DID_E347_IGBT_Max_Temperature  # Diagnostics Data Import
            DID_E347_IGBT_Max_Temperature (DcmDspDidSignal): DcmDspDidDataPos=0, DcmDspDidDataRef=DID_E347_IGBT_Max_Temperature_DID_E347_IGBT_Max_Temperature  # Diagnostics Data Import
          DID_E346_ECM_Torque_Allowed_Status: DcmDspDidIdentifier=58182, DcmDspDidInfoRef=DidInfo_DID_E346_ECM_Torque_Allowed_Status  # Diagnostics Data Import
            DID_E346_ECM_Torque_Allowed_Status (DcmDspDidSignal): DcmDspDidDataPos=0, DcmDspDidDataRef=DID_E346_ECM_Torque_Allowed_Status_DID_E346_ECM_Torque_Allowed_Status  # Diagnostics Data Import
          DID_E341_q_axis_voltage: DcmDspDidIdentifier=58177, DcmDspDidInfoRef=DidInfo_DID_E341_q_axis_voltage  # Diagnostics Data Import
            DID_E341_q_axis_voltage (DcmDspDidSignal): DcmDspDidDataPos=0, DcmDspDidDataRef=DID_E341_q_axis_voltage_DID_E341_q_axis_voltage  # Diagnostics Data Import
          DID_E339_d_axis_voltage: DcmDspDidIdentifier=58169, DcmDspDidInfoRef=DidInfo_DID_E339_d_axis_voltage  # Diagnostics Data Import
            DID_E339_d_axis_voltage (DcmDspDidSignal): DcmDspDidDataPos=0, DcmDspDidDataRef=DID_E339_d_axis_voltage_DID_E339_d_axis_voltage  # Diagnostics Data Import
          DID_E338_q_axis_current_feedback: DcmDspDidIdentifier=58168, DcmDspDidInfoRef=DidInfo_DID_E338_q_axis_current_feedback  # Diagnostics Data Import
            DID_E338_q_axis_current_feedback (DcmDspDidSignal): DcmDspDidDataPos=0, DcmDspDidDataRef=DID_E338_q_axis_current_feedback_DID_E338_q_axis_current_feedback  # Diagnostics Data Import
          DID_E337_q_axis_current_setpoint: DcmDspDidIdentifier=58167, DcmDspDidInfoRef=DidInfo_DID_E337_q_axis_current_setpoint  # Diagnostics Data Import
            DID_E337_q_axis_current_setpoint (DcmDspDidSignal): DcmDspDidDataPos=0, DcmDspDidDataRef=DID_E337_q_axis_current_setpoint_DID_E337_q_axis_current_setpoint  # Diagnostics Data Import
          DID_E336_d_axis_current_feedback: DcmDspDidIdentifier=58166, DcmDspDidInfoRef=DidInfo_DID_E336_d_axis_current_feedback  # Diagnostics Data Import
            DID_E336_d_axis_current_feedback (DcmDspDidSignal): DcmDspDidDataPos=0, DcmDspDidDataRef=DID_E336_d_axis_current_feedback_DID_E336_d_axis_current_feedback  # Diagnostics Data Import
          DID_E335_d_axis_current_setpoint: DcmDspDidIdentifier=58165, DcmDspDidInfoRef=DidInfo_DID_E335_d_axis_current_setpoint  # Diagnostics Data Import
            DID_E335_d_axis_current_setpoint (DcmDspDidSignal): DcmDspDidDataPos=0, DcmDspDidDataRef=DID_E335_d_axis_current_setpoint_DID_E335_d_axis_current_setpoint  # Diagnostics Data Import
          DID_E333_2002_State: DcmDspDidIdentifier=58163, DcmDspDidInfoRef=DidInfo_DID_E333_2002_State  # Diagnostics Data Import
            8 x DcmDspDidSignal:
              INVALID_SHORTNAME_2002_L_Ser: DcmDspDidDataPos=56, DcmDspDidDataRef=DID_E333_2002_State_2002_L_Ser  # Diagnostics Data Import
              INVALID_SHORTNAME_2002_H_Ser: DcmDspDidDataPos=48, DcmDspDidDataRef=DID_E333_2002_State_2002_H_Ser  # Diagnostics Data Import
              INVALID_SHORTNAME_2002_Lw: DcmDspDidDataPos=40, DcmDspDidDataRef=DID_E333_2002_State_2002_Lw  # Diagnostics Data Import
              INVALID_SHORTNAME_2002_Lv: DcmDspDidDataPos=32, DcmDspDidDataRef=DID_E333_2002_State_2002_Lv  # Diagnostics Data Import
              INVALID_SHORTNAME_2002_Lu: DcmDspDidDataPos=24, DcmDspDidDataRef=DID_E333_2002_State_2002_Lu  # Diagnostics Data Import
              INVALID_SHORTNAME_2002_Hw: DcmDspDidDataPos=16, DcmDspDidDataRef=DID_E333_2002_State_2002_Hw  # Diagnostics Data Import
              INVALID_SHORTNAME_2002_Hv: DcmDspDidDataPos=8, DcmDspDidDataRef=DID_E333_2002_State_2002_Hv  # Diagnostics Data Import
              INVALID_SHORTNAME_2002_Hu: DcmDspDidDataPos=0, DcmDspDidDataRef=DID_E333_2002_State_2002_Hu  # Diagnostics Data Import
          DID_E331_Software_Version: DcmDspDidIdentifier=58161, DcmDspDidInfoRef=DidInfo_DID_E331_Software_Version  # Diagnostics Data Import
            3 x DcmDspDidSignal:
              DID_E331_3_Calibration_Data_Software_Version: DcmDspDidDataPos=128, DcmDspDidDataRef=DID_E331_Software_Version_DID_E331_3_Calibration_Data_Software_Version  # Diagnostics Data Import
              DID_E331_2_BSW_Software_Version: DcmDspDidDataPos=64, DcmDspDidDataRef=DID_E331_Software_Version_DID_E331_2_BSW_Software_Version  # Diagnostics Data Import
              DID_E331_1_ASW_Software_Version: DcmDspDidDataPos=0, DcmDspDidDataRef=DID_E331_Software_Version_DID_E331_1_ASW_Software_Version  # Diagnostics Data Import
          DID_E324_Motor_Derating_reason_of_IEM_MGM: DcmDspDidIdentifier=58148, DcmDspDidInfoRef=DidInfo_DID_E324_Motor_Derating_reason_of_IEM_MGM  # Diagnostics Data Import
            DID_E324_Motor_Derating_reason_of_IEMMGM (DcmDspDidSignal): DcmDspDidDataPos=0, DcmDspDidDataRef=DID_E324_Motor_Derating_reason_of_IEM_MGM_DID_E324_Motor_Derating_reason_of_IEMMGM  # Diagnostics Data Import
          DID_E320_System_Mode_Mismatch: DcmDspDidIdentifier=58144, DcmDspDidInfoRef=DidInfo_DID_E320_System_Mode_Mismatch  # Diagnostics Data Import
            DID_E320_System_Mode_Mismatch (DcmDspDidSignal): DcmDspDidDataPos=0, DcmDspDidDataRef=DID_E320_System_Mode_Mismatch_DID_E320_System_Mode_Mismatch  # Diagnostics Data Import
          DID_E319_Torque_Direction: DcmDspDidIdentifier=58137, DcmDspDidInfoRef=DidInfo_DID_E319_Torque_Direction  # Diagnostics Data Import
            DID_E319_Torque_Direction (DcmDspDidSignal): DcmDspDidDataPos=0, DcmDspDidDataRef=DID_E319_Torque_Direction_DID_E319_Torque_Direction  # Diagnostics Data Import
          DID_E315_Available_Torque_minimum: DcmDspDidIdentifier=58133, DcmDspDidInfoRef=DidInfo_DID_E315_Available_Torque_minimum  # Diagnostics Data Import
            DID_E315_Available_Torque_minimum (DcmDspDidSignal): DcmDspDidDataPos=0, DcmDspDidDataRef=DID_E315_Available_Torque_minimum_DID_E315_Available_Torque_minimum  # Diagnostics Data Import
          DID_E314_Available_Torque_maximum: DcmDspDidIdentifier=58132, DcmDspDidInfoRef=DidInfo_DID_E314_Available_Torque_maximum  # Diagnostics Data Import
            DID_E314_Available_Torque_maximum (DcmDspDidSignal): DcmDspDidDataPos=0, DcmDspDidDataRef=DID_E314_Available_Torque_maximum_DID_E314_Available_Torque_maximum  # Diagnostics Data Import
          DID_E313_Active_discharge_status: DcmDspDidIdentifier=58131, DcmDspDidInfoRef=DidInfo_DID_E313_Active_discharge_status  # Diagnostics Data Import
            DID_E313_Active_discharge_status (DcmDspDidSignal): DcmDspDidDataPos=0, DcmDspDidDataRef=DID_E313_Active_discharge_status_DID_E313_Active_discharge_status  # Diagnostics Data Import
          DID_E312_Wheel_Speed: DcmDspDidIdentifier=58130, DcmDspDidInfoRef=DidInfo_DID_E312_Wheel_Speed  # Diagnostics Data Import
            DID_E312_Wheel_Speed (DcmDspDidSignal): DcmDspDidDataPos=0, DcmDspDidDataRef=DID_E312_Wheel_Speed_DID_E312_Wheel_Speed  # Diagnostics Data Import
          DID_E311_Crash_Status: DcmDspDidIdentifier=58129, DcmDspDidInfoRef=DidInfo_DID_E311_Crash_Status  # Diagnostics Data Import
            DID_E311_Crash_Status (DcmDspDidSignal): DcmDspDidDataPos=0, DcmDspDidDataRef=DID_E311_Crash_Status_DID_E311_Crash_Status  # Diagnostics Data Import
          DID_E310_IEM_MGM_Derating_Status: DcmDspDidIdentifier=58128, DcmDspDidInfoRef=DidInfo_DID_E310_IEM_MGM_Derating_Status  # Diagnostics Data Import
            DID_E310_IEMMGM_Derating_Status (DcmDspDidSignal): DcmDspDidDataPos=0, DcmDspDidDataRef=DID_E310_IEM_MGM_Derating_Status_DID_E310_IEMMGM_Derating_Status  # Diagnostics Data Import
          DID_E309_ECM_Mode_Request: DcmDspDidIdentifier=58121, DcmDspDidInfoRef=DidInfo_DID_E309_ECM_Mode_Request  # Diagnostics Data Import
            DID_E309_ECM_Mode_Request (DcmDspDidSignal): DcmDspDidDataPos=0, DcmDspDidDataRef=DID_E309_ECM_Mode_Request_DID_E309_ECM_Mode_Request  # Diagnostics Data Import
          DID_E308_ECM_Torque_Request: DcmDspDidIdentifier=58120, DcmDspDidInfoRef=DidInfo_DID_E308_ECM_Torque_Request  # Diagnostics Data Import
            DID_E308_ECM_Torque_Request (DcmDspDidSignal): DcmDspDidDataPos=0, DcmDspDidDataRef=DID_E308_ECM_Torque_Request_DID_E308_ECM_Torque_Request  # Diagnostics Data Import
          DID_E307_System_Mode: DcmDspDidIdentifier=58119, DcmDspDidInfoRef=DidInfo_DID_E307_System_Mode  # Diagnostics Data Import
            DID_E307_System_Mode (DcmDspDidSignal): DcmDspDidDataPos=0, DcmDspDidDataRef=DID_E307_System_Mode_DID_E307_System_Mode  # Diagnostics Data Import
          DID_E306_Motor_Temperature: DcmDspDidIdentifier=58118, DcmDspDidInfoRef=DidInfo_DID_E306_Motor_Temperature  # Diagnostics Data Import
            DID_E306_Motor_Temperature (DcmDspDidSignal): DcmDspDidDataPos=0, DcmDspDidDataRef=DID_E306_Motor_Temperature_DID_E306_Motor_Temperature  # Diagnostics Data Import
          DID_E305_Inverter_IGBT_Junction_Temp: DcmDspDidIdentifier=58117, DcmDspDidInfoRef=DidInfo_DID_E305_Inverter_IGBT_Junction_Temp  # Diagnostics Data Import
            DID_E305_Inverter_IGBT_Junction_Temp (DcmDspDidSignal): DcmDspDidDataPos=0, DcmDspDidDataRef=DID_E305_Inverter_IGBT_Junction_Temp_DID_E305_Inverter_IGBT_Junction_Temp  # Diagnostics Data Import
          DID_E304_Actual_Torque: DcmDspDidIdentifier=58116, DcmDspDidInfoRef=DidInfo_DID_E304_Actual_Torque  # Diagnostics Data Import
            DID_E304_Actual_Torque (DcmDspDidSignal): DcmDspDidDataPos=0, DcmDspDidDataRef=DID_E304_Actual_Torque_DID_E304_Actual_Torque  # Diagnostics Data Import
          DID_E303_Motor_Speed: DcmDspDidIdentifier=58115, DcmDspDidInfoRef=DidInfo_DID_E303_Motor_Speed  # Diagnostics Data Import
            DID_E303_Motor_Speed_ (DcmDspDidSignal): DcmDspDidDataPos=0, DcmDspDidDataRef=DID_E303_Motor_Speed_DID_E303_Motor_Speed_  # Diagnostics Data Import
          DID_E301_HVDC_Current: DcmDspDidIdentifier=58113, DcmDspDidInfoRef=DidInfo_DID_E301_HVDC_Current  # Diagnostics Data Import
            DID_E301_HVDC_Current_ (DcmDspDidSignal): DcmDspDidDataPos=0, DcmDspDidDataRef=DID_E301_HVDC_Current_DID_E301_HVDC_Current_  # Diagnostics Data Import
          DID_E300_HVDC_Voltage: DcmDspDidIdentifier=58112, DcmDspDidInfoRef=DidInfo_DID_E300_HVDC_Voltage  # Diagnostics Data Import
            DID_E300_HVDC_Voltage (DcmDspDidSignal): DcmDspDidDataPos=0, DcmDspDidDataRef=DID_E300_HVDC_Voltage_DID_E300_HVDC_Voltage  # Diagnostics Data Import
          DID_E103_Car_Configuration_Parameter_Faults: DcmDspDidIdentifier=57603, DcmDspDidInfoRef=DidInfo_DID_E103_Car_Configuration_Parameter_Faults  # Diagnostics Data Import
            21 x DcmDspDidSignal:
              DID_E103_21_10th_parameter_invalid_value: DcmDspDidDataPos=240, DcmDspDidDataRef=DID_E103_Car_Configuration_Parameter_Faults_DID_E103_21_10th_parameter_invalid_value  # Diagnostics Data Import
              DID_E103_20_10th_parameter_number_of_the_car_configuration_data_that_is_invalid: DcmDspDidDataPos=224, DcmDspDidDataRef=DID_E103_Car_Configuration_Parameter_Faults_DID_E103_20_10th_parameter_number_of_the_car_configuration_data_that_is_invalid  # Diagnostics Data Import
              DID_E103_19_9th_parameter_invalid_value: DcmDspDidDataPos=216, DcmDspDidDataRef=DID_E103_Car_Configuration_Parameter_Faults_DID_E103_19_9th_parameter_invalid_value  # Diagnostics Data Import
              DID_E103_18_9th_parameter_number_of_the_car_configuration_data_that_is_invalid: DcmDspDidDataPos=200, DcmDspDidDataRef=DID_E103_Car_Configuration_Parameter_Faults_DID_E103_18_9th_parameter_number_of_the_car_configuration_data_that_is_invalid  # Diagnostics Data Import
              DID_E103_17_8th_parameter_invalid_value: DcmDspDidDataPos=192, DcmDspDidDataRef=DID_E103_Car_Configuration_Parameter_Faults_DID_E103_17_8th_parameter_invalid_value  # Diagnostics Data Import
              DID_E103_16_8th_parameter_number_of_the_car_configuration_data_that_is_invalid: DcmDspDidDataPos=176, DcmDspDidDataRef=DID_E103_Car_Configuration_Parameter_Faults_DID_E103_16_8th_parameter_number_of_the_car_configuration_data_that_is_invalid  # Diagnostics Data Import
              DID_E103_15_7th_parameter_invalid_value: DcmDspDidDataPos=168, DcmDspDidDataRef=DID_E103_Car_Configuration_Parameter_Faults_DID_E103_15_7th_parameter_invalid_value  # Diagnostics Data Import
              DID_E103_14_7th_parameter_number_of_the_car_configuration_data_that_is_invalid: DcmDspDidDataPos=152, DcmDspDidDataRef=DID_E103_Car_Configuration_Parameter_Faults_DID_E103_14_7th_parameter_number_of_the_car_configuration_data_that_is_invalid  # Diagnostics Data Import
              DID_E103_13_6th_parameter_invalid_value: DcmDspDidDataPos=144, DcmDspDidDataRef=DID_E103_Car_Configuration_Parameter_Faults_DID_E103_13_6th_parameter_invalid_value  # Diagnostics Data Import
              DID_E103_12_6th_parameter_number_of_the_car_configuration_data_that_is_invalid: DcmDspDidDataPos=128, DcmDspDidDataRef=DID_E103_Car_Configuration_Parameter_Faults_DID_E103_12_6th_parameter_number_of_the_car_configuration_data_that_is_invalid  # Diagnostics Data Import
              DID_E103_11_5th_parameter_invalid_value: DcmDspDidDataPos=120, DcmDspDidDataRef=DID_E103_Car_Configuration_Parameter_Faults_DID_E103_11_5th_parameter_invalid_value  # Diagnostics Data Import
              DID_E103_10_5th_parameter_number_of_the_car_configuration_data_that_is_invalid: DcmDspDidDataPos=104, DcmDspDidDataRef=DID_E103_Car_Configuration_Parameter_Faults_DID_E103_10_5th_parameter_number_of_the_car_configuration_data_that_is_invalid  # Diagnostics Data Import
              DID_E103_9_4th_parameter_invalid_value: DcmDspDidDataPos=96, DcmDspDidDataRef=DID_E103_Car_Configuration_Parameter_Faults_DID_E103_9_4th_parameter_invalid_value  # Diagnostics Data Import
              DID_E103_8_4th_parameter_number_of_the_car_configuration_data_that_is_invalid: DcmDspDidDataPos=80, DcmDspDidDataRef=DID_E103_Car_Configuration_Parameter_Faults_DID_E103_8_4th_parameter_number_of_the_car_configuration_data_that_is_invalid  # Diagnostics Data Import
              DID_E103_7_3rd_parameter_invalid_value: DcmDspDidDataPos=72, DcmDspDidDataRef=DID_E103_Car_Configuration_Parameter_Faults_DID_E103_7_3rd_parameter_invalid_value  # Diagnostics Data Import
              DID_E103_6_3rd_parameter_number_of_the_car_configuration_data_that_is_invalid: DcmDspDidDataPos=56, DcmDspDidDataRef=DID_E103_Car_Configuration_Parameter_Faults_DID_E103_6_3rd_parameter_number_of_the_car_configuration_data_that_is_invalid  # Diagnostics Data Import
              DID_E103_5_2nd_parameter_invalid_value: DcmDspDidDataPos=48, DcmDspDidDataRef=DID_E103_Car_Configuration_Parameter_Faults_DID_E103_5_2nd_parameter_invalid_value  # Diagnostics Data Import
              DID_E103_4_2nd_parameter_number_of_the_car_configuration_data_that_is_invalid: DcmDspDidDataPos=32, DcmDspDidDataRef=DID_E103_Car_Configuration_Parameter_Faults_DID_E103_4_2nd_parameter_number_of_the_car_configuration_data_that_is_invalid  # Diagnostics Data Import
              DID_E103_3_1st_parameter_invalid_value: DcmDspDidDataPos=24, DcmDspDidDataRef=DID_E103_Car_Configuration_Parameter_Faults_DID_E103_3_1st_parameter_invalid_value  # Diagnostics Data Import
              DID_E103_2_1st_parameter_number_of_the_car_configuration_data_that_is_invalid: DcmDspDidDataPos=8, DcmDspDidDataRef=DID_E103_Car_Configuration_Parameter_Faults_DID_E103_2_1st_parameter_number_of_the_car_configuration_data_that_is_invalid  # Diagnostics Data Import
              DID_E103_1_Number_of_invalid_car_configuration_parameter_values_recognised: DcmDspDidDataPos=0, DcmDspDidDataRef=DID_E103_Car_Configuration_Parameter_Faults_DID_E103_1_Number_of_invalid_car_configuration_parameter_values_recognised  # Diagnostics Data Import
          DID_DD0C_Electric_Power_Level: DcmDspDidIdentifier=56588, DcmDspDidInfoRef=DidInfo_DID_DD0C_Electric_Power_Level  # Diagnostics Data Import
            DID_DD0C_Electric_Power_Level (DcmDspDidSignal): DcmDspDidDataPos=0, DcmDspDidDataRef=DID_DD0C_Electric_Power_Level_DID_DD0C_Electric_Power_Level  # Diagnostics Data Import
          DID_DD0A_Usage_Mode: DcmDspDidIdentifier=56586, DcmDspDidInfoRef=DidInfo_DID_DD0A_Usage_Mode  # Diagnostics Data Import
            DID_DD0A_Usage_Mode (DcmDspDidSignal): DcmDspDidDataPos=0, DcmDspDidDataRef=DID_DD0A_Usage_Mode_DID_DD0A_Usage_Mode  # Diagnostics Data Import
          DID_DD02_Vehicle_Battery_Voltage: DcmDspDidIdentifier=56578, DcmDspDidInfoRef=DidInfo_DID_DD02_Vehicle_Battery_Voltage  # Diagnostics Data Import
            DID_DD02_Vehicle_Battery_Voltage (DcmDspDidSignal): DcmDspDidDataPos=0, DcmDspDidDataRef=DID_DD02_Vehicle_Battery_Voltage_DID_DD02_Vehicle_Battery_Voltage  # Diagnostics Data Import
          DID_DD01_Total_Distance: DcmDspDidIdentifier=56577, DcmDspDidInfoRef=DidInfo_DID_DD01_Total_Distance  # Diagnostics Data Import
            DID_DD01_Total_Distance (DcmDspDidSignal): DcmDspDidDataPos=0, DcmDspDidDataRef=DID_DD01_Total_Distance_DID_DD01_Total_Distance  # Diagnostics Data Import
          DID_DD00_Global_Real_Time: DcmDspDidIdentifier=56576, DcmDspDidInfoRef=DidInfo_DID_DD00_Global_Real_Time  # Diagnostics Data Import
            DID_DD00_Global_Real_Time (DcmDspDidSignal): DcmDspDidDataPos=0, DcmDspDidDataRef=DID_DD00_Global_Real_Time_DID_DD00_Global_Real_Time  # Diagnostics Data Import
          DID_D211_Network_Management_History_Propulsion_CAN: DcmDspDidIdentifier=53777, DcmDspDidInfoRef=DidInfo_DID_D211_Network_Management_History_Propulsion_CAN  # Diagnostics Data Import
            20 x DcmDspDidSignal:
              DID_D211_20_10th_Latest_State_Global_Real_Time: DcmDspDidDataPos=368, DcmDspDidDataRef=DID_D211_Network_Management_History_Propulsion_CAN_DID_D211_20_10th_Latest_State_Global_Real_Time  # Diagnostics Data Import
              DID_D211_19_10th_Latest_State_NM_History: DcmDspDidDataPos=360, DcmDspDidDataRef=DID_D211_Network_Management_History_Propulsion_CAN_DID_D211_19_10th_Latest_State_NM_History  # Diagnostics Data Import
              DID_D211_18_9th_Latest_State_Global_Real_Time: DcmDspDidDataPos=328, DcmDspDidDataRef=DID_D211_Network_Management_History_Propulsion_CAN_DID_D211_18_9th_Latest_State_Global_Real_Time  # Diagnostics Data Import
              DID_D211_17_9th_Latest_State_NM_History: DcmDspDidDataPos=320, DcmDspDidDataRef=DID_D211_Network_Management_History_Propulsion_CAN_DID_D211_17_9th_Latest_State_NM_History  # Diagnostics Data Import
              DID_D211_16_8th_Latest_State_Global_Real_Time: DcmDspDidDataPos=288, DcmDspDidDataRef=DID_D211_Network_Management_History_Propulsion_CAN_DID_D211_16_8th_Latest_State_Global_Real_Time  # Diagnostics Data Import
              DID_D211_15_8th_Latest_State_NM_History: DcmDspDidDataPos=280, DcmDspDidDataRef=DID_D211_Network_Management_History_Propulsion_CAN_DID_D211_15_8th_Latest_State_NM_History  # Diagnostics Data Import
              DID_D211_14_7th_Latest_State_Global_Real_Time: DcmDspDidDataPos=248, DcmDspDidDataRef=DID_D211_Network_Management_History_Propulsion_CAN_DID_D211_14_7th_Latest_State_Global_Real_Time  # Diagnostics Data Import
              DID_D211_13_7th_Latest_State_NM_History: DcmDspDidDataPos=240, DcmDspDidDataRef=DID_D211_Network_Management_History_Propulsion_CAN_DID_D211_13_7th_Latest_State_NM_History  # Diagnostics Data Import
              DID_D211_12_6th_Latest_State_Global_Real_Time: DcmDspDidDataPos=208, DcmDspDidDataRef=DID_D211_Network_Management_History_Propulsion_CAN_DID_D211_12_6th_Latest_State_Global_Real_Time  # Diagnostics Data Import
              DID_D211_11_6th_Latest_State_NM_History: DcmDspDidDataPos=200, DcmDspDidDataRef=DID_D211_Network_Management_History_Propulsion_CAN_DID_D211_11_6th_Latest_State_NM_History  # Diagnostics Data Import
              DID_D211_10_5th_Latest_State_Global_Real_Time: DcmDspDidDataPos=168, DcmDspDidDataRef=DID_D211_Network_Management_History_Propulsion_CAN_DID_D211_10_5th_Latest_State_Global_Real_Time  # Diagnostics Data Import
              DID_D211_9_5th_Latest_State_NM_History: DcmDspDidDataPos=160, DcmDspDidDataRef=DID_D211_Network_Management_History_Propulsion_CAN_DID_D211_9_5th_Latest_State_NM_History  # Diagnostics Data Import
              DID_D211_8_4th_Latest_State_Global_Real_Time: DcmDspDidDataPos=128, DcmDspDidDataRef=DID_D211_Network_Management_History_Propulsion_CAN_DID_D211_8_4th_Latest_State_Global_Real_Time  # Diagnostics Data Import
              DID_D211_7_4th_Latest_State_NM_History: DcmDspDidDataPos=120, DcmDspDidDataRef=DID_D211_Network_Management_History_Propulsion_CAN_DID_D211_7_4th_Latest_State_NM_History  # Diagnostics Data Import
              DID_D211_6_3rd_Latest_State_Global_Real_Time: DcmDspDidDataPos=88, DcmDspDidDataRef=DID_D211_Network_Management_History_Propulsion_CAN_DID_D211_6_3rd_Latest_State_Global_Real_Time  # Diagnostics Data Import
              DID_D211_5_3rd_Latest_State_NM_History: DcmDspDidDataPos=80, DcmDspDidDataRef=DID_D211_Network_Management_History_Propulsion_CAN_DID_D211_5_3rd_Latest_State_NM_History  # Diagnostics Data Import
              DID_D211_4_2nd_Latest_State_Global_Real_Time: DcmDspDidDataPos=48, DcmDspDidDataRef=DID_D211_Network_Management_History_Propulsion_CAN_DID_D211_4_2nd_Latest_State_Global_Real_Time  # Diagnostics Data Import
              DID_D211_3_2nd_Latest_State_NM_History: DcmDspDidDataPos=40, DcmDspDidDataRef=DID_D211_Network_Management_History_Propulsion_CAN_DID_D211_3_2nd_Latest_State_NM_History  # Diagnostics Data Import
              DID_D211_2_Latest_State_Global_Real_Time: DcmDspDidDataPos=8, DcmDspDidDataRef=DID_D211_Network_Management_History_Propulsion_CAN_DID_D211_2_Latest_State_Global_Real_Time  # Diagnostics Data Import
              DID_D211_1_Latest_State_NM_History: DcmDspDidDataPos=0, DcmDspDidDataRef=DID_D211_Network_Management_History_Propulsion_CAN_DID_D211_1_Latest_State_NM_History  # Diagnostics Data Import
          DID_D134_Car_Mode: DcmDspDidIdentifier=53556, DcmDspDidInfoRef=DidInfo_DID_D134_Car_Mode  # Diagnostics Data Import
            DID_D134_Car_Mode (DcmDspDidSignal): DcmDspDidDataPos=0, DcmDspDidDataRef=DID_D134_Car_Mode_DID_D134_Car_Mode  # Diagnostics Data Import
          DID_D12F_Security_Constant_Level_11_12: DcmDspDidIdentifier=53551, DcmDspDidInfoRef=DidInfo_DID_D12F_Security_Constant_Level_11_12  # Diagnostics Data Import
            DID_D12F_Security_Constant_Level_1112 (DcmDspDidSignal): DcmDspDidDataPos=0, DcmDspDidDataRef=DID_D12F_Security_Constant_Level_11_12_DID_D12F_Security_Constant_Level_1112  # Diagnostics Data Import
          DID_D0B5_SDB_version: DcmDspDidIdentifier=53429, DcmDspDidInfoRef=DidInfo_DID_D0B5_SDB_version  # Diagnostics Data Import
            SDB_version (DcmDspDidSignal): DcmDspDidDataPos=0, DcmDspDidDataRef=DID_D0B5_SDB_version_SDB_version  # Diagnostics Data Import
          DID_D09A_High_Quiescent_Current_Function_Activation_Deactivation: DcmDspDidIdentifier=53402, DcmDspDidInfoRef=DidInfo_DID_D09A_High_Quiescent_Current_Function_Activation_Deactivation  # Diagnostics Data Import
            DID_D09A_High_Quiescent_Current_Function_ActivationDeactivation (DcmDspDidSignal):  # Diagnostics Data Import
              DcmDspDidDataPos = 0
              DcmDspDidDataRef = DID_D09A_High_Quiescent_Current_Function_Activation_Deactivation_DID_D09A_High_Quiescent_Current_Function_ActivationDeactivation
          DID_D03A_swAuth_Public_Key_CheckSum: DcmDspDidIdentifier=53306, DcmDspDidInfoRef=DidInfo_DID_D03A_swAuth_Public_Key_CheckSum  # Diagnostics Data Import
            DID_D03A_swAuth_Public_Key_CheckSum (DcmDspDidSignal): DcmDspDidDataPos=0, DcmDspDidDataRef=DID_D03A_swAuth_Public_Key_CheckSum_DID_D03A_swAuth_Public_Key_CheckSum  # Diagnostics Data Import
          DID_D005_High_Quiescent_Current_Fault_Identification_Data: DcmDspDidIdentifier=53253, DcmDspDidInfoRef=DidInfo_DID_D005_High_Quiescent_Current_Fault_Identification_Data  # Diagnostics Data Import
            85 x DcmDspDidSignal:
              DID_D005_5st_Usage_Mode_when_DID_is_triggered: DcmDspDidDataPos=1992, DcmDspDidDataRef=DID_D005_High_Quiescent_Current_Fault_Identification_Data_DID_D005_5st_Usage_Mode_when_DID_is_triggered  # Diagnostics Data Import
              Bitfield_5th: DcmDspDidDataPos=1984, DcmDspDidDataRef=DID_D005_High_Quiescent_Current_Fault_Identification_Data_Bitfield_5th  # Diagnostics Data Import
              Reserved_Data_Field_5st: DcmDspDidDataPos=1808, DcmDspDidDataRef=DID_D005_High_Quiescent_Current_Fault_Identification_Data_Reserved_Data_Field_5st  # Diagnostics Data Import
              Functionality_Activity_Level_Detect_DC_Bus_voltage_Abnormal_5st: DcmDspDidDataPos=1800, DcmDspDidDataRef=DID_D005_High_Quiescent_Current_Fault_Identification_Data_Functionality_Activity_Level_Detect_DC_Bus_voltage_Abnormal_5st  # Diagnostics Data Import
              Functionality_Activity_Level_Detect_Motor_Speed_Abnormal_5st: DcmDspDidDataPos=1792, DcmDspDidDataRef=DID_D005_High_Quiescent_Current_Fault_Identification_Data_Functionality_Activity_Level_Detect_Motor_Speed_Abnormal_5st  # Diagnostics Data Import
              Functionality_Activity_Level_Detect_CPSR_Keep_Active_5st: DcmDspDidDataPos=1784, DcmDspDidDataRef=DID_D005_High_Quiescent_Current_Fault_Identification_Data_Functionality_Activity_Level_Detect_CPSR_Keep_Active_5st  # Diagnostics Data Import
              Reserved_PNC_5st: DcmDspDidDataPos=1728, DcmDspDidDataRef=DID_D005_High_Quiescent_Current_Fault_Identification_Data_Reserved_PNC_5st  # Diagnostics Data Import
              D005_5st_Functionality_Activity_Level_PNC39: DcmDspDidDataPos=1720, DcmDspDidDataRef=DID_D005_High_Quiescent_Current_Fault_Identification_Data_D005_5st_Functionality_Activity_Level_PNC39  # Diagnostics Data Import
              D005_5st_Functionality_Activity_Level_PNC35: DcmDspDidDataPos=1712, DcmDspDidDataRef=DID_D005_High_Quiescent_Current_Fault_Identification_Data_D005_5st_Functionality_Activity_Level_PNC35  # Diagnostics Data Import
              D005_5st_Functionality_Activity_Level_PNC30: DcmDspDidDataPos=1704, DcmDspDidDataRef=DID_D005_High_Quiescent_Current_Fault_Identification_Data_D005_5st_Functionality_Activity_Level_PNC30  # Diagnostics Data Import
              D005_5st_Functionality_Activity_Level_PNC29: DcmDspDidDataPos=1696, DcmDspDidDataRef=DID_D005_High_Quiescent_Current_Fault_Identification_Data_D005_5st_Functionality_Activity_Level_PNC29  # Diagnostics Data Import
              D005_5st_Functionality_Activity_Level_PNC27: DcmDspDidDataPos=1688, DcmDspDidDataRef=DID_D005_High_Quiescent_Current_Fault_Identification_Data_D005_5st_Functionality_Activity_Level_PNC27  # Diagnostics Data Import
              D005_5st_Functionality_Activity_Level_PNC26: DcmDspDidDataPos=1680, DcmDspDidDataRef=DID_D005_High_Quiescent_Current_Fault_Identification_Data_D005_5st_Functionality_Activity_Level_PNC26  # Diagnostics Data Import
              D005_5st_Functionality_Activity_Level_PNC25: DcmDspDidDataPos=1672, DcmDspDidDataRef=DID_D005_High_Quiescent_Current_Fault_Identification_Data_D005_5st_Functionality_Activity_Level_PNC25  # Diagnostics Data Import
              D005_5st_Functionality_Activity_Level_PNC24: DcmDspDidDataPos=1664, DcmDspDidDataRef=DID_D005_High_Quiescent_Current_Fault_Identification_Data_D005_5st_Functionality_Activity_Level_PNC24  # Diagnostics Data Import
              DID_D005_5st_Global_time_when_Functionality_Activity_level_Sleep_in_the_ECU: DcmDspDidDataPos=1632, DcmDspDidDataRef=DID_D005_High_Quiescent_Current_Fault_Identification_Data_DID_D005_5st_Global_time_when_Functionality_Activity_level_Sle91c5dfd2  # Diagnostics Data Import
              DID_D005_5st_System_Global_Time_the_time_when_the_DID_is_triggered: DcmDspDidDataPos=1600, DcmDspDidDataRef=DID_D005_High_Quiescent_Current_Fault_Identification_Data_DID_D005_5st_System_Global_Time_the_time_when_the_DID_is_triggered  # Diagnostics Data Import
              DID_D005_4st_Usage_Mode_when_DID_is_triggered: DcmDspDidDataPos=1592, DcmDspDidDataRef=DID_D005_High_Quiescent_Current_Fault_Identification_Data_DID_D005_4st_Usage_Mode_when_DID_is_triggered  # Diagnostics Data Import
              Bitfield_4th: DcmDspDidDataPos=1584, DcmDspDidDataRef=DID_D005_High_Quiescent_Current_Fault_Identification_Data_Bitfield_4th  # Diagnostics Data Import
              Reserved_Data_Field_4st: DcmDspDidDataPos=1408, DcmDspDidDataRef=DID_D005_High_Quiescent_Current_Fault_Identification_Data_Reserved_Data_Field_4st  # Diagnostics Data Import
              Functionality_Activity_Level_Detect_DC_Bus_voltage_Abnormal_4st: DcmDspDidDataPos=1400, DcmDspDidDataRef=DID_D005_High_Quiescent_Current_Fault_Identification_Data_Functionality_Activity_Level_Detect_DC_Bus_voltage_Abnormal_4st  # Diagnostics Data Import
              Functionality_Activity_Level_Detect_Motor_Speed_Abnormal_4st: DcmDspDidDataPos=1392, DcmDspDidDataRef=DID_D005_High_Quiescent_Current_Fault_Identification_Data_Functionality_Activity_Level_Detect_Motor_Speed_Abnormal_4st  # Diagnostics Data Import
              Functionality_Activity_Level_Detect_CPSR_Keep_Active_4st: DcmDspDidDataPos=1384, DcmDspDidDataRef=DID_D005_High_Quiescent_Current_Fault_Identification_Data_Functionality_Activity_Level_Detect_CPSR_Keep_Active_4st  # Diagnostics Data Import
              Reserved_PNC_4st: DcmDspDidDataPos=1328, DcmDspDidDataRef=DID_D005_High_Quiescent_Current_Fault_Identification_Data_Reserved_PNC_4st  # Diagnostics Data Import
              D005_4st_Functionality_Activity_Level_PNC39: DcmDspDidDataPos=1320, DcmDspDidDataRef=DID_D005_High_Quiescent_Current_Fault_Identification_Data_D005_4st_Functionality_Activity_Level_PNC39  # Diagnostics Data Import
              D005_4st_Functionality_Activity_Level_PNC35: DcmDspDidDataPos=1312, DcmDspDidDataRef=DID_D005_High_Quiescent_Current_Fault_Identification_Data_D005_4st_Functionality_Activity_Level_PNC35  # Diagnostics Data Import
              D005_4st_Functionality_Activity_Level_PNC30: DcmDspDidDataPos=1304, DcmDspDidDataRef=DID_D005_High_Quiescent_Current_Fault_Identification_Data_D005_4st_Functionality_Activity_Level_PNC30  # Diagnostics Data Import
              D005_4st_Functionality_Activity_Level_PNC29: DcmDspDidDataPos=1296, DcmDspDidDataRef=DID_D005_High_Quiescent_Current_Fault_Identification_Data_D005_4st_Functionality_Activity_Level_PNC29  # Diagnostics Data Import
              D005_4st_Functionality_Activity_Level_PNC27: DcmDspDidDataPos=1288, DcmDspDidDataRef=DID_D005_High_Quiescent_Current_Fault_Identification_Data_D005_4st_Functionality_Activity_Level_PNC27  # Diagnostics Data Import
              D005_4st_Functionality_Activity_Level_PNC26: DcmDspDidDataPos=1280, DcmDspDidDataRef=DID_D005_High_Quiescent_Current_Fault_Identification_Data_D005_4st_Functionality_Activity_Level_PNC26  # Diagnostics Data Import
              D005_4st_Functionality_Activity_Level_PNC25: DcmDspDidDataPos=1272, DcmDspDidDataRef=DID_D005_High_Quiescent_Current_Fault_Identification_Data_D005_4st_Functionality_Activity_Level_PNC25  # Diagnostics Data Import
              D005_4st_Functionality_Activity_Level_PNC24: DcmDspDidDataPos=1264, DcmDspDidDataRef=DID_D005_High_Quiescent_Current_Fault_Identification_Data_D005_4st_Functionality_Activity_Level_PNC24  # Diagnostics Data Import
              DID_D005_4st_Global_time_when_Functionality_Activity_level_Sleep_in_the_ECU: DcmDspDidDataPos=1232, DcmDspDidDataRef=DID_D005_High_Quiescent_Current_Fault_Identification_Data_DID_D005_4st_Global_time_when_Functionality_Activity_level_Sled82c72cd  # Diagnostics Data Import
              DID_D005_4st_System_Global_Time_the_time_when_the_DID_is_triggered: DcmDspDidDataPos=1200, DcmDspDidDataRef=DID_D005_High_Quiescent_Current_Fault_Identification_Data_DID_D005_4st_System_Global_Time_the_time_when_the_DID_is_triggered  # Diagnostics Data Import
              DID_D005_3st_Usage_Mode_when_DID_is_triggered: DcmDspDidDataPos=1192, DcmDspDidDataRef=DID_D005_High_Quiescent_Current_Fault_Identification_Data_DID_D005_3st_Usage_Mode_when_DID_is_triggered  # Diagnostics Data Import
              Bitfield_3th: DcmDspDidDataPos=1184, DcmDspDidDataRef=DID_D005_High_Quiescent_Current_Fault_Identification_Data_Bitfield_3th  # Diagnostics Data Import
              Reserved_Data_Field_3st: DcmDspDidDataPos=1008, DcmDspDidDataRef=DID_D005_High_Quiescent_Current_Fault_Identification_Data_Reserved_Data_Field_3st  # Diagnostics Data Import
              Functionality_Activity_Level_Detect_DC_Bus_voltage_Abnormal3st: DcmDspDidDataPos=1000, DcmDspDidDataRef=DID_D005_High_Quiescent_Current_Fault_Identification_Data_Functionality_Activity_Level_Detect_DC_Bus_voltage_Abnormal3st  # Diagnostics Data Import
              Functionality_Activity_Level_Detect_Motor_Speed_Abnormal_3st: DcmDspDidDataPos=992, DcmDspDidDataRef=DID_D005_High_Quiescent_Current_Fault_Identification_Data_Functionality_Activity_Level_Detect_Motor_Speed_Abnormal_3st  # Diagnostics Data Import
              Functionality_Activity_Level_Detect_CPSR_Keep_Active_3st: DcmDspDidDataPos=984, DcmDspDidDataRef=DID_D005_High_Quiescent_Current_Fault_Identification_Data_Functionality_Activity_Level_Detect_CPSR_Keep_Active_3st  # Diagnostics Data Import
              Reserved_PNC_3st: DcmDspDidDataPos=928, DcmDspDidDataRef=DID_D005_High_Quiescent_Current_Fault_Identification_Data_Reserved_PNC_3st  # Diagnostics Data Import
              D005_3st_Functionality_Activity_Level_PNC39: DcmDspDidDataPos=920, DcmDspDidDataRef=DID_D005_High_Quiescent_Current_Fault_Identification_Data_D005_3st_Functionality_Activity_Level_PNC39  # Diagnostics Data Import
              D005_3st_Functionality_Activity_Level_PNC35: DcmDspDidDataPos=912, DcmDspDidDataRef=DID_D005_High_Quiescent_Current_Fault_Identification_Data_D005_3st_Functionality_Activity_Level_PNC35  # Diagnostics Data Import
              D005_3st_Functionality_Activity_Level_PNC30: DcmDspDidDataPos=904, DcmDspDidDataRef=DID_D005_High_Quiescent_Current_Fault_Identification_Data_D005_3st_Functionality_Activity_Level_PNC30  # Diagnostics Data Import
              D005_3st_Functionality_Activity_Level_PNC29: DcmDspDidDataPos=896, DcmDspDidDataRef=DID_D005_High_Quiescent_Current_Fault_Identification_Data_D005_3st_Functionality_Activity_Level_PNC29  # Diagnostics Data Import
              D005_3st_Functionality_Activity_Level_PNC27: DcmDspDidDataPos=888, DcmDspDidDataRef=DID_D005_High_Quiescent_Current_Fault_Identification_Data_D005_3st_Functionality_Activity_Level_PNC27  # Diagnostics Data Import
              D005_3st_Functionality_Activity_Level_PNC26: DcmDspDidDataPos=880, DcmDspDidDataRef=DID_D005_High_Quiescent_Current_Fault_Identification_Data_D005_3st_Functionality_Activity_Level_PNC26  # Diagnostics Data Import
              D005_3st_Functionality_Activity_Level_PNC25: DcmDspDidDataPos=872, DcmDspDidDataRef=DID_D005_High_Quiescent_Current_Fault_Identification_Data_D005_3st_Functionality_Activity_Level_PNC25  # Diagnostics Data Import
              D005_3st_Functionality_Activity_Level_PNC24: DcmDspDidDataPos=864, DcmDspDidDataRef=DID_D005_High_Quiescent_Current_Fault_Identification_Data_D005_3st_Functionality_Activity_Level_PNC24  # Diagnostics Data Import
              DID_D005_3st_Global_time_when_Functionality_Activity_level_Sleep_in_the_ECU: DcmDspDidDataPos=832, DcmDspDidDataRef=DID_D005_High_Quiescent_Current_Fault_Identification_Data_DID_D005_3st_Global_time_when_Functionality_Activity_level_Slefec137d1  # Diagnostics Data Import
              DID_D005_3st_System_Global_Time_the_time_when_the_DID_is_triggered: DcmDspDidDataPos=800, DcmDspDidDataRef=DID_D005_High_Quiescent_Current_Fault_Identification_Data_DID_D005_3st_System_Global_Time_the_time_when_the_DID_is_triggered  # Diagnostics Data Import
              DID_D005_2st_Usage_Mode_when_DID_is_triggered: DcmDspDidDataPos=792, DcmDspDidDataRef=DID_D005_High_Quiescent_Current_Fault_Identification_Data_DID_D005_2st_Usage_Mode_when_DID_is_triggered  # Diagnostics Data Import
              Bitfield_2th: DcmDspDidDataPos=784, DcmDspDidDataRef=DID_D005_High_Quiescent_Current_Fault_Identification_Data_Bitfield_2th  # Diagnostics Data Import
              Reserved_Data_Field_2st: DcmDspDidDataPos=608, DcmDspDidDataRef=DID_D005_High_Quiescent_Current_Fault_Identification_Data_Reserved_Data_Field_2st  # Diagnostics Data Import
              Functionality_Activity_Level_Detect_DC_Bus_voltage_Abnormal_2st: DcmDspDidDataPos=600, DcmDspDidDataRef=DID_D005_High_Quiescent_Current_Fault_Identification_Data_Functionality_Activity_Level_Detect_DC_Bus_voltage_Abnormal_2st  # Diagnostics Data Import
              Functionality_Activity_Level_Detect_Motor_Speed_Abnormal_2st: DcmDspDidDataPos=592, DcmDspDidDataRef=DID_D005_High_Quiescent_Current_Fault_Identification_Data_Functionality_Activity_Level_Detect_Motor_Speed_Abnormal_2st  # Diagnostics Data Import
              Functionality_Activity_Level_Detect_CPSR_Keep_Active_2st: DcmDspDidDataPos=584, DcmDspDidDataRef=DID_D005_High_Quiescent_Current_Fault_Identification_Data_Functionality_Activity_Level_Detect_CPSR_Keep_Active_2st  # Diagnostics Data Import
              Reserved_PNC_2st: DcmDspDidDataPos=528, DcmDspDidDataRef=DID_D005_High_Quiescent_Current_Fault_Identification_Data_Reserved_PNC_2st  # Diagnostics Data Import
              D005_2st_Functionality_Activity_Level_PNC39: DcmDspDidDataPos=520, DcmDspDidDataRef=DID_D005_High_Quiescent_Current_Fault_Identification_Data_D005_2st_Functionality_Activity_Level_PNC39  # Diagnostics Data Import
              D005_2st_Functionality_Activity_Level_PNC35: DcmDspDidDataPos=512, DcmDspDidDataRef=DID_D005_High_Quiescent_Current_Fault_Identification_Data_D005_2st_Functionality_Activity_Level_PNC35  # Diagnostics Data Import
              D005_2st_Functionality_Activity_Level_PNC30: DcmDspDidDataPos=504, DcmDspDidDataRef=DID_D005_High_Quiescent_Current_Fault_Identification_Data_D005_2st_Functionality_Activity_Level_PNC30  # Diagnostics Data Import
              D005_2st_Functionality_Activity_Level_PNC29: DcmDspDidDataPos=496, DcmDspDidDataRef=DID_D005_High_Quiescent_Current_Fault_Identification_Data_D005_2st_Functionality_Activity_Level_PNC29  # Diagnostics Data Import
              D005_2st_Functionality_Activity_Level_PNC27: DcmDspDidDataPos=488, DcmDspDidDataRef=DID_D005_High_Quiescent_Current_Fault_Identification_Data_D005_2st_Functionality_Activity_Level_PNC27  # Diagnostics Data Import
              D005_2st_Functionality_Activity_Level_PNC26: DcmDspDidDataPos=480, DcmDspDidDataRef=DID_D005_High_Quiescent_Current_Fault_Identification_Data_D005_2st_Functionality_Activity_Level_PNC26  # Diagnostics Data Import
              D005_2st_Functionality_Activity_Level_PNC25: DcmDspDidDataPos=472, DcmDspDidDataRef=DID_D005_High_Quiescent_Current_Fault_Identification_Data_D005_2st_Functionality_Activity_Level_PNC25  # Diagnostics Data Import
              D005_2st_Functionality_Activity_Level_PNC24: DcmDspDidDataPos=464, DcmDspDidDataRef=DID_D005_High_Quiescent_Current_Fault_Identification_Data_D005_2st_Functionality_Activity_Level_PNC24  # Diagnostics Data Import
              DID_D005_2st_Global_time_when_Functionality_Activity_level_Sleep_in_the_ECU: DcmDspDidDataPos=432, DcmDspDidDataRef=DID_D005_High_Quiescent_Current_Fault_Identification_Data_DID_D005_2st_Global_time_when_Functionality_Activity_level_Sleb7289ace  # Diagnostics Data Import
              DID_D005_2st_System_Global_Time_the_time_when_the_DID_is_triggered: DcmDspDidDataPos=400, DcmDspDidDataRef=DID_D005_High_Quiescent_Current_Fault_Identification_Data_DID_D005_2st_System_Global_Time_the_time_when_the_DID_is_triggered  # Diagnostics Data Import
              DID_D005_1st_Usage_Mode_when_DID_is_triggered: DcmDspDidDataPos=392, DcmDspDidDataRef=DID_D005_High_Quiescent_Current_Fault_Identification_Data_DID_D005_1st_Usage_Mode_when_DID_is_triggered  # Diagnostics Data Import
              Bitfield_1th: DcmDspDidDataPos=384, DcmDspDidDataRef=DID_D005_High_Quiescent_Current_Fault_Identification_Data_Bitfield_1th  # Diagnostics Data Import
              Reserved_Data_Field_1st: DcmDspDidDataPos=208, DcmDspDidDataRef=DID_D005_High_Quiescent_Current_Fault_Identification_Data_Reserved_Data_Field_1st  # Diagnostics Data Import
              Functionality_Activity_Level_Detect_DC_Bus_voltage_Abnormal_1st: DcmDspDidDataPos=200, DcmDspDidDataRef=DID_D005_High_Quiescent_Current_Fault_Identification_Data_Functionality_Activity_Level_Detect_DC_Bus_voltage_Abnormal_1st  # Diagnostics Data Import
              Functionality_Activity_Level_Detect_Motor_Speed_Abnormal_1st: DcmDspDidDataPos=192, DcmDspDidDataRef=DID_D005_High_Quiescent_Current_Fault_Identification_Data_Functionality_Activity_Level_Detect_Motor_Speed_Abnormal_1st  # Diagnostics Data Import
              Functionality_Activity_Level_Detect_CPSR_Keep_Active_1st: DcmDspDidDataPos=184, DcmDspDidDataRef=DID_D005_High_Quiescent_Current_Fault_Identification_Data_Functionality_Activity_Level_Detect_CPSR_Keep_Active_1st  # Diagnostics Data Import
              Reserved_PNC_1st: DcmDspDidDataPos=128, DcmDspDidDataRef=DID_D005_High_Quiescent_Current_Fault_Identification_Data_Reserved_PNC_1st  # Diagnostics Data Import
              D005_1st_Functionality_Activity_Level_PNC39: DcmDspDidDataPos=120, DcmDspDidDataRef=DID_D005_High_Quiescent_Current_Fault_Identification_Data_D005_1st_Functionality_Activity_Level_PNC39  # Diagnostics Data Import
              D005_1st_Functionality_Activity_Level_PNC35: DcmDspDidDataPos=112, DcmDspDidDataRef=DID_D005_High_Quiescent_Current_Fault_Identification_Data_D005_1st_Functionality_Activity_Level_PNC35  # Diagnostics Data Import
              D005_1st_Functionality_Activity_Level_PNC30: DcmDspDidDataPos=104, DcmDspDidDataRef=DID_D005_High_Quiescent_Current_Fault_Identification_Data_D005_1st_Functionality_Activity_Level_PNC30  # Diagnostics Data Import
              D005_1st_Functionality_Activity_Level_PNC29: DcmDspDidDataPos=96, DcmDspDidDataRef=DID_D005_High_Quiescent_Current_Fault_Identification_Data_D005_1st_Functionality_Activity_Level_PNC29  # Diagnostics Data Import
              D005_1st_Functionality_Activity_Level_PNC27: DcmDspDidDataPos=88, DcmDspDidDataRef=DID_D005_High_Quiescent_Current_Fault_Identification_Data_D005_1st_Functionality_Activity_Level_PNC27  # Diagnostics Data Import
              D005_1st_Functionality_Activity_Level_PNC26: DcmDspDidDataPos=80, DcmDspDidDataRef=DID_D005_High_Quiescent_Current_Fault_Identification_Data_D005_1st_Functionality_Activity_Level_PNC26  # Diagnostics Data Import
              D005_1st_Functionality_Activity_Level_PNC25: DcmDspDidDataPos=72, DcmDspDidDataRef=DID_D005_High_Quiescent_Current_Fault_Identification_Data_D005_1st_Functionality_Activity_Level_PNC25  # Diagnostics Data Import
              D005_1st_Functionality_Activity_Level_PNC24: DcmDspDidDataPos=64, DcmDspDidDataRef=DID_D005_High_Quiescent_Current_Fault_Identification_Data_D005_1st_Functionality_Activity_Level_PNC24  # Diagnostics Data Import
              DID_D005_2_1st_Global_time_when_Functionality_Activity_level_Sleep_in_the_ECU: DcmDspDidDataPos=32, DcmDspDidDataRef=DID_D005_High_Quiescent_Current_Fault_Identification_Data_DID_D005_2_1st_Global_time_when_Functionality_Activity_level_Sa38038bb  # Diagnostics Data Import
              DID_D005_1_1st_System_Global_Time_the_time_when_the_DID_is_triggered: DcmDspDidDataPos=0, DcmDspDidDataRef=DID_D005_High_Quiescent_Current_Fault_Identification_Data_DID_D005_1_1st_System_Global_Time_the_time_when_the_DID_is_triggered  # Diagnostics Data Import
          DID_D003_Vehicle_Speed: DcmDspDidIdentifier=53251, DcmDspDidInfoRef=DidInfo_DID_D003_Vehicle_Speed  # Diagnostics Data Import
            DID_D003_Vehicle_Speed (DcmDspDidSignal): DcmDspDidDataPos=0, DcmDspDidDataRef=DID_D003_Vehicle_Speed_DID_D003_Vehicle_Speed  # Diagnostics Data Import
          DID_40E0_Secret_Key_Immobilizer_Target_3: DcmDspDidIdentifier=16607, DcmDspDidInfoRef=DidInfo_DID_40E0_Secret_Key_Immobilizer_Target_3  # Diagnostics Data Import
            DID_40DF_Secret_Key_Immobilizer_Target_2 (DcmDspDidSignal): DcmDspDidDataPos=0, DcmDspDidDataRef=DID_40E0_Secret_Key_Immobilizer_Target_3_DID_40DF_Secret_Key_Immobilizer_Target_2  # Diagnostics Data Import
        DataInfo_DID_F1AF_ECU_Software_Extended_Part_Numbers_Geely_ASCII_part_003 (DcmDspDataInfo): DcmDspDataFixedLength=true  # Diagnostics Data Import
        DID_F1AF_ECU_Software_Extended_Part_Numbers_Geely_ASCII_part_003 (DcmDspData): DcmDspDataSize=24, DcmDspDataType=UINT8_N, DcmDspDataInfoRef=DataInfo_DID_F1AF_ECU_Software_Extended_Part_Numbers_Geely_ASCII_part_003  # Diagnostics Data Import
        DataInfo_DID_F1AF_ECU_Software_Extended_Part_Numbers_Geely_BCD_part_003 (DcmDspDataInfo): DcmDspDataFixedLength=true  # Diagnostics Data Import
        DID_F1AF_ECU_Software_Extended_Part_Numbers_Geely_BCD_part_003 (DcmDspData): DcmDspDataSize=40, DcmDspDataType=UINT8_N, DcmDspDataInfoRef=DataInfo_DID_F1AF_ECU_Software_Extended_Part_Numbers_Geely_BCD_part_003  # Diagnostics Data Import
        DataInfo_DID_F1AF_ECU_Software_Extended_Part_Numbers_Geely_ASCII_part_002 (DcmDspDataInfo): DcmDspDataFixedLength=true  # Diagnostics Data Import
        DID_F1AF_ECU_Software_Extended_Part_Numbers_Geely_ASCII_part_002 (DcmDspData): DcmDspDataSize=24, DcmDspDataType=UINT8_N, DcmDspDataInfoRef=DataInfo_DID_F1AF_ECU_Software_Extended_Part_Numbers_Geely_ASCII_part_002  # Diagnostics Data Import
        DataInfo_DID_F1AF_ECU_Software_Extended_Part_Numbers_Geely_BCD_part_002 (DcmDspDataInfo): DcmDspDataFixedLength=true  # Diagnostics Data Import
        DID_F1AF_ECU_Software_Extended_Part_Numbers_Geely_BCD_part_002 (DcmDspData): DcmDspDataSize=40, DcmDspDataType=UINT8_N, DcmDspDataInfoRef=DataInfo_DID_F1AF_ECU_Software_Extended_Part_Numbers_Geely_BCD_part_002  # Diagnostics Data Import
        DataInfo_DID_F1AF_ECU_Software_Extended_Part_Numbers_Geely_ASCII_part_001 (DcmDspDataInfo): DcmDspDataFixedLength=true  # Diagnostics Data Import
        DID_F1AF_ECU_Software_Extended_Part_Numbers_Geely_ASCII_part_001 (DcmDspData): DcmDspDataSize=24, DcmDspDataType=UINT8_N, DcmDspDataInfoRef=DataInfo_DID_F1AF_ECU_Software_Extended_Part_Numbers_Geely_ASCII_part_001  # Diagnostics Data Import
        DataInfo_DID_F1AF_ECU_Software_Extended_Part_Numbers_Geely_BCD_part_001 (DcmDspDataInfo): DcmDspDataFixedLength=true  # Diagnostics Data Import
        DID_F1AF_ECU_Software_Extended_Part_Numbers_Geely_BCD_part_001 (DcmDspData): DcmDspDataSize=40, DcmDspDataType=UINT8_N, DcmDspDataInfoRef=DataInfo_DID_F1AF_ECU_Software_Extended_Part_Numbers_Geely_BCD_part_001  # Diagnostics Data Import
        DataInfo_DID_F1AF_ECU_Software_Extended_Part_Numbers_Geely_ASCII_part (DcmDspDataInfo): DcmDspDataFixedLength=true  # Diagnostics Data Import
        DID_F1AF_ECU_Software_Extended_Part_Numbers_Geely_ASCII_part (DcmDspData): DcmDspDataSize=24, DcmDspDataType=UINT8_N, DcmDspDataInfoRef=DataInfo_DID_F1AF_ECU_Software_Extended_Part_Numbers_Geely_ASCII_part  # Diagnostics Data Import
        DataInfo_DID_F1AF_ECU_Software_Extended_Part_Numbers_Geely_BCD_part (DcmDspDataInfo): DcmDspDataFixedLength=true  # Diagnostics Data Import
        DID_F1AF_ECU_Software_Extended_Part_Numbers_Geely_BCD_part (DcmDspData): DcmDspDataSize=40, DcmDspDataType=UINT8_N, DcmDspDataInfoRef=DataInfo_DID_F1AF_ECU_Software_Extended_Part_Numbers_Geely_BCD_part  # Diagnostics Data Import
        DataInfo_DID_F1AF_ECU_Software_Extended_Part_Numbers_Geely_DID_F1AF_1_Total_number_of_ECU_Software_Part_Numbers (DcmDspDataInfo): DcmDspDataFixedLength=true  # Diagnostics Data Import
        DID_F1AF_ECU_Software_Extended_Part_Numbers_Geely_DID_F1AF_1_Total_number_of_ECU_Software_Part_Numbers (DcmDspData):  # Diagnostics Data Import
          DcmDspDataSize = 8
          DcmDspDataType = UINT8
          DcmDspDataInfoRef = DataInfo_DID_F1AF_ECU_Software_Extended_Part_Numbers_Geely_DID_F1AF_1_Total_number_of_ECU_Software_Part_Numbers
        DataInfo_DID_F1AE_ECU_Software_Part_Numbers_Geely_ASCII_part (DcmDspDataInfo): DcmDspDataFixedLength=true  # Diagnostics Data Import
        DID_F1AE_ECU_Software_Part_Numbers_Geely_ASCII_part (DcmDspData): DcmDspDataSize=24, DcmDspDataType=UINT8_N, DcmDspDataInfoRef=DataInfo_DID_F1AE_ECU_Software_Part_Numbers_Geely_ASCII_part  # Diagnostics Data Import
        DataInfo_DID_F1AE_ECU_Software_Part_Numbers_Geely_BCD_part (DcmDspDataInfo): DcmDspDataFixedLength=true  # Diagnostics Data Import
        DID_F1AE_ECU_Software_Part_Numbers_Geely_BCD_part (DcmDspData): DcmDspDataSize=40, DcmDspDataType=UINT8_N, DcmDspDataInfoRef=DataInfo_DID_F1AE_ECU_Software_Part_Numbers_Geely_BCD_part  # Diagnostics Data Import
        DataInfo_DID_F1AE_ECU_Software_Part_Numbers_Geely_DID_F1AE_1_Total_number_of_ECU_Software_Part_Numbers (DcmDspDataInfo): DcmDspDataFixedLength=true  # Diagnostics Data Import
        DID_F1AE_ECU_Software_Part_Numbers_Geely_DID_F1AE_1_Total_number_of_ECU_Software_Part_Numbers (DcmDspData):  # Diagnostics Data Import
          DcmDspDataSize = 8
          DcmDspDataType = UINT8
          DcmDspDataInfoRef = DataInfo_DID_F1AE_ECU_Software_Part_Numbers_Geely_DID_F1AE_1_Total_number_of_ECU_Software_Part_Numbers
        DataInfo_DID_F1AB_ECU_Delivery_Assembly_Part_Number_Geely_ASCII_part (DcmDspDataInfo): DcmDspDataFixedLength=true  # Diagnostics Data Import
        DID_F1AB_ECU_Delivery_Assembly_Part_Number_Geely_ASCII_part (DcmDspData): DcmDspDataSize=24, DcmDspDataType=UINT8_N, DcmDspDataInfoRef=DataInfo_DID_F1AB_ECU_Delivery_Assembly_Part_Number_Geely_ASCII_part  # Diagnostics Data Import
        DataInfo_DID_F1AB_ECU_Delivery_Assembly_Part_Number_Geely_BCD_part (DcmDspDataInfo): DcmDspDataFixedLength=true  # Diagnostics Data Import
        DID_F1AB_ECU_Delivery_Assembly_Part_Number_Geely_BCD_part (DcmDspData): DcmDspDataSize=40, DcmDspDataType=UINT8_N, DcmDspDataInfoRef=DataInfo_DID_F1AB_ECU_Delivery_Assembly_Part_Number_Geely_BCD_part  # Diagnostics Data Import
        DataInfo_DID_F1AA_ECU_Core_Assembly_Part_Number_Geely_ASCII_part (DcmDspDataInfo): DcmDspDataFixedLength=true  # Diagnostics Data Import
        DID_F1AA_ECU_Core_Assembly_Part_Number_Geely_ASCII_part (DcmDspData): DcmDspDataSize=24, DcmDspDataType=UINT8_N, DcmDspDataInfoRef=DataInfo_DID_F1AA_ECU_Core_Assembly_Part_Number_Geely_ASCII_part  # Diagnostics Data Import
        DataInfo_DID_F1AA_ECU_Core_Assembly_Part_Number_Geely_BCD_part (DcmDspDataInfo): DcmDspDataFixedLength=true  # Diagnostics Data Import
        DID_F1AA_ECU_Core_Assembly_Part_Number_Geely_BCD_part (DcmDspData): DcmDspDataSize=40, DcmDspDataType=UINT8_N, DcmDspDataInfoRef=DataInfo_DID_F1AA_ECU_Core_Assembly_Part_Number_Geely_BCD_part  # Diagnostics Data Import
        DataInfo_DID_F1A5_Primary_Bootloader_Software_Part_Number_Geely_ASCII_part (DcmDspDataInfo): DcmDspDataFixedLength=true  # Diagnostics Data Import
        DID_F1A5_Primary_Bootloader_Software_Part_Number_Geely_ASCII_part (DcmDspData): DcmDspDataSize=24, DcmDspDataType=UINT8_N, DcmDspDataInfoRef=DataInfo_DID_F1A5_Primary_Bootloader_Software_Part_Number_Geely_ASCII_part  # Diagnostics Data Import
        DataInfo_DID_F1A5_Primary_Bootloader_Software_Part_Number_Geely_BCD_part (DcmDspDataInfo): DcmDspDataFixedLength=true  # Diagnostics Data Import
        DID_F1A5_Primary_Bootloader_Software_Part_Number_Geely_BCD_part (DcmDspData): DcmDspDataSize=40, DcmDspDataType=UINT8_N, DcmDspDataInfoRef=DataInfo_DID_F1A5_Primary_Bootloader_Software_Part_Number_Geely_BCD_part  # Diagnostics Data Import
        DataInfo_DID_F1A1_Primary_Bootloader_Diagnostic_Database_Part_Number_Geely_ASCII_part (DcmDspDataInfo): DcmDspDataFixedLength=true  # Diagnostics Data Import
        DID_F1A1_Primary_Bootloader_Diagnostic_Database_Part_Number_Geely_ASCII_part (DcmDspData):  # Diagnostics Data Import
          DcmDspDataSize = 24
          DcmDspDataType = UINT8_N
          DcmDspDataInfoRef = DataInfo_DID_F1A1_Primary_Bootloader_Diagnostic_Database_Part_Number_Geely_ASCII_part
        DataInfo_DID_F1A1_Primary_Bootloader_Diagnostic_Database_Part_Number_Geely_BCD_part (DcmDspDataInfo): DcmDspDataFixedLength=true  # Diagnostics Data Import
        DID_F1A1_Primary_Bootloader_Diagnostic_Database_Part_Number_Geely_BCD_part (DcmDspData): DcmDspDataSize=40, DcmDspDataType=UINT8_N, DcmDspDataInfoRef=DataInfo_DID_F1A1_Primary_Bootloader_Diagnostic_Database_Part_Number_Geely_BCD_part  # Diagnostics Data Import
        DataInfo_DID_F1A0_Application_Diagnostic_Database_Part_Number_Geely_ASCII_part (DcmDspDataInfo): DcmDspDataFixedLength=true  # Diagnostics Data Import
        DID_F1A0_Application_Diagnostic_Database_Part_Number_Geely_ASCII_part (DcmDspData): DcmDspDataSize=24, DcmDspDataType=UINT8_N, DcmDspDataInfoRef=DataInfo_DID_F1A0_Application_Diagnostic_Database_Part_Number_Geely_ASCII_part  # Diagnostics Data Import
        DataInfo_DID_F1A0_Application_Diagnostic_Database_Part_Number_Geely_BCD_part (DcmDspDataInfo): DcmDspDataFixedLength=true  # Diagnostics Data Import
        DID_F1A0_Application_Diagnostic_Database_Part_Number_Geely_BCD_part (DcmDspData): DcmDspDataSize=40, DcmDspDataType=UINT8_N, DcmDspDataInfoRef=DataInfo_DID_F1A0_Application_Diagnostic_Database_Part_Number_Geely_BCD_part  # Diagnostics Data Import
        DataInfo_DID_F18C_ECU_Serial_Number_DID_F18C_ECU_Serial_Number (DcmDspDataInfo): DcmDspDataFixedLength=true  # Diagnostics Data Import
        DID_F18C_ECU_Serial_Number_DID_F18C_ECU_Serial_Number (DcmDspData): DcmDspDataSize=32, DcmDspDataType=UINT32, DcmDspDataInfoRef=DataInfo_DID_F18C_ECU_Serial_Number_DID_F18C_ECU_Serial_Number  # Diagnostics Data Import
        DataInfo_DID_F186_Active_Diagnostic_Session_DID_F186_Active_Diagnostic_Session (DcmDspDataInfo): DcmDspDataFixedLength=true  # Diagnostics Data Import
        DID_F186_Active_Diagnostic_Session_DID_F186_Active_Diagnostic_Session (DcmDspData): DcmDspDataSize=8, DcmDspDataType=UINT8, DcmDspDataInfoRef=DataInfo_DID_F186_Active_Diagnostic_Session_DID_F186_Active_Diagnostic_Session  # Diagnostics Data Import
        DataInfo_DID_F12F_ECU_Software_Extended_Part_Numbers_ASCII_part_009 (DcmDspDataInfo): DcmDspDataFixedLength=true  # Diagnostics Data Import
        DID_F12F_ECU_Software_Extended_Part_Numbers_ASCII_part_009 (DcmDspData): DcmDspDataSize=24, DcmDspDataType=UINT8_N, DcmDspDataInfoRef=DataInfo_DID_F12F_ECU_Software_Extended_Part_Numbers_ASCII_part_009  # Diagnostics Data Import
        DataInfo_DID_F12F_ECU_Software_Extended_Part_Numbers_BCD_part_009 (DcmDspDataInfo): DcmDspDataFixedLength=true  # Diagnostics Data Import
        DID_F12F_ECU_Software_Extended_Part_Numbers_BCD_part_009 (DcmDspData): DcmDspDataSize=32, DcmDspDataType=UINT32, DcmDspDataInfoRef=DataInfo_DID_F12F_ECU_Software_Extended_Part_Numbers_BCD_part_009  # Diagnostics Data Import
        DataInfo_DID_F12F_ECU_Software_Extended_Part_Numbers_ASCII_part_008 (DcmDspDataInfo): DcmDspDataFixedLength=true  # Diagnostics Data Import
        DID_F12F_ECU_Software_Extended_Part_Numbers_ASCII_part_008 (DcmDspData): DcmDspDataSize=24, DcmDspDataType=UINT8_N, DcmDspDataInfoRef=DataInfo_DID_F12F_ECU_Software_Extended_Part_Numbers_ASCII_part_008  # Diagnostics Data Import
        DataInfo_DID_F12F_ECU_Software_Extended_Part_Numbers_BCD_part_008 (DcmDspDataInfo): DcmDspDataFixedLength=true  # Diagnostics Data Import
        DID_F12F_ECU_Software_Extended_Part_Numbers_BCD_part_008 (DcmDspData): DcmDspDataSize=32, DcmDspDataType=UINT32, DcmDspDataInfoRef=DataInfo_DID_F12F_ECU_Software_Extended_Part_Numbers_BCD_part_008  # Diagnostics Data Import
        DataInfo_DID_F12F_ECU_Software_Extended_Part_Numbers_ASCII_part_007 (DcmDspDataInfo): DcmDspDataFixedLength=true  # Diagnostics Data Import
        DID_F12F_ECU_Software_Extended_Part_Numbers_ASCII_part_007 (DcmDspData): DcmDspDataSize=24, DcmDspDataType=UINT8_N, DcmDspDataInfoRef=DataInfo_DID_F12F_ECU_Software_Extended_Part_Numbers_ASCII_part_007  # Diagnostics Data Import
        DataInfo_DID_F12F_ECU_Software_Extended_Part_Numbers_BCD_part_007 (DcmDspDataInfo): DcmDspDataFixedLength=true  # Diagnostics Data Import
        DID_F12F_ECU_Software_Extended_Part_Numbers_BCD_part_007 (DcmDspData): DcmDspDataSize=32, DcmDspDataType=UINT32, DcmDspDataInfoRef=DataInfo_DID_F12F_ECU_Software_Extended_Part_Numbers_BCD_part_007  # Diagnostics Data Import
        DataInfo_DID_F12F_ECU_Software_Extended_Part_Numbers_ASCII_part_006 (DcmDspDataInfo): DcmDspDataFixedLength=true  # Diagnostics Data Import
        DID_F12F_ECU_Software_Extended_Part_Numbers_ASCII_part_006 (DcmDspData): DcmDspDataSize=24, DcmDspDataType=UINT8_N, DcmDspDataInfoRef=DataInfo_DID_F12F_ECU_Software_Extended_Part_Numbers_ASCII_part_006  # Diagnostics Data Import
        DataInfo_DID_F12F_ECU_Software_Extended_Part_Numbers_BCD_part_006 (DcmDspDataInfo): DcmDspDataFixedLength=true  # Diagnostics Data Import
        DID_F12F_ECU_Software_Extended_Part_Numbers_BCD_part_006 (DcmDspData): DcmDspDataSize=32, DcmDspDataType=UINT32, DcmDspDataInfoRef=DataInfo_DID_F12F_ECU_Software_Extended_Part_Numbers_BCD_part_006  # Diagnostics Data Import
        DataInfo_DID_F12F_ECU_Software_Extended_Part_Numbers_ASCII_part_005 (DcmDspDataInfo): DcmDspDataFixedLength=true  # Diagnostics Data Import
        DID_F12F_ECU_Software_Extended_Part_Numbers_ASCII_part_005 (DcmDspData): DcmDspDataSize=24, DcmDspDataType=UINT8_N, DcmDspDataInfoRef=DataInfo_DID_F12F_ECU_Software_Extended_Part_Numbers_ASCII_part_005  # Diagnostics Data Import
        DataInfo_DID_F12F_ECU_Software_Extended_Part_Numbers_BCD_part_005 (DcmDspDataInfo): DcmDspDataFixedLength=true  # Diagnostics Data Import
        DID_F12F_ECU_Software_Extended_Part_Numbers_BCD_part_005 (DcmDspData): DcmDspDataSize=32, DcmDspDataType=UINT32, DcmDspDataInfoRef=DataInfo_DID_F12F_ECU_Software_Extended_Part_Numbers_BCD_part_005  # Diagnostics Data Import
        DataInfo_DID_F12F_ECU_Software_Extended_Part_Numbers_ASCII_part_004 (DcmDspDataInfo): DcmDspDataFixedLength=true  # Diagnostics Data Import
        DID_F12F_ECU_Software_Extended_Part_Numbers_ASCII_part_004 (DcmDspData): DcmDspDataSize=24, DcmDspDataType=UINT8_N, DcmDspDataInfoRef=DataInfo_DID_F12F_ECU_Software_Extended_Part_Numbers_ASCII_part_004  # Diagnostics Data Import
        DataInfo_DID_F12F_ECU_Software_Extended_Part_Numbers_BCD_part_004 (DcmDspDataInfo): DcmDspDataFixedLength=true  # Diagnostics Data Import
        DID_F12F_ECU_Software_Extended_Part_Numbers_BCD_part_004 (DcmDspData): DcmDspDataSize=32, DcmDspDataType=UINT32, DcmDspDataInfoRef=DataInfo_DID_F12F_ECU_Software_Extended_Part_Numbers_BCD_part_004  # Diagnostics Data Import
        DataInfo_DID_F12F_ECU_Software_Extended_Part_Numbers_ASCII_part_003 (DcmDspDataInfo): DcmDspDataFixedLength=true  # Diagnostics Data Import
        DID_F12F_ECU_Software_Extended_Part_Numbers_ASCII_part_003 (DcmDspData): DcmDspDataSize=24, DcmDspDataType=UINT8_N, DcmDspDataInfoRef=DataInfo_DID_F12F_ECU_Software_Extended_Part_Numbers_ASCII_part_003  # Diagnostics Data Import
        DataInfo_DID_F12F_ECU_Software_Extended_Part_Numbers_BCD_part_003 (DcmDspDataInfo): DcmDspDataFixedLength=true  # Diagnostics Data Import
        DID_F12F_ECU_Software_Extended_Part_Numbers_BCD_part_003 (DcmDspData): DcmDspDataSize=32, DcmDspDataType=UINT32, DcmDspDataInfoRef=DataInfo_DID_F12F_ECU_Software_Extended_Part_Numbers_BCD_part_003  # Diagnostics Data Import
        DataInfo_DID_F12F_ECU_Software_Extended_Part_Numbers_ASCII_part_002 (DcmDspDataInfo): DcmDspDataFixedLength=true  # Diagnostics Data Import
        DID_F12F_ECU_Software_Extended_Part_Numbers_ASCII_part_002 (DcmDspData): DcmDspDataSize=24, DcmDspDataType=UINT8_N, DcmDspDataInfoRef=DataInfo_DID_F12F_ECU_Software_Extended_Part_Numbers_ASCII_part_002  # Diagnostics Data Import
        DataInfo_DID_F12F_ECU_Software_Extended_Part_Numbers_BCD_part_002 (DcmDspDataInfo): DcmDspDataFixedLength=true  # Diagnostics Data Import
        DID_F12F_ECU_Software_Extended_Part_Numbers_BCD_part_002 (DcmDspData): DcmDspDataSize=32, DcmDspDataType=UINT32, DcmDspDataInfoRef=DataInfo_DID_F12F_ECU_Software_Extended_Part_Numbers_BCD_part_002  # Diagnostics Data Import
        DataInfo_DID_F12F_ECU_Software_Extended_Part_Numbers_ASCII_part_001 (DcmDspDataInfo): DcmDspDataFixedLength=true  # Diagnostics Data Import
        DID_F12F_ECU_Software_Extended_Part_Numbers_ASCII_part_001 (DcmDspData): DcmDspDataSize=24, DcmDspDataType=UINT8_N, DcmDspDataInfoRef=DataInfo_DID_F12F_ECU_Software_Extended_Part_Numbers_ASCII_part_001  # Diagnostics Data Import
        DataInfo_DID_F12F_ECU_Software_Extended_Part_Numbers_BCD_part_001 (DcmDspDataInfo): DcmDspDataFixedLength=true  # Diagnostics Data Import
        DID_F12F_ECU_Software_Extended_Part_Numbers_BCD_part_001 (DcmDspData): DcmDspDataSize=32, DcmDspDataType=UINT32, DcmDspDataInfoRef=DataInfo_DID_F12F_ECU_Software_Extended_Part_Numbers_BCD_part_001  # Diagnostics Data Import
        DataInfo_DID_F12F_ECU_Software_Extended_Part_Numbers_ASCII_part (DcmDspDataInfo): DcmDspDataFixedLength=true  # Diagnostics Data Import
        DID_F12F_ECU_Software_Extended_Part_Numbers_ASCII_part (DcmDspData): DcmDspDataSize=24, DcmDspDataType=UINT8_N, DcmDspDataInfoRef=DataInfo_DID_F12F_ECU_Software_Extended_Part_Numbers_ASCII_part  # Diagnostics Data Import
        DataInfo_DID_F12F_ECU_Software_Extended_Part_Numbers_BCD_part (DcmDspDataInfo): DcmDspDataFixedLength=true  # Diagnostics Data Import
        DID_F12F_ECU_Software_Extended_Part_Numbers_BCD_part (DcmDspData): DcmDspDataSize=32, DcmDspDataType=UINT32, DcmDspDataInfoRef=DataInfo_DID_F12F_ECU_Software_Extended_Part_Numbers_BCD_part  # Diagnostics Data Import
        DataInfo_DID_F12F_ECU_Software_Extended_Part_Numbers_DID_F12F_1_Total_number_of_ECU_Software_Part_Numbers (DcmDspDataInfo): DcmDspDataFixedLength=true  # Diagnostics Data Import
        DID_F12F_ECU_Software_Extended_Part_Numbers_DID_F12F_1_Total_number_of_ECU_Software_Part_Numbers (DcmDspData):  # Diagnostics Data Import
          DcmDspDataSize = 8
          DcmDspDataType = UINT8
          DcmDspDataInfoRef = DataInfo_DID_F12F_ECU_Software_Extended_Part_Numbers_DID_F12F_1_Total_number_of_ECU_Software_Part_Numbers
        DataInfo_DID_F12E_ECU_Software_Part_Numbers_ASCII_part (DcmDspDataInfo): DcmDspDataFixedLength=true  # Diagnostics Data Import
        DID_F12E_ECU_Software_Part_Numbers_ASCII_part (DcmDspData): DcmDspDataSize=24, DcmDspDataType=UINT8_N, DcmDspDataInfoRef=DataInfo_DID_F12E_ECU_Software_Part_Numbers_ASCII_part  # Diagnostics Data Import
        DataInfo_DID_F12E_ECU_Software_Part_Numbers_BCD_part (DcmDspDataInfo): DcmDspDataFixedLength=true  # Diagnostics Data Import
        DID_F12E_ECU_Software_Part_Numbers_BCD_part (DcmDspData): DcmDspDataSize=32, DcmDspDataType=UINT32, DcmDspDataInfoRef=DataInfo_DID_F12E_ECU_Software_Part_Numbers_BCD_part  # Diagnostics Data Import
        DataInfo_DID_F12E_ECU_Software_Part_Numbers_DID_F12E_1_ECU_Software (DcmDspDataInfo): DcmDspDataFixedLength=true  # Diagnostics Data Import
        DID_F12E_ECU_Software_Part_Numbers_DID_F12E_1_ECU_Software (DcmDspData): DcmDspDataSize=8, DcmDspDataType=UINT8, DcmDspDataInfoRef=DataInfo_DID_F12E_ECU_Software_Part_Numbers_DID_F12E_1_ECU_Software  # Diagnostics Data Import
        DataInfo_DID_F12B_ECU_Delivery_Assembly_Part_Number_ASCII_part (DcmDspDataInfo): DcmDspDataFixedLength=true  # Diagnostics Data Import
        DID_F12B_ECU_Delivery_Assembly_Part_Number_ASCII_part (DcmDspData): DcmDspDataSize=24, DcmDspDataType=UINT8_N, DcmDspDataInfoRef=DataInfo_DID_F12B_ECU_Delivery_Assembly_Part_Number_ASCII_part  # Diagnostics Data Import
        DataInfo_DID_F12B_ECU_Delivery_Assembly_Part_Number_BCD_part (DcmDspDataInfo): DcmDspDataFixedLength=true  # Diagnostics Data Import
        DID_F12B_ECU_Delivery_Assembly_Part_Number_BCD_part (DcmDspData): DcmDspDataSize=32, DcmDspDataType=UINT32, DcmDspDataInfoRef=DataInfo_DID_F12B_ECU_Delivery_Assembly_Part_Number_BCD_part  # Diagnostics Data Import
        DataInfo_DID_F12A_ECU_Core_Assembly_Part_Number_ASCII_part (DcmDspDataInfo): DcmDspDataFixedLength=true  # Diagnostics Data Import
        DID_F12A_ECU_Core_Assembly_Part_Number_ASCII_part (DcmDspData): DcmDspDataSize=24, DcmDspDataType=UINT8_N, DcmDspDataInfoRef=DataInfo_DID_F12A_ECU_Core_Assembly_Part_Number_ASCII_part  # Diagnostics Data Import
        DataInfo_DID_F12A_ECU_Core_Assembly_Part_Number_BCD_part (DcmDspDataInfo): DcmDspDataFixedLength=true  # Diagnostics Data Import
        DID_F12A_ECU_Core_Assembly_Part_Number_BCD_part (DcmDspData): DcmDspDataSize=32, DcmDspDataType=UINT32, DcmDspDataInfoRef=DataInfo_DID_F12A_ECU_Core_Assembly_Part_Number_BCD_part  # Diagnostics Data Import
        DataInfo_DID_F126_Autosar_BSW_Cluster_Versions_DID_F126_45_LIN_CLUSTER_AR_RELEASE_REVISION_VERSION (DcmDspDataInfo): DcmDspDataFixedLength=true  # Diagnostics Data Import
        DID_F126_Autosar_BSW_Cluster_Versions_DID_F126_45_LIN_CLUSTER_AR_RELEASE_REVISION_VERSION (DcmDspData):  # Diagnostics Data Import
          DcmDspDataSize = 8
          DcmDspDataType = UINT8
          DcmDspDataInfoRef = DataInfo_DID_F126_Autosar_BSW_Cluster_Versions_DID_F126_45_LIN_CLUSTER_AR_RELEASE_REVISION_VERSION
        DataInfo_DID_F126_Autosar_BSW_Cluster_Versions_DID_F126_44_LIN_CLUSTER_AR_RELEASE_MINOR_VERSION (DcmDspDataInfo): DcmDspDataFixedLength=true  # Diagnostics Data Import
        DID_F126_Autosar_BSW_Cluster_Versions_DID_F126_44_LIN_CLUSTER_AR_RELEASE_MINOR_VERSION (DcmDspData):  # Diagnostics Data Import
          DcmDspDataSize = 8
          DcmDspDataType = UINT8
          DcmDspDataInfoRef = DataInfo_DID_F126_Autosar_BSW_Cluster_Versions_DID_F126_44_LIN_CLUSTER_AR_RELEASE_MINOR_VERSION
        DataInfo_DID_F126_Autosar_BSW_Cluster_Versions_DID_F126_43_LIN_CLUSTER_AR_RELEASE_MAJOR_VERSION (DcmDspDataInfo): DcmDspDataFixedLength=true  # Diagnostics Data Import
        DID_F126_Autosar_BSW_Cluster_Versions_DID_F126_43_LIN_CLUSTER_AR_RELEASE_MAJOR_VERSION (DcmDspData):  # Diagnostics Data Import
          DcmDspDataSize = 8
          DcmDspDataType = UINT8
          DcmDspDataInfoRef = DataInfo_DID_F126_Autosar_BSW_Cluster_Versions_DID_F126_43_LIN_CLUSTER_AR_RELEASE_MAJOR_VERSION
        DataInfo_DID_F126_Autosar_BSW_Cluster_Versions_DID_F126_42_LIN_CLUSTER_SW_PATCH_VERSION (DcmDspDataInfo): DcmDspDataFixedLength=true  # Diagnostics Data Import
        DID_F126_Autosar_BSW_Cluster_Versions_DID_F126_42_LIN_CLUSTER_SW_PATCH_VERSION (DcmDspData):  # Diagnostics Data Import
          DcmDspDataSize = 8
          DcmDspDataType = UINT8
          DcmDspDataInfoRef = DataInfo_DID_F126_Autosar_BSW_Cluster_Versions_DID_F126_42_LIN_CLUSTER_SW_PATCH_VERSION
        DataInfo_DID_F126_Autosar_BSW_Cluster_Versions_DID_F126_41_LIN_CLUSTER_SW_MINOR_VERSION (DcmDspDataInfo): DcmDspDataFixedLength=true  # Diagnostics Data Import
        DID_F126_Autosar_BSW_Cluster_Versions_DID_F126_41_LIN_CLUSTER_SW_MINOR_VERSION (DcmDspData):  # Diagnostics Data Import
          DcmDspDataSize = 8
          DcmDspDataType = UINT8
          DcmDspDataInfoRef = DataInfo_DID_F126_Autosar_BSW_Cluster_Versions_DID_F126_41_LIN_CLUSTER_SW_MINOR_VERSION
        DataInfo_DID_F126_Autosar_BSW_Cluster_Versions_DID_F126_40_LIN_CLUSTER_SW_MAJOR_VERSION (DcmDspDataInfo): DcmDspDataFixedLength=true  # Diagnostics Data Import
        DID_F126_Autosar_BSW_Cluster_Versions_DID_F126_40_LIN_CLUSTER_SW_MAJOR_VERSION (DcmDspData):  # Diagnostics Data Import
          DcmDspDataSize = 8
          DcmDspDataType = UINT8
          DcmDspDataInfoRef = DataInfo_DID_F126_Autosar_BSW_Cluster_Versions_DID_F126_40_LIN_CLUSTER_SW_MAJOR_VERSION
        DataInfo_DID_F126_Autosar_BSW_Cluster_Versions_DID_F126_39_LIN_CLUSTER_VENDOR_ID (DcmDspDataInfo): DcmDspDataFixedLength=true  # Diagnostics Data Import
        DID_F126_Autosar_BSW_Cluster_Versions_DID_F126_39_LIN_CLUSTER_VENDOR_ID (DcmDspData): DcmDspDataSize=16, DcmDspDataType=UINT16, DcmDspDataInfoRef=DataInfo_DID_F126_Autosar_BSW_Cluster_Versions_DID_F126_39_LIN_CLUSTER_VENDOR_ID  # Diagnostics Data Import
        DataInfo_DID_F126_Autosar_BSW_Cluster_Versions_DID_F126_38_FLEXRAY_CLUSTER_AR_RELEASE_REVISION_VERSION (DcmDspDataInfo): DcmDspDataFixedLength=true  # Diagnostics Data Import
        DID_F126_Autosar_BSW_Cluster_Versions_DID_F126_38_FLEXRAY_CLUSTER_AR_RELEASE_REVISION_VERSION (DcmDspData):  # Diagnostics Data Import
          DcmDspDataSize = 8
          DcmDspDataType = UINT8
          DcmDspDataInfoRef = DataInfo_DID_F126_Autosar_BSW_Cluster_Versions_DID_F126_38_FLEXRAY_CLUSTER_AR_RELEASE_REVISION_VERSION
        DataInfo_DID_F126_Autosar_BSW_Cluster_Versions_DID_F126_37_FLEXRAY_CLUSTER_AR_RELEASE_MINOR_VERSION (DcmDspDataInfo): DcmDspDataFixedLength=true  # Diagnostics Data Import
        DID_F126_Autosar_BSW_Cluster_Versions_DID_F126_37_FLEXRAY_CLUSTER_AR_RELEASE_MINOR_VERSION (DcmDspData):  # Diagnostics Data Import
          DcmDspDataSize = 8
          DcmDspDataType = UINT8
          DcmDspDataInfoRef = DataInfo_DID_F126_Autosar_BSW_Cluster_Versions_DID_F126_37_FLEXRAY_CLUSTER_AR_RELEASE_MINOR_VERSION
        DataInfo_DID_F126_Autosar_BSW_Cluster_Versions_DID_F126_36_FLEXRAY_CLUSTER_AR_RELEASE_MAJOR_VERSION (DcmDspDataInfo): DcmDspDataFixedLength=true  # Diagnostics Data Import
        DID_F126_Autosar_BSW_Cluster_Versions_DID_F126_36_FLEXRAY_CLUSTER_AR_RELEASE_MAJOR_VERSION (DcmDspData):  # Diagnostics Data Import
          DcmDspDataSize = 8
          DcmDspDataType = UINT8
          DcmDspDataInfoRef = DataInfo_DID_F126_Autosar_BSW_Cluster_Versions_DID_F126_36_FLEXRAY_CLUSTER_AR_RELEASE_MAJOR_VERSION
        DataInfo_DID_F126_Autosar_BSW_Cluster_Versions_DID_F126_35_FLEXRAY_CLUSTER_SW_PATCH_VERSION (DcmDspDataInfo): DcmDspDataFixedLength=true  # Diagnostics Data Import
        DID_F126_Autosar_BSW_Cluster_Versions_DID_F126_35_FLEXRAY_CLUSTER_SW_PATCH_VERSION (DcmDspData):  # Diagnostics Data Import
          DcmDspDataSize = 8
          DcmDspDataType = UINT8
          DcmDspDataInfoRef = DataInfo_DID_F126_Autosar_BSW_Cluster_Versions_DID_F126_35_FLEXRAY_CLUSTER_SW_PATCH_VERSION
        DataInfo_DID_F126_Autosar_BSW_Cluster_Versions_DID_F126_34_FLEXRAY_CLUSTER_SW_MINOR_VERSION (DcmDspDataInfo): DcmDspDataFixedLength=true  # Diagnostics Data Import
        DID_F126_Autosar_BSW_Cluster_Versions_DID_F126_34_FLEXRAY_CLUSTER_SW_MINOR_VERSION (DcmDspData):  # Diagnostics Data Import
          DcmDspDataSize = 8
          DcmDspDataType = UINT8
          DcmDspDataInfoRef = DataInfo_DID_F126_Autosar_BSW_Cluster_Versions_DID_F126_34_FLEXRAY_CLUSTER_SW_MINOR_VERSION
        DataInfo_DID_F126_Autosar_BSW_Cluster_Versions_DID_F126_33_FLEXRAY_CLUSTER_SW_MAJOR_VERSION (DcmDspDataInfo): DcmDspDataFixedLength=true  # Diagnostics Data Import
        DID_F126_Autosar_BSW_Cluster_Versions_DID_F126_33_FLEXRAY_CLUSTER_SW_MAJOR_VERSION (DcmDspData):  # Diagnostics Data Import
          DcmDspDataSize = 8
          DcmDspDataType = UINT8
          DcmDspDataInfoRef = DataInfo_DID_F126_Autosar_BSW_Cluster_Versions_DID_F126_33_FLEXRAY_CLUSTER_SW_MAJOR_VERSION
        DataInfo_DID_F126_Autosar_BSW_Cluster_Versions_DID_F126_32_FLEXRAY_CLUSTER_VENDOR_ID (DcmDspDataInfo): DcmDspDataFixedLength=true  # Diagnostics Data Import
        DID_F126_Autosar_BSW_Cluster_Versions_DID_F126_32_FLEXRAY_CLUSTER_VENDOR_ID (DcmDspData): DcmDspDataSize=16, DcmDspDataType=UINT16, DcmDspDataInfoRef=DataInfo_DID_F126_Autosar_BSW_Cluster_Versions_DID_F126_32_FLEXRAY_CLUSTER_VENDOR_ID  # Diagnostics Data Import
        DataInfo_DID_F126_Autosar_BSW_Cluster_Versions_DID_F126_31_CAN_CLUSTER_AR_RELEASE_REVISION_VERSION (DcmDspDataInfo): DcmDspDataFixedLength=true  # Diagnostics Data Import
        DID_F126_Autosar_BSW_Cluster_Versions_DID_F126_31_CAN_CLUSTER_AR_RELEASE_REVISION_VERSION (DcmDspData):  # Diagnostics Data Import
          DcmDspDataSize = 8
          DcmDspDataType = UINT8
          DcmDspDataInfoRef = DataInfo_DID_F126_Autosar_BSW_Cluster_Versions_DID_F126_31_CAN_CLUSTER_AR_RELEASE_REVISION_VERSION
        DataInfo_DID_F126_Autosar_BSW_Cluster_Versions_DID_F126_30_CAN_CLUSTER_AR_RELEASE_MINOR_VERSION (DcmDspDataInfo): DcmDspDataFixedLength=true  # Diagnostics Data Import
        DID_F126_Autosar_BSW_Cluster_Versions_DID_F126_30_CAN_CLUSTER_AR_RELEASE_MINOR_VERSION (DcmDspData):  # Diagnostics Data Import
          DcmDspDataSize = 8
          DcmDspDataType = UINT8
          DcmDspDataInfoRef = DataInfo_DID_F126_Autosar_BSW_Cluster_Versions_DID_F126_30_CAN_CLUSTER_AR_RELEASE_MINOR_VERSION
        DataInfo_DID_F126_Autosar_BSW_Cluster_Versions_DID_F126_29_CAN_CLUSTER_AR_RELEASE_MAJOR_VERSION (DcmDspDataInfo): DcmDspDataFixedLength=true  # Diagnostics Data Import
        DID_F126_Autosar_BSW_Cluster_Versions_DID_F126_29_CAN_CLUSTER_AR_RELEASE_MAJOR_VERSION (DcmDspData):  # Diagnostics Data Import
          DcmDspDataSize = 8
          DcmDspDataType = UINT8
          DcmDspDataInfoRef = DataInfo_DID_F126_Autosar_BSW_Cluster_Versions_DID_F126_29_CAN_CLUSTER_AR_RELEASE_MAJOR_VERSION
        DataInfo_DID_F126_Autosar_BSW_Cluster_Versions_DID_F126_28_CAN_CLUSTER_SW_PATCH_VERSION (DcmDspDataInfo): DcmDspDataFixedLength=true  # Diagnostics Data Import
        DID_F126_Autosar_BSW_Cluster_Versions_DID_F126_28_CAN_CLUSTER_SW_PATCH_VERSION (DcmDspData):  # Diagnostics Data Import
          DcmDspDataSize = 8
          DcmDspDataType = UINT8
          DcmDspDataInfoRef = DataInfo_DID_F126_Autosar_BSW_Cluster_Versions_DID_F126_28_CAN_CLUSTER_SW_PATCH_VERSION
        DataInfo_DID_F126_Autosar_BSW_Cluster_Versions_DID_F126_27_CAN_CLUSTER_SW_MINOR_VERSION (DcmDspDataInfo): DcmDspDataFixedLength=true  # Diagnostics Data Import
        DID_F126_Autosar_BSW_Cluster_Versions_DID_F126_27_CAN_CLUSTER_SW_MINOR_VERSION (DcmDspData):  # Diagnostics Data Import
          DcmDspDataSize = 8
          DcmDspDataType = UINT8
          DcmDspDataInfoRef = DataInfo_DID_F126_Autosar_BSW_Cluster_Versions_DID_F126_27_CAN_CLUSTER_SW_MINOR_VERSION
        DataInfo_DID_F126_Autosar_BSW_Cluster_Versions_DID_F126_26_CAN_CLUSTER_SW_MAJOR_VERSION (DcmDspDataInfo): DcmDspDataFixedLength=true  # Diagnostics Data Import
        DID_F126_Autosar_BSW_Cluster_Versions_DID_F126_26_CAN_CLUSTER_SW_MAJOR_VERSION (DcmDspData):  # Diagnostics Data Import
          DcmDspDataSize = 8
          DcmDspDataType = UINT8
          DcmDspDataInfoRef = DataInfo_DID_F126_Autosar_BSW_Cluster_Versions_DID_F126_26_CAN_CLUSTER_SW_MAJOR_VERSION
        DataInfo_DID_F126_Autosar_BSW_Cluster_Versions_DID_F126_25_CAN_CLUSTER_VENDOR_ID (DcmDspDataInfo): DcmDspDataFixedLength=true  # Diagnostics Data Import
        DID_F126_Autosar_BSW_Cluster_Versions_DID_F126_25_CAN_CLUSTER_VENDOR_ID (DcmDspData): DcmDspDataSize=16, DcmDspDataType=UINT16, DcmDspDataInfoRef=DataInfo_DID_F126_Autosar_BSW_Cluster_Versions_DID_F126_25_CAN_CLUSTER_VENDOR_ID  # Diagnostics Data Import
        DataInfo_DID_F126_Autosar_BSW_Cluster_Versions_DID_F126_24_COM_CLUSTER_AR_RELEASE_REVISION_VERSION (DcmDspDataInfo): DcmDspDataFixedLength=true  # Diagnostics Data Import
        DID_F126_Autosar_BSW_Cluster_Versions_DID_F126_24_COM_CLUSTER_AR_RELEASE_REVISION_VERSION (DcmDspData):  # Diagnostics Data Import
          DcmDspDataSize = 8
          DcmDspDataType = UINT8
          DcmDspDataInfoRef = DataInfo_DID_F126_Autosar_BSW_Cluster_Versions_DID_F126_24_COM_CLUSTER_AR_RELEASE_REVISION_VERSION
        DataInfo_DID_F126_Autosar_BSW_Cluster_Versions_DID_F126_23_COM_CLUSTER_AR_RELEASE_MINOR_VERSION (DcmDspDataInfo): DcmDspDataFixedLength=true  # Diagnostics Data Import
        DID_F126_Autosar_BSW_Cluster_Versions_DID_F126_23_COM_CLUSTER_AR_RELEASE_MINOR_VERSION (DcmDspData):  # Diagnostics Data Import
          DcmDspDataSize = 8
          DcmDspDataType = UINT8
          DcmDspDataInfoRef = DataInfo_DID_F126_Autosar_BSW_Cluster_Versions_DID_F126_23_COM_CLUSTER_AR_RELEASE_MINOR_VERSION
        DataInfo_DID_F126_Autosar_BSW_Cluster_Versions_DID_F126_22_COM_CLUSTER_AR_RELEASE_MAJOR_VERSION (DcmDspDataInfo): DcmDspDataFixedLength=true  # Diagnostics Data Import
        DID_F126_Autosar_BSW_Cluster_Versions_DID_F126_22_COM_CLUSTER_AR_RELEASE_MAJOR_VERSION (DcmDspData):  # Diagnostics Data Import
          DcmDspDataSize = 8
          DcmDspDataType = UINT8
          DcmDspDataInfoRef = DataInfo_DID_F126_Autosar_BSW_Cluster_Versions_DID_F126_22_COM_CLUSTER_AR_RELEASE_MAJOR_VERSION
        DataInfo_DID_F126_Autosar_BSW_Cluster_Versions_DID_F126_21_COM_CLUSTER_SW_PATCH_VERSION (DcmDspDataInfo): DcmDspDataFixedLength=true  # Diagnostics Data Import
        DID_F126_Autosar_BSW_Cluster_Versions_DID_F126_21_COM_CLUSTER_SW_PATCH_VERSION (DcmDspData):  # Diagnostics Data Import
          DcmDspDataSize = 8
          DcmDspDataType = UINT8
          DcmDspDataInfoRef = DataInfo_DID_F126_Autosar_BSW_Cluster_Versions_DID_F126_21_COM_CLUSTER_SW_PATCH_VERSION
        DataInfo_DID_F126_Autosar_BSW_Cluster_Versions_DID_F126_20_COM_CLUSTER_SW_MINOR_VERSION (DcmDspDataInfo): DcmDspDataFixedLength=true  # Diagnostics Data Import
        DID_F126_Autosar_BSW_Cluster_Versions_DID_F126_20_COM_CLUSTER_SW_MINOR_VERSION (DcmDspData):  # Diagnostics Data Import
          DcmDspDataSize = 8
          DcmDspDataType = UINT8
          DcmDspDataInfoRef = DataInfo_DID_F126_Autosar_BSW_Cluster_Versions_DID_F126_20_COM_CLUSTER_SW_MINOR_VERSION
        DataInfo_DID_F126_Autosar_BSW_Cluster_Versions_DID_F126_19_COM_CLUSTER_SW_MAJOR_VERSION (DcmDspDataInfo): DcmDspDataFixedLength=true  # Diagnostics Data Import
        DID_F126_Autosar_BSW_Cluster_Versions_DID_F126_19_COM_CLUSTER_SW_MAJOR_VERSION (DcmDspData):  # Diagnostics Data Import
          DcmDspDataSize = 8
          DcmDspDataType = UINT8
          DcmDspDataInfoRef = DataInfo_DID_F126_Autosar_BSW_Cluster_Versions_DID_F126_19_COM_CLUSTER_SW_MAJOR_VERSION
        DataInfo_DID_F126_Autosar_BSW_Cluster_Versions_DID_F126_18_COM_CLUSTER_VENDOR_ID (DcmDspDataInfo): DcmDspDataFixedLength=true  # Diagnostics Data Import
        DID_F126_Autosar_BSW_Cluster_Versions_DID_F126_18_COM_CLUSTER_VENDOR_ID (DcmDspData): DcmDspDataSize=16, DcmDspDataType=UINT16, DcmDspDataInfoRef=DataInfo_DID_F126_Autosar_BSW_Cluster_Versions_DID_F126_18_COM_CLUSTER_VENDOR_ID  # Diagnostics Data Import
        DataInfo_DID_F126_Autosar_BSW_Cluster_Versions_DID_F126_17_MODEMGMT_CLUSTER_AR_RELEASE_REVISION_VERSION (DcmDspDataInfo): DcmDspDataFixedLength=true  # Diagnostics Data Import
        DID_F126_Autosar_BSW_Cluster_Versions_DID_F126_17_MODEMGMT_CLUSTER_AR_RELEASE_REVISION_VERSION (DcmDspData):  # Diagnostics Data Import
          DcmDspDataSize = 8
          DcmDspDataType = UINT8
          DcmDspDataInfoRef = DataInfo_DID_F126_Autosar_BSW_Cluster_Versions_DID_F126_17_MODEMGMT_CLUSTER_AR_RELEASE_REVISION_VERSION
        DataInfo_DID_F126_Autosar_BSW_Cluster_Versions_DID_F126_16_MODEMGMT_CLUSTER_AR_RELEASE_MINOR_VERSION (DcmDspDataInfo): DcmDspDataFixedLength=true  # Diagnostics Data Import
        DID_F126_Autosar_BSW_Cluster_Versions_DID_F126_16_MODEMGMT_CLUSTER_AR_RELEASE_MINOR_VERSION (DcmDspData):  # Diagnostics Data Import
          DcmDspDataSize = 8
          DcmDspDataType = UINT8
          DcmDspDataInfoRef = DataInfo_DID_F126_Autosar_BSW_Cluster_Versions_DID_F126_16_MODEMGMT_CLUSTER_AR_RELEASE_MINOR_VERSION
        DataInfo_DID_F126_Autosar_BSW_Cluster_Versions_DID_F126_15_MODEMGMT_CLUSTER_AR_RELEASE_MAJOR_VERSION (DcmDspDataInfo): DcmDspDataFixedLength=true  # Diagnostics Data Import
        DID_F126_Autosar_BSW_Cluster_Versions_DID_F126_15_MODEMGMT_CLUSTER_AR_RELEASE_MAJOR_VERSION (DcmDspData):  # Diagnostics Data Import
          DcmDspDataSize = 8
          DcmDspDataType = UINT8
          DcmDspDataInfoRef = DataInfo_DID_F126_Autosar_BSW_Cluster_Versions_DID_F126_15_MODEMGMT_CLUSTER_AR_RELEASE_MAJOR_VERSION
        DataInfo_DID_F126_Autosar_BSW_Cluster_Versions_DID_F126_14_MODEMGMT_CLUSTER_SW_PATCH_VERSION (DcmDspDataInfo): DcmDspDataFixedLength=true  # Diagnostics Data Import
        DID_F126_Autosar_BSW_Cluster_Versions_DID_F126_14_MODEMGMT_CLUSTER_SW_PATCH_VERSION (DcmDspData):  # Diagnostics Data Import
          DcmDspDataSize = 8
          DcmDspDataType = UINT8
          DcmDspDataInfoRef = DataInfo_DID_F126_Autosar_BSW_Cluster_Versions_DID_F126_14_MODEMGMT_CLUSTER_SW_PATCH_VERSION
        DataInfo_DID_F126_Autosar_BSW_Cluster_Versions_DID_F126_13_MODEMGMT_CLUSTER_SW_MINOR_VERSION (DcmDspDataInfo): DcmDspDataFixedLength=true  # Diagnostics Data Import
        DID_F126_Autosar_BSW_Cluster_Versions_DID_F126_13_MODEMGMT_CLUSTER_SW_MINOR_VERSION (DcmDspData):  # Diagnostics Data Import
          DcmDspDataSize = 8
          DcmDspDataType = UINT8
          DcmDspDataInfoRef = DataInfo_DID_F126_Autosar_BSW_Cluster_Versions_DID_F126_13_MODEMGMT_CLUSTER_SW_MINOR_VERSION
        DataInfo_DID_F126_Autosar_BSW_Cluster_Versions_DID_F126_12_MODEMGMT_CLUSTER_SW_MAJOR_VERSION (DcmDspDataInfo): DcmDspDataFixedLength=true  # Diagnostics Data Import
        DID_F126_Autosar_BSW_Cluster_Versions_DID_F126_12_MODEMGMT_CLUSTER_SW_MAJOR_VERSION (DcmDspData):  # Diagnostics Data Import
          DcmDspDataSize = 8
          DcmDspDataType = UINT8
          DcmDspDataInfoRef = DataInfo_DID_F126_Autosar_BSW_Cluster_Versions_DID_F126_12_MODEMGMT_CLUSTER_SW_MAJOR_VERSION
        DataInfo_DID_F126_Autosar_BSW_Cluster_Versions_DID_F126_11_MODEMGMT_CLUSTER_VENDOR_ID (DcmDspDataInfo): DcmDspDataFixedLength=true  # Diagnostics Data Import
        DID_F126_Autosar_BSW_Cluster_Versions_DID_F126_11_MODEMGMT_CLUSTER_VENDOR_ID (DcmDspData):  # Diagnostics Data Import
          DcmDspDataSize = 16
          DcmDspDataType = UINT16
          DcmDspDataInfoRef = DataInfo_DID_F126_Autosar_BSW_Cluster_Versions_DID_F126_11_MODEMGMT_CLUSTER_VENDOR_ID
        DataInfo_DID_F126_Autosar_BSW_Cluster_Versions_DID_F126_10_DIAG_CLUSTER_VCC_FIM_VERSION (DcmDspDataInfo): DcmDspDataFixedLength=true  # Diagnostics Data Import
        DID_F126_Autosar_BSW_Cluster_Versions_DID_F126_10_DIAG_CLUSTER_VCC_FIM_VERSION (DcmDspData):  # Diagnostics Data Import
          DcmDspDataSize = 8
          DcmDspDataType = UINT8
          DcmDspDataInfoRef = DataInfo_DID_F126_Autosar_BSW_Cluster_Versions_DID_F126_10_DIAG_CLUSTER_VCC_FIM_VERSION
        DataInfo_DID_F126_Autosar_BSW_Cluster_Versions_DID_F126_9_DIAG_CLUSTER_VCC_DCM_VERSION (DcmDspDataInfo): DcmDspDataFixedLength=true  # Diagnostics Data Import
        DID_F126_Autosar_BSW_Cluster_Versions_DID_F126_9_DIAG_CLUSTER_VCC_DCM_VERSION (DcmDspData): DcmDspDataSize=8, DcmDspDataType=UINT8, DcmDspDataInfoRef=DataInfo_DID_F126_Autosar_BSW_Cluster_Versions_DID_F126_9_DIAG_CLUSTER_VCC_DCM_VERSION  # Diagnostics Data Import
        DataInfo_DID_F126_Autosar_BSW_Cluster_Versions_DID_F126_8_DIAG_CLUSTER_VCC_DEM_VERSION (DcmDspDataInfo): DcmDspDataFixedLength=true  # Diagnostics Data Import
        DID_F126_Autosar_BSW_Cluster_Versions_DID_F126_8_DIAG_CLUSTER_VCC_DEM_VERSION (DcmDspData): DcmDspDataSize=8, DcmDspDataType=UINT8, DcmDspDataInfoRef=DataInfo_DID_F126_Autosar_BSW_Cluster_Versions_DID_F126_8_DIAG_CLUSTER_VCC_DEM_VERSION  # Diagnostics Data Import
        DataInfo_DID_F126_Autosar_BSW_Cluster_Versions_DID_F126_7_DIAG_CLUSTER_AR_RELEASE_REVISION_VERSION (DcmDspDataInfo): DcmDspDataFixedLength=true  # Diagnostics Data Import
        DID_F126_Autosar_BSW_Cluster_Versions_DID_F126_7_DIAG_CLUSTER_AR_RELEASE_REVISION_VERSION (DcmDspData):  # Diagnostics Data Import
          DcmDspDataSize = 8
          DcmDspDataType = UINT8
          DcmDspDataInfoRef = DataInfo_DID_F126_Autosar_BSW_Cluster_Versions_DID_F126_7_DIAG_CLUSTER_AR_RELEASE_REVISION_VERSION
        DataInfo_DID_F126_Autosar_BSW_Cluster_Versions_DID_F126_6_DIAG_CLUSTER_AR_RELEASE_MINOR_VERSION (DcmDspDataInfo): DcmDspDataFixedLength=true  # Diagnostics Data Import
        DID_F126_Autosar_BSW_Cluster_Versions_DID_F126_6_DIAG_CLUSTER_AR_RELEASE_MINOR_VERSION (DcmDspData):  # Diagnostics Data Import
          DcmDspDataSize = 8
          DcmDspDataType = UINT8
          DcmDspDataInfoRef = DataInfo_DID_F126_Autosar_BSW_Cluster_Versions_DID_F126_6_DIAG_CLUSTER_AR_RELEASE_MINOR_VERSION
        DataInfo_DID_F126_Autosar_BSW_Cluster_Versions_DID_F126_5_DIAG_CLUSTER_AR_RELEASE_MAJOR_VERSION (DcmDspDataInfo): DcmDspDataFixedLength=true  # Diagnostics Data Import
        DID_F126_Autosar_BSW_Cluster_Versions_DID_F126_5_DIAG_CLUSTER_AR_RELEASE_MAJOR_VERSION (DcmDspData):  # Diagnostics Data Import
          DcmDspDataSize = 8
          DcmDspDataType = UINT8
          DcmDspDataInfoRef = DataInfo_DID_F126_Autosar_BSW_Cluster_Versions_DID_F126_5_DIAG_CLUSTER_AR_RELEASE_MAJOR_VERSION
        DataInfo_DID_F126_Autosar_BSW_Cluster_Versions_DID_F126_4_DIAG_CLUSTER_SW_PATCH_VERSION (DcmDspDataInfo): DcmDspDataFixedLength=true  # Diagnostics Data Import
        DID_F126_Autosar_BSW_Cluster_Versions_DID_F126_4_DIAG_CLUSTER_SW_PATCH_VERSION (DcmDspData):  # Diagnostics Data Import
          DcmDspDataSize = 8
          DcmDspDataType = UINT8
          DcmDspDataInfoRef = DataInfo_DID_F126_Autosar_BSW_Cluster_Versions_DID_F126_4_DIAG_CLUSTER_SW_PATCH_VERSION
        DataInfo_DID_F126_Autosar_BSW_Cluster_Versions_DID_F126_3_DIAG_CLUSTER_SW_MINOR_VERSION (DcmDspDataInfo): DcmDspDataFixedLength=true  # Diagnostics Data Import
        DID_F126_Autosar_BSW_Cluster_Versions_DID_F126_3_DIAG_CLUSTER_SW_MINOR_VERSION (DcmDspData):  # Diagnostics Data Import
          DcmDspDataSize = 8
          DcmDspDataType = UINT8
          DcmDspDataInfoRef = DataInfo_DID_F126_Autosar_BSW_Cluster_Versions_DID_F126_3_DIAG_CLUSTER_SW_MINOR_VERSION
        DataInfo_DID_F126_Autosar_BSW_Cluster_Versions_DID_F126_2_DIAG_CLUSTER_SW_MAJOR_VERSION (DcmDspDataInfo): DcmDspDataFixedLength=true  # Diagnostics Data Import
        DID_F126_Autosar_BSW_Cluster_Versions_DID_F126_2_DIAG_CLUSTER_SW_MAJOR_VERSION (DcmDspData):  # Diagnostics Data Import
          DcmDspDataSize = 8
          DcmDspDataType = UINT8
          DcmDspDataInfoRef = DataInfo_DID_F126_Autosar_BSW_Cluster_Versions_DID_F126_2_DIAG_CLUSTER_SW_MAJOR_VERSION
        DataInfo_DID_F126_Autosar_BSW_Cluster_Versions_DID_F126_1_DIAG_CLUSTER_VENDOR_ID (DcmDspDataInfo): DcmDspDataFixedLength=true  # Diagnostics Data Import
        DID_F126_Autosar_BSW_Cluster_Versions_DID_F126_1_DIAG_CLUSTER_VENDOR_ID (DcmDspData): DcmDspDataSize=16, DcmDspDataType=UINT16, DcmDspDataInfoRef=DataInfo_DID_F126_Autosar_BSW_Cluster_Versions_DID_F126_1_DIAG_CLUSTER_VENDOR_ID  # Diagnostics Data Import
        DataInfo_DID_F125_Primary_Bootloader_Software_Part_Number_ASCII_part (DcmDspDataInfo): DcmDspDataFixedLength=true  # Diagnostics Data Import
        DID_F125_Primary_Bootloader_Software_Part_Number_ASCII_part (DcmDspData): DcmDspDataSize=24, DcmDspDataType=UINT8_N, DcmDspDataInfoRef=DataInfo_DID_F125_Primary_Bootloader_Software_Part_Number_ASCII_part  # Diagnostics Data Import
        DataInfo_DID_F125_Primary_Bootloader_Software_Part_Number_BCD_part (DcmDspDataInfo): DcmDspDataFixedLength=true  # Diagnostics Data Import
        DID_F125_Primary_Bootloader_Software_Part_Number_BCD_part (DcmDspData): DcmDspDataSize=32, DcmDspDataType=UINT32, DcmDspDataInfoRef=DataInfo_DID_F125_Primary_Bootloader_Software_Part_Number_BCD_part  # Diagnostics Data Import
        DataInfo_DID_F121_Primary_Bootloader_Diagnostic_Database_Part_Number_ASCII_part (DcmDspDataInfo): DcmDspDataFixedLength=true  # Diagnostics Data Import
        DID_F121_Primary_Bootloader_Diagnostic_Database_Part_Number_ASCII_part (DcmDspData): DcmDspDataSize=24, DcmDspDataType=UINT8_N, DcmDspDataInfoRef=DataInfo_DID_F121_Primary_Bootloader_Diagnostic_Database_Part_Number_ASCII_part  # Diagnostics Data Import
        DataInfo_DID_F121_Primary_Bootloader_Diagnostic_Database_Part_Number_BCD_part (DcmDspDataInfo): DcmDspDataFixedLength=true  # Diagnostics Data Import
        DID_F121_Primary_Bootloader_Diagnostic_Database_Part_Number_BCD_part (DcmDspData): DcmDspDataSize=32, DcmDspDataType=UINT32, DcmDspDataInfoRef=DataInfo_DID_F121_Primary_Bootloader_Diagnostic_Database_Part_Number_BCD_part  # Diagnostics Data Import
        DataInfo_Application_Diagnostic_Database_Part_Number_Partnumber_Variant (DcmDspDataInfo): DcmDspDataFixedLength=true  # Diagnostics Data Import
        Application_Diagnostic_Database_Part_Number_Partnumber_Variant (DcmDspData): DcmDspDataSize=24, DcmDspDataType=UINT8_N, DcmDspDataInfoRef=DataInfo_Application_Diagnostic_Database_Part_Number_Partnumber_Variant  # Diagnostics Data Import
        DataInfo_Application_Diagnostic_Database_Part_Number_Partnumber_Main (DcmDspDataInfo): DcmDspDataFixedLength=true  # Diagnostics Data Import
        Application_Diagnostic_Database_Part_Number_Partnumber_Main (DcmDspData): DcmDspDataSize=32, DcmDspDataType=UINT32, DcmDspDataInfoRef=DataInfo_Application_Diagnostic_Database_Part_Number_Partnumber_Main  # Diagnostics Data Import
        DataInfo_DID_EF1D_EOL_config_word_C_DID_EF1D_EOL_config_word_C (DcmDspDataInfo): DcmDspDataFixedLength=true  # Diagnostics Data Import
        DID_EF1D_EOL_config_word_C_DID_EF1D_EOL_config_word_C (DcmDspData): DcmDspDataSize=16, DcmDspDataType=UINT16, DcmDspDataInfoRef=DataInfo_DID_EF1D_EOL_config_word_C_DID_EF1D_EOL_config_word_C  # Diagnostics Data Import
        DataInfo_DID_EF1C_EOL_config_word_B_DID_EF1C_EOL_config_word_B (DcmDspDataInfo): DcmDspDataFixedLength=true  # Diagnostics Data Import
        DID_EF1C_EOL_config_word_B_DID_EF1C_EOL_config_word_B (DcmDspData): DcmDspDataSize=320, DcmDspDataType=UINT8_N, DcmDspDataInfoRef=DataInfo_DID_EF1C_EOL_config_word_B_DID_EF1C_EOL_config_word_B  # Diagnostics Data Import
        DataInfo_DID_EF1B_EOL_config_word_A_DID_EF1B_EOL_config_word_A (DcmDspDataInfo): DcmDspDataFixedLength=true  # Diagnostics Data Import
        DID_EF1B_EOL_config_word_A_DID_EF1B_EOL_config_word_A (DcmDspData): DcmDspDataSize=16, DcmDspDataType=UINT16, DcmDspDataInfoRef=DataInfo_DID_EF1B_EOL_config_word_A_DID_EF1B_EOL_config_word_A  # Diagnostics Data Import
        DataInfo_DID_EF0A_Active_Discharge_Time_DID_EF0A_Active_Discharge_Time (DcmDspDataInfo): DcmDspDataFixedLength=true  # Diagnostics Data Import
        DID_EF0A_Active_Discharge_Time_DID_EF0A_Active_Discharge_Time (DcmDspData): DcmDspDataSize=8, DcmDspDataType=UINT8, DcmDspDataInfoRef=DataInfo_DID_EF0A_Active_Discharge_Time_DID_EF0A_Active_Discharge_Time  # Diagnostics Data Import
        DataInfo_DID_EEFD_Sofware_Project_Version_DID_EEFD_Clutch_Control_Fault_Indication (DcmDspDataInfo): DcmDspDataFixedLength=true  # Diagnostics Data Import
        DID_EEFD_Sofware_Project_Version_DID_EEFD_Clutch_Control_Fault_Indication (DcmDspData): DcmDspDataSize=192, DcmDspDataType=UINT8_N, DcmDspDataInfoRef=DataInfo_DID_EEFD_Sofware_Project_Version_DID_EEFD_Clutch_Control_Fault_Indication  # Diagnostics Data Import
        DataInfo_DID_EED5_Safety_Torque_QF_factor_EED5_Safety_Torque_Quality_factor (DcmDspDataInfo): DcmDspDataFixedLength=true  # Diagnostics Data Import
        DID_EED5_Safety_Torque_QF_factor_EED5_Safety_Torque_Quality_factor (DcmDspData): DcmDspDataSize=8, DcmDspDataType=UINT8_N, DcmDspDataInfoRef=DataInfo_DID_EED5_Safety_Torque_QF_factor_EED5_Safety_Torque_Quality_factor  # Diagnostics Data Import
        DataInfo_DID_EED4_Safty_Function_Mode_DID_EED4_Safty_Function_Mode (DcmDspDataInfo): DcmDspDataFixedLength=true  # Diagnostics Data Import
        DID_EED4_Safty_Function_Mode_DID_EED4_Safty_Function_Mode (DcmDspData): DcmDspDataSize=8, DcmDspDataType=UINT8_N, DcmDspDataInfoRef=DataInfo_DID_EED4_Safty_Function_Mode_DID_EED4_Safty_Function_Mode  # Diagnostics Data Import
        DataInfo_DID_EED3_Safety_speed_DID_EED3_Safety_speed (DcmDspDataInfo): DcmDspDataFixedLength=true  # Diagnostics Data Import
        DID_EED3_Safety_speed_DID_EED3_Safety_speed (DcmDspData): DcmDspDataSize=16, DcmDspDataType=UINT16, DcmDspDataInfoRef=DataInfo_DID_EED3_Safety_speed_DID_EED3_Safety_speed  # Diagnostics Data Import
        DataInfo_DID_0xEEC7_1_DID_EED2_SaftyTorque (DcmDspDataInfo): DcmDspDataFixedLength=true  # Diagnostics Data Import
        DID_0xEEC7_1_DID_EED2_SaftyTorque (DcmDspData): DcmDspDataSize=16, DcmDspDataType=UINT16, DcmDspDataInfoRef=DataInfo_DID_0xEEC7_1_DID_EED2_SaftyTorque  # Diagnostics Data Import
        DataInfo_DID_EED1_Safty_monitor_Fault_Indication_EED1_3 (DcmDspDataInfo): DcmDspDataFixedLength=true  # Diagnostics Data Import
        DID_EED1_Safty_monitor_Fault_Indication_EED1_3 (DcmDspData): DcmDspDataSize=8, DcmDspDataType=UINT8, DcmDspDataInfoRef=DataInfo_DID_EED1_Safty_monitor_Fault_Indication_EED1_3  # Diagnostics Data Import
        DataInfo_DID_EED1_Safty_monitor_Fault_Indication_EED1_2 (DcmDspDataInfo): DcmDspDataFixedLength=true  # Diagnostics Data Import
        DID_EED1_Safty_monitor_Fault_Indication_EED1_2 (DcmDspData): DcmDspDataSize=8, DcmDspDataType=UINT8, DcmDspDataInfoRef=DataInfo_DID_EED1_Safty_monitor_Fault_Indication_EED1_2  # Diagnostics Data Import
        DataInfo_DID_EED1_Safty_monitor_Fault_Indication_EED1_1 (DcmDspDataInfo): DcmDspDataFixedLength=true  # Diagnostics Data Import
        DID_EED1_Safty_monitor_Fault_Indication_EED1_1 (DcmDspData): DcmDspDataSize=8, DcmDspDataType=UINT8, DcmDspDataInfoRef=DataInfo_DID_EED1_Safty_monitor_Fault_Indication_EED1_1  # Diagnostics Data Import
        DataInfo_DID_EED1_Safty_monitor_Fault_Indication_EED1_0 (DcmDspDataInfo): DcmDspDataFixedLength=true  # Diagnostics Data Import
        DID_EED1_Safty_monitor_Fault_Indication_EED1_0 (DcmDspData): DcmDspDataSize=8, DcmDspDataType=UINT8, DcmDspDataInfoRef=DataInfo_DID_EED1_Safty_monitor_Fault_Indication_EED1_0  # Diagnostics Data Import
        DataInfo_DID_EEC5_ImobEng2_node_status_DID_EEC5_ImobEng2_node_status (DcmDspDataInfo): DcmDspDataFixedLength=true  # Diagnostics Data Import
        DID_EEC5_ImobEng2_node_status_DID_EEC5_ImobEng2_node_status (DcmDspData): DcmDspDataSize=8, DcmDspDataType=UINT8, DcmDspDataInfoRef=DataInfo_DID_EEC5_ImobEng2_node_status_DID_EEC5_ImobEng2_node_status  # Diagnostics Data Import
        DataInfo_DID_EEC4_Charging_Power_Sustain_Relay_CPSR_Voltage_DID_EEC4_Charging_Power_Sustain_RelayCPSR_Voltage (DcmDspDataInfo): DcmDspDataFixedLength=true  # Diagnostics Data Import
        DID_EEC4_Charging_Power_Sustain_Relay_CPSR_Voltage_DID_EEC4_Charging_Power_Sustain_RelayCPSR_Voltage (DcmDspData):  # Diagnostics Data Import
          DcmDspDataSize = 8
          DcmDspDataType = UINT8
          DcmDspDataInfoRef = DataInfo_DID_EEC4_Charging_Power_Sustain_Relay_CPSR_Voltage_DID_EEC4_Charging_Power_Sustain_RelayCPSR_Voltage
        DataInfo_DID_EEC3_ECU_power_supply_Voltage_DID_EEC3_ECU_power_supply_Voltage (DcmDspDataInfo): DcmDspDataFixedLength=true  # Diagnostics Data Import
        DID_EEC3_ECU_power_supply_Voltage_DID_EEC3_ECU_power_supply_Voltage (DcmDspData): DcmDspDataSize=8, DcmDspDataType=UINT8, DcmDspDataInfoRef=DataInfo_DID_EEC3_ECU_power_supply_Voltage_DID_EEC3_ECU_power_supply_Voltage  # Diagnostics Data Import
        DataInfo_DID_EEBF_HV_Main_Relay_Status_DID_EEBF_HV_Main_Relay_Status (DcmDspDataInfo): DcmDspDataFixedLength=true  # Diagnostics Data Import
        DID_EEBF_HV_Main_Relay_Status_DID_EEBF_HV_Main_Relay_Status (DcmDspData): DcmDspDataSize=8, DcmDspDataType=UINT8, DcmDspDataInfoRef=DataInfo_DID_EEBF_HV_Main_Relay_Status_DID_EEBF_HV_Main_Relay_Status  # Diagnostics Data Import
        DataInfo_DID_EEBE_Offset_angle_status_DID_EEBE_Offset_angle_status (DcmDspDataInfo): DcmDspDataFixedLength=true  # Diagnostics Data Import
        DID_EEBE_Offset_angle_status_DID_EEBE_Offset_angle_status (DcmDspData): DcmDspDataSize=8, DcmDspDataType=UINT8, DcmDspDataInfoRef=DataInfo_DID_EEBE_Offset_angle_status_DID_EEBE_Offset_angle_status  # Diagnostics Data Import
        DataInfo_DID_EEBD_IEM_MGM_rotor_offset_angle_DID_EEBD_IEMMGM_rotor_offset_angle (DcmDspDataInfo): DcmDspDataFixedLength=true  # Diagnostics Data Import
        DID_EEBD_IEM_MGM_rotor_offset_angle_DID_EEBD_IEMMGM_rotor_offset_angle (DcmDspData): DcmDspDataSize=32, DcmDspDataType=UINT32, DcmDspDataInfoRef=DataInfo_DID_EEBD_IEM_MGM_rotor_offset_angle_DID_EEBD_IEMMGM_rotor_offset_angle  # Diagnostics Data Import
        DataInfo_DID_EEB8_HV_voltage_received_from_BECM_DID_EEB8_HV_voltage_received_from_BECM (DcmDspDataInfo): DcmDspDataFixedLength=true  # Diagnostics Data Import
        DID_EEB8_HV_voltage_received_from_BECM_DID_EEB8_HV_voltage_received_from_BECM (DcmDspData):  # Diagnostics Data Import
          DcmDspDataSize = 16
          DcmDspDataType = UINT16
          DcmDspDataInfoRef = DataInfo_DID_EEB8_HV_voltage_received_from_BECM_DID_EEB8_HV_voltage_received_from_BECM
        DataInfo_DID_EEB7_ECM_Power_Limitation_minimum_DID_EEB7_ECM_Power_Limitation_minimum (DcmDspDataInfo): DcmDspDataFixedLength=true  # Diagnostics Data Import
        DID_EEB7_ECM_Power_Limitation_minimum_DID_EEB7_ECM_Power_Limitation_minimum (DcmDspData): DcmDspDataSize=16, DcmDspDataType=UINT16, DcmDspDataInfoRef=DataInfo_DID_EEB7_ECM_Power_Limitation_minimum_DID_EEB7_ECM_Power_Limitation_minimum  # Diagnostics Data Import
        DataInfo_DID_EEB6_ECM_Power_Limitation_maximum_DID_EEB6_ECM_Power_Limitation_maximum (DcmDspDataInfo): DcmDspDataFixedLength=true  # Diagnostics Data Import
        DID_EEB6_ECM_Power_Limitation_maximum_DID_EEB6_ECM_Power_Limitation_maximum (DcmDspData): DcmDspDataSize=16, DcmDspDataType=UINT16, DcmDspDataInfoRef=DataInfo_DID_EEB6_ECM_Power_Limitation_maximum_DID_EEB6_ECM_Power_Limitation_maximum  # Diagnostics Data Import
        DataInfo_DID_EEB5_IEM_MGM_current_torque_DID_EEB5_IEMMGM_current_torque (DcmDspDataInfo): DcmDspDataFixedLength=true  # Diagnostics Data Import
        DID_EEB5_IEM_MGM_current_torque_DID_EEB5_IEMMGM_current_torque (DcmDspData): DcmDspDataSize=16, DcmDspDataType=UINT16, DcmDspDataInfoRef=DataInfo_DID_EEB5_IEM_MGM_current_torque_DID_EEB5_IEMMGM_current_torque  # Diagnostics Data Import
        DataInfo_DID_EEB2_Three_Phase_Motor_Current_RMS_Current_DID_EEB2_Three_Phase_Motor_Current_RMS_Current (DcmDspDataInfo): DcmDspDataFixedLength=true  # Diagnostics Data Import
        DID_EEB2_Three_Phase_Motor_Current_RMS_Current_DID_EEB2_Three_Phase_Motor_Current_RMS_Current (DcmDspData):  # Diagnostics Data Import
          DcmDspDataSize = 16
          DcmDspDataType = UINT16
          DcmDspDataInfoRef = DataInfo_DID_EEB2_Three_Phase_Motor_Current_RMS_Current_DID_EEB2_Three_Phase_Motor_Current_RMS_Current
        DataInfo_DID_EE9F_Gate_Status_DID_EE9F_Gate_Status (DcmDspDataInfo): DcmDspDataFixedLength=true  # Diagnostics Data Import
        DID_EE9F_Gate_Status_DID_EE9F_Gate_Status (DcmDspData): DcmDspDataSize=8, DcmDspDataType=UINT8, DcmDspDataInfoRef=DataInfo_DID_EE9F_Gate_Status_DID_EE9F_Gate_Status  # Diagnostics Data Import
        DataInfo_DID_EE9E_Transient_Phase_Current_C_DID_EE9E_Transient_Phase_Current_C (DcmDspDataInfo): DcmDspDataFixedLength=true  # Diagnostics Data Import
        DID_EE9E_Transient_Phase_Current_C_DID_EE9E_Transient_Phase_Current_C (DcmDspData): DcmDspDataSize=16, DcmDspDataType=UINT16, DcmDspDataInfoRef=DataInfo_DID_EE9E_Transient_Phase_Current_C_DID_EE9E_Transient_Phase_Current_C  # Diagnostics Data Import
        DataInfo_DID_EE9D_Transient_Phase_Current_B_DID_EE9D_Transient_Phase_Current_B (DcmDspDataInfo): DcmDspDataFixedLength=true  # Diagnostics Data Import
        DID_EE9D_Transient_Phase_Current_B_DID_EE9D_Transient_Phase_Current_B (DcmDspData): DcmDspDataSize=16, DcmDspDataType=UINT16, DcmDspDataInfoRef=DataInfo_DID_EE9D_Transient_Phase_Current_B_DID_EE9D_Transient_Phase_Current_B  # Diagnostics Data Import
        DataInfo_DID_EE9C_Transient_Phase_Current_A_DID_EE9C_Transient_Phase_Current_A (DcmDspDataInfo): DcmDspDataFixedLength=true  # Diagnostics Data Import
        DID_EE9C_Transient_Phase_Current_A_DID_EE9C_Transient_Phase_Current_A (DcmDspData): DcmDspDataSize=16, DcmDspDataType=UINT16, DcmDspDataInfoRef=DataInfo_DID_EE9C_Transient_Phase_Current_A_DID_EE9C_Transient_Phase_Current_A  # Diagnostics Data Import
        DataInfo_DID_EE9A_Inverter_Coolant_Temperature_DID_EE9A_Inverter_Coolant_Temperature (DcmDspDataInfo): DcmDspDataFixedLength=true  # Diagnostics Data Import
        DID_EE9A_Inverter_Coolant_Temperature_DID_EE9A_Inverter_Coolant_Temperature (DcmDspData): DcmDspDataSize=8, DcmDspDataType=UINT8, DcmDspDataInfoRef=DataInfo_DID_EE9A_Inverter_Coolant_Temperature_DID_EE9A_Inverter_Coolant_Temperature  # Diagnostics Data Import
        DataInfo_DID_EDA0_Complete_ECU_Part_Serial_Number_s_Reserved (DcmDspDataInfo): DcmDspDataFixedLength=true  # Diagnostics Data Import
        DID_EDA0_Complete_ECU_Part_Serial_Number_s_Reserved (DcmDspData): DcmDspDataSize=80, DcmDspDataType=UINT8_N, DcmDspDataInfoRef=DataInfo_DID_EDA0_Complete_ECU_Part_Serial_Number_s_Reserved  # Diagnostics Data Import
        DataInfo_DID_EDA0_Complete_ECU_Part_Serial_Number_s_ASCII_part (DcmDspDataInfo): DcmDspDataFixedLength=true  # Diagnostics Data Import
        DID_EDA0_Complete_ECU_Part_Serial_Number_s_ASCII_part (DcmDspData): DcmDspDataSize=24, DcmDspDataType=UINT8_N, DcmDspDataInfoRef=DataInfo_DID_EDA0_Complete_ECU_Part_Serial_Number_s_ASCII_part  # Diagnostics Data Import
        DataInfo_DID_EDA0_Complete_ECU_Part_Serial_Number_s_BCD_part (DcmDspDataInfo): DcmDspDataFixedLength=true  # Diagnostics Data Import
        DID_EDA0_Complete_ECU_Part_Serial_Number_s_BCD_part (DcmDspData): DcmDspDataSize=32, DcmDspDataType=UINT32, DcmDspDataInfoRef=DataInfo_DID_EDA0_Complete_ECU_Part_Serial_Number_s_BCD_part  # Diagnostics Data Import
        DataInfo_DID_EDA0_Complete_ECU_Part_Serial_Number_s_DID_F12E_1_Total_number_of_ECU_Software_Part_Numbers (DcmDspDataInfo): DcmDspDataFixedLength=true  # Diagnostics Data Import
        DID_EDA0_Complete_ECU_Part_Serial_Number_s_DID_F12E_1_Total_number_of_ECU_Software_Part_Numbers (DcmDspData):  # Diagnostics Data Import
          DcmDspDataSize = 8
          DcmDspDataType = UINT8
          DcmDspDataInfoRef = DataInfo_DID_EDA0_Complete_ECU_Part_Serial_Number_s_DID_F12E_1_Total_number_of_ECU_Software_Part_Numbers
        DataInfo_DID_EDA0_Complete_ECU_Part_Serial_Number_s_DID_F18C_ECU_Serial_Number (DcmDspDataInfo): DcmDspDataFixedLength=true  # Diagnostics Data Import
        DID_EDA0_Complete_ECU_Part_Serial_Number_s_DID_F18C_ECU_Serial_Number (DcmDspData): DcmDspDataSize=32, DcmDspDataType=UINT32, DcmDspDataInfoRef=DataInfo_DID_EDA0_Complete_ECU_Part_Serial_Number_s_DID_F18C_ECU_Serial_Number  # Diagnostics Data Import
        DataInfo_DID_EDA0_Complete_ECU_Part_Serial_Number_s_DID_F12B_ECU_Delivery_Assembly_Part_Number1 (DcmDspDataInfo): DcmDspDataFixedLength=true  # Diagnostics Data Import
        DID_EDA0_Complete_ECU_Part_Serial_Number_s_DID_F12B_ECU_Delivery_Assembly_Part_Number1 (DcmDspData):  # Diagnostics Data Import
          DcmDspDataSize = 24
          DcmDspDataType = UINT8_N
          DcmDspDataInfoRef = DataInfo_DID_EDA0_Complete_ECU_Part_Serial_Number_s_DID_F12B_ECU_Delivery_Assembly_Part_Number1
        DataInfo_DID_EDA0_Complete_ECU_Part_Serial_Number_s_DID_F12B_ECU_Delivery_Assembly_Part_Number (DcmDspDataInfo): DcmDspDataFixedLength=true  # Diagnostics Data Import
        DID_EDA0_Complete_ECU_Part_Serial_Number_s_DID_F12B_ECU_Delivery_Assembly_Part_Number (DcmDspData):  # Diagnostics Data Import
          DcmDspDataSize = 32
          DcmDspDataType = UINT32
          DcmDspDataInfoRef = DataInfo_DID_EDA0_Complete_ECU_Part_Serial_Number_s_DID_F12B_ECU_Delivery_Assembly_Part_Number
        DataInfo_DID_EDA0_Complete_ECU_Part_Serial_Number_s_DID_F12A_ECU_Delivery_Assembly_Part_Number1_1 (DcmDspDataInfo): DcmDspDataFixedLength=true  # Diagnostics Data Import
        DID_EDA0_Complete_ECU_Part_Serial_Number_s_DID_F12A_ECU_Delivery_Assembly_Part_Number1_1 (DcmDspData):  # Diagnostics Data Import
          DcmDspDataSize = 24
          DcmDspDataType = UINT8_N
          DcmDspDataInfoRef = DataInfo_DID_EDA0_Complete_ECU_Part_Serial_Number_s_DID_F12A_ECU_Delivery_Assembly_Part_Number1_1
        DataInfo_DID_EDA0_Complete_ECU_Part_Serial_Number_s_DID_F12A_ECU_Delivery_Assembly_Part_Number_1 (DcmDspDataInfo): DcmDspDataFixedLength=true  # Diagnostics Data Import
        DID_EDA0_Complete_ECU_Part_Serial_Number_s_DID_F12A_ECU_Delivery_Assembly_Part_Number_1 (DcmDspData):  # Diagnostics Data Import
          DcmDspDataSize = 32
          DcmDspDataType = UINT32
          DcmDspDataInfoRef = DataInfo_DID_EDA0_Complete_ECU_Part_Serial_Number_s_DID_F12A_ECU_Delivery_Assembly_Part_Number_1
        DataInfo_DID_EDA0_Complete_ECU_Part_Serial_Number_s_F120_Application_Diagnostic_Database_Part_Number1 (DcmDspDataInfo): DcmDspDataFixedLength=true  # Diagnostics Data Import
        DID_EDA0_Complete_ECU_Part_Serial_Number_s_F120_Application_Diagnostic_Database_Part_Number1 (DcmDspData):  # Diagnostics Data Import
          DcmDspDataSize = 24
          DcmDspDataType = UINT8_N
          DcmDspDataInfoRef = DataInfo_DID_EDA0_Complete_ECU_Part_Serial_Number_s_F120_Application_Diagnostic_Database_Part_Number1
        DataInfo_DID_EDA0_Complete_ECU_Part_Serial_Number_s_F120_Application_Diagnostic_Database_Part_Number (DcmDspDataInfo): DcmDspDataFixedLength=true  # Diagnostics Data Import
        DID_EDA0_Complete_ECU_Part_Serial_Number_s_F120_Application_Diagnostic_Database_Part_Number (DcmDspData):  # Diagnostics Data Import
          DcmDspDataSize = 32
          DcmDspDataType = UINT32
          DcmDspDataInfoRef = DataInfo_DID_EDA0_Complete_ECU_Part_Serial_Number_s_F120_Application_Diagnostic_Database_Part_Number
        DataInfo_DID_ED20_Complete_set_of_ECU_part_serial_numbers_Geely_Reserved (DcmDspDataInfo): DcmDspDataFixedLength=true  # Diagnostics Data Import
        DID_ED20_Complete_set_of_ECU_part_serial_numbers_Geely_Reserved (DcmDspData): DcmDspDataSize=80, DcmDspDataType=UINT8_N, DcmDspDataInfoRef=DataInfo_DID_ED20_Complete_set_of_ECU_part_serial_numbers_Geely_Reserved  # Diagnostics Data Import
        DataInfo_DID_ED20_Complete_set_of_ECU_part_serial_numbers_Geely_ASCII_part_003 (DcmDspDataInfo): DcmDspDataFixedLength=true  # Diagnostics Data Import
        DID_ED20_Complete_set_of_ECU_part_serial_numbers_Geely_ASCII_part_003 (DcmDspData): DcmDspDataSize=24, DcmDspDataType=UINT8_N, DcmDspDataInfoRef=DataInfo_DID_ED20_Complete_set_of_ECU_part_serial_numbers_Geely_ASCII_part_003  # Diagnostics Data Import
        DataInfo_DID_ED20_Complete_set_of_ECU_part_serial_numbers_Geely_BCD_part_003 (DcmDspDataInfo): DcmDspDataFixedLength=true  # Diagnostics Data Import
        DID_ED20_Complete_set_of_ECU_part_serial_numbers_Geely_BCD_part_003 (DcmDspData): DcmDspDataSize=40, DcmDspDataType=UINT8_N, DcmDspDataInfoRef=DataInfo_DID_ED20_Complete_set_of_ECU_part_serial_numbers_Geely_BCD_part_003  # Diagnostics Data Import
        DataInfo_DID_ED20_Complete_set_of_ECU_part_serial_numbers_Geely_DID_F1AE_1_Total_number_of_ECU_Software_Part_Numbers (DcmDspDataInfo): DcmDspDataFixedLength=true  # Diagnostics Data Import
        DID_ED20_Complete_set_of_ECU_part_serial_numbers_Geely_DID_F1AE_1_Total_number_of_ECU_Software_Part_Numbers (DcmDspData):  # Diagnostics Data Import
          DcmDspDataSize = 8
          DcmDspDataType = UINT8
          DcmDspDataInfoRef = DataInfo_DID_ED20_Complete_set_of_ECU_part_serial_numbers_Geely_DID_F1AE_1_Total_number_of_ECU_Software_Part_Numbers
        DataInfo_DID_ED20_Complete_set_of_ECU_part_serial_numbers_Geely_DID_F18C_ECU_Serial_Number (DcmDspDataInfo): DcmDspDataFixedLength=true  # Diagnostics Data Import
        DID_ED20_Complete_set_of_ECU_part_serial_numbers_Geely_DID_F18C_ECU_Serial_Number (DcmDspData):  # Diagnostics Data Import
          DcmDspDataSize = 32
          DcmDspDataType = UINT32
          DcmDspDataInfoRef = DataInfo_DID_ED20_Complete_set_of_ECU_part_serial_numbers_Geely_DID_F18C_ECU_Serial_Number
        DataInfo_DID_ED20_Complete_set_of_ECU_part_serial_numbers_Geely_ASCII_part_002 (DcmDspDataInfo): DcmDspDataFixedLength=true  # Diagnostics Data Import
        DID_ED20_Complete_set_of_ECU_part_serial_numbers_Geely_ASCII_part_002 (DcmDspData): DcmDspDataSize=24, DcmDspDataType=UINT8_N, DcmDspDataInfoRef=DataInfo_DID_ED20_Complete_set_of_ECU_part_serial_numbers_Geely_ASCII_part_002  # Diagnostics Data Import
        DataInfo_DID_ED20_Complete_set_of_ECU_part_serial_numbers_Geely_BCD_part_002 (DcmDspDataInfo): DcmDspDataFixedLength=true  # Diagnostics Data Import
        DID_ED20_Complete_set_of_ECU_part_serial_numbers_Geely_BCD_part_002 (DcmDspData): DcmDspDataSize=40, DcmDspDataType=UINT8_N, DcmDspDataInfoRef=DataInfo_DID_ED20_Complete_set_of_ECU_part_serial_numbers_Geely_BCD_part_002  # Diagnostics Data Import
        DataInfo_DID_ED20_Complete_set_of_ECU_part_serial_numbers_Geely_ASCII_part_001 (DcmDspDataInfo): DcmDspDataFixedLength=true  # Diagnostics Data Import
        DID_ED20_Complete_set_of_ECU_part_serial_numbers_Geely_ASCII_part_001 (DcmDspData): DcmDspDataSize=24, DcmDspDataType=UINT8_N, DcmDspDataInfoRef=DataInfo_DID_ED20_Complete_set_of_ECU_part_serial_numbers_Geely_ASCII_part_001  # Diagnostics Data Import
        DataInfo_DID_ED20_Complete_set_of_ECU_part_serial_numbers_Geely_BCD_part_001 (DcmDspDataInfo): DcmDspDataFixedLength=true  # Diagnostics Data Import
        DID_ED20_Complete_set_of_ECU_part_serial_numbers_Geely_BCD_part_001 (DcmDspData): DcmDspDataSize=40, DcmDspDataType=UINT8_N, DcmDspDataInfoRef=DataInfo_DID_ED20_Complete_set_of_ECU_part_serial_numbers_Geely_BCD_part_001  # Diagnostics Data Import
        DataInfo_DID_ED20_Complete_set_of_ECU_part_serial_numbers_Geely_ASCII_part (DcmDspDataInfo): DcmDspDataFixedLength=true  # Diagnostics Data Import
        DID_ED20_Complete_set_of_ECU_part_serial_numbers_Geely_ASCII_part (DcmDspData): DcmDspDataSize=24, DcmDspDataType=UINT8_N, DcmDspDataInfoRef=DataInfo_DID_ED20_Complete_set_of_ECU_part_serial_numbers_Geely_ASCII_part  # Diagnostics Data Import
        DataInfo_DID_ED20_Complete_set_of_ECU_part_serial_numbers_Geely_BCD_part (DcmDspDataInfo): DcmDspDataFixedLength=true  # Diagnostics Data Import
        DID_ED20_Complete_set_of_ECU_part_serial_numbers_Geely_BCD_part (DcmDspData): DcmDspDataSize=40, DcmDspDataType=UINT8_N, DcmDspDataInfoRef=DataInfo_DID_ED20_Complete_set_of_ECU_part_serial_numbers_Geely_BCD_part  # Diagnostics Data Import
        DataInfo_DID_E364_AURIX_Fault_Indication_DID_E364_AURIX_Fault_Indication (DcmDspDataInfo): DcmDspDataFixedLength=true  # Diagnostics Data Import
        DID_E364_AURIX_Fault_Indication_DID_E364_AURIX_Fault_Indication (DcmDspData): DcmDspDataSize=8, DcmDspDataType=UINT8_N, DcmDspDataInfoRef=DataInfo_DID_E364_AURIX_Fault_Indication_DID_E364_AURIX_Fault_Indication  # Diagnostics Data Import
        DataInfo_DID_E363_Modulation_index_DID_E363_Modulation_index (DcmDspDataInfo): DcmDspDataFixedLength=true  # Diagnostics Data Import
        DID_E363_Modulation_index_DID_E363_Modulation_index (DcmDspData): DcmDspDataSize=8, DcmDspDataType=UINT8, DcmDspDataInfoRef=DataInfo_DID_E363_Modulation_index_DID_E363_Modulation_index  # Diagnostics Data Import
        DataInfo_DID_E358_Resolve_angle_DID_E358_Resolve_angle (DcmDspDataInfo): DcmDspDataFixedLength=true  # Diagnostics Data Import
        DID_E358_Resolve_angle_DID_E358_Resolve_angle (DcmDspData): DcmDspDataSize=16, DcmDspDataType=UINT16, DcmDspDataInfoRef=DataInfo_DID_E358_Resolve_angle_DID_E358_Resolve_angle  # Diagnostics Data Import
        DataInfo_DID_E357_Resolve_compensated_angle_DID_E357_Resolve_compensated_angle (DcmDspDataInfo): DcmDspDataFixedLength=true  # Diagnostics Data Import
        DID_E357_Resolve_compensated_angle_DID_E357_Resolve_compensated_angle (DcmDspData): DcmDspDataSize=8, DcmDspDataType=UINT8, DcmDspDataInfoRef=DataInfo_DID_E357_Resolve_compensated_angle_DID_E357_Resolve_compensated_angle  # Diagnostics Data Import
        DataInfo_DID_E353_Flux_weakening_correction_factor_DID_E353_Flux_weakening_correction_factor (DcmDspDataInfo): DcmDspDataFixedLength=true  # Diagnostics Data Import
        DID_E353_Flux_weakening_correction_factor_DID_E353_Flux_weakening_correction_factor (DcmDspData):  # Diagnostics Data Import
          DcmDspDataSize = 16
          DcmDspDataType = UINT16
          DcmDspDataInfoRef = DataInfo_DID_E353_Flux_weakening_correction_factor_DID_E353_Flux_weakening_correction_factor
        DataInfo_DID_E350_Phase_W_PWM_duty_DID_E350_Phase_W_PWM_duty (DcmDspDataInfo): DcmDspDataFixedLength=true  # Diagnostics Data Import
        DID_E350_Phase_W_PWM_duty_DID_E350_Phase_W_PWM_duty (DcmDspData): DcmDspDataSize=8, DcmDspDataType=UINT8, DcmDspDataInfoRef=DataInfo_DID_E350_Phase_W_PWM_duty_DID_E350_Phase_W_PWM_duty  # Diagnostics Data Import
        DataInfo_DID_E349_Phase_V_PWM_duty_DID_E349_Phase_V_PWM_duty (DcmDspDataInfo): DcmDspDataFixedLength=true  # Diagnostics Data Import
        DID_E349_Phase_V_PWM_duty_DID_E349_Phase_V_PWM_duty (DcmDspData): DcmDspDataSize=8, DcmDspDataType=UINT8, DcmDspDataInfoRef=DataInfo_DID_E349_Phase_V_PWM_duty_DID_E349_Phase_V_PWM_duty  # Diagnostics Data Import
        DataInfo_DID_E348_Phase_U_PWM_duty_DID_E348_Phase_U_PWM_duty (DcmDspDataInfo): DcmDspDataFixedLength=true  # Diagnostics Data Import
        DID_E348_Phase_U_PWM_duty_DID_E348_Phase_U_PWM_duty (DcmDspData): DcmDspDataSize=8, DcmDspDataType=UINT8, DcmDspDataInfoRef=DataInfo_DID_E348_Phase_U_PWM_duty_DID_E348_Phase_U_PWM_duty  # Diagnostics Data Import
        DataInfo_DID_E347_IGBT_Max_Temperature_DID_E347_IGBT_Max_Temperature (DcmDspDataInfo): DcmDspDataFixedLength=true  # Diagnostics Data Import
        DID_E347_IGBT_Max_Temperature_DID_E347_IGBT_Max_Temperature (DcmDspData): DcmDspDataSize=8, DcmDspDataType=UINT8, DcmDspDataInfoRef=DataInfo_DID_E347_IGBT_Max_Temperature_DID_E347_IGBT_Max_Temperature  # Diagnostics Data Import
        DataInfo_DID_E346_ECM_Torque_Allowed_Status_DID_E346_ECM_Torque_Allowed_Status (DcmDspDataInfo): DcmDspDataFixedLength=true  # Diagnostics Data Import
        DID_E346_ECM_Torque_Allowed_Status_DID_E346_ECM_Torque_Allowed_Status (DcmDspData): DcmDspDataSize=8, DcmDspDataType=UINT8, DcmDspDataInfoRef=DataInfo_DID_E346_ECM_Torque_Allowed_Status_DID_E346_ECM_Torque_Allowed_Status  # Diagnostics Data Import
        DataInfo_DID_E341_q_axis_voltage_DID_E341_q_axis_voltage (DcmDspDataInfo): DcmDspDataFixedLength=true  # Diagnostics Data Import
        DID_E341_q_axis_voltage_DID_E341_q_axis_voltage (DcmDspData): DcmDspDataSize=16, DcmDspDataType=UINT16, DcmDspDataInfoRef=DataInfo_DID_E341_q_axis_voltage_DID_E341_q_axis_voltage  # Diagnostics Data Import
        DataInfo_DID_E339_d_axis_voltage_DID_E339_d_axis_voltage (DcmDspDataInfo): DcmDspDataFixedLength=true  # Diagnostics Data Import
        DID_E339_d_axis_voltage_DID_E339_d_axis_voltage (DcmDspData): DcmDspDataSize=16, DcmDspDataType=UINT16, DcmDspDataInfoRef=DataInfo_DID_E339_d_axis_voltage_DID_E339_d_axis_voltage  # Diagnostics Data Import
        DataInfo_DID_E338_q_axis_current_feedback_DID_E338_q_axis_current_feedback (DcmDspDataInfo): DcmDspDataFixedLength=true  # Diagnostics Data Import
        DID_E338_q_axis_current_feedback_DID_E338_q_axis_current_feedback (DcmDspData): DcmDspDataSize=16, DcmDspDataType=UINT16, DcmDspDataInfoRef=DataInfo_DID_E338_q_axis_current_feedback_DID_E338_q_axis_current_feedback  # Diagnostics Data Import

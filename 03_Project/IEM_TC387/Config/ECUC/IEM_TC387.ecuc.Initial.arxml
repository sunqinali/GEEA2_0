[part 5 of 5: package /InitialEcuC]
AUTOSAR XML (schema 4-2-2)
package /InitialEcuC  (continued)
  module config Dem  (continued)
    DemConfigSet  (continued)
      INV_UHVDC_PLAUS (DemEventParameter):  # Diagnostics Data Import
        DemEventKind = DEM_EVENT_KIND_SWC
        DemMaxNumberFreezeFrameRecords = 2
        DemDTCClassRef = DTCClass_INV_UHVDC_PLAUS
        DemExtendedDataClassRef = ExtendedDataClass_5ecd55b9
        DemFreezeFrameClassRef = FreezeFrameClass_c3111450
        DemEventClass:  # Diagnostics Data Import
          DemAgingAllowed = true
          DemAgingCycleCounterThreshold = 40
          DemEventDestination = DEM_DTC_ORIGIN_PRIMARY_MEMORY
          DemEventPriority = 1
          DemEventFailureCycleCounterThreshold = 0
          DemAgingCycleRef = PowerCycle
          DemEnableConditionGroupRef = EnableConditionGroup_fecd1d5c
          DemOperationCycleRef = PowerCycle
          IndicatorAttribute_WarningIndicator (DemIndicatorAttribute): DemIndicatorFailureCycleSource=DEM_FAILURE_CYCLE_EVENT, DemIndicatorHealingCycleRef=PowerCycle, DemIndicatorRef=WarningIndicator  # Diagnostics Data Import
          DemDebounceAlgorithmClass  # Diagnostics Data Import
            DemDebounceCounterBased: DemDebounceCounterDecrementStepSize=128, DemDebounceCounterIncrementStepSize=127, DemDebounceCounterJumpDown=true, DemDebounceCounterJumpUp=true  # Diagnostics Data Import
      DTCClass_INV_UHVDC_PLAUS (DemDTCClass): DemDTCSeverity=DEM_DTC_SEV_IMMEDIATELY, DemUdsDTC=1053794  # Diagnostics Data Import
      INV_UHVDC_OV_HWP (DemEventParameter):  # Diagnostics Data Import
        DemEventKind = DEM_EVENT_KIND_SWC
        DemMaxNumberFreezeFrameRecords = 2
        DemDTCClassRef = DTCClass_INV_UHVDC_OV_HWP
        DemExtendedDataClassRef = ExtendedDataClass_5ecd55b9
        DemFreezeFrameClassRef = FreezeFrameClass_c3111450
        DemEventClass:  # Diagnostics Data Import
          DemAgingAllowed = true
          DemAgingCycleCounterThreshold = 40
          DemEventDestination = DEM_DTC_ORIGIN_PRIMARY_MEMORY
          DemEventPriority = 1
          DemEventFailureCycleCounterThreshold = 0
          DemAgingCycleRef = PowerCycle
          DemEnableConditionGroupRef = EnableConditionGroup_7ab46a93
          DemOperationCycleRef = PowerCycle
          IndicatorAttribute_WarningIndicator (DemIndicatorAttribute): DemIndicatorFailureCycleSource=DEM_FAILURE_CYCLE_EVENT, DemIndicatorHealingCycleRef=PowerCycle, DemIndicatorRef=WarningIndicator  # Diagnostics Data Import
          DemDebounceAlgorithmClass  # Diagnostics Data Import
            DemDebounceCounterBased: DemDebounceCounterDecrementStepSize=128, DemDebounceCounterIncrementStepSize=127, DemDebounceCounterJumpDown=true, DemDebounceCounterJumpUp=true  # Diagnostics Data Import
      DTCClass_INV_UHVDC_OV_HWP (DemDTCClass): DemDTCSeverity=DEM_DTC_SEV_IMMEDIATELY, DemUdsDTC=1053719  # Diagnostics Data Import
      INV_UHVDC_UV_HWP (DemEventParameter):  # Diagnostics Data Import
        DemEventKind = DEM_EVENT_KIND_SWC
        DemMaxNumberFreezeFrameRecords = 2
        DemDTCClassRef = DTCClass_INV_UHVDC_UV_HWP
        DemExtendedDataClassRef = ExtendedDataClass_5ecd55b9
        DemFreezeFrameClassRef = FreezeFrameClass_c3111450
        DemEventClass:  # Diagnostics Data Import
          DemAgingAllowed = true
          DemAgingCycleCounterThreshold = 40
          DemEventDestination = DEM_DTC_ORIGIN_PRIMARY_MEMORY
          DemEventPriority = 1
          DemEventFailureCycleCounterThreshold = 0
          DemAgingCycleRef = PowerCycle
          DemOperationCycleRef = PowerCycle
          IndicatorAttribute_WarningIndicator (DemIndicatorAttribute): DemIndicatorFailureCycleSource=DEM_FAILURE_CYCLE_EVENT, DemIndicatorHealingCycleRef=PowerCycle, DemIndicatorRef=WarningIndicator  # Diagnostics Data Import
          DemDebounceAlgorithmClass  # Diagnostics Data Import
            DemDebounceCounterBased: DemDebounceCounterDecrementStepSize=128, DemDebounceCounterIncrementStepSize=127, DemDebounceCounterJumpDown=true, DemDebounceCounterJumpUp=true  # Diagnostics Data Import
      DTCClass_INV_UHVDC_UV_HWP (DemDTCClass): DemDTCSeverity=DEM_DTC_SEV_IMMEDIATELY, DemUdsDTC=1053718  # Diagnostics Data Import
      INV_IAC_OC_SWP (DemEventParameter):  # Diagnostics Data Import
        DemEventKind = DEM_EVENT_KIND_SWC
        DemMaxNumberFreezeFrameRecords = 2
        DemDTCClassRef = DTCClass_INV_IAC_OC_SWP
        DemExtendedDataClassRef = ExtendedDataClass_5ecd55b9
        DemFreezeFrameClassRef = FreezeFrameClass_c3111450
        DemEventClass:  # Diagnostics Data Import
          DemAgingAllowed = true
          DemAgingCycleCounterThreshold = 1
          DemEventDestination = DEM_DTC_ORIGIN_PRIMARY_MEMORY
          DemEventPriority = 1
          DemEventFailureCycleCounterThreshold = 0
          DemAgingCycleRef = PowerCycle
          DemEnableConditionGroupRef = EnableConditionGroup_06a6aa19
          DemOperationCycleRef = PowerCycle
          IndicatorAttribute_WarningIndicator (DemIndicatorAttribute): DemIndicatorFailureCycleSource=DEM_FAILURE_CYCLE_EVENT, DemIndicatorHealingCycleRef=PowerCycle, DemIndicatorRef=WarningIndicator  # Diagnostics Data Import
          DemDebounceAlgorithmClass  # Diagnostics Data Import
            DemDebounceCounterBased: DemDebounceCounterDecrementStepSize=128, DemDebounceCounterIncrementStepSize=127, DemDebounceCounterJumpDown=true, DemDebounceCounterJumpUp=true  # Diagnostics Data Import
      DTCClass_INV_IAC_OC_SWP (DemDTCClass): DemDTCSeverity=DEM_DTC_SEV_IMMEDIATELY, DemUdsDTC=1052957  # Diagnostics Data Import
      INV_IAC_OC_HWP (DemEventParameter):  # Diagnostics Data Import
        DemEventKind = DEM_EVENT_KIND_SWC
        DemMaxNumberFreezeFrameRecords = 2
        DemDTCClassRef = DTCClass_INV_IAC_OC_HWP
        DemExtendedDataClassRef = ExtendedDataClass_5ecd55b9
        DemFreezeFrameClassRef = FreezeFrameClass_c3111450
        DemEventClass:  # Diagnostics Data Import
          DemAgingAllowed = true
          DemAgingCycleCounterThreshold = 40
          DemEventDestination = DEM_DTC_ORIGIN_PRIMARY_MEMORY
          DemEventPriority = 1
          DemEventFailureCycleCounterThreshold = 0
          DemAgingCycleRef = PowerCycle
          DemEnableConditionGroupRef = EnableConditionGroup_4c1ef766
          DemOperationCycleRef = PowerCycle
          IndicatorAttribute_WarningIndicator (DemIndicatorAttribute): DemIndicatorFailureCycleSource=DEM_FAILURE_CYCLE_EVENT, DemIndicatorHealingCycleRef=PowerCycle, DemIndicatorRef=WarningIndicator  # Diagnostics Data Import
          DemDebounceAlgorithmClass  # Diagnostics Data Import
            DemDebounceCounterBased: DemDebounceCounterDecrementStepSize=128, DemDebounceCounterIncrementStepSize=127, DemDebounceCounterJumpDown=true, DemDebounceCounterJumpUp=true  # Diagnostics Data Import
      DTCClass_INV_IAC_OC_HWP (DemDTCClass): DemDTCSeverity=DEM_DTC_SEV_IMMEDIATELY, DemUdsDTC=1052953  # Diagnostics Data Import
      INV_UHVDC_2_RNG_HI (DemEventParameter):  # Diagnostics Data Import
        DemEventKind = DEM_EVENT_KIND_SWC
        DemMaxNumberFreezeFrameRecords = 2
        DemDTCClassRef = DTCClass_INV_UHVDC_2_RNG_HI
        DemExtendedDataClassRef = ExtendedDataClass_5ecd55b9
        DemFreezeFrameClassRef = FreezeFrameClass_c3111450
        DemEventClass:  # Diagnostics Data Import
          DemAgingAllowed = true
          DemAgingCycleCounterThreshold = 40
          DemEventDestination = DEM_DTC_ORIGIN_PRIMARY_MEMORY
          DemEventPriority = 1
          DemEventFailureCycleCounterThreshold = 0
          DemAgingCycleRef = PowerCycle
          DemEnableConditionGroupRef = EnableConditionGroup_fecd1d5c
          DemOperationCycleRef = PowerCycle
          IndicatorAttribute_WarningIndicator (DemIndicatorAttribute): DemIndicatorFailureCycleSource=DEM_FAILURE_CYCLE_EVENT, DemIndicatorHealingCycleRef=PowerCycle, DemIndicatorRef=WarningIndicator  # Diagnostics Data Import
          DemDebounceAlgorithmClass  # Diagnostics Data Import
            DemDebounceCounterBased: DemDebounceCounterDecrementStepSize=128, DemDebounceCounterIncrementStepSize=127, DemDebounceCounterJumpDown=true, DemDebounceCounterJumpUp=true  # Diagnostics Data Import
      DTCClass_INV_UHVDC_2_RNG_HI (DemDTCClass): DemDTCSeverity=DEM_DTC_SEV_IMMEDIATELY, DemUdsDTC=893719  # Diagnostics Data Import
      INV_UHVDC_1_RNG_HI (DemEventParameter):  # Diagnostics Data Import
        DemEventKind = DEM_EVENT_KIND_SWC
        DemMaxNumberFreezeFrameRecords = 2
        DemDTCClassRef = DTCClass_INV_UHVDC_1_RNG_HI
        DemExtendedDataClassRef = ExtendedDataClass_5ecd55b9
        DemFreezeFrameClassRef = FreezeFrameClass_c3111450
        DemEventClass:  # Diagnostics Data Import
          DemAgingAllowed = true
          DemAgingCycleCounterThreshold = 40
          DemEventDestination = DEM_DTC_ORIGIN_PRIMARY_MEMORY
          DemEventPriority = 1
          DemEventFailureCycleCounterThreshold = 0
          DemAgingCycleRef = PowerCycle
          DemEnableConditionGroupRef = EnableConditionGroup_7ab46a93
          DemOperationCycleRef = PowerCycle
          IndicatorAttribute_WarningIndicator (DemIndicatorAttribute): DemIndicatorFailureCycleSource=DEM_FAILURE_CYCLE_EVENT, DemIndicatorHealingCycleRef=PowerCycle, DemIndicatorRef=WarningIndicator  # Diagnostics Data Import
          DemDebounceAlgorithmClass  # Diagnostics Data Import
            DemDebounceCounterBased: DemDebounceCounterDecrementStepSize=128, DemDebounceCounterIncrementStepSize=127, DemDebounceCounterJumpDown=true, DemDebounceCounterJumpUp=true  # Diagnostics Data Import
      DTCClass_INV_UHVDC_1_RNG_HI (DemDTCClass): DemDTCSeverity=DEM_DTC_SEV_IMMEDIATELY, DemUdsDTC=863511  # Diagnostics Data Import
      INV_UHVDC_1_ELEC_HI (DemEventParameter):  # Diagnostics Data Import
        DemEventKind = DEM_EVENT_KIND_SWC
        DemMaxNumberFreezeFrameRecords = 2
        DemDTCClassRef = DTCClass_INV_UHVDC_1_ELEC_HI
        DemExtendedDataClassRef = ExtendedDataClass_5ecd55b9
        DemFreezeFrameClassRef = FreezeFrameClass_c3111450
        DemEventClass:  # Diagnostics Data Import
          DemAgingAllowed = true
          DemAgingCycleCounterThreshold = 40
          DemEventDestination = DEM_DTC_ORIGIN_PRIMARY_MEMORY
          DemEventPriority = 1
          DemEventFailureCycleCounterThreshold = 0
          DemAgingCycleRef = PowerCycle
          DemEnableConditionGroupRef = EnableConditionGroup_7ab46a93
          DemOperationCycleRef = PowerCycle
          IndicatorAttribute_WarningIndicator (DemIndicatorAttribute): DemIndicatorFailureCycleSource=DEM_FAILURE_CYCLE_EVENT, DemIndicatorHealingCycleRef=PowerCycle, DemIndicatorRef=WarningIndicator  # Diagnostics Data Import
          DemDebounceAlgorithmClass  # Diagnostics Data Import
            DemDebounceCounterBased: DemDebounceCounterDecrementStepSize=128, DemDebounceCounterIncrementStepSize=127, DemDebounceCounterJumpDown=true, DemDebounceCounterJumpUp=true  # Diagnostics Data Import
      DTCClass_INV_UHVDC_1_ELEC_HI (DemDTCClass): DemDTCSeverity=DEM_DTC_SEV_IMMEDIATELY, DemUdsDTC=863506  # Diagnostics Data Import
      INV_RSLVR_COS_AMP (DemEventParameter):  # Diagnostics Data Import
        DemEventKind = DEM_EVENT_KIND_SWC
        DemMaxNumberFreezeFrameRecords = 2
        DemDTCClassRef = DTCClass_INV_RSLVR_COS_AMP
        DemExtendedDataClassRef = ExtendedDataClass_5ecd55b9
        DemFreezeFrameClassRef = FreezeFrameClass_c3111450
        DemEventClass:  # Diagnostics Data Import
          DemAgingAllowed = true
          DemAgingCycleCounterThreshold = 40
          DemEventDestination = DEM_DTC_ORIGIN_PRIMARY_MEMORY
          DemEventPriority = 1
          DemEventFailureCycleCounterThreshold = 0
          DemAgingCycleRef = PowerCycle
          DemEnableConditionGroupRef = EnableConditionGroup_1027fc3a
          DemOperationCycleRef = PowerCycle
          IndicatorAttribute_WarningIndicator (DemIndicatorAttribute): DemIndicatorFailureCycleSource=DEM_FAILURE_CYCLE_EVENT, DemIndicatorHealingCycleRef=PowerCycle, DemIndicatorRef=WarningIndicator  # Diagnostics Data Import
          DemDebounceAlgorithmClass  # Diagnostics Data Import
            DemDebounceCounterBased: DemDebounceCounterDecrementStepSize=128, DemDebounceCounterIncrementStepSize=127, DemDebounceCounterJumpDown=true, DemDebounceCounterJumpUp=true  # Diagnostics Data Import
      DTCClass_INV_RSLVR_COS_AMP (DemDTCClass): DemDTCSeverity=DEM_DTC_SEV_IMMEDIATELY, DemUdsDTC=842274  # Diagnostics Data Import
      INV_RSLVR_COS_RNG_NOK (DemEventParameter):  # Diagnostics Data Import
        DemEventKind = DEM_EVENT_KIND_SWC
        DemMaxNumberFreezeFrameRecords = 2
        DemDTCClassRef = DTCClass_INV_RSLVR_COS_RNG_NOK
        DemExtendedDataClassRef = ExtendedDataClass_5ecd55b9
        DemFreezeFrameClassRef = FreezeFrameClass_c3111450
        DemEventClass:  # Diagnostics Data Import
          DemAgingAllowed = true
          DemAgingCycleCounterThreshold = 40
          DemEventDestination = DEM_DTC_ORIGIN_PRIMARY_MEMORY
          DemEventPriority = 1
          DemEventFailureCycleCounterThreshold = 0
          DemAgingCycleRef = PowerCycle
          DemOperationCycleRef = PowerCycle
          IndicatorAttribute_WarningIndicator (DemIndicatorAttribute): DemIndicatorFailureCycleSource=DEM_FAILURE_CYCLE_EVENT, DemIndicatorHealingCycleRef=PowerCycle, DemIndicatorRef=WarningIndicator  # Diagnostics Data Import
          DemDebounceAlgorithmClass  # Diagnostics Data Import
            DemDebounceCounterBased: DemDebounceCounterDecrementStepSize=128, DemDebounceCounterIncrementStepSize=127, DemDebounceCounterJumpDown=true, DemDebounceCounterJumpUp=true  # Diagnostics Data Import
      DTCClass_INV_RSLVR_COS_RNG_NOK (DemDTCClass): DemDTCSeverity=DEM_DTC_SEV_IMMEDIATELY, DemUdsDTC=842268  # Diagnostics Data Import
      INV_RSLVR_COS_RNG_HI (DemEventParameter):  # Diagnostics Data Import
        DemEventKind = DEM_EVENT_KIND_SWC
        DemMaxNumberFreezeFrameRecords = 2
        DemDTCClassRef = DTCClass_INV_RSLVR_COS_RNG_HI
        DemExtendedDataClassRef = ExtendedDataClass_5ecd55b9
        DemFreezeFrameClassRef = FreezeFrameClass_c3111450
        DemEventClass:  # Diagnostics Data Import
          DemAgingAllowed = true
          DemAgingCycleCounterThreshold = 40
          DemEventDestination = DEM_DTC_ORIGIN_PRIMARY_MEMORY
          DemEventPriority = 1
          DemEventFailureCycleCounterThreshold = 0
          DemAgingCycleRef = PowerCycle
          DemEnableConditionGroupRef = EnableConditionGroup_1027fc3a
          DemOperationCycleRef = PowerCycle
          IndicatorAttribute_WarningIndicator (DemIndicatorAttribute): DemIndicatorFailureCycleSource=DEM_FAILURE_CYCLE_EVENT, DemIndicatorHealingCycleRef=PowerCycle, DemIndicatorRef=WarningIndicator  # Diagnostics Data Import
          DemDebounceAlgorithmClass  # Diagnostics Data Import
            DemDebounceCounterBased: DemDebounceCounterDecrementStepSize=128, DemDebounceCounterIncrementStepSize=127, DemDebounceCounterJumpDown=true, DemDebounceCounterJumpUp=true  # Diagnostics Data Import
      DTCClass_INV_RSLVR_COS_RNG_HI (DemDTCClass): DemDTCSeverity=DEM_DTC_SEV_IMMEDIATELY, DemUdsDTC=842263  # Diagnostics Data Import
      INV_RSLVR_COS_RNG_LO (DemEventParameter):  # Diagnostics Data Import
        DemEventKind = DEM_EVENT_KIND_SWC
        DemMaxNumberFreezeFrameRecords = 2
        DemDTCClassRef = DTCClass_INV_RSLVR_COS_RNG_LO
        DemExtendedDataClassRef = ExtendedDataClass_5ecd55b9
        DemFreezeFrameClassRef = FreezeFrameClass_c3111450
        DemEventClass:  # Diagnostics Data Import
          DemAgingAllowed = true
          DemAgingCycleCounterThreshold = 40
          DemEventDestination = DEM_DTC_ORIGIN_PRIMARY_MEMORY
          DemEventPriority = 1
          DemEventFailureCycleCounterThreshold = 0
          DemAgingCycleRef = PowerCycle
          DemEnableConditionGroupRef = EnableConditionGroup_1027fc3a
          DemOperationCycleRef = PowerCycle
          IndicatorAttribute_WarningIndicator (DemIndicatorAttribute): DemIndicatorFailureCycleSource=DEM_FAILURE_CYCLE_EVENT, DemIndicatorHealingCycleRef=PowerCycle, DemIndicatorRef=WarningIndicator  # Diagnostics Data Import
          DemDebounceAlgorithmClass  # Diagnostics Data Import
            DemDebounceCounterBased: DemDebounceCounterDecrementStepSize=128, DemDebounceCounterIncrementStepSize=127, DemDebounceCounterJumpDown=true, DemDebounceCounterJumpUp=true  # Diagnostics Data Import
      DTCClass_INV_RSLVR_COS_RNG_LO (DemDTCClass): DemDTCSeverity=DEM_DTC_SEV_IMMEDIATELY, DemUdsDTC=842262  # Diagnostics Data Import
      INV_RSLVR_COS_ELEC_OPEN (DemEventParameter):  # Diagnostics Data Import
        DemEventKind = DEM_EVENT_KIND_SWC
        DemMaxNumberFreezeFrameRecords = 2
        DemDTCClassRef = DTCClass_INV_RSLVR_COS_ELEC_OPEN
        DemExtendedDataClassRef = ExtendedDataClass_5ecd55b9
        DemFreezeFrameClassRef = FreezeFrameClass_c3111450
        DemEventClass:  # Diagnostics Data Import
          DemAgingAllowed = true
          DemAgingCycleCounterThreshold = 40
          DemEventDestination = DEM_DTC_ORIGIN_PRIMARY_MEMORY
          DemEventPriority = 1
          DemEventFailureCycleCounterThreshold = 0
          DemAgingCycleRef = PowerCycle
          DemEnableConditionGroupRef = EnableConditionGroup_1027fc3a
          DemOperationCycleRef = PowerCycle
          IndicatorAttribute_WarningIndicator (DemIndicatorAttribute): DemIndicatorFailureCycleSource=DEM_FAILURE_CYCLE_EVENT, DemIndicatorHealingCycleRef=PowerCycle, DemIndicatorRef=WarningIndicator  # Diagnostics Data Import
          DemDebounceAlgorithmClass  # Diagnostics Data Import
            DemDebounceCounterBased: DemDebounceCounterDecrementStepSize=128, DemDebounceCounterIncrementStepSize=127, DemDebounceCounterJumpDown=true, DemDebounceCounterJumpUp=true  # Diagnostics Data Import
      DTCClass_INV_RSLVR_COS_ELEC_OPEN (DemDTCClass): DemDTCSeverity=DEM_DTC_SEV_IMMEDIATELY, DemUdsDTC=842259  # Diagnostics Data Import
      INV_RSLVR_COS_ELEC_HI (DemEventParameter):  # Diagnostics Data Import
        DemEventKind = DEM_EVENT_KIND_SWC
        DemMaxNumberFreezeFrameRecords = 2
        DemDTCClassRef = DTCClass_INV_RSLVR_COS_ELEC_HI
        DemExtendedDataClassRef = ExtendedDataClass_5ecd55b9
        DemFreezeFrameClassRef = FreezeFrameClass_c3111450
        DemEventClass:  # Diagnostics Data Import
          DemAgingAllowed = true
          DemAgingCycleCounterThreshold = 40
          DemEventDestination = DEM_DTC_ORIGIN_PRIMARY_MEMORY
          DemEventPriority = 1
          DemEventFailureCycleCounterThreshold = 0
          DemAgingCycleRef = PowerCycle
          DemEnableConditionGroupRef = EnableConditionGroup_1027fc3a
          DemOperationCycleRef = PowerCycle
          IndicatorAttribute_WarningIndicator (DemIndicatorAttribute): DemIndicatorFailureCycleSource=DEM_FAILURE_CYCLE_EVENT, DemIndicatorHealingCycleRef=PowerCycle, DemIndicatorRef=WarningIndicator  # Diagnostics Data Import
          DemDebounceAlgorithmClass  # Diagnostics Data Import
            DemDebounceCounterBased: DemDebounceCounterDecrementStepSize=128, DemDebounceCounterIncrementStepSize=127, DemDebounceCounterJumpDown=true, DemDebounceCounterJumpUp=true  # Diagnostics Data Import
      DTCClass_INV_RSLVR_COS_ELEC_HI (DemDTCClass): DemDTCSeverity=DEM_DTC_SEV_IMMEDIATELY, DemUdsDTC=842258  # Diagnostics Data Import
      INV_RSLVR_COS_ELEC_LO (DemEventParameter):  # Diagnostics Data Import
        DemEventKind = DEM_EVENT_KIND_SWC
        DemMaxNumberFreezeFrameRecords = 2
        DemDTCClassRef = DTCClass_INV_RSLVR_COS_ELEC_LO
        DemExtendedDataClassRef = ExtendedDataClass_5ecd55b9
        DemFreezeFrameClassRef = FreezeFrameClass_c3111450
        DemEventClass:  # Diagnostics Data Import
          DemAgingAllowed = true
          DemAgingCycleCounterThreshold = 40
          DemEventDestination = DEM_DTC_ORIGIN_PRIMARY_MEMORY
          DemEventPriority = 1
          DemEventFailureCycleCounterThreshold = 0
          DemAgingCycleRef = PowerCycle
          DemEnableConditionGroupRef = EnableConditionGroup_1027fc3a
          DemOperationCycleRef = PowerCycle
          IndicatorAttribute_WarningIndicator (DemIndicatorAttribute): DemIndicatorFailureCycleSource=DEM_FAILURE_CYCLE_EVENT, DemIndicatorHealingCycleRef=PowerCycle, DemIndicatorRef=WarningIndicator  # Diagnostics Data Import
          DemDebounceAlgorithmClass  # Diagnostics Data Import
            DemDebounceCounterBased: DemDebounceCounterDecrementStepSize=128, DemDebounceCounterIncrementStepSize=127, DemDebounceCounterJumpDown=true, DemDebounceCounterJumpUp=true  # Diagnostics Data Import
      DTCClass_INV_RSLVR_COS_ELEC_LO (DemDTCClass): DemDTCSeverity=DEM_DTC_SEV_IMMEDIATELY, DemUdsDTC=842257  # Diagnostics Data Import
      INV_RSLVR_COS_ELEC_FLT (DemEventParameter):  # Diagnostics Data Import
        DemEventKind = DEM_EVENT_KIND_SWC
        DemMaxNumberFreezeFrameRecords = 2
        DemDTCClassRef = DTCClass_INV_RSLVR_COS_ELEC_FLT
        DemExtendedDataClassRef = ExtendedDataClass_5ecd55b9
        DemFreezeFrameClassRef = FreezeFrameClass_c3111450
        DemEventClass:  # Diagnostics Data Import
          DemAgingAllowed = true
          DemAgingCycleCounterThreshold = 40
          DemEventDestination = DEM_DTC_ORIGIN_PRIMARY_MEMORY
          DemEventPriority = 1
          DemEventFailureCycleCounterThreshold = 0
          DemAgingCycleRef = PowerCycle
          DemOperationCycleRef = PowerCycle
          IndicatorAttribute_WarningIndicator (DemIndicatorAttribute): DemIndicatorFailureCycleSource=DEM_FAILURE_CYCLE_EVENT, DemIndicatorHealingCycleRef=PowerCycle, DemIndicatorRef=WarningIndicator  # Diagnostics Data Import
          DemDebounceAlgorithmClass  # Diagnostics Data Import
            DemDebounceCounterBased: DemDebounceCounterDecrementStepSize=128, DemDebounceCounterIncrementStepSize=127, DemDebounceCounterJumpDown=true, DemDebounceCounterJumpUp=true  # Diagnostics Data Import
      DTCClass_INV_RSLVR_COS_ELEC_FLT (DemDTCClass): DemDTCSeverity=DEM_DTC_SEV_IMMEDIATELY, DemUdsDTC=842241  # Diagnostics Data Import
      INV_UHVDC_OV_SWP (DemEventParameter):  # Diagnostics Data Import
        DemEventKind = DEM_EVENT_KIND_SWC
        DemMaxNumberFreezeFrameRecords = 2
        DemDTCClassRef = DTCClass_INV_UHVDC_OV_SWP
        DemExtendedDataClassRef = ExtendedDataClass_5ecd55b9
        DemFreezeFrameClassRef = FreezeFrameClass_c3111450
        DemEventClass:  # Diagnostics Data Import
          DemAgingAllowed = true
          DemAgingCycleCounterThreshold = 40
          DemEventDestination = DEM_DTC_ORIGIN_PRIMARY_MEMORY
          DemEventPriority = 1
          DemEventFailureCycleCounterThreshold = 0
          DemAgingCycleRef = PowerCycle
          DemEnableConditionGroupRef = EnableConditionGroup_06a6aa19
          DemOperationCycleRef = PowerCycle
          IndicatorAttribute_WarningIndicator (DemIndicatorAttribute): DemIndicatorFailureCycleSource=DEM_FAILURE_CYCLE_EVENT, DemIndicatorHealingCycleRef=PowerCycle, DemIndicatorRef=WarningIndicator  # Diagnostics Data Import
          DemDebounceAlgorithmClass  # Diagnostics Data Import
            DemDebounceCounterBased: DemDebounceCounterDecrementStepSize=128, DemDebounceCounterIncrementStepSize=127, DemDebounceCounterJumpDown=true, DemDebounceCounterJumpUp=true  # Diagnostics Data Import
      DTCClass_INV_UHVDC_OV_SWP (DemDTCClass): DemDTCSeverity=DEM_DTC_SEV_IMMEDIATELY, DemUdsDTC=817408  # Diagnostics Data Import
      INV_RSLVR_SIN_AMP (DemEventParameter):  # Diagnostics Data Import
        DemEventKind = DEM_EVENT_KIND_SWC
        DemMaxNumberFreezeFrameRecords = 2
        DemDTCClassRef = DTCClass_INV_RSLVR_SIN_AMP
        DemExtendedDataClassRef = ExtendedDataClass_5ecd55b9
        DemFreezeFrameClassRef = FreezeFrameClass_c3111450
        DemEventClass:  # Diagnostics Data Import
          DemAgingAllowed = true
          DemAgingCycleCounterThreshold = 40
          DemEventDestination = DEM_DTC_ORIGIN_PRIMARY_MEMORY
          DemEventPriority = 1
          DemEventFailureCycleCounterThreshold = 0
          DemAgingCycleRef = PowerCycle
          DemEnableConditionGroupRef = EnableConditionGroup_1027fc3a
          DemOperationCycleRef = PowerCycle
          IndicatorAttribute_WarningIndicator (DemIndicatorAttribute): DemIndicatorFailureCycleSource=DEM_FAILURE_CYCLE_EVENT, DemIndicatorHealingCycleRef=PowerCycle, DemIndicatorRef=WarningIndicator  # Diagnostics Data Import
          DemDebounceAlgorithmClass  # Diagnostics Data Import
            DemDebounceCounterBased: DemDebounceCounterDecrementStepSize=128, DemDebounceCounterIncrementStepSize=127, DemDebounceCounterJumpDown=true, DemDebounceCounterJumpUp=true  # Diagnostics Data Import
      DTCClass_INV_RSLVR_SIN_AMP (DemDTCClass): DemDTCSeverity=DEM_DTC_SEV_IMMEDIATELY, DemUdsDTC=809506  # Diagnostics Data Import
      INV_RSLVR_SIN_RNG_NOK (DemEventParameter):  # Diagnostics Data Import
        DemEventKind = DEM_EVENT_KIND_SWC
        DemMaxNumberFreezeFrameRecords = 2
        DemDTCClassRef = DTCClass_INV_RSLVR_SIN_RNG_NOK
        DemExtendedDataClassRef = ExtendedDataClass_5ecd55b9
        DemFreezeFrameClassRef = FreezeFrameClass_c3111450
        DemEventClass:  # Diagnostics Data Import
          DemAgingAllowed = true
          DemAgingCycleCounterThreshold = 40
          DemEventDestination = DEM_DTC_ORIGIN_PRIMARY_MEMORY
          DemEventPriority = 1
          DemEventFailureCycleCounterThreshold = 0
          DemAgingCycleRef = PowerCycle
          DemOperationCycleRef = PowerCycle
          IndicatorAttribute_WarningIndicator (DemIndicatorAttribute): DemIndicatorFailureCycleSource=DEM_FAILURE_CYCLE_EVENT, DemIndicatorHealingCycleRef=PowerCycle, DemIndicatorRef=WarningIndicator  # Diagnostics Data Import
          DemDebounceAlgorithmClass  # Diagnostics Data Import
            DemDebounceCounterBased: DemDebounceCounterDecrementStepSize=128, DemDebounceCounterIncrementStepSize=127, DemDebounceCounterJumpDown=true, DemDebounceCounterJumpUp=true  # Diagnostics Data Import
      DTCClass_INV_RSLVR_SIN_RNG_NOK (DemDTCClass): DemDTCSeverity=DEM_DTC_SEV_IMMEDIATELY, DemUdsDTC=809500  # Diagnostics Data Import
      INV_RSLVR_SIN_RNG_HI (DemEventParameter):  # Diagnostics Data Import
        DemEventKind = DEM_EVENT_KIND_SWC
        DemMaxNumberFreezeFrameRecords = 2
        DemDTCClassRef = DTCClass_INV_RSLVR_SIN_RNG_HI
        DemExtendedDataClassRef = ExtendedDataClass_5ecd55b9
        DemFreezeFrameClassRef = FreezeFrameClass_c3111450
        DemEventClass:  # Diagnostics Data Import
          DemAgingAllowed = true
          DemAgingCycleCounterThreshold = 40
          DemEventDestination = DEM_DTC_ORIGIN_PRIMARY_MEMORY
          DemEventPriority = 1
          DemEventFailureCycleCounterThreshold = 0
          DemAgingCycleRef = PowerCycle
          DemEnableConditionGroupRef = EnableConditionGroup_1027fc3a
          DemOperationCycleRef = PowerCycle
          IndicatorAttribute_WarningIndicator (DemIndicatorAttribute): DemIndicatorFailureCycleSource=DEM_FAILURE_CYCLE_EVENT, DemIndicatorHealingCycleRef=PowerCycle, DemIndicatorRef=WarningIndicator  # Diagnostics Data Import
          DemDebounceAlgorithmClass  # Diagnostics Data Import
            DemDebounceCounterBased: DemDebounceCounterDecrementStepSize=128, DemDebounceCounterIncrementStepSize=127, DemDebounceCounterJumpDown=true, DemDebounceCounterJumpUp=true  # Diagnostics Data Import
      DTCClass_INV_RSLVR_SIN_RNG_HI (DemDTCClass): DemDTCSeverity=DEM_DTC_SEV_IMMEDIATELY, DemUdsDTC=809495  # Diagnostics Data Import
      INV_RSLVR_SIN_RNG_LO (DemEventParameter):  # Diagnostics Data Import
        DemEventKind = DEM_EVENT_KIND_SWC
        DemMaxNumberFreezeFrameRecords = 2
        DemDTCClassRef = DTCClass_INV_RSLVR_SIN_RNG_LO
        DemExtendedDataClassRef = ExtendedDataClass_5ecd55b9
        DemFreezeFrameClassRef = FreezeFrameClass_c3111450
        DemEventClass:  # Diagnostics Data Import
          DemAgingAllowed = true
          DemAgingCycleCounterThreshold = 40
          DemEventDestination = DEM_DTC_ORIGIN_PRIMARY_MEMORY
          DemEventPriority = 1
          DemEventFailureCycleCounterThreshold = 0
          DemAgingCycleRef = PowerCycle
          DemEnableConditionGroupRef = EnableConditionGroup_7ab46a93
          DemOperationCycleRef = PowerCycle
          IndicatorAttribute_WarningIndicator (DemIndicatorAttribute): DemIndicatorFailureCycleSource=DEM_FAILURE_CYCLE_EVENT, DemIndicatorHealingCycleRef=PowerCycle, DemIndicatorRef=WarningIndicator  # Diagnostics Data Import
          DemDebounceAlgorithmClass  # Diagnostics Data Import
            DemDebounceCounterBased: DemDebounceCounterDecrementStepSize=128, DemDebounceCounterIncrementStepSize=127, DemDebounceCounterJumpDown=true, DemDebounceCounterJumpUp=true  # Diagnostics Data Import
      DTCClass_INV_RSLVR_SIN_RNG_LO (DemDTCClass): DemDTCSeverity=DEM_DTC_SEV_IMMEDIATELY, DemUdsDTC=809494  # Diagnostics Data Import
      INV_RSLVR_SIN_ELEC_OPEN (DemEventParameter):  # Diagnostics Data Import
        DemEventKind = DEM_EVENT_KIND_SWC
        DemMaxNumberFreezeFrameRecords = 2
        DemDTCClassRef = DTCClass_INV_RSLVR_SIN_ELEC_OPEN
        DemExtendedDataClassRef = ExtendedDataClass_5ecd55b9
        DemFreezeFrameClassRef = FreezeFrameClass_c3111450
        DemEventClass:  # Diagnostics Data Import
          DemAgingAllowed = true
          DemAgingCycleCounterThreshold = 40
          DemEventDestination = DEM_DTC_ORIGIN_PRIMARY_MEMORY
          DemEventPriority = 1
          DemEventFailureCycleCounterThreshold = 0
          DemAgingCycleRef = PowerCycle
          DemEnableConditionGroupRef = EnableConditionGroup_1027fc3a
          DemOperationCycleRef = PowerCycle
          IndicatorAttribute_WarningIndicator (DemIndicatorAttribute): DemIndicatorFailureCycleSource=DEM_FAILURE_CYCLE_EVENT, DemIndicatorHealingCycleRef=PowerCycle, DemIndicatorRef=WarningIndicator  # Diagnostics Data Import
          DemDebounceAlgorithmClass  # Diagnostics Data Import
            DemDebounceCounterBased: DemDebounceCounterDecrementStepSize=128, DemDebounceCounterIncrementStepSize=127, DemDebounceCounterJumpDown=true, DemDebounceCounterJumpUp=true  # Diagnostics Data Import
      DTCClass_INV_RSLVR_SIN_ELEC_OPEN (DemDTCClass): DemDTCSeverity=DEM_DTC_SEV_IMMEDIATELY, DemUdsDTC=809491  # Diagnostics Data Import
      INV_RSLVR_SIN_ELEC_HI (DemEventParameter):  # Diagnostics Data Import
        DemEventKind = DEM_EVENT_KIND_SWC
        DemMaxNumberFreezeFrameRecords = 2
        DemDTCClassRef = DTCClass_INV_RSLVR_SIN_ELEC_HI
        DemExtendedDataClassRef = ExtendedDataClass_5ecd55b9
        DemFreezeFrameClassRef = FreezeFrameClass_c3111450
        DemEventClass:  # Diagnostics Data Import
          DemAgingAllowed = true
          DemAgingCycleCounterThreshold = 40
          DemEventDestination = DEM_DTC_ORIGIN_PRIMARY_MEMORY
          DemEventPriority = 1
          DemEventFailureCycleCounterThreshold = 0
          DemAgingCycleRef = PowerCycle
          DemEnableConditionGroupRef = EnableConditionGroup_1027fc3a
          DemOperationCycleRef = PowerCycle
          IndicatorAttribute_WarningIndicator (DemIndicatorAttribute): DemIndicatorFailureCycleSource=DEM_FAILURE_CYCLE_EVENT, DemIndicatorHealingCycleRef=PowerCycle, DemIndicatorRef=WarningIndicator  # Diagnostics Data Import
          DemDebounceAlgorithmClass  # Diagnostics Data Import
            DemDebounceCounterBased: DemDebounceCounterDecrementStepSize=128, DemDebounceCounterIncrementStepSize=127, DemDebounceCounterJumpDown=true, DemDebounceCounterJumpUp=true  # Diagnostics Data Import
      DTCClass_INV_RSLVR_SIN_ELEC_HI (DemDTCClass): DemDTCSeverity=DEM_DTC_SEV_IMMEDIATELY, DemUdsDTC=809490  # Diagnostics Data Import
      INV_RSLVR_SIN_ELEC_LO (DemEventParameter):  # Diagnostics Data Import
        DemEventKind = DEM_EVENT_KIND_SWC
        DemMaxNumberFreezeFrameRecords = 2
        DemDTCClassRef = DTCClass_INV_RSLVR_SIN_ELEC_LO
        DemExtendedDataClassRef = ExtendedDataClass_5ecd55b9
        DemFreezeFrameClassRef = FreezeFrameClass_c3111450
        DemEventClass:  # Diagnostics Data Import
          DemAgingAllowed = true
          DemAgingCycleCounterThreshold = 40
          DemEventDestination = DEM_DTC_ORIGIN_PRIMARY_MEMORY
          DemEventPriority = 1
          DemEventFailureCycleCounterThreshold = 0
          DemAgingCycleRef = PowerCycle
          DemEnableConditionGroupRef = EnableConditionGroup_1027fc3a
          DemOperationCycleRef = PowerCycle
          IndicatorAttribute_WarningIndicator (DemIndicatorAttribute): DemIndicatorFailureCycleSource=DEM_FAILURE_CYCLE_EVENT, DemIndicatorHealingCycleRef=PowerCycle, DemIndicatorRef=WarningIndicator  # Diagnostics Data Import
          DemDebounceAlgorithmClass  # Diagnostics Data Import
            DemDebounceCounterBased: DemDebounceCounterDecrementStepSize=128, DemDebounceCounterIncrementStepSize=127, DemDebounceCounterJumpDown=true, DemDebounceCounterJumpUp=true  # Diagnostics Data Import
      DTCClass_INV_RSLVR_SIN_ELEC_LO (DemDTCClass): DemDTCSeverity=DEM_DTC_SEV_IMMEDIATELY, DemUdsDTC=809489  # Diagnostics Data Import
      INV_RSLVR_SIN_ELEC_FLT (DemEventParameter):  # Diagnostics Data Import
        DemEventKind = DEM_EVENT_KIND_SWC
        DemMaxNumberFreezeFrameRecords = 2
        DemDTCClassRef = DTCClass_INV_RSLVR_SIN_ELEC_FLT
        DemExtendedDataClassRef = ExtendedDataClass_5ecd55b9
        DemFreezeFrameClassRef = FreezeFrameClass_c3111450
        DemEventClass:  # Diagnostics Data Import
          DemAgingAllowed = true
          DemAgingCycleCounterThreshold = 40
          DemEventDestination = DEM_DTC_ORIGIN_PRIMARY_MEMORY
          DemEventPriority = 1
          DemEventFailureCycleCounterThreshold = 0
          DemAgingCycleRef = PowerCycle
          DemOperationCycleRef = PowerCycle
          IndicatorAttribute_WarningIndicator (DemIndicatorAttribute): DemIndicatorFailureCycleSource=DEM_FAILURE_CYCLE_EVENT, DemIndicatorHealingCycleRef=PowerCycle, DemIndicatorRef=WarningIndicator  # Diagnostics Data Import
          DemDebounceAlgorithmClass  # Diagnostics Data Import
            DemDebounceCounterBased: DemDebounceCounterDecrementStepSize=128, DemDebounceCounterIncrementStepSize=127, DemDebounceCounterJumpDown=true, DemDebounceCounterJumpUp=true  # Diagnostics Data Import
      DTCClass_INV_RSLVR_SIN_ELEC_FLT (DemDTCClass): DemDTCSeverity=DEM_DTC_SEV_IMMEDIATELY, DemUdsDTC=809473  # Diagnostics Data Import
      INV_RSLVR_EXCT_PLAUS (DemEventParameter):  # Diagnostics Data Import
        DemEventKind = DEM_EVENT_KIND_SWC
        DemMaxNumberFreezeFrameRecords = 2
        DemDTCClassRef = DTCClass_INV_RSLVR_EXCT_PLAUS
        DemExtendedDataClassRef = ExtendedDataClass_5ecd55b9
        DemFreezeFrameClassRef = FreezeFrameClass_c3111450
        DemEventClass:  # Diagnostics Data Import
          DemAgingAllowed = true
          DemAgingCycleCounterThreshold = 40
          DemEventDestination = DEM_DTC_ORIGIN_PRIMARY_MEMORY
          DemEventPriority = 1
          DemEventFailureCycleCounterThreshold = 0
          DemAgingCycleRef = PowerCycle
          DemEnableConditionGroupRef = EnableConditionGroup_1027fc3a
          DemOperationCycleRef = PowerCycle
          IndicatorAttribute_WarningIndicator (DemIndicatorAttribute): DemIndicatorFailureCycleSource=DEM_FAILURE_CYCLE_EVENT, DemIndicatorHealingCycleRef=PowerCycle, DemIndicatorRef=WarningIndicator  # Diagnostics Data Import
          DemDebounceAlgorithmClass  # Diagnostics Data Import
            DemDebounceCounterBased: DemDebounceCounterDecrementStepSize=128, DemDebounceCounterIncrementStepSize=127, DemDebounceCounterJumpDown=true, DemDebounceCounterJumpUp=true  # Diagnostics Data Import
      DTCClass_INV_RSLVR_EXCT_PLAUS (DemDTCClass): DemDTCSeverity=DEM_DTC_SEV_IMMEDIATELY, DemUdsDTC=807010  # Diagnostics Data Import
      INV_RSLVR_EXCT_FREQ_RNG_NOK (DemEventParameter):  # Diagnostics Data Import
        DemEventKind = DEM_EVENT_KIND_SWC
        DemMaxNumberFreezeFrameRecords = 2
        DemDTCClassRef = DTCClass_INV_RSLVR_EXCT_FREQ_RNG_NOK
        DemExtendedDataClassRef = ExtendedDataClass_5ecd55b9
        DemFreezeFrameClassRef = FreezeFrameClass_c3111450
        DemEventClass:  # Diagnostics Data Import
          DemAgingAllowed = true
          DemAgingCycleCounterThreshold = 40
          DemEventDestination = DEM_DTC_ORIGIN_PRIMARY_MEMORY
          DemEventPriority = 1
          DemEventFailureCycleCounterThreshold = 0
          DemAgingCycleRef = PowerCycle
          DemOperationCycleRef = PowerCycle
          IndicatorAttribute_WarningIndicator (DemIndicatorAttribute): DemIndicatorFailureCycleSource=DEM_FAILURE_CYCLE_EVENT, DemIndicatorHealingCycleRef=PowerCycle, DemIndicatorRef=WarningIndicator  # Diagnostics Data Import
          DemDebounceAlgorithmClass  # Diagnostics Data Import
            DemDebounceCounterBased: DemDebounceCounterDecrementStepSize=128, DemDebounceCounterIncrementStepSize=127, DemDebounceCounterJumpDown=true, DemDebounceCounterJumpUp=true  # Diagnostics Data Import
      DTCClass_INV_RSLVR_EXCT_FREQ_RNG_NOK (DemDTCClass): DemDTCSeverity=DEM_DTC_SEV_IMMEDIATELY, DemUdsDTC=806968  # Diagnostics Data Import
      INV_RSLVR_EXCT_RNG_NOK (DemEventParameter):  # Diagnostics Data Import
        DemEventKind = DEM_EVENT_KIND_SWC
        DemMaxNumberFreezeFrameRecords = 2
        DemDTCClassRef = DTCClass_INV_RSLVR_EXCT_RNG_NOK
        DemExtendedDataClassRef = ExtendedDataClass_5ecd55b9
        DemFreezeFrameClassRef = FreezeFrameClass_c3111450
        DemEventClass:  # Diagnostics Data Import
          DemAgingAllowed = true
          DemAgingCycleCounterThreshold = 40
          DemEventDestination = DEM_DTC_ORIGIN_PRIMARY_MEMORY
          DemEventPriority = 1
          DemEventFailureCycleCounterThreshold = 0
          DemAgingCycleRef = PowerCycle
          DemOperationCycleRef = PowerCycle
          IndicatorAttribute_WarningIndicator (DemIndicatorAttribute): DemIndicatorFailureCycleSource=DEM_FAILURE_CYCLE_EVENT, DemIndicatorHealingCycleRef=PowerCycle, DemIndicatorRef=WarningIndicator  # Diagnostics Data Import
          DemDebounceAlgorithmClass  # Diagnostics Data Import
            DemDebounceCounterBased: DemDebounceCounterDecrementStepSize=128, DemDebounceCounterIncrementStepSize=127, DemDebounceCounterJumpDown=true, DemDebounceCounterJumpUp=true  # Diagnostics Data Import
      DTCClass_INV_RSLVR_EXCT_RNG_NOK (DemDTCClass): DemDTCSeverity=DEM_DTC_SEV_IMMEDIATELY, DemUdsDTC=806940  # Diagnostics Data Import
      INV_RSLVR_EXCT_RNG_HI (DemEventParameter):  # Diagnostics Data Import
        DemEventKind = DEM_EVENT_KIND_SWC
        DemMaxNumberFreezeFrameRecords = 2
        DemDTCClassRef = DTCClass_INV_RSLVR_EXCT_RNG_HI
        DemExtendedDataClassRef = ExtendedDataClass_5ecd55b9
        DemFreezeFrameClassRef = FreezeFrameClass_c3111450
        DemEventClass:  # Diagnostics Data Import
          DemAgingAllowed = true
          DemAgingCycleCounterThreshold = 40
          DemEventDestination = DEM_DTC_ORIGIN_PRIMARY_MEMORY
          DemEventPriority = 1
          DemEventFailureCycleCounterThreshold = 0
          DemAgingCycleRef = PowerCycle
          DemEnableConditionGroupRef = EnableConditionGroup_1027fc3a
          DemOperationCycleRef = PowerCycle
          IndicatorAttribute_WarningIndicator (DemIndicatorAttribute): DemIndicatorFailureCycleSource=DEM_FAILURE_CYCLE_EVENT, DemIndicatorHealingCycleRef=PowerCycle, DemIndicatorRef=WarningIndicator  # Diagnostics Data Import
          DemDebounceAlgorithmClass  # Diagnostics Data Import
            DemDebounceCounterBased: DemDebounceCounterDecrementStepSize=128, DemDebounceCounterIncrementStepSize=127, DemDebounceCounterJumpDown=true, DemDebounceCounterJumpUp=true  # Diagnostics Data Import
      DTCClass_INV_RSLVR_EXCT_RNG_HI (DemDTCClass): DemDTCSeverity=DEM_DTC_SEV_IMMEDIATELY, DemUdsDTC=806935  # Diagnostics Data Import
      INV_RSLVR_EXCT_RNG_LO (DemEventParameter):  # Diagnostics Data Import
        DemEventKind = DEM_EVENT_KIND_SWC
        DemMaxNumberFreezeFrameRecords = 2
        DemDTCClassRef = DTCClass_INV_RSLVR_EXCT_RNG_LO
        DemExtendedDataClassRef = ExtendedDataClass_5ecd55b9
        DemFreezeFrameClassRef = FreezeFrameClass_c3111450
        DemEventClass:  # Diagnostics Data Import
          DemAgingAllowed = true
          DemAgingCycleCounterThreshold = 40
          DemEventDestination = DEM_DTC_ORIGIN_PRIMARY_MEMORY
          DemEventPriority = 1
          DemEventFailureCycleCounterThreshold = 0
          DemAgingCycleRef = PowerCycle
          DemEnableConditionGroupRef = EnableConditionGroup_1027fc3a
          DemOperationCycleRef = PowerCycle
          IndicatorAttribute_WarningIndicator (DemIndicatorAttribute): DemIndicatorFailureCycleSource=DEM_FAILURE_CYCLE_EVENT, DemIndicatorHealingCycleRef=PowerCycle, DemIndicatorRef=WarningIndicator  # Diagnostics Data Import
          DemDebounceAlgorithmClass  # Diagnostics Data Import
            DemDebounceCounterBased: DemDebounceCounterDecrementStepSize=128, DemDebounceCounterIncrementStepSize=127, DemDebounceCounterJumpDown=true, DemDebounceCounterJumpUp=true  # Diagnostics Data Import
      DTCClass_INV_RSLVR_EXCT_RNG_LO (DemDTCClass): DemDTCSeverity=DEM_DTC_SEV_IMMEDIATELY, DemUdsDTC=806934  # Diagnostics Data Import
      INV_RSLVR_EXCT_ELEC_OPEN (DemEventParameter):  # Diagnostics Data Import
        DemEventKind = DEM_EVENT_KIND_SWC
        DemMaxNumberFreezeFrameRecords = 2
        DemDTCClassRef = DTCClass_INV_RSLVR_EXCT_ELEC_OPEN
        DemExtendedDataClassRef = ExtendedDataClass_5ecd55b9
        DemFreezeFrameClassRef = FreezeFrameClass_c3111450
        DemEventClass:  # Diagnostics Data Import
          DemAgingAllowed = true
          DemAgingCycleCounterThreshold = 40
          DemEventDestination = DEM_DTC_ORIGIN_PRIMARY_MEMORY
          DemEventPriority = 1
          DemEventFailureCycleCounterThreshold = 0
          DemAgingCycleRef = PowerCycle
          DemEnableConditionGroupRef = EnableConditionGroup_1027fc3a
          DemOperationCycleRef = PowerCycle
          IndicatorAttribute_WarningIndicator (DemIndicatorAttribute): DemIndicatorFailureCycleSource=DEM_FAILURE_CYCLE_EVENT, DemIndicatorHealingCycleRef=PowerCycle, DemIndicatorRef=WarningIndicator  # Diagnostics Data Import
          DemDebounceAlgorithmClass  # Diagnostics Data Import
            DemDebounceCounterBased: DemDebounceCounterDecrementStepSize=128, DemDebounceCounterIncrementStepSize=127, DemDebounceCounterJumpDown=true, DemDebounceCounterJumpUp=true  # Diagnostics Data Import
      DTCClass_INV_RSLVR_EXCT_ELEC_OPEN (DemDTCClass): DemDTCSeverity=DEM_DTC_SEV_IMMEDIATELY, DemUdsDTC=806931  # Diagnostics Data Import
      INV_RSLVR_EXCT_ELEC_HI (DemEventParameter):  # Diagnostics Data Import
        DemEventKind = DEM_EVENT_KIND_SWC
        DemMaxNumberFreezeFrameRecords = 2
        DemDTCClassRef = DTCClass_INV_RSLVR_EXCT_ELEC_HI
        DemExtendedDataClassRef = ExtendedDataClass_5ecd55b9
        DemFreezeFrameClassRef = FreezeFrameClass_c3111450
        DemEventClass:  # Diagnostics Data Import
          DemAgingAllowed = true
          DemAgingCycleCounterThreshold = 40
          DemEventDestination = DEM_DTC_ORIGIN_PRIMARY_MEMORY
          DemEventPriority = 1
          DemEventFailureCycleCounterThreshold = 0
          DemAgingCycleRef = PowerCycle
          DemEnableConditionGroupRef = EnableConditionGroup_1027fc3a
          DemOperationCycleRef = PowerCycle
          IndicatorAttribute_WarningIndicator (DemIndicatorAttribute): DemIndicatorFailureCycleSource=DEM_FAILURE_CYCLE_EVENT, DemIndicatorHealingCycleRef=PowerCycle, DemIndicatorRef=WarningIndicator  # Diagnostics Data Import
          DemDebounceAlgorithmClass  # Diagnostics Data Import
            DemDebounceCounterBased: DemDebounceCounterDecrementStepSize=128, DemDebounceCounterIncrementStepSize=127, DemDebounceCounterJumpDown=true, DemDebounceCounterJumpUp=true  # Diagnostics Data Import
      DTCClass_INV_RSLVR_EXCT_ELEC_HI (DemDTCClass): DemDTCSeverity=DEM_DTC_SEV_IMMEDIATELY, DemUdsDTC=806930  # Diagnostics Data Import
      INV_RSLVR_EXCT_ELEC_LO (DemEventParameter):  # Diagnostics Data Import
        DemEventKind = DEM_EVENT_KIND_SWC
        DemMaxNumberFreezeFrameRecords = 2
        DemDTCClassRef = DTCClass_INV_RSLVR_EXCT_ELEC_LO
        DemExtendedDataClassRef = ExtendedDataClass_5ecd55b9
        DemFreezeFrameClassRef = FreezeFrameClass_c3111450
        DemEventClass:  # Diagnostics Data Import
          DemAgingAllowed = true
          DemAgingCycleCounterThreshold = 40
          DemEventDestination = DEM_DTC_ORIGIN_PRIMARY_MEMORY
          DemEventPriority = 1
          DemEventFailureCycleCounterThreshold = 0
          DemAgingCycleRef = PowerCycle
          DemEnableConditionGroupRef = EnableConditionGroup_1027fc3a
          DemOperationCycleRef = PowerCycle
          IndicatorAttribute_WarningIndicator (DemIndicatorAttribute): DemIndicatorFailureCycleSource=DEM_FAILURE_CYCLE_EVENT, DemIndicatorHealingCycleRef=PowerCycle, DemIndicatorRef=WarningIndicator  # Diagnostics Data Import
          DemDebounceAlgorithmClass  # Diagnostics Data Import
            DemDebounceCounterBased: DemDebounceCounterDecrementStepSize=128, DemDebounceCounterIncrementStepSize=127, DemDebounceCounterJumpDown=true, DemDebounceCounterJumpUp=true  # Diagnostics Data Import
      DTCClass_INV_RSLVR_EXCT_ELEC_LO (DemDTCClass): DemDTCSeverity=DEM_DTC_SEV_IMMEDIATELY, DemUdsDTC=806929  # Diagnostics Data Import
      INV_RSLVR_EXCT_ELEC_FLT (DemEventParameter):  # Diagnostics Data Import
        DemEventKind = DEM_EVENT_KIND_SWC
        DemMaxNumberFreezeFrameRecords = 2
        DemDTCClassRef = DTCClass_INV_RSLVR_EXCT_ELEC_FLT
        DemExtendedDataClassRef = ExtendedDataClass_5ecd55b9
        DemFreezeFrameClassRef = FreezeFrameClass_c3111450
        DemEventClass:  # Diagnostics Data Import
          DemAgingAllowed = true
          DemAgingCycleCounterThreshold = 40
          DemEventDestination = DEM_DTC_ORIGIN_PRIMARY_MEMORY
          DemEventPriority = 1
          DemEventFailureCycleCounterThreshold = 0
          DemAgingCycleRef = PowerCycle
          DemOperationCycleRef = PowerCycle
          IndicatorAttribute_WarningIndicator (DemIndicatorAttribute): DemIndicatorFailureCycleSource=DEM_FAILURE_CYCLE_EVENT, DemIndicatorHealingCycleRef=PowerCycle, DemIndicatorRef=WarningIndicator  # Diagnostics Data Import
          DemDebounceAlgorithmClass  # Diagnostics Data Import
            DemDebounceCounterBased: DemDebounceCounterDecrementStepSize=128, DemDebounceCounterIncrementStepSize=127, DemDebounceCounterJumpDown=true, DemDebounceCounterJumpUp=true  # Diagnostics Data Import
      DTCClass_INV_RSLVR_EXCT_ELEC_FLT (DemDTCClass): DemDTCSeverity=DEM_DTC_SEV_IMMEDIATELY, DemUdsDTC=806913  # Diagnostics Data Import
      VcEvMonErrMode (DemEventParameter):  # Diagnostics Data Import
        DemEventKind = DEM_EVENT_KIND_SWC
        DemMaxNumberFreezeFrameRecords = 2
        DemDTCClassRef = DTCClass_VcEvMonErrMode
        DemExtendedDataClassRef = ExtendedDataClass_5ecd55b9
        DemFreezeFrameClassRef = FreezeFrameClass_c3111450
        DemEventClass:  # Diagnostics Data Import
          DemAgingAllowed = true
          DemAgingCycleCounterThreshold = 40
          DemEventDestination = DEM_DTC_ORIGIN_PRIMARY_MEMORY
          DemEventPriority = 1
          DemEventFailureCycleCounterThreshold = 0
          DemAgingCycleRef = PowerCycle
          DemEnableConditionGroupRef = EnableConditionGroup_0e207db3
          DemOperationCycleRef = PowerCycle
          IndicatorAttribute_WarningIndicator (DemIndicatorAttribute): DemIndicatorFailureCycleSource=DEM_FAILURE_CYCLE_EVENT, DemIndicatorHealingCycleRef=PowerCycle, DemIndicatorRef=WarningIndicator  # Diagnostics Data Import
          DemDebounceAlgorithmClass  # Diagnostics Data Import
            DemDebounceCounterBased: DemDebounceCounterDecrementStepSize=128, DemDebounceCounterIncrementStepSize=127, DemDebounceCounterJumpDown=true, DemDebounceCounterJumpUp=true  # Diagnostics Data Import
      DTCClass_VcEvMonErrMode (DemDTCClass): DemDTCSeverity=DEM_DTC_SEV_IMMEDIATELY, DemUdsDTC=792980  # Diagnostics Data Import
      VcEvMonTrqAct (DemEventParameter):  # Diagnostics Data Import
        DemEventKind = DEM_EVENT_KIND_SWC
        DemMaxNumberFreezeFrameRecords = 2
        DemDTCClassRef = DTCClass_VcEvMonTrqAct
        DemExtendedDataClassRef = ExtendedDataClass_5ecd55b9
        DemFreezeFrameClassRef = FreezeFrameClass_c3111450
        DemEventClass:  # Diagnostics Data Import
          DemAgingAllowed = true
          DemAgingCycleCounterThreshold = 40
          DemEventDestination = DEM_DTC_ORIGIN_PRIMARY_MEMORY
          DemEventPriority = 1
          DemEventFailureCycleCounterThreshold = 0
          DemAgingCycleRef = PowerCycle
          DemEnableConditionGroupRef = EnableConditionGroup_02c4dcbd
          DemOperationCycleRef = PowerCycle
          IndicatorAttribute_WarningIndicator (DemIndicatorAttribute): DemIndicatorFailureCycleSource=DEM_FAILURE_CYCLE_EVENT, DemIndicatorHealingCycleRef=PowerCycle, DemIndicatorRef=WarningIndicator  # Diagnostics Data Import
          DemDebounceAlgorithmClass  # Diagnostics Data Import
            DemDebounceCounterBased: DemDebounceCounterDecrementStepSize=128, DemDebounceCounterIncrementStepSize=127, DemDebounceCounterJumpDown=true, DemDebounceCounterJumpUp=true  # Diagnostics Data Import
      DTCClass_VcEvMonTrqAct (DemDTCClass): DemDTCSeverity=DEM_DTC_SEV_IMMEDIATELY, DemUdsDTC=792932  # Diagnostics Data Import
      MON_TQ_PLAUS_PWR_MDL (DemEventParameter):  # Diagnostics Data Import
        DemEventKind = DEM_EVENT_KIND_SWC
        DemMaxNumberFreezeFrameRecords = 2
        DemDTCClassRef = DTCClass_MON_TQ_PLAUS_PWR_MDL
        DemExtendedDataClassRef = ExtendedDataClass_5ecd55b9
        DemFreezeFrameClassRef = FreezeFrameClass_c3111450
        DemEventClass:  # Diagnostics Data Import
          DemAgingAllowed = true
          DemAgingCycleCounterThreshold = 40
          DemEventDestination = DEM_DTC_ORIGIN_PRIMARY_MEMORY
          DemEventPriority = 1
          DemEventFailureCycleCounterThreshold = 0
          DemAgingCycleRef = PowerCycle
          DemEnableConditionGroupRef = EnableConditionGroup_500f9dc2
          DemOperationCycleRef = PowerCycle
          IndicatorAttribute_WarningIndicator (DemIndicatorAttribute): DemIndicatorFailureCycleSource=DEM_FAILURE_CYCLE_EVENT, DemIndicatorHealingCycleRef=PowerCycle, DemIndicatorRef=WarningIndicator  # Diagnostics Data Import
          DemDebounceAlgorithmClass  # Diagnostics Data Import
            DemDebounceCounterBased: DemDebounceCounterDecrementStepSize=128, DemDebounceCounterIncrementStepSize=127, DemDebounceCounterJumpDown=true, DemDebounceCounterJumpUp=true  # Diagnostics Data Import
      DTCClass_MON_TQ_PLAUS_PWR_MDL (DemDTCClass): DemDTCSeverity=DEM_DTC_SEV_IMMEDIATELY, DemUdsDTC=792930  # Diagnostics Data Import
      VcEvMonTrqCmp (DemEventParameter):  # Diagnostics Data Import
        DemEventKind = DEM_EVENT_KIND_SWC
        DemMaxNumberFreezeFrameRecords = 2
        DemDTCClassRef = DTCClass_VcEvMonTrqCmp
        DemExtendedDataClassRef = ExtendedDataClass_5ecd55b9
        DemFreezeFrameClassRef = FreezeFrameClass_c3111450
        DemEventClass:  # Diagnostics Data Import
          DemAgingAllowed = true
          DemAgingCycleCounterThreshold = 40
          DemEventDestination = DEM_DTC_ORIGIN_PRIMARY_MEMORY
          DemEventPriority = 1
          DemEventFailureCycleCounterThreshold = 0
          DemAgingCycleRef = PowerCycle
          DemEnableConditionGroupRef = EnableConditionGroup_361fad53
          DemOperationCycleRef = PowerCycle
          IndicatorAttribute_WarningIndicator (DemIndicatorAttribute): DemIndicatorFailureCycleSource=DEM_FAILURE_CYCLE_EVENT, DemIndicatorHealingCycleRef=PowerCycle, DemIndicatorRef=WarningIndicator  # Diagnostics Data Import
          DemDebounceAlgorithmClass  # Diagnostics Data Import
            DemDebounceCounterBased: DemDebounceCounterDecrementStepSize=128, DemDebounceCounterIncrementStepSize=127, DemDebounceCounterJumpDown=true, DemDebounceCounterJumpUp=true  # Diagnostics Data Import
      DTCClass_VcEvMonTrqCmp (DemDTCClass): DemDTCSeverity=DEM_DTC_SEV_IMMEDIATELY, DemUdsDTC=792929  # Diagnostics Data Import
      FS_MONITIOR_ASC_FW_FLT (DemEventParameter):  # Diagnostics Data Import
        DemEventKind = DEM_EVENT_KIND_SWC
        DemMaxNumberFreezeFrameRecords = 2
        DemDTCClassRef = DTCClass_FS_MONITIOR_ASC_FW_FLT
        DemExtendedDataClassRef = ExtendedDataClass_5ecd55b9
        DemFreezeFrameClassRef = FreezeFrameClass_5b6f811c
        DemEventClass:  # Diagnostics Data Import
          DemAgingAllowed = true
          DemAgingCycleCounterThreshold = 40
          DemEventDestination = DEM_DTC_ORIGIN_PRIMARY_MEMORY
          DemEventPriority = 1
          DemEventFailureCycleCounterThreshold = 0
          DemAgingCycleRef = PowerCycle
          DemOperationCycleRef = PowerCycle
          IndicatorAttribute_WarningIndicator (DemIndicatorAttribute): DemIndicatorFailureCycleSource=DEM_FAILURE_CYCLE_EVENT, DemIndicatorHealingCycleRef=PowerCycle, DemIndicatorRef=WarningIndicator  # Diagnostics Data Import
          DemDebounceAlgorithmClass  # Diagnostics Data Import
            DemDebounceCounterBased: DemDebounceCounterDecrementStepSize=128, DemDebounceCounterIncrementStepSize=127, DemDebounceCounterJumpDown=true, DemDebounceCounterJumpUp=true  # Diagnostics Data Import
      DTCClass_FS_MONITIOR_ASC_FW_FLT (DemDTCClass): DemDTCSeverity=DEM_DTC_SEV_IMMEDIATELY, DemUdsDTC=792838  # Diagnostics Data Import
      FS_MONITIOR_ASC_FLT (DemEventParameter):  # Diagnostics Data Import
        DemEventKind = DEM_EVENT_KIND_SWC
        DemMaxNumberFreezeFrameRecords = 2
        DemDTCClassRef = DTCClass_FS_MONITIOR_ASC_FLT
        DemExtendedDataClassRef = ExtendedDataClass_5ecd55b9
        DemFreezeFrameClassRef = FreezeFrameClass_5b6f811c
        DemEventClass:  # Diagnostics Data Import
          DemAgingAllowed = true
          DemAgingCycleCounterThreshold = 40
          DemEventDestination = DEM_DTC_ORIGIN_PRIMARY_MEMORY
          DemEventPriority = 1
          DemEventFailureCycleCounterThreshold = 0
          DemAgingCycleRef = PowerCycle
          DemOperationCycleRef = PowerCycle
          IndicatorAttribute_WarningIndicator (DemIndicatorAttribute): DemIndicatorFailureCycleSource=DEM_FAILURE_CYCLE_EVENT, DemIndicatorHealingCycleRef=PowerCycle, DemIndicatorRef=WarningIndicator  # Diagnostics Data Import
          DemDebounceAlgorithmClass  # Diagnostics Data Import
            DemDebounceCounterBased: DemDebounceCounterDecrementStepSize=128, DemDebounceCounterIncrementStepSize=127, DemDebounceCounterJumpDown=true, DemDebounceCounterJumpUp=true  # Diagnostics Data Import
      DTCClass_FS_MONITIOR_ASC_FLT (DemDTCClass): DemDTCSeverity=DEM_DTC_SEV_IMMEDIATELY, DemUdsDTC=792836  # Diagnostics Data Import
      VcEvMonTrqActPlaus (DemEventParameter):  # Diagnostics Data Import
        DemEventKind = DEM_EVENT_KIND_SWC
        DemMaxNumberFreezeFrameRecords = 2
        DemDTCClassRef = DTCClass_VcEvMonTrqActPlaus
        DemExtendedDataClassRef = ExtendedDataClass_5ecd55b9
        DemFreezeFrameClassRef = FreezeFrameClass_c3111450
        DemEventClass:  # Diagnostics Data Import
          DemAgingAllowed = true
          DemAgingCycleCounterThreshold = 40
          DemEventDestination = DEM_DTC_ORIGIN_PRIMARY_MEMORY
          DemEventPriority = 1
          DemEventFailureCycleCounterThreshold = 0
          DemAgingCycleRef = PowerCycle
          DemEnableConditionGroupRef = EnableConditionGroup_361fad53
          DemOperationCycleRef = PowerCycle
          IndicatorAttribute_WarningIndicator (DemIndicatorAttribute): DemIndicatorFailureCycleSource=DEM_FAILURE_CYCLE_EVENT, DemIndicatorHealingCycleRef=PowerCycle, DemIndicatorRef=WarningIndicator  # Diagnostics Data Import
          DemDebounceAlgorithmClass  # Diagnostics Data Import
            DemDebounceCounterBased: DemDebounceCounterDecrementStepSize=128, DemDebounceCounterIncrementStepSize=127, DemDebounceCounterJumpDown=true, DemDebounceCounterJumpUp=true  # Diagnostics Data Import
      DTCClass_VcEvMonTrqActPlaus (DemDTCClass): DemDTCSeverity=DEM_DTC_SEV_IMMEDIATELY, DemUdsDTC=792832  # Diagnostics Data Import
      INV_RSLVR_EXCT_OC_HWP (DemEventParameter):  # Diagnostics Data Import
        DemEventKind = DEM_EVENT_KIND_SWC
        DemMaxNumberFreezeFrameRecords = 2
        DemDTCClassRef = DTCClass_INV_RSLVR_EXCT_OC_HWP
        DemExtendedDataClassRef = ExtendedDataClass_5ecd55b9
        DemFreezeFrameClassRef = FreezeFrameClass_c3111450
        DemEventClass:  # Diagnostics Data Import
          DemAgingAllowed = true
          DemAgingCycleCounterThreshold = 40
          DemEventDestination = DEM_DTC_ORIGIN_PRIMARY_MEMORY
          DemEventPriority = 1
          DemEventFailureCycleCounterThreshold = 0
          DemAgingCycleRef = PowerCycle
          DemEnableConditionGroupRef = EnableConditionGroup_830522f7
          DemOperationCycleRef = PowerCycle
          IndicatorAttribute_WarningIndicator (DemIndicatorAttribute): DemIndicatorFailureCycleSource=DEM_FAILURE_CYCLE_EVENT, DemIndicatorHealingCycleRef=PowerCycle, DemIndicatorRef=WarningIndicator  # Diagnostics Data Import
          DemDebounceAlgorithmClass  # Diagnostics Data Import
            DemDebounceCounterBased: DemDebounceCounterDecrementStepSize=128, DemDebounceCounterIncrementStepSize=127, DemDebounceCounterJumpDown=true, DemDebounceCounterJumpUp=true  # Diagnostics Data Import
      DTCClass_INV_RSLVR_EXCT_OC_HWP (DemDTCClass): DemDTCSeverity=DEM_DTC_SEV_MAINTENANCE_ONLY, DemUdsDTC=789290  # Diagnostics Data Import
      INV_IAC_PHA_LOSS_MPL (DemEventParameter):  # Diagnostics Data Import
        DemEventKind = DEM_EVENT_KIND_SWC
        DemMaxNumberFreezeFrameRecords = 2
        DemDTCClassRef = DTCClass_INV_IAC_PHA_LOSS_MPL
        DemExtendedDataClassRef = ExtendedDataClass_5ecd55b9
        DemFreezeFrameClassRef = FreezeFrameClass_c3111450
        DemEventClass:  # Diagnostics Data Import
          DemAgingAllowed = true
          DemAgingCycleCounterThreshold = 40
          DemEventDestination = DEM_DTC_ORIGIN_PRIMARY_MEMORY
          DemEventPriority = 1
          DemEventFailureCycleCounterThreshold = 0
          DemAgingCycleRef = PowerCycle
          DemEnableConditionGroupRef = EnableConditionGroup_500f9dc2
          DemOperationCycleRef = PowerCycle
          IndicatorAttribute_WarningIndicator (DemIndicatorAttribute): DemIndicatorFailureCycleSource=DEM_FAILURE_CYCLE_EVENT, DemIndicatorHealingCycleRef=PowerCycle, DemIndicatorRef=WarningIndicator  # Diagnostics Data Import
          DemDebounceAlgorithmClass  # Diagnostics Data Import
            DemDebounceCounterBased: DemDebounceCounterDecrementStepSize=128, DemDebounceCounterIncrementStepSize=127, DemDebounceCounterJumpDown=true, DemDebounceCounterJumpUp=true  # Diagnostics Data Import
      DTCClass_INV_IAC_PHA_LOSS_MPL (DemDTCClass): DemDTCSeverity=DEM_DTC_SEV_IMMEDIATELY, DemUdsDTC=787731  # Diagnostics Data Import
      INV_IAC_W_RNG_HI (DemEventParameter):  # Diagnostics Data Import
        DemEventKind = DEM_EVENT_KIND_SWC
        DemMaxNumberFreezeFrameRecords = 2
        DemDTCClassRef = DTCClass_INV_IAC_W_RNG_HI
        DemExtendedDataClassRef = ExtendedDataClass_5ecd55b9
        DemFreezeFrameClassRef = FreezeFrameClass_c3111450
        DemEventClass:  # Diagnostics Data Import
          DemAgingAllowed = true
          DemAgingCycleCounterThreshold = 40
          DemEventDestination = DEM_DTC_ORIGIN_PRIMARY_MEMORY
          DemEventPriority = 1
          DemEventFailureCycleCounterThreshold = 0
          DemAgingCycleRef = PowerCycle
          DemEnableConditionGroupRef = EnableConditionGroup_2747052a
          DemOperationCycleRef = PowerCycle
          IndicatorAttribute_WarningIndicator (DemIndicatorAttribute): DemIndicatorFailureCycleSource=DEM_FAILURE_CYCLE_EVENT, DemIndicatorHealingCycleRef=PowerCycle, DemIndicatorRef=WarningIndicator  # Diagnostics Data Import
          DemDebounceAlgorithmClass  # Diagnostics Data Import
            DemDebounceCounterBased: DemDebounceCounterDecrementStepSize=128, DemDebounceCounterIncrementStepSize=127, DemDebounceCounterJumpDown=true, DemDebounceCounterJumpUp=true  # Diagnostics Data Import
      DTCClass_INV_IAC_W_RNG_HI (DemDTCClass): DemDTCSeverity=DEM_DTC_SEV_IMMEDIATELY, DemUdsDTC=781593  # Diagnostics Data Import
      INV_IAC_W_RNG_LO (DemEventParameter):  # Diagnostics Data Import
        DemEventKind = DEM_EVENT_KIND_SWC
        DemMaxNumberFreezeFrameRecords = 2
        DemDTCClassRef = DTCClass_INV_IAC_W_RNG_LO
        DemExtendedDataClassRef = ExtendedDataClass_5ecd55b9
        DemFreezeFrameClassRef = FreezeFrameClass_c3111450
        DemEventClass:  # Diagnostics Data Import
          DemAgingAllowed = true
          DemAgingCycleCounterThreshold = 40
          DemEventDestination = DEM_DTC_ORIGIN_PRIMARY_MEMORY
          DemEventPriority = 1
          DemEventFailureCycleCounterThreshold = 0
          DemAgingCycleRef = PowerCycle
          DemEnableConditionGroupRef = EnableConditionGroup_2747052a
          DemOperationCycleRef = PowerCycle
          IndicatorAttribute_WarningIndicator (DemIndicatorAttribute): DemIndicatorFailureCycleSource=DEM_FAILURE_CYCLE_EVENT, DemIndicatorHealingCycleRef=PowerCycle, DemIndicatorRef=WarningIndicator  # Diagnostics Data Import
          DemDebounceAlgorithmClass  # Diagnostics Data Import
            DemDebounceCounterBased: DemDebounceCounterDecrementStepSize=128, DemDebounceCounterIncrementStepSize=127, DemDebounceCounterJumpDown=true, DemDebounceCounterJumpUp=true  # Diagnostics Data Import
      DTCClass_INV_IAC_W_RNG_LO (DemDTCClass): DemDTCSeverity=DEM_DTC_SEV_IMMEDIATELY, DemUdsDTC=781592  # Diagnostics Data Import
      INV_IAC_W_ELEC_LO (DemEventParameter):  # Diagnostics Data Import
        DemEventKind = DEM_EVENT_KIND_SWC
        DemMaxNumberFreezeFrameRecords = 2
        DemDTCClassRef = DTCClass_INV_IAC_W_ELEC_LO
        DemExtendedDataClassRef = ExtendedDataClass_5ecd55b9
        DemFreezeFrameClassRef = FreezeFrameClass_c3111450
        DemEventClass:  # Diagnostics Data Import
          DemAgingAllowed = true
          DemAgingCycleCounterThreshold = 40
          DemEventDestination = DEM_DTC_ORIGIN_PRIMARY_MEMORY
          DemEventPriority = 1
          DemEventFailureCycleCounterThreshold = 0
          DemAgingCycleRef = PowerCycle
          DemEnableConditionGroupRef = EnableConditionGroup_2747052a
          DemOperationCycleRef = PowerCycle
          IndicatorAttribute_WarningIndicator (DemIndicatorAttribute): DemIndicatorFailureCycleSource=DEM_FAILURE_CYCLE_EVENT, DemIndicatorHealingCycleRef=PowerCycle, DemIndicatorRef=WarningIndicator  # Diagnostics Data Import
          DemDebounceAlgorithmClass  # Diagnostics Data Import
            DemDebounceCounterBased: DemDebounceCounterDecrementStepSize=128, DemDebounceCounterIncrementStepSize=127, DemDebounceCounterJumpDown=true, DemDebounceCounterJumpUp=true  # Diagnostics Data Import
      DTCClass_INV_IAC_W_ELEC_LO (DemDTCClass): DemDTCSeverity=DEM_DTC_SEV_IMMEDIATELY, DemUdsDTC=781587  # Diagnostics Data Import
      INV_IAC_W_ELEC_HI (DemEventParameter):  # Diagnostics Data Import
        DemEventKind = DEM_EVENT_KIND_SWC
        DemMaxNumberFreezeFrameRecords = 2
        DemDTCClassRef = DTCClass_INV_IAC_W_ELEC_HI
        DemExtendedDataClassRef = ExtendedDataClass_5ecd55b9
        DemFreezeFrameClassRef = FreezeFrameClass_c3111450
        DemEventClass:  # Diagnostics Data Import
          DemAgingAllowed = true
          DemAgingCycleCounterThreshold = 40
          DemEventDestination = DEM_DTC_ORIGIN_PRIMARY_MEMORY
          DemEventPriority = 1
          DemEventFailureCycleCounterThreshold = 0
          DemAgingCycleRef = PowerCycle
          DemEnableConditionGroupRef = EnableConditionGroup_2747052a
          DemOperationCycleRef = PowerCycle
          IndicatorAttribute_WarningIndicator (DemIndicatorAttribute): DemIndicatorFailureCycleSource=DEM_FAILURE_CYCLE_EVENT, DemIndicatorHealingCycleRef=PowerCycle, DemIndicatorRef=WarningIndicator  # Diagnostics Data Import
          DemDebounceAlgorithmClass  # Diagnostics Data Import
            DemDebounceCounterBased: DemDebounceCounterDecrementStepSize=128, DemDebounceCounterIncrementStepSize=127, DemDebounceCounterJumpDown=true, DemDebounceCounterJumpUp=true  # Diagnostics Data Import
      DTCClass_INV_IAC_W_ELEC_HI (DemDTCClass): DemDTCSeverity=DEM_DTC_SEV_IMMEDIATELY, DemUdsDTC=781586  # Diagnostics Data Import
      INV_IAC_V_ELEC_HWP_001 (DemEventParameter):  # Diagnostics Data Import
        DemEventKind = DEM_EVENT_KIND_SWC
        DemMaxNumberFreezeFrameRecords = 2
        DemDTCClassRef = DTCClass_INV_IAC_V_ELEC_HWP_001
        DemExtendedDataClassRef = ExtendedDataClass_5ecd55b9
        DemFreezeFrameClassRef = FreezeFrameClass_79980272
        DemEventClass:  # Diagnostics Data Import
          DemAgingAllowed = true
          DemAgingCycleCounterThreshold = 40
          DemEventDestination = DEM_DTC_ORIGIN_PRIMARY_MEMORY
          DemEventPriority = 1
          DemEventFailureCycleCounterThreshold = 0
          DemAgingCycleRef = PowerCycle
          DemOperationCycleRef = PowerCycle
          IndicatorAttribute_WarningIndicator (DemIndicatorAttribute): DemIndicatorFailureCycleSource=DEM_FAILURE_CYCLE_EVENT, DemIndicatorHealingCycleRef=PowerCycle, DemIndicatorRef=WarningIndicator  # Diagnostics Data Import
          DemDebounceAlgorithmClass  # Diagnostics Data Import
            DemDebounceCounterBased: DemDebounceCounterDecrementStepSize=128, DemDebounceCounterIncrementStepSize=127, DemDebounceCounterJumpDown=true, DemDebounceCounterJumpUp=true  # Diagnostics Data Import
      DTCClass_INV_IAC_V_ELEC_HWP_001 (DemDTCClass): DemDTCSeverity=DEM_DTC_SEV_IMMEDIATELY, DemUdsDTC=781569  # Diagnostics Data Import
      INV_IAC_V_RNG_HI (DemEventParameter):  # Diagnostics Data Import
        DemEventKind = DEM_EVENT_KIND_SWC
        DemMaxNumberFreezeFrameRecords = 2
        DemDTCClassRef = DTCClass_INV_IAC_V_RNG_HI
        DemExtendedDataClassRef = ExtendedDataClass_5ecd55b9
        DemFreezeFrameClassRef = FreezeFrameClass_c3111450
        DemEventClass:  # Diagnostics Data Import
          DemAgingAllowed = true
          DemAgingCycleCounterThreshold = 40
          DemEventDestination = DEM_DTC_ORIGIN_PRIMARY_MEMORY
          DemEventPriority = 1
          DemEventFailureCycleCounterThreshold = 0
          DemAgingCycleRef = PowerCycle
          DemEnableConditionGroupRef = EnableConditionGroup_2747052a
          DemOperationCycleRef = PowerCycle
          IndicatorAttribute_WarningIndicator (DemIndicatorAttribute): DemIndicatorFailureCycleSource=DEM_FAILURE_CYCLE_EVENT, DemIndicatorHealingCycleRef=PowerCycle, DemIndicatorRef=WarningIndicator  # Diagnostics Data Import
          DemDebounceAlgorithmClass  # Diagnostics Data Import
            DemDebounceCounterBased: DemDebounceCounterDecrementStepSize=128, DemDebounceCounterIncrementStepSize=127, DemDebounceCounterJumpDown=true, DemDebounceCounterJumpUp=true  # Diagnostics Data Import
      DTCClass_INV_IAC_V_RNG_HI (DemDTCClass): DemDTCSeverity=DEM_DTC_SEV_IMMEDIATELY, DemUdsDTC=780569  # Diagnostics Data Import
      INV_IAC_V_RNG_LO (DemEventParameter):  # Diagnostics Data Import
        DemEventKind = DEM_EVENT_KIND_SWC
        DemMaxNumberFreezeFrameRecords = 2
        DemDTCClassRef = DTCClass_INV_IAC_V_RNG_LO
        DemExtendedDataClassRef = ExtendedDataClass_5ecd55b9
        DemFreezeFrameClassRef = FreezeFrameClass_c3111450
        DemEventClass:  # Diagnostics Data Import
          DemAgingAllowed = true
          DemAgingCycleCounterThreshold = 40
          DemEventDestination = DEM_DTC_ORIGIN_PRIMARY_MEMORY
          DemEventPriority = 1
          DemEventFailureCycleCounterThreshold = 0
          DemAgingCycleRef = PowerCycle
          DemEnableConditionGroupRef = EnableConditionGroup_2747052a
          DemOperationCycleRef = PowerCycle
          IndicatorAttribute_WarningIndicator (DemIndicatorAttribute): DemIndicatorFailureCycleSource=DEM_FAILURE_CYCLE_EVENT, DemIndicatorHealingCycleRef=PowerCycle, DemIndicatorRef=WarningIndicator  # Diagnostics Data Import
          DemDebounceAlgorithmClass  # Diagnostics Data Import
            DemDebounceCounterBased: DemDebounceCounterDecrementStepSize=128, DemDebounceCounterIncrementStepSize=127, DemDebounceCounterJumpDown=true, DemDebounceCounterJumpUp=true  # Diagnostics Data Import
      DTCClass_INV_IAC_V_RNG_LO (DemDTCClass): DemDTCSeverity=DEM_DTC_SEV_IMMEDIATELY, DemUdsDTC=780568  # Diagnostics Data Import
      INV_IAC_V_ELEC_LO (DemEventParameter):  # Diagnostics Data Import
        DemEventKind = DEM_EVENT_KIND_SWC
        DemMaxNumberFreezeFrameRecords = 2
        DemDTCClassRef = DTCClass_INV_IAC_V_ELEC_LO
        DemExtendedDataClassRef = ExtendedDataClass_5ecd55b9
        DemFreezeFrameClassRef = FreezeFrameClass_c3111450
        DemEventClass:  # Diagnostics Data Import
          DemAgingAllowed = true
          DemAgingCycleCounterThreshold = 40
          DemEventDestination = DEM_DTC_ORIGIN_PRIMARY_MEMORY
          DemEventPriority = 1
          DemEventFailureCycleCounterThreshold = 0
          DemAgingCycleRef = PowerCycle
          DemEnableConditionGroupRef = EnableConditionGroup_2747052a
          DemOperationCycleRef = PowerCycle
          IndicatorAttribute_WarningIndicator (DemIndicatorAttribute): DemIndicatorFailureCycleSource=DEM_FAILURE_CYCLE_EVENT, DemIndicatorHealingCycleRef=PowerCycle, DemIndicatorRef=WarningIndicator  # Diagnostics Data Import
          DemDebounceAlgorithmClass  # Diagnostics Data Import
            DemDebounceCounterBased: DemDebounceCounterDecrementStepSize=128, DemDebounceCounterIncrementStepSize=127, DemDebounceCounterJumpDown=true, DemDebounceCounterJumpUp=true  # Diagnostics Data Import
      DTCClass_INV_IAC_V_ELEC_LO (DemDTCClass): DemDTCSeverity=DEM_DTC_SEV_IMMEDIATELY, DemUdsDTC=780563  # Diagnostics Data Import
      INV_IAC_V_ELEC_HI (DemEventParameter):  # Diagnostics Data Import
        DemEventKind = DEM_EVENT_KIND_SWC
        DemMaxNumberFreezeFrameRecords = 2
        DemDTCClassRef = DTCClass_INV_IAC_V_ELEC_HI
        DemExtendedDataClassRef = ExtendedDataClass_5ecd55b9
        DemFreezeFrameClassRef = FreezeFrameClass_c3111450
        DemEventClass:  # Diagnostics Data Import
          DemAgingAllowed = true
          DemAgingCycleCounterThreshold = 40
          DemEventDestination = DEM_DTC_ORIGIN_PRIMARY_MEMORY
          DemEventPriority = 1
          DemEventFailureCycleCounterThreshold = 0
          DemAgingCycleRef = PowerCycle
          DemEnableConditionGroupRef = EnableConditionGroup_2747052a
          DemOperationCycleRef = PowerCycle
          IndicatorAttribute_WarningIndicator (DemIndicatorAttribute): DemIndicatorFailureCycleSource=DEM_FAILURE_CYCLE_EVENT, DemIndicatorHealingCycleRef=PowerCycle, DemIndicatorRef=WarningIndicator  # Diagnostics Data Import
          DemDebounceAlgorithmClass  # Diagnostics Data Import
            DemDebounceCounterBased: DemDebounceCounterDecrementStepSize=128, DemDebounceCounterIncrementStepSize=127, DemDebounceCounterJumpDown=true, DemDebounceCounterJumpUp=true  # Diagnostics Data Import
      DTCClass_INV_IAC_V_ELEC_HI (DemDTCClass): DemDTCSeverity=DEM_DTC_SEV_IMMEDIATELY, DemUdsDTC=780562  # Diagnostics Data Import
      INV_IAC_V_ELEC_HWP (DemEventParameter):  # Diagnostics Data Import
        DemEventKind = DEM_EVENT_KIND_SWC
        DemMaxNumberFreezeFrameRecords = 2
        DemDTCClassRef = DTCClass_INV_IAC_V_ELEC_HWP
        DemExtendedDataClassRef = ExtendedDataClass_5ecd55b9
        DemFreezeFrameClassRef = FreezeFrameClass_c3111450
        DemEventClass:  # Diagnostics Data Import
          DemAgingAllowed = true
          DemAgingCycleCounterThreshold = 40
          DemEventDestination = DEM_DTC_ORIGIN_PRIMARY_MEMORY
          DemEventPriority = 1
          DemEventFailureCycleCounterThreshold = 0
          DemAgingCycleRef = PowerCycle
          DemOperationCycleRef = PowerCycle
          IndicatorAttribute_WarningIndicator (DemIndicatorAttribute): DemIndicatorFailureCycleSource=DEM_FAILURE_CYCLE_EVENT, DemIndicatorHealingCycleRef=PowerCycle, DemIndicatorRef=WarningIndicator  # Diagnostics Data Import
          DemDebounceAlgorithmClass  # Diagnostics Data Import
            DemDebounceCounterBased: DemDebounceCounterDecrementStepSize=128, DemDebounceCounterIncrementStepSize=127, DemDebounceCounterJumpDown=true, DemDebounceCounterJumpUp=true  # Diagnostics Data Import
      DTCClass_INV_IAC_V_ELEC_HWP (DemDTCClass): DemDTCSeverity=DEM_DTC_SEV_IMMEDIATELY, DemUdsDTC=780545  # Diagnostics Data Import
      VcEvMonIPH (DemEventParameter):  # Diagnostics Data Import
        DemEventKind = DEM_EVENT_KIND_SWC
        DemMaxNumberFreezeFrameRecords = 2
        DemDTCClassRef = DTCClass_VcEvMonIPH
        DemExtendedDataClassRef = ExtendedDataClass_5ecd55b9
        DemFreezeFrameClassRef = FreezeFrameClass_c3111450
        DemEventClass:  # Diagnostics Data Import
          DemAgingAllowed = true
          DemAgingCycleCounterThreshold = 40
          DemEventDestination = DEM_DTC_ORIGIN_PRIMARY_MEMORY
          DemEventPriority = 1
          DemEventFailureCycleCounterThreshold = 0
          DemAgingCycleRef = PowerCycle
          DemEnableConditionGroupRef = EnableConditionGroup_e2fc0f3d
          DemOperationCycleRef = PowerCycle
          IndicatorAttribute_WarningIndicator (DemIndicatorAttribute): DemIndicatorFailureCycleSource=DEM_FAILURE_CYCLE_EVENT, DemIndicatorHealingCycleRef=PowerCycle, DemIndicatorRef=WarningIndicator  # Diagnostics Data Import
          DemDebounceAlgorithmClass  # Diagnostics Data Import
            DemDebounceCounterBased: DemDebounceCounterDecrementStepSize=128, DemDebounceCounterIncrementStepSize=127, DemDebounceCounterJumpDown=true, DemDebounceCounterJumpUp=true  # Diagnostics Data Import
      DTCClass_VcEvMonIPH (DemDTCClass): DemDTCSeverity=DEM_DTC_SEV_IMMEDIATELY, DemUdsDTC=779876  # Diagnostics Data Import
      INV_IAC_U_RNG_HI (DemEventParameter):  # Diagnostics Data Import
        DemEventKind = DEM_EVENT_KIND_SWC
        DemMaxNumberFreezeFrameRecords = 2
        DemDTCClassRef = DTCClass_INV_IAC_U_RNG_HI
        DemExtendedDataClassRef = ExtendedDataClass_5ecd55b9
        DemFreezeFrameClassRef = FreezeFrameClass_c3111450
        DemEventClass:  # Diagnostics Data Import
          DemAgingAllowed = true
          DemAgingCycleCounterThreshold = 40
          DemEventDestination = DEM_DTC_ORIGIN_PRIMARY_MEMORY
          DemEventPriority = 1
          DemEventFailureCycleCounterThreshold = 0
          DemAgingCycleRef = PowerCycle
          DemEnableConditionGroupRef = EnableConditionGroup_2747052a
          DemOperationCycleRef = PowerCycle
          IndicatorAttribute_WarningIndicator (DemIndicatorAttribute): DemIndicatorFailureCycleSource=DEM_FAILURE_CYCLE_EVENT, DemIndicatorHealingCycleRef=PowerCycle, DemIndicatorRef=WarningIndicator  # Diagnostics Data Import
          DemDebounceAlgorithmClass  # Diagnostics Data Import
            DemDebounceCounterBased: DemDebounceCounterDecrementStepSize=128, DemDebounceCounterIncrementStepSize=127, DemDebounceCounterJumpDown=true, DemDebounceCounterJumpUp=true  # Diagnostics Data Import
      DTCClass_INV_IAC_U_RNG_HI (DemDTCClass): DemDTCSeverity=DEM_DTC_SEV_IMMEDIATELY, DemUdsDTC=779545  # Diagnostics Data Import
      INV_IAC_U_RNG_LO (DemEventParameter):  # Diagnostics Data Import
        DemEventKind = DEM_EVENT_KIND_SWC
        DemMaxNumberFreezeFrameRecords = 2
        DemDTCClassRef = DTCClass_INV_IAC_U_RNG_LO
        DemExtendedDataClassRef = ExtendedDataClass_5ecd55b9
        DemFreezeFrameClassRef = FreezeFrameClass_c3111450
        DemEventClass:  # Diagnostics Data Import
          DemAgingAllowed = true
          DemAgingCycleCounterThreshold = 40
          DemEventDestination = DEM_DTC_ORIGIN_PRIMARY_MEMORY
          DemEventPriority = 1
          DemEventFailureCycleCounterThreshold = 0
          DemAgingCycleRef = PowerCycle
          DemEnableConditionGroupRef = EnableConditionGroup_2747052a
          DemOperationCycleRef = PowerCycle
          IndicatorAttribute_WarningIndicator (DemIndicatorAttribute): DemIndicatorFailureCycleSource=DEM_FAILURE_CYCLE_EVENT, DemIndicatorHealingCycleRef=PowerCycle, DemIndicatorRef=WarningIndicator  # Diagnostics Data Import
          DemDebounceAlgorithmClass  # Diagnostics Data Import
            DemDebounceCounterBased: DemDebounceCounterDecrementStepSize=128, DemDebounceCounterIncrementStepSize=127, DemDebounceCounterJumpDown=true, DemDebounceCounterJumpUp=true  # Diagnostics Data Import
      DTCClass_INV_IAC_U_RNG_LO (DemDTCClass): DemDTCSeverity=DEM_DTC_SEV_IMMEDIATELY, DemUdsDTC=779544  # Diagnostics Data Import
      INV_IAC_U_ELEC_LO (DemEventParameter):  # Diagnostics Data Import
        DemEventKind = DEM_EVENT_KIND_SWC
        DemMaxNumberFreezeFrameRecords = 2
        DemDTCClassRef = DTCClass_INV_IAC_U_ELEC_LO
        DemExtendedDataClassRef = ExtendedDataClass_5ecd55b9
        DemFreezeFrameClassRef = FreezeFrameClass_c3111450
        DemEventClass:  # Diagnostics Data Import
          DemAgingAllowed = true
          DemAgingCycleCounterThreshold = 40
          DemEventDestination = DEM_DTC_ORIGIN_PRIMARY_MEMORY
          DemEventPriority = 1
          DemEventFailureCycleCounterThreshold = 0
          DemAgingCycleRef = PowerCycle
          DemEnableConditionGroupRef = EnableConditionGroup_d38dfb27
          DemOperationCycleRef = PowerCycle
          IndicatorAttribute_WarningIndicator (DemIndicatorAttribute): DemIndicatorFailureCycleSource=DEM_FAILURE_CYCLE_EVENT, DemIndicatorHealingCycleRef=PowerCycle, DemIndicatorRef=WarningIndicator  # Diagnostics Data Import
          DemDebounceAlgorithmClass  # Diagnostics Data Import
            DemDebounceCounterBased: DemDebounceCounterDecrementStepSize=128, DemDebounceCounterIncrementStepSize=127, DemDebounceCounterJumpDown=true, DemDebounceCounterJumpUp=true  # Diagnostics Data Import
      DTCClass_INV_IAC_U_ELEC_LO (DemDTCClass): DemDTCSeverity=DEM_DTC_SEV_IMMEDIATELY, DemUdsDTC=779539  # Diagnostics Data Import
      INV_IAC_U_ELEC_HI (DemEventParameter):  # Diagnostics Data Import
        DemEventKind = DEM_EVENT_KIND_SWC
        DemMaxNumberFreezeFrameRecords = 2
        DemDTCClassRef = DTCClass_INV_IAC_U_ELEC_HI
        DemExtendedDataClassRef = ExtendedDataClass_5ecd55b9
        DemFreezeFrameClassRef = FreezeFrameClass_c3111450
        DemEventClass:  # Diagnostics Data Import
          DemAgingAllowed = true
          DemAgingCycleCounterThreshold = 40
          DemEventDestination = DEM_DTC_ORIGIN_PRIMARY_MEMORY
          DemEventPriority = 1
          DemEventFailureCycleCounterThreshold = 0
          DemAgingCycleRef = PowerCycle
          DemEnableConditionGroupRef = EnableConditionGroup_2747052a
          DemOperationCycleRef = PowerCycle
          IndicatorAttribute_WarningIndicator (DemIndicatorAttribute): DemIndicatorFailureCycleSource=DEM_FAILURE_CYCLE_EVENT, DemIndicatorHealingCycleRef=PowerCycle, DemIndicatorRef=WarningIndicator  # Diagnostics Data Import
          DemDebounceAlgorithmClass  # Diagnostics Data Import
            DemDebounceCounterBased: DemDebounceCounterDecrementStepSize=128, DemDebounceCounterIncrementStepSize=127, DemDebounceCounterJumpDown=true, DemDebounceCounterJumpUp=true  # Diagnostics Data Import
      DTCClass_INV_IAC_U_ELEC_HI (DemDTCClass): DemDTCSeverity=DEM_DTC_SEV_IMMEDIATELY, DemUdsDTC=779538  # Diagnostics Data Import
      INV_IAC_U_ELEC_HWP (DemEventParameter):  # Diagnostics Data Import
        DemEventKind = DEM_EVENT_KIND_SWC
        DemMaxNumberFreezeFrameRecords = 2
        DemDTCClassRef = DTCClass_INV_IAC_U_ELEC_HWP
        DemExtendedDataClassRef = ExtendedDataClass_5ecd55b9
        DemFreezeFrameClassRef = FreezeFrameClass_c3111450
        DemEventClass:  # Diagnostics Data Import
          DemAgingAllowed = true
          DemAgingCycleCounterThreshold = 40
          DemEventDestination = DEM_DTC_ORIGIN_PRIMARY_MEMORY
          DemEventPriority = 1
          DemEventFailureCycleCounterThreshold = 0
          DemAgingCycleRef = PowerCycle
          DemOperationCycleRef = PowerCycle
          IndicatorAttribute_WarningIndicator (DemIndicatorAttribute): DemIndicatorFailureCycleSource=DEM_FAILURE_CYCLE_EVENT, DemIndicatorHealingCycleRef=PowerCycle, DemIndicatorRef=WarningIndicator  # Diagnostics Data Import
          DemDebounceAlgorithmClass  # Diagnostics Data Import
            DemDebounceCounterBased: DemDebounceCounterDecrementStepSize=128, DemDebounceCounterIncrementStepSize=127, DemDebounceCounterJumpDown=true, DemDebounceCounterJumpUp=true  # Diagnostics Data Import
      DTCClass_INV_IAC_U_ELEC_HWP (DemDTCClass): DemDTCSeverity=DEM_DTC_SEV_IMMEDIATELY, DemUdsDTC=779521  # Diagnostics Data Import
      INV_CU_TEMP2_RNG_NOK (DemEventParameter):  # Diagnostics Data Import
        DemEventKind = DEM_EVENT_KIND_SWC
        DemMaxNumberFreezeFrameRecords = 2
        DemDTCClassRef = DTCClass_INV_CU_TEMP2_RNG_NOK
        DemExtendedDataClassRef = ExtendedDataClass_5ecd55b9
        DemFreezeFrameClassRef = FreezeFrameClass_c3111450
        DemEventClass:  # Diagnostics Data Import
          DemAgingAllowed = true
          DemAgingCycleCounterThreshold = 40
          DemEventDestination = DEM_DTC_ORIGIN_PRIMARY_MEMORY
          DemEventPriority = 2
          DemEventFailureCycleCounterThreshold = 0
          DemAgingCycleRef = PowerCycle
          DemOperationCycleRef = PowerCycle
          IndicatorAttribute_WarningIndicator (DemIndicatorAttribute): DemIndicatorFailureCycleSource=DEM_FAILURE_CYCLE_EVENT, DemIndicatorHealingCycleRef=PowerCycle, DemIndicatorRef=WarningIndicator  # Diagnostics Data Import
          DemDebounceAlgorithmClass  # Diagnostics Data Import
            DemDebounceCounterBased: DemDebounceCounterDecrementStepSize=128, DemDebounceCounterIncrementStepSize=127, DemDebounceCounterJumpDown=true, DemDebounceCounterJumpUp=true  # Diagnostics Data Import
      DTCClass_INV_CU_TEMP2_RNG_NOK (DemDTCClass): DemDTCSeverity=DEM_DTC_SEV_MAINTENANCE_ONLY, DemUdsDTC=717340  # Diagnostics Data Import
      CU_TEMP2_RNG_LO (DemEventParameter):  # Diagnostics Data Import
        DemEventKind = DEM_EVENT_KIND_SWC
        DemMaxNumberFreezeFrameRecords = 2
        DemDTCClassRef = DTCClass_CU_TEMP2_RNG_LO
        DemExtendedDataClassRef = ExtendedDataClass_5ecd55b9
        DemFreezeFrameClassRef = FreezeFrameClass_c3111450
        DemEventClass:  # Diagnostics Data Import
          DemAgingAllowed = true
          DemAgingCycleCounterThreshold = 40
          DemEventDestination = DEM_DTC_ORIGIN_PRIMARY_MEMORY
          DemEventPriority = 1
          DemEventFailureCycleCounterThreshold = 0
          DemAgingCycleRef = PowerCycle
          DemEnableConditionGroupRef = EnableConditionGroup_7ab46a93
          DemOperationCycleRef = PowerCycle
          IndicatorAttribute_WarningIndicator (DemIndicatorAttribute): DemIndicatorFailureCycleSource=DEM_FAILURE_CYCLE_EVENT, DemIndicatorHealingCycleRef=PowerCycle, DemIndicatorRef=WarningIndicator  # Diagnostics Data Import
          DemDebounceAlgorithmClass  # Diagnostics Data Import
            DemDebounceCounterBased: DemDebounceCounterDecrementStepSize=128, DemDebounceCounterIncrementStepSize=127, DemDebounceCounterJumpDown=true, DemDebounceCounterJumpUp=true  # Diagnostics Data Import
      DTCClass_CU_TEMP2_RNG_LO (DemDTCClass): DemDTCSeverity=DEM_DTC_SEV_MAINTENANCE_ONLY, DemUdsDTC=717330  # Diagnostics Data Import
      CU_TEMP2_RNG_HI (DemEventParameter):  # Diagnostics Data Import
        DemEventKind = DEM_EVENT_KIND_SWC
        DemMaxNumberFreezeFrameRecords = 2
        DemDTCClassRef = DTCClass_CU_TEMP2_RNG_HI
        DemExtendedDataClassRef = ExtendedDataClass_5ecd55b9
        DemFreezeFrameClassRef = FreezeFrameClass_c3111450
        DemEventClass:  # Diagnostics Data Import
          DemAgingAllowed = true
          DemAgingCycleCounterThreshold = 40
          DemEventDestination = DEM_DTC_ORIGIN_PRIMARY_MEMORY
          DemEventPriority = 1
          DemEventFailureCycleCounterThreshold = 0
          DemAgingCycleRef = PowerCycle
          DemEnableConditionGroupRef = EnableConditionGroup_7ab46a93
          DemOperationCycleRef = PowerCycle
          IndicatorAttribute_WarningIndicator (DemIndicatorAttribute): DemIndicatorFailureCycleSource=DEM_FAILURE_CYCLE_EVENT, DemIndicatorHealingCycleRef=PowerCycle, DemIndicatorRef=WarningIndicator  # Diagnostics Data Import
          DemDebounceAlgorithmClass  # Diagnostics Data Import
            DemDebounceCounterBased: DemDebounceCounterDecrementStepSize=128, DemDebounceCounterIncrementStepSize=127, DemDebounceCounterJumpDown=true, DemDebounceCounterJumpUp=true  # Diagnostics Data Import
      DTCClass_CU_TEMP2_RNG_HI (DemDTCClass): DemDTCSeverity=DEM_DTC_SEV_MAINTENANCE_ONLY, DemUdsDTC=717329  # Diagnostics Data Import
      INV_COOLT_INLET_TEMP_HWP (DemEventParameter):  # Diagnostics Data Import
        DemEventKind = DEM_EVENT_KIND_SWC
        DemMaxNumberFreezeFrameRecords = 2
        DemDTCClassRef = DTCClass_INV_COOLT_INLET_TEMP_HWP
        DemExtendedDataClassRef = ExtendedDataClass_5ecd55b9
        DemFreezeFrameClassRef = FreezeFrameClass_c3111450
        DemEventClass:  # Diagnostics Data Import
          DemAgingAllowed = true
          DemAgingCycleCounterThreshold = 40
          DemEventDestination = DEM_DTC_ORIGIN_PRIMARY_MEMORY
          DemEventPriority = 2
          DemEventFailureCycleCounterThreshold = 0
          DemAgingCycleRef = PowerCycle
          DemEnableConditionGroupRef = EnableConditionGroup_7ab46a93
          DemOperationCycleRef = PowerCycle
          IndicatorAttribute_WarningIndicator (DemIndicatorAttribute): DemIndicatorFailureCycleSource=DEM_FAILURE_CYCLE_EVENT, DemIndicatorHealingCycleRef=PowerCycle, DemIndicatorRef=WarningIndicator  # Diagnostics Data Import
          DemDebounceAlgorithmClass  # Diagnostics Data Import
            DemDebounceCounterBased: DemDebounceCounterDecrementStepSize=128, DemDebounceCounterIncrementStepSize=127, DemDebounceCounterJumpDown=true, DemDebounceCounterJumpUp=true  # Diagnostics Data Import
      DTCClass_INV_COOLT_INLET_TEMP_HWP (DemDTCClass): DemDTCSeverity=DEM_DTC_SEV_MAINTENANCE_ONLY, DemUdsDTC=693067  # Diagnostics Data Import
      INV_CONTROL_LIMIT (DemEventParameter):  # Diagnostics Data Import
        DemEventKind = DEM_EVENT_KIND_SWC
        DemMaxNumberFreezeFrameRecords = 2
        DemDTCClassRef = DTCClass_INV_CONTROL_LIMIT
        DemExtendedDataClassRef = ExtendedDataClass_5ecd55b9
        DemFreezeFrameClassRef = FreezeFrameClass_c3111450
        DemEventClass:  # Diagnostics Data Import
          DemAgingAllowed = true
          DemAgingCycleCounterThreshold = 40
          DemEventDestination = DEM_DTC_ORIGIN_PRIMARY_MEMORY
          DemEventPriority = 1
          DemEventFailureCycleCounterThreshold = 0
          DemAgingCycleRef = PowerCycle
          DemEnableConditionGroupRef = EnableConditionGroup_06a6aa19
          DemOperationCycleRef = PowerCycle
          IndicatorAttribute_WarningIndicator (DemIndicatorAttribute): DemIndicatorFailureCycleSource=DEM_FAILURE_CYCLE_EVENT, DemIndicatorHealingCycleRef=PowerCycle, DemIndicatorRef=WarningIndicator  # Diagnostics Data Import
          DemDebounceAlgorithmClass  # Diagnostics Data Import
            DemDebounceCounterBased: DemDebounceCounterDecrementStepSize=128, DemDebounceCounterIncrementStepSize=127, DemDebounceCounterJumpDown=true, DemDebounceCounterJumpUp=true  # Diagnostics Data Import
      DTCClass_INV_CONTROL_LIMIT (DemDTCClass): DemDTCSeverity=DEM_DTC_SEV_IMMEDIATELY, DemUdsDTC=692372  # Diagnostics Data Import
      VcEvEMPerfPlaus (DemEventParameter):  # Diagnostics Data Import
        DemEventKind = DEM_EVENT_KIND_SWC
        DemMaxNumberFreezeFrameRecords = 2
        DemDTCClassRef = DTCClass_VcEvEMPerfPlaus
        DemExtendedDataClassRef = ExtendedDataClass_5ecd55b9
        DemFreezeFrameClassRef = FreezeFrameClass_c3111450
        DemEventClass:  # Diagnostics Data Import
          DemAgingAllowed = true
          DemAgingCycleCounterThreshold = 40
          DemEventDestination = DEM_DTC_ORIGIN_PRIMARY_MEMORY
          DemEventPriority = 1
          DemEventFailureCycleCounterThreshold = 0
          DemAgingCycleRef = PowerCycle
          DemEnableConditionGroupRef = EnableConditionGroup_500f9dc2
          DemOperationCycleRef = PowerCycle
          IndicatorAttribute_WarningIndicator (DemIndicatorAttribute): DemIndicatorFailureCycleSource=DEM_FAILURE_CYCLE_EVENT, DemIndicatorHealingCycleRef=PowerCycle, DemIndicatorRef=WarningIndicator  # Diagnostics Data Import
          DemDebounceAlgorithmClass  # Diagnostics Data Import
            DemDebounceCounterBased: DemDebounceCounterDecrementStepSize=128, DemDebounceCounterIncrementStepSize=127, DemDebounceCounterJumpDown=true, DemDebounceCounterJumpUp=true  # Diagnostics Data Import
      DTCClass_VcEvEMPerfPlaus (DemDTCClass): DemDTCSeverity=DEM_DTC_SEV_IMMEDIATELY, DemUdsDTC=692370  # Diagnostics Data Import
      INV_IAC_W_AMP (DemEventParameter):  # Diagnostics Data Import
        DemEventKind = DEM_EVENT_KIND_SWC
        DemMaxNumberFreezeFrameRecords = 2
        DemDTCClassRef = DTCClass_INV_IAC_W_AMP
        DemExtendedDataClassRef = ExtendedDataClass_5ecd55b9
        DemFreezeFrameClassRef = FreezeFrameClass_c3111450
        DemEventClass:  # Diagnostics Data Import
          DemAgingAllowed = true
          DemAgingCycleCounterThreshold = 40
          DemEventDestination = DEM_DTC_ORIGIN_PRIMARY_MEMORY
          DemEventPriority = 1
          DemEventFailureCycleCounterThreshold = 0
          DemAgingCycleRef = PowerCycle
          DemEnableConditionGroupRef = EnableConditionGroup_0d30bf3f
          DemOperationCycleRef = PowerCycle
          IndicatorAttribute_WarningIndicator (DemIndicatorAttribute): DemIndicatorFailureCycleSource=DEM_FAILURE_CYCLE_EVENT, DemIndicatorHealingCycleRef=PowerCycle, DemIndicatorRef=WarningIndicator  # Diagnostics Data Import
          DemDebounceAlgorithmClass  # Diagnostics Data Import
            DemDebounceCounterBased: DemDebounceCounterDecrementStepSize=128, DemDebounceCounterIncrementStepSize=127, DemDebounceCounterJumpDown=true, DemDebounceCounterJumpUp=true  # Diagnostics Data Import
      DTCClass_INV_IAC_W_AMP (DemDTCClass): DemDTCSeverity=DEM_DTC_SEV_IMMEDIATELY, DemUdsDTC=680738  # Diagnostics Data Import
      INV_IAC_V_AMP (DemEventParameter):  # Diagnostics Data Import
        DemEventKind = DEM_EVENT_KIND_SWC
        DemMaxNumberFreezeFrameRecords = 2
        DemDTCClassRef = DTCClass_INV_IAC_V_AMP
        DemExtendedDataClassRef = ExtendedDataClass_5ecd55b9
        DemFreezeFrameClassRef = FreezeFrameClass_c3111450
        DemEventClass:  # Diagnostics Data Import
          DemAgingAllowed = true
          DemAgingCycleCounterThreshold = 40
          DemEventDestination = DEM_DTC_ORIGIN_PRIMARY_MEMORY
          DemEventPriority = 1
          DemEventFailureCycleCounterThreshold = 0
          DemAgingCycleRef = PowerCycle
          DemEnableConditionGroupRef = EnableConditionGroup_0d30bf3f
          DemOperationCycleRef = PowerCycle
          IndicatorAttribute_WarningIndicator (DemIndicatorAttribute): DemIndicatorFailureCycleSource=DEM_FAILURE_CYCLE_EVENT, DemIndicatorHealingCycleRef=PowerCycle, DemIndicatorRef=WarningIndicator  # Diagnostics Data Import
          DemDebounceAlgorithmClass  # Diagnostics Data Import
            DemDebounceCounterBased: DemDebounceCounterDecrementStepSize=128, DemDebounceCounterIncrementStepSize=127, DemDebounceCounterJumpDown=true, DemDebounceCounterJumpUp=true  # Diagnostics Data Import
      DTCClass_INV_IAC_V_AMP (DemDTCClass): DemDTCSeverity=DEM_DTC_SEV_IMMEDIATELY, DemUdsDTC=679970  # Diagnostics Data Import
      INV_IAC_U_AMP (DemEventParameter):  # Diagnostics Data Import
        DemEventKind = DEM_EVENT_KIND_SWC
        DemMaxNumberFreezeFrameRecords = 2
        DemDTCClassRef = DTCClass_INV_IAC_U_AMP
        DemExtendedDataClassRef = ExtendedDataClass_5ecd55b9
        DemFreezeFrameClassRef = FreezeFrameClass_c3111450
        DemEventClass:  # Diagnostics Data Import
          DemAgingAllowed = true
          DemAgingCycleCounterThreshold = 40
          DemEventDestination = DEM_DTC_ORIGIN_PRIMARY_MEMORY
          DemEventPriority = 1
          DemEventFailureCycleCounterThreshold = 0
          DemAgingCycleRef = PowerCycle
          DemEnableConditionGroupRef = EnableConditionGroup_0d30bf3f
          DemOperationCycleRef = PowerCycle
          IndicatorAttribute_WarningIndicator (DemIndicatorAttribute): DemIndicatorFailureCycleSource=DEM_FAILURE_CYCLE_EVENT, DemIndicatorHealingCycleRef=PowerCycle, DemIndicatorRef=WarningIndicator  # Diagnostics Data Import
          DemDebounceAlgorithmClass  # Diagnostics Data Import
            DemDebounceCounterBased: DemDebounceCounterDecrementStepSize=128, DemDebounceCounterIncrementStepSize=127, DemDebounceCounterJumpDown=true, DemDebounceCounterJumpUp=true  # Diagnostics Data Import
      DTCClass_INV_IAC_U_AMP (DemDTCClass): DemDTCSeverity=DEM_DTC_SEV_IMMEDIATELY, DemUdsDTC=679202  # Diagnostics Data Import
      INV_EM_STATOR_TEMP2_RNG_SWT (DemEventParameter):  # Diagnostics Data Import
        DemEventKind = DEM_EVENT_KIND_SWC
        DemMaxNumberFreezeFrameRecords = 2
        DemDTCClassRef = DTCClass_INV_EM_STATOR_TEMP2_RNG_SWT
        DemExtendedDataClassRef = ExtendedDataClass_5ecd55b9
        DemFreezeFrameClassRef = FreezeFrameClass_c3111450
        DemEventClass:  # Diagnostics Data Import
          DemAgingAllowed = true
          DemAgingCycleCounterThreshold = 40
          DemEventDestination = DEM_DTC_ORIGIN_PRIMARY_MEMORY
          DemEventPriority = 1
          DemEventFailureCycleCounterThreshold = 0
          DemAgingCycleRef = PowerCycle
          DemEnableConditionGroupRef = EnableConditionGroup_7ab46a93
          DemOperationCycleRef = PowerCycle
          IndicatorAttribute_WarningIndicator (DemIndicatorAttribute): DemIndicatorFailureCycleSource=DEM_FAILURE_CYCLE_EVENT, DemIndicatorHealingCycleRef=PowerCycle, DemIndicatorRef=WarningIndicator  # Diagnostics Data Import
          DemDebounceAlgorithmClass  # Diagnostics Data Import
            DemDebounceCounterBased: DemDebounceCounterDecrementStepSize=128, DemDebounceCounterIncrementStepSize=127, DemDebounceCounterJumpDown=true, DemDebounceCounterJumpUp=true  # Diagnostics Data Import
      DTCClass_INV_EM_STATOR_TEMP2_RNG_SWT (DemDTCClass): DemDTCSeverity=DEM_DTC_SEV_MAINTENANCE_ONLY, DemUdsDTC=667690  # Diagnostics Data Import
      INV_EM_STATOR_TEMP2_GRDT (DemEventParameter):  # Diagnostics Data Import
        DemEventKind = DEM_EVENT_KIND_SWC
        DemMaxNumberFreezeFrameRecords = 2
        DemDTCClassRef = DTCClass_INV_EM_STATOR_TEMP2_GRDT
        DemExtendedDataClassRef = ExtendedDataClass_5ecd55b9
        DemFreezeFrameClassRef = FreezeFrameClass_c3111450
        DemEventClass:  # Diagnostics Data Import
          DemAgingAllowed = true
          DemAgingCycleCounterThreshold = 40
          DemEventDestination = DEM_DTC_ORIGIN_PRIMARY_MEMORY
          DemEventPriority = 1
          DemEventFailureCycleCounterThreshold = 0
          DemAgingCycleRef = PowerCycle
          DemEnableConditionGroupRef = EnableConditionGroup_90577524
          DemOperationCycleRef = PowerCycle
          IndicatorAttribute_WarningIndicator (DemIndicatorAttribute): DemIndicatorFailureCycleSource=DEM_FAILURE_CYCLE_EVENT, DemIndicatorHealingCycleRef=PowerCycle, DemIndicatorRef=WarningIndicator  # Diagnostics Data Import
          DemDebounceAlgorithmClass  # Diagnostics Data Import
            DemDebounceCounterBased: DemDebounceCounterDecrementStepSize=128, DemDebounceCounterIncrementStepSize=127, DemDebounceCounterJumpDown=true, DemDebounceCounterJumpUp=true  # Diagnostics Data Import
      DTCClass_INV_EM_STATOR_TEMP2_GRDT (DemDTCClass): DemDTCSeverity=DEM_DTC_SEV_MAINTENANCE_ONLY, DemUdsDTC=667687  # Diagnostics Data Import
      INV_EM_STATOR_TEMP2_RNG_NOK (DemEventParameter):  # Diagnostics Data Import
        DemEventKind = DEM_EVENT_KIND_SWC
        DemMaxNumberFreezeFrameRecords = 2
        DemDTCClassRef = DTCClass_INV_EM_STATOR_TEMP2_RNG_NOK
        DemExtendedDataClassRef = ExtendedDataClass_5ecd55b9
        DemFreezeFrameClassRef = FreezeFrameClass_c3111450
        DemEventClass:  # Diagnostics Data Import
          DemAgingAllowed = true
          DemAgingCycleCounterThreshold = 40
          DemEventDestination = DEM_DTC_ORIGIN_PRIMARY_MEMORY
          DemEventPriority = 1
          DemEventFailureCycleCounterThreshold = 0
          DemAgingCycleRef = PowerCycle
          DemEnableConditionGroupRef = EnableConditionGroup_7ab46a93
          DemOperationCycleRef = PowerCycle
          IndicatorAttribute_WarningIndicator (DemIndicatorAttribute): DemIndicatorFailureCycleSource=DEM_FAILURE_CYCLE_EVENT, DemIndicatorHealingCycleRef=PowerCycle, DemIndicatorRef=WarningIndicator  # Diagnostics Data Import
          DemDebounceAlgorithmClass  # Diagnostics Data Import
            DemDebounceCounterBased: DemDebounceCounterDecrementStepSize=128, DemDebounceCounterIncrementStepSize=127, DemDebounceCounterJumpDown=true, DemDebounceCounterJumpUp=true  # Diagnostics Data Import
      DTCClass_INV_EM_STATOR_TEMP2_RNG_NOK (DemDTCClass): DemDTCSeverity=DEM_DTC_SEV_MAINTENANCE_ONLY, DemUdsDTC=667676  # Diagnostics Data Import
      INV_EM_STATOR_TEMP2_RNG_LO (DemEventParameter):  # Diagnostics Data Import
        DemEventKind = DEM_EVENT_KIND_SWC
        DemMaxNumberFreezeFrameRecords = 2
        DemDTCClassRef = DTCClass_INV_EM_STATOR_TEMP2_RNG_LO
        DemExtendedDataClassRef = ExtendedDataClass_5ecd55b9
        DemFreezeFrameClassRef = FreezeFrameClass_c3111450
        DemEventClass:  # Diagnostics Data Import
          DemAgingAllowed = true
          DemAgingCycleCounterThreshold = 40
          DemEventDestination = DEM_DTC_ORIGIN_PRIMARY_MEMORY
          DemEventPriority = 1
          DemEventFailureCycleCounterThreshold = 0
          DemAgingCycleRef = PowerCycle
          DemEnableConditionGroupRef = EnableConditionGroup_7ab46a93
          DemOperationCycleRef = PowerCycle
          IndicatorAttribute_WarningIndicator (DemIndicatorAttribute): DemIndicatorFailureCycleSource=DEM_FAILURE_CYCLE_EVENT, DemIndicatorHealingCycleRef=PowerCycle, DemIndicatorRef=WarningIndicator  # Diagnostics Data Import
          DemDebounceAlgorithmClass  # Diagnostics Data Import
            DemDebounceCounterBased: DemDebounceCounterDecrementStepSize=128, DemDebounceCounterIncrementStepSize=127, DemDebounceCounterJumpDown=true, DemDebounceCounterJumpUp=true  # Diagnostics Data Import
      DTCClass_INV_EM_STATOR_TEMP2_RNG_LO (DemDTCClass): DemDTCSeverity=DEM_DTC_SEV_MAINTENANCE_ONLY, DemUdsDTC=667666  # Diagnostics Data Import
      INV_EM_STATOR_TEMP2_RNG_HI (DemEventParameter):  # Diagnostics Data Import
        DemEventKind = DEM_EVENT_KIND_SWC
        DemMaxNumberFreezeFrameRecords = 2
        DemDTCClassRef = DTCClass_INV_EM_STATOR_TEMP2_RNG_HI
        DemExtendedDataClassRef = ExtendedDataClass_5ecd55b9
        DemFreezeFrameClassRef = FreezeFrameClass_c3111450
        DemEventClass:  # Diagnostics Data Import
          DemAgingAllowed = true
          DemAgingCycleCounterThreshold = 40
          DemEventDestination = DEM_DTC_ORIGIN_PRIMARY_MEMORY
          DemEventPriority = 1
          DemEventFailureCycleCounterThreshold = 0
          DemAgingCycleRef = PowerCycle
          DemEnableConditionGroupRef = EnableConditionGroup_7ab46a93
          DemOperationCycleRef = PowerCycle
          IndicatorAttribute_WarningIndicator (DemIndicatorAttribute): DemIndicatorFailureCycleSource=DEM_FAILURE_CYCLE_EVENT, DemIndicatorHealingCycleRef=PowerCycle, DemIndicatorRef=WarningIndicator  # Diagnostics Data Import
          DemDebounceAlgorithmClass  # Diagnostics Data Import
            DemDebounceCounterBased: DemDebounceCounterDecrementStepSize=128, DemDebounceCounterIncrementStepSize=127, DemDebounceCounterJumpDown=true, DemDebounceCounterJumpUp=true  # Diagnostics Data Import
      DTCClass_INV_EM_STATOR_TEMP2_RNG_HI (DemDTCClass): DemDTCSeverity=DEM_DTC_SEV_MAINTENANCE_ONLY, DemUdsDTC=667665  # Diagnostics Data Import
      INV_EM_STATOR_TEMP2_ELE_FLT (DemEventParameter):  # Diagnostics Data Import
        DemEventKind = DEM_EVENT_KIND_SWC
        DemMaxNumberFreezeFrameRecords = 2
        DemDTCClassRef = DTCClass_INV_EM_STATOR_TEMP2_ELE_FLT
        DemExtendedDataClassRef = ExtendedDataClass_5ecd55b9
        DemFreezeFrameClassRef = FreezeFrameClass_c3111450
        DemEventClass:  # Diagnostics Data Import
          DemAgingAllowed = true
          DemAgingCycleCounterThreshold = 40
          DemEventDestination = DEM_DTC_ORIGIN_PRIMARY_MEMORY
          DemEventPriority = 1
          DemEventFailureCycleCounterThreshold = 0
          DemAgingCycleRef = PowerCycle
          DemEnableConditionGroupRef = EnableConditionGroup_7ab46a93
          DemOperationCycleRef = PowerCycle
          IndicatorAttribute_WarningIndicator (DemIndicatorAttribute): DemIndicatorFailureCycleSource=DEM_FAILURE_CYCLE_EVENT, DemIndicatorHealingCycleRef=PowerCycle, DemIndicatorRef=WarningIndicator  # Diagnostics Data Import
          DemDebounceAlgorithmClass  # Diagnostics Data Import
            DemDebounceCounterBased: DemDebounceCounterDecrementStepSize=128, DemDebounceCounterIncrementStepSize=127, DemDebounceCounterJumpDown=true, DemDebounceCounterJumpUp=true  # Diagnostics Data Import
      DTCClass_INV_EM_STATOR_TEMP2_ELE_FLT (DemDTCClass): DemDTCSeverity=DEM_DTC_SEV_MAINTENANCE_ONLY, DemUdsDTC=667649  # Diagnostics Data Import
      INV_EM_STATOR_TEMP_RNG_SWT (DemEventParameter):  # Diagnostics Data Import
        DemEventKind = DEM_EVENT_KIND_SWC
        DemMaxNumberFreezeFrameRecords = 2
        DemDTCClassRef = DTCClass_INV_EM_STATOR_TEMP_RNG_SWT
        DemExtendedDataClassRef = ExtendedDataClass_5ecd55b9
        DemFreezeFrameClassRef = FreezeFrameClass_c3111450
        DemEventClass:  # Diagnostics Data Import
          DemAgingAllowed = true
          DemAgingCycleCounterThreshold = 40
          DemEventDestination = DEM_DTC_ORIGIN_PRIMARY_MEMORY
          DemEventPriority = 1
          DemEventFailureCycleCounterThreshold = 0
          DemAgingCycleRef = PowerCycle
          DemEnableConditionGroupRef = EnableConditionGroup_7ab46a93
          DemOperationCycleRef = PowerCycle
          IndicatorAttribute_WarningIndicator (DemIndicatorAttribute): DemIndicatorFailureCycleSource=DEM_FAILURE_CYCLE_EVENT, DemIndicatorHealingCycleRef=PowerCycle, DemIndicatorRef=WarningIndicator  # Diagnostics Data Import
          DemDebounceAlgorithmClass  # Diagnostics Data Import
            DemDebounceCounterBased: DemDebounceCounterDecrementStepSize=128, DemDebounceCounterIncrementStepSize=127, DemDebounceCounterJumpDown=true, DemDebounceCounterJumpUp=true  # Diagnostics Data Import
      DTCClass_INV_EM_STATOR_TEMP_RNG_SWT (DemDTCClass): DemDTCSeverity=DEM_DTC_SEV_MAINTENANCE_ONLY, DemUdsDTC=666154  # Diagnostics Data Import
      INV_EM_STATOR_TEMP_GRDT (DemEventParameter):  # Diagnostics Data Import
        DemEventKind = DEM_EVENT_KIND_SWC
        DemMaxNumberFreezeFrameRecords = 2
        DemDTCClassRef = DTCClass_INV_EM_STATOR_TEMP_GRDT
        DemExtendedDataClassRef = ExtendedDataClass_5ecd55b9
        DemFreezeFrameClassRef = FreezeFrameClass_c3111450
        DemEventClass:  # Diagnostics Data Import
          DemAgingAllowed = true
          DemAgingCycleCounterThreshold = 40
          DemEventDestination = DEM_DTC_ORIGIN_PRIMARY_MEMORY
          DemEventPriority = 2
          DemEventFailureCycleCounterThreshold = 0
          DemAgingCycleRef = PowerCycle
          DemEnableConditionGroupRef = EnableConditionGroup_90577524
          DemOperationCycleRef = PowerCycle
          IndicatorAttribute_WarningIndicator (DemIndicatorAttribute): DemIndicatorFailureCycleSource=DEM_FAILURE_CYCLE_EVENT, DemIndicatorHealingCycleRef=PowerCycle, DemIndicatorRef=WarningIndicator  # Diagnostics Data Import
          DemDebounceAlgorithmClass  # Diagnostics Data Import
            DemDebounceCounterBased: DemDebounceCounterDecrementStepSize=128, DemDebounceCounterIncrementStepSize=127, DemDebounceCounterJumpDown=true, DemDebounceCounterJumpUp=true  # Diagnostics Data Import
      DTCClass_INV_EM_STATOR_TEMP_GRDT (DemDTCClass): DemDTCSeverity=DEM_DTC_SEV_MAINTENANCE_ONLY, DemUdsDTC=666151  # Diagnostics Data Import
      INV_EM_STATOR_TEMP_RNG_NOK (DemEventParameter):  # Diagnostics Data Import
        DemEventKind = DEM_EVENT_KIND_SWC
        DemMaxNumberFreezeFrameRecords = 2
        DemDTCClassRef = DTCClass_INV_EM_STATOR_TEMP_RNG_NOK
        DemExtendedDataClassRef = ExtendedDataClass_5ecd55b9
        DemFreezeFrameClassRef = FreezeFrameClass_c3111450
        DemEventClass:  # Diagnostics Data Import
          DemAgingAllowed = true
          DemAgingCycleCounterThreshold = 40
          DemEventDestination = DEM_DTC_ORIGIN_PRIMARY_MEMORY
          DemEventPriority = 1
          DemEventFailureCycleCounterThreshold = 0
          DemAgingCycleRef = PowerCycle
          DemEnableConditionGroupRef = EnableConditionGroup_7ab46a93
          DemOperationCycleRef = PowerCycle
          IndicatorAttribute_WarningIndicator (DemIndicatorAttribute): DemIndicatorFailureCycleSource=DEM_FAILURE_CYCLE_EVENT, DemIndicatorHealingCycleRef=PowerCycle, DemIndicatorRef=WarningIndicator  # Diagnostics Data Import
          DemDebounceAlgorithmClass  # Diagnostics Data Import
            DemDebounceCounterBased: DemDebounceCounterDecrementStepSize=128, DemDebounceCounterIncrementStepSize=127, DemDebounceCounterJumpDown=true, DemDebounceCounterJumpUp=true  # Diagnostics Data Import
      DTCClass_INV_EM_STATOR_TEMP_RNG_NOK (DemDTCClass): DemDTCSeverity=DEM_DTC_SEV_MAINTENANCE_ONLY, DemUdsDTC=666140  # Diagnostics Data Import
      INV_EM_STATOR_TEMP_RNG_LO (DemEventParameter):  # Diagnostics Data Import
        DemEventKind = DEM_EVENT_KIND_SWC
        DemMaxNumberFreezeFrameRecords = 2
        DemDTCClassRef = DTCClass_INV_EM_STATOR_TEMP_RNG_LO
        DemExtendedDataClassRef = ExtendedDataClass_5ecd55b9
        DemFreezeFrameClassRef = FreezeFrameClass_c3111450
        DemEventClass:  # Diagnostics Data Import
          DemAgingAllowed = true
          DemAgingCycleCounterThreshold = 40
          DemEventDestination = DEM_DTC_ORIGIN_PRIMARY_MEMORY
          DemEventPriority = 1
          DemEventFailureCycleCounterThreshold = 0
          DemAgingCycleRef = PowerCycle
          DemEnableConditionGroupRef = EnableConditionGroup_7ab46a93
          DemOperationCycleRef = PowerCycle
          IndicatorAttribute_WarningIndicator (DemIndicatorAttribute): DemIndicatorFailureCycleSource=DEM_FAILURE_CYCLE_EVENT, DemIndicatorHealingCycleRef=PowerCycle, DemIndicatorRef=WarningIndicator  # Diagnostics Data Import
          DemDebounceAlgorithmClass  # Diagnostics Data Import
            DemDebounceCounterBased: DemDebounceCounterDecrementStepSize=128, DemDebounceCounterIncrementStepSize=127, DemDebounceCounterJumpDown=true, DemDebounceCounterJumpUp=true  # Diagnostics Data Import
      DTCClass_INV_EM_STATOR_TEMP_RNG_LO (DemDTCClass): DemDTCSeverity=DEM_DTC_SEV_MAINTENANCE_ONLY, DemUdsDTC=666130  # Diagnostics Data Import
      INV_EM_STATOR_TEMP_RNG_HI (DemEventParameter):  # Diagnostics Data Import
        DemEventKind = DEM_EVENT_KIND_SWC
        DemMaxNumberFreezeFrameRecords = 2
        DemDTCClassRef = DTCClass_INV_EM_STATOR_TEMP_RNG_HI
        DemExtendedDataClassRef = ExtendedDataClass_5ecd55b9
        DemFreezeFrameClassRef = FreezeFrameClass_c3111450
        DemEventClass:  # Diagnostics Data Import
          DemAgingAllowed = true
          DemAgingCycleCounterThreshold = 40
          DemEventDestination = DEM_DTC_ORIGIN_PRIMARY_MEMORY
          DemEventPriority = 1
          DemEventFailureCycleCounterThreshold = 0
          DemAgingCycleRef = PowerCycle
          DemEnableConditionGroupRef = EnableConditionGroup_7ab46a93
          DemOperationCycleRef = PowerCycle
          IndicatorAttribute_WarningIndicator (DemIndicatorAttribute): DemIndicatorFailureCycleSource=DEM_FAILURE_CYCLE_EVENT, DemIndicatorHealingCycleRef=PowerCycle, DemIndicatorRef=WarningIndicator  # Diagnostics Data Import
          DemDebounceAlgorithmClass  # Diagnostics Data Import
            DemDebounceCounterBased: DemDebounceCounterDecrementStepSize=128, DemDebounceCounterIncrementStepSize=127, DemDebounceCounterJumpDown=true, DemDebounceCounterJumpUp=true  # Diagnostics Data Import
      DTCClass_INV_EM_STATOR_TEMP_RNG_HI (DemDTCClass): DemDTCSeverity=DEM_DTC_SEV_MAINTENANCE_ONLY, DemUdsDTC=666129  # Diagnostics Data Import
      INV_EM_STATOR_TEMP_ELE_FLT (DemEventParameter):  # Diagnostics Data Import
        DemEventKind = DEM_EVENT_KIND_SWC
        DemMaxNumberFreezeFrameRecords = 2
        DemDTCClassRef = DTCClass_INV_EM_STATOR_TEMP_ELE_FLT
        DemExtendedDataClassRef = ExtendedDataClass_5ecd55b9
        DemFreezeFrameClassRef = FreezeFrameClass_c3111450
        DemEventClass:  # Diagnostics Data Import
          DemAgingAllowed = true
          DemAgingCycleCounterThreshold = 40
          DemEventDestination = DEM_DTC_ORIGIN_PRIMARY_MEMORY
          DemEventPriority = 1
          DemEventFailureCycleCounterThreshold = 0
          DemAgingCycleRef = PowerCycle
          DemEnableConditionGroupRef = EnableConditionGroup_7ab46a93
          DemOperationCycleRef = PowerCycle
          IndicatorAttribute_WarningIndicator (DemIndicatorAttribute): DemIndicatorFailureCycleSource=DEM_FAILURE_CYCLE_EVENT, DemIndicatorHealingCycleRef=PowerCycle, DemIndicatorRef=WarningIndicator  # Diagnostics Data Import
          DemDebounceAlgorithmClass  # Diagnostics Data Import
            DemDebounceCounterBased: DemDebounceCounterDecrementStepSize=128, DemDebounceCounterIncrementStepSize=127, DemDebounceCounterJumpDown=true, DemDebounceCounterJumpUp=true  # Diagnostics Data Import
      DTCClass_INV_EM_STATOR_TEMP_ELE_FLT (DemDTCClass): DemDTCSeverity=DEM_DTC_SEV_MAINTENANCE_ONLY, DemUdsDTC=666113  # Diagnostics Data Import
      PS_KL30_RNG_HI (DemEventParameter):  # Diagnostics Data Import
        DemEventKind = DEM_EVENT_KIND_SWC
        DemMaxNumberFreezeFrameRecords = 2
        DemDTCClassRef = DTCClass_PS_KL30_RNG_HI
        DemExtendedDataClassRef = ExtendedDataClass_5ecd55b9
        DemFreezeFrameClassRef = FreezeFrameClass_c3111450
        DemEventClass:  # Diagnostics Data Import
          DemAgingAllowed = true
          DemAgingCycleCounterThreshold = 40
          DemEventDestination = DEM_DTC_ORIGIN_PRIMARY_MEMORY
          DemEventPriority = 2
          DemEventFailureCycleCounterThreshold = 0
          DemAgingCycleRef = PowerCycle
          DemEnableConditionGroupRef = EnableConditionGroup_7ab46a93
          DemOperationCycleRef = PowerCycle
          IndicatorAttribute_WarningIndicator (DemIndicatorAttribute): DemIndicatorFailureCycleSource=DEM_FAILURE_CYCLE_EVENT, DemIndicatorHealingCycleRef=PowerCycle, DemIndicatorRef=WarningIndicator  # Diagnostics Data Import
          DemDebounceAlgorithmClass  # Diagnostics Data Import
            DemDebounceCounterBased: DemDebounceCounterDecrementStepSize=128, DemDebounceCounterIncrementStepSize=127, DemDebounceCounterJumpDown=true, DemDebounceCounterJumpUp=true  # Diagnostics Data Import
      DTCClass_PS_KL30_RNG_HI (DemDTCClass): DemDTCSeverity=DEM_DTC_SEV_IMMEDIATELY, DemUdsDTC=662435  # Diagnostics Data Import
      PS_KL30_RNG_LO (DemEventParameter):  # Diagnostics Data Import
        DemEventKind = DEM_EVENT_KIND_SWC
        DemMaxNumberFreezeFrameRecords = 2
        DemDTCClassRef = DTCClass_PS_KL30_RNG_LO
        DemExtendedDataClassRef = ExtendedDataClass_5ecd55b9
        DemFreezeFrameClassRef = FreezeFrameClass_c3111450
        DemEventClass:  # Diagnostics Data Import
          DemAgingAllowed = true
          DemAgingCycleCounterThreshold = 40
          DemEventDestination = DEM_DTC_ORIGIN_PRIMARY_MEMORY
          DemEventPriority = 1
          DemEventFailureCycleCounterThreshold = 0
          DemAgingCycleRef = PowerCycle
          DemEnableConditionGroupRef = EnableConditionGroup_7ab46a93
          DemOperationCycleRef = PowerCycle
          IndicatorAttribute_WarningIndicator (DemIndicatorAttribute): DemIndicatorFailureCycleSource=DEM_FAILURE_CYCLE_EVENT, DemIndicatorHealingCycleRef=PowerCycle, DemIndicatorRef=WarningIndicator  # Diagnostics Data Import
          DemDebounceAlgorithmClass  # Diagnostics Data Import
            DemDebounceCounterBased: DemDebounceCounterDecrementStepSize=128, DemDebounceCounterIncrementStepSize=127, DemDebounceCounterJumpDown=true, DemDebounceCounterJumpUp=true  # Diagnostics Data Import
      DTCClass_PS_KL30_RNG_LO (DemDTCClass): DemDTCSeverity=DEM_DTC_SEV_IMMEDIATELY, DemUdsDTC=662434  # Diagnostics Data Import
      PS_KL30_BACKUP_FLT (DemEventParameter):  # Diagnostics Data Import
        DemEventKind = DEM_EVENT_KIND_SWC
        DemMaxNumberFreezeFrameRecords = 2
        DemDTCClassRef = DTCClass_PS_KL30_BACKUP_FLT
        DemExtendedDataClassRef = ExtendedDataClass_5ecd55b9
        DemFreezeFrameClassRef = FreezeFrameClass_c3111450
        DemEventClass:  # Diagnostics Data Import
          DemAgingAllowed = true
          DemAgingCycleCounterThreshold = 40
          DemEventDestination = DEM_DTC_ORIGIN_PRIMARY_MEMORY
          DemEventPriority = 1
          DemEventFailureCycleCounterThreshold = 0
          DemAgingCycleRef = PowerCycle
          DemEnableConditionGroupRef = EnableConditionGroup_7ab46a93
          DemOperationCycleRef = PowerCycle
          IndicatorAttribute_WarningIndicator (DemIndicatorAttribute): DemIndicatorFailureCycleSource=DEM_FAILURE_CYCLE_EVENT, DemIndicatorHealingCycleRef=PowerCycle, DemIndicatorRef=WarningIndicator  # Diagnostics Data Import
          DemDebounceAlgorithmClass  # Diagnostics Data Import
            DemDebounceCounterBased: DemDebounceCounterDecrementStepSize=128, DemDebounceCounterIncrementStepSize=127, DemDebounceCounterJumpDown=true, DemDebounceCounterJumpUp=true  # Diagnostics Data Import
      DTCClass_PS_KL30_BACKUP_FLT (DemDTCClass): DemDTCSeverity=DEM_DTC_SEV_MAINTENANCE_ONLY, DemUdsDTC=662370  # Diagnostics Data Import
      Ga_ZeroFindDistanFailure (DemEventParameter):  # Diagnostics Data Import
        DemEventKind = DEM_EVENT_KIND_SWC
        DemMaxNumberFreezeFrameRecords = 2
        DemDTCClassRef = DTCClass_Ga_ZeroFindDistanFailure
        DemExtendedDataClassRef = ExtendedDataClass_5ecd55b9
        DemFreezeFrameClassRef = FreezeFrameClass_dc4c3f47
        DemEventClass:  # Diagnostics Data Import
          DemAgingAllowed = true
          DemAgingCycleCounterThreshold = 40
          DemEventDestination = DEM_DTC_ORIGIN_PRIMARY_MEMORY
          DemEventPriority = 1
          DemEventFailureCycleCounterThreshold = 0
          DemAgingCycleRef = PowerCycle
          DemEnableConditionGroupRef = EnableConditionGroup_06a6aa19
          DemOperationCycleRef = PowerCycle
          IndicatorAttribute_WarningIndicator (DemIndicatorAttribute): DemIndicatorFailureCycleSource=DEM_FAILURE_CYCLE_EVENT, DemIndicatorHealingCycleRef=PowerCycle, DemIndicatorRef=WarningIndicator  # Diagnostics Data Import
          DemDebounceAlgorithmClass  # Diagnostics Data Import
            DemDebounceCounterBased: DemDebounceCounterDecrementStepSize=128, DemDebounceCounterIncrementStepSize=127, DemDebounceCounterJumpDown=true, DemDebounceCounterJumpUp=true  # Diagnostics Data Import
      DTCClass_Ga_ZeroFindDistanFailure (DemDTCClass): DemDTCSeverity=DEM_DTC_SEV_IMMEDIATELY, DemUdsDTC=528537  # Diagnostics Data Import
      Ga_MoveOverThd (DemEventParameter):  # Diagnostics Data Import
        DemEventKind = DEM_EVENT_KIND_SWC
        DemMaxNumberFreezeFrameRecords = 2
        DemDTCClassRef = DTCClass_Ga_MoveOverThd
        DemExtendedDataClassRef = ExtendedDataClass_5ecd55b9
        DemFreezeFrameClassRef = FreezeFrameClass_dc4c3f47
        DemEventClass:  # Diagnostics Data Import
          DemAgingAllowed = true
          DemAgingCycleCounterThreshold = 40
          DemEventDestination = DEM_DTC_ORIGIN_PRIMARY_MEMORY
          DemEventPriority = 1
          DemEventFailureCycleCounterThreshold = 0
          DemAgingCycleRef = PowerCycle
          DemEnableConditionGroupRef = EnableConditionGroup_06a6aa19
          DemOperationCycleRef = PowerCycle
          IndicatorAttribute_WarningIndicator (DemIndicatorAttribute): DemIndicatorFailureCycleSource=DEM_FAILURE_CYCLE_EVENT, DemIndicatorHealingCycleRef=PowerCycle, DemIndicatorRef=WarningIndicator  # Diagnostics Data Import
          DemDebounceAlgorithmClass  # Diagnostics Data Import
            DemDebounceCounterBased: DemDebounceCounterDecrementStepSize=128, DemDebounceCounterIncrementStepSize=127, DemDebounceCounterJumpDown=true, DemDebounceCounterJumpUp=true  # Diagnostics Data Import
      DTCClass_Ga_MoveOverThd (DemDTCClass): DemDTCSeverity=DEM_DTC_SEV_IMMEDIATELY, DemUdsDTC=528532  # Diagnostics Data Import
      DiagC_ClutchService (DemEventParameter):  # Diagnostics Data Import
        DemEventKind = DEM_EVENT_KIND_SWC
        DemMaxNumberFreezeFrameRecords = 2
        DemDTCClassRef = DTCClass_DiagC_ClutchService
        DemExtendedDataClassRef = ExtendedDataClass_5ecd55b9
        DemFreezeFrameClassRef = FreezeFrameClass_dc4c3f47
        DemEventClass:  # Diagnostics Data Import
          DemAgingAllowed = true
          DemAgingCycleCounterThreshold = 40
          DemEventDestination = DEM_DTC_ORIGIN_PRIMARY_MEMORY
          DemEventPriority = 1
          DemEventFailureCycleCounterThreshold = 0
          DemAgingCycleRef = PowerCycle
          DemEnableConditionGroupRef = EnableConditionGroup_06a6aa19
          DemOperationCycleRef = PowerCycle
          IndicatorAttribute_WarningIndicator (DemIndicatorAttribute): DemIndicatorFailureCycleSource=DEM_FAILURE_CYCLE_EVENT, DemIndicatorHealingCycleRef=PowerCycle, DemIndicatorRef=WarningIndicator  # Diagnostics Data Import
          DemDebounceAlgorithmClass  # Diagnostics Data Import
            DemDebounceCounterBased: DemDebounceCounterDecrementStepSize=128, DemDebounceCounterIncrementStepSize=127, DemDebounceCounterJumpDown=true, DemDebounceCounterJumpUp=true  # Diagnostics Data Import
      DTCClass_DiagC_ClutchService (DemDTCClass): DemDTCSeverity=DEM_DTC_SEV_IMMEDIATELY, DemUdsDTC=528530  # Diagnostics Data Import
      PS_WhlSnsr_FLT (DemEventParameter):  # Diagnostics Data Import
        DemEventKind = DEM_EVENT_KIND_SWC
        DemMaxNumberFreezeFrameRecords = 2
        DemDTCClassRef = DTCClass_PS_WhlSnsr_FLT
        DemExtendedDataClassRef = ExtendedDataClass_5ecd55b9
        DemFreezeFrameClassRef = FreezeFrameClass_dc4c3f47
        DemEventClass:  # Diagnostics Data Import
          DemAgingAllowed = true
          DemAgingCycleCounterThreshold = 40
          DemEventDestination = DEM_DTC_ORIGIN_PRIMARY_MEMORY
          DemEventPriority = 1
          DemEventFailureCycleCounterThreshold = 0
          DemAgingCycleRef = PowerCycle
          DemEnableConditionGroupRef = EnableConditionGroup_06a6aa19
          DemOperationCycleRef = PowerCycle
          IndicatorAttribute_WarningIndicator (DemIndicatorAttribute): DemIndicatorFailureCycleSource=DEM_FAILURE_CYCLE_EVENT, DemIndicatorHealingCycleRef=PowerCycle, DemIndicatorRef=WarningIndicator  # Diagnostics Data Import
          DemDebounceAlgorithmClass  # Diagnostics Data Import
            DemDebounceCounterBased: DemDebounceCounterDecrementStepSize=128, DemDebounceCounterIncrementStepSize=127, DemDebounceCounterJumpDown=true, DemDebounceCounterJumpUp=true  # Diagnostics Data Import
      DTCClass_PS_WhlSnsr_FLT (DemDTCClass): DemDTCSeverity=DEM_DTC_SEV_IMMEDIATELY, DemUdsDTC=466945  # Diagnostics Data Import
      PS_P15_W_FLT (DemEventParameter):  # Diagnostics Data Import
        DemEventKind = DEM_EVENT_KIND_SWC
        DemMaxNumberFreezeFrameRecords = 2
        DemDTCClassRef = DTCClass_PS_P15_W_FLT
        DemExtendedDataClassRef = ExtendedDataClass_5ecd55b9
        DemFreezeFrameClassRef = FreezeFrameClass_c3111450
        DemEventClass:  # Diagnostics Data Import
          DemAgingAllowed = true
          DemAgingCycleCounterThreshold = 40
          DemEventDestination = DEM_DTC_ORIGIN_PRIMARY_MEMORY
          DemEventPriority = 1
          DemEventFailureCycleCounterThreshold = 0
          DemAgingCycleRef = PowerCycle
          DemEnableConditionGroupRef = EnableConditionGroup_7ab46a93
          DemOperationCycleRef = PowerCycle
          IndicatorAttribute_WarningIndicator (DemIndicatorAttribute): DemIndicatorFailureCycleSource=DEM_FAILURE_CYCLE_EVENT, DemIndicatorHealingCycleRef=PowerCycle, DemIndicatorRef=WarningIndicator  # Diagnostics Data Import
          DemDebounceAlgorithmClass  # Diagnostics Data Import
            DemDebounceCounterBased: DemDebounceCounterDecrementStepSize=128, DemDebounceCounterIncrementStepSize=127, DemDebounceCounterJumpDown=true, DemDebounceCounterJumpUp=true  # Diagnostics Data Import
      DTCClass_PS_P15_W_FLT (DemDTCClass): DemDTCSeverity=DEM_DTC_SEV_MAINTENANCE_ONLY, DemUdsDTC=452124  # Diagnostics Data Import
      PS_P15_V_FLT (DemEventParameter):  # Diagnostics Data Import
        DemEventKind = DEM_EVENT_KIND_SWC
        DemMaxNumberFreezeFrameRecords = 2
        DemDTCClassRef = DTCClass_PS_P15_V_FLT
        DemExtendedDataClassRef = ExtendedDataClass_5ecd55b9
        DemFreezeFrameClassRef = FreezeFrameClass_c3111450
        DemEventClass:  # Diagnostics Data Import
          DemAgingAllowed = true
          DemAgingCycleCounterThreshold = 40
          DemEventDestination = DEM_DTC_ORIGIN_PRIMARY_MEMORY
          DemEventPriority = 1
          DemEventFailureCycleCounterThreshold = 0
          DemAgingCycleRef = PowerCycle
          DemEnableConditionGroupRef = EnableConditionGroup_7ab46a93
          DemOperationCycleRef = PowerCycle
          IndicatorAttribute_WarningIndicator (DemIndicatorAttribute): DemIndicatorFailureCycleSource=DEM_FAILURE_CYCLE_EVENT, DemIndicatorHealingCycleRef=PowerCycle, DemIndicatorRef=WarningIndicator  # Diagnostics Data Import
          DemDebounceAlgorithmClass  # Diagnostics Data Import
            DemDebounceCounterBased: DemDebounceCounterDecrementStepSize=128, DemDebounceCounterIncrementStepSize=127, DemDebounceCounterJumpDown=true, DemDebounceCounterJumpUp=true  # Diagnostics Data Import
      DTCClass_PS_P15_V_FLT (DemDTCClass): DemDTCSeverity=DEM_DTC_SEV_MAINTENANCE_ONLY, DemUdsDTC=439068  # Diagnostics Data Import
      PS_P15_U_FLT (DemEventParameter):  # Diagnostics Data Import
        DemEventKind = DEM_EVENT_KIND_SWC
        DemMaxNumberFreezeFrameRecords = 2
        DemDTCClassRef = DTCClass_PS_P15_U_FLT
        DemExtendedDataClassRef = ExtendedDataClass_5ecd55b9
        DemFreezeFrameClassRef = FreezeFrameClass_c3111450
        DemEventClass:  # Diagnostics Data Import
          DemAgingAllowed = true
          DemAgingCycleCounterThreshold = 40
          DemEventDestination = DEM_DTC_ORIGIN_PRIMARY_MEMORY
          DemEventPriority = 1
          DemEventFailureCycleCounterThreshold = 0
          DemAgingCycleRef = PowerCycle
          DemEnableConditionGroupRef = EnableConditionGroup_7ab46a93
          DemOperationCycleRef = PowerCycle
          IndicatorAttribute_WarningIndicator (DemIndicatorAttribute): DemIndicatorFailureCycleSource=DEM_FAILURE_CYCLE_EVENT, DemIndicatorHealingCycleRef=PowerCycle, DemIndicatorRef=WarningIndicator  # Diagnostics Data Import
          DemDebounceAlgorithmClass  # Diagnostics Data Import
            DemDebounceCounterBased: DemDebounceCounterDecrementStepSize=128, DemDebounceCounterIncrementStepSize=127, DemDebounceCounterJumpDown=true, DemDebounceCounterJumpUp=true  # Diagnostics Data Import
      DTCClass_PS_P15_U_FLT (DemDTCClass): DemDTCSeverity=DEM_DTC_SEV_MAINTENANCE_ONLY, DemUdsDTC=438300  # Diagnostics Data Import
  module config EcuC
    EcucPduCollection: PduIdTypeEnum=UINT8, PduLengthTypeEnum=UINT16
      108 x Pdu:
        BecmPropSignalIpdu01_7a983997_Rx: PduLength=8
        BecmPropSignalIpdu01_e4f1b6c7_Rx: PduLength=8, SysTPduToFrameMappingRef=BecmPropSignalIpdu01_map
        BecmPropSignalIpdu02_a919b6a0_Rx: PduLength=8, SysTPduToFrameMappingRef=BecmPropSignalIpdu02_map
        BecmPropSignalIpdu02_e391682d_Rx: PduLength=8
        BecmPropSignalIpdu03_24914b42_Rx: PduLength=8, SysTPduToFrameMappingRef=BecmPropSignalIpdu03_map
        BecmPropSignalIpdu03_949658bb_Rx: PduLength=8
        BecmPropSignalIpdu15_64eecccf_Rx: PduLength=8
        BecmPropSignalIpdu15_f1c84025_Rx: PduLength=8, SysTPduToFrameMappingRef=BecmPropSignalIpdu15_map
        CddObcPropSignalIPdu01_003f0830_Rx: PduLength=8
        CddObcPropSignalIPdu01_1ee0577a_Rx: PduLength=8, SysTPduToFrameMappingRef=CddObcPropSignalIPdu01_map
        ECMPropSignalIPDU02_2a2da2a9_Rx: PduLength=8, SysTPduToFrameMappingRef=ECMPropSignalIPDU02_map
        ECMPropSignalIPDU02_bd22093c_Rx: PduLength=8
        ECMPropSignalIPDU04_5441ac09_Rx: PduLength=8
        ECMPropSignalIPDU04_b1fda267_Rx: PduLength=8, SysTPduToFrameMappingRef=ECMPropSignalIPDU04_map
        ECMPropSignalIPDU05_23469c9f_Rx: PduLength=8
        ECMPropSignalIPDU05_3c755f85_Rx: PduLength=8, SysTPduToFrameMappingRef=ECMPropSignalIPDU05_map
        ECMPropSignalIPDU06_719d5fe2_Rx: PduLength=8, SysTPduToFrameMappingRef=ECMPropSignalIPDU06_map
        ECMPropSignalIPDU06_ba4fcd25_Rx: PduLength=8
        EcmPropSignalIPDU08_2e126ae8_Rx: PduLength=8
        EcmPropSignalIPDU08_f2c9e4fc_Rx: PduLength=8, SysTPduToFrameMappingRef=EcmPropSignalIPDU08_map
        EcmPropSignalIPDU11_4ed5e30d_Rx: PduLength=8
        EcmPropSignalIPDU11_86a9e821_Rx: PduLength=8, SysTPduToFrameMappingRef=EcmPropSignalIPDU11_map
        EcmPropSignalIPDU28_1c24086a_Rx: PduLength=8
        EcmPropSignalIPDU28_6fdbf3ae_Rx: PduLength=8, SysTPduToFrameMappingRef=EcmPropSignalIPDU28_map
        EcmPropSignalIPdu24_045785fe_Rx: PduLength=8, SysTPduToFrameMappingRef=EcmPropSignalIPdu24_map
        EcmPropSignalIPdu24_8dedad9f_Rx: PduLength=8
        EcmPropSignalIPdu25_89df781c_Rx: PduLength=8, SysTPduToFrameMappingRef=EcmPropSignalIPdu25_map
        EcmPropSignalIPdu25_faea9d09_Rx: PduLength=8
        EtcToAllJ1979OBDDiagDcmIpdu11_b7ab7660_Rx: PduLength=6
        EtcToAllJ1979OBDDiagDcmIpdu11_f3f7d8ab_Rx: PduLength=6
        EtcToIemJ1979OBDDiagDcmIpdu11_ac95f359_Rx: PduLength=4000
        EtcToIemJ1979OBDDiagDcmIpdu11_ad182927_Rx: PduLength=4000
        IemEduPropSignalIPdu01_3346005e_Tx: PduLength=8
        IemEduPropSignalIPdu01_a3cd4ce7_Tx: PduLength=8, SysTPduToFrameMappingRef=IemEduPropSignalIPdu01_map
        IemEduPropSignalIPdu02_aa4f51e4_Tx: PduLength=8
        IemEduPropSignalIPdu02_ee254c80_Tx: PduLength=8, SysTPduToFrameMappingRef=IemEduPropSignalIPdu02_map
        IemPropCanNmNode_6342b4e7_Rx: PduLength=8, SysTPduToFrameMappingRef=IgmPropNmPdu1_map
        IemPropNmPdu1_277f9a9b_Tx: PduLength=8, SysTPduToFrameMappingRef=IemPropNmPdu1_map
        IemPropSignalIPdu01_1988e981_Tx: PduLength=8, SysTPduToFrameMappingRef=IemPropSignalIPdu01_map
        IemPropSignalIPdu01_21049770_Tx: PduLength=8
        IemPropSignalIPdu02_5460e9e6_Tx: PduLength=8, SysTPduToFrameMappingRef=IemPropSignalIPdu02_map
        IemPropSignalIPdu02_b80dc6ca_Tx: PduLength=8
        IemPropSignalIPdu03_cf0af65c_Tx: PduLength=8
        IemPropSignalIPdu03_d9e81404_Tx: PduLength=8, SysTPduToFrameMappingRef=IemPropSignalIPdu03_map
        IemPropSignalIPdu04_516e63ff_Tx: PduLength=8
        IemPropSignalIPdu04_cfb0e928_Tx: PduLength=8, SysTPduToFrameMappingRef=IemPropSignalIPdu04_map
        IemPropSignalIPdu06_0fd014ad_Tx: PduLength=8, SysTPduToFrameMappingRef=IemPropSignalIPdu06_map
        IemPropSignalIPdu06_bf6002d3_Tx: PduLength=8
        IemPropSignalIPdu07_8258e94f_Tx: PduLength=8, SysTPduToFrameMappingRef=IemPropSignalIPdu07_map
        IemPropSignalIPdu07_c8673245_Tx: PduLength=8
        IemPropSignalIPdu08_2361eef5_Tx: PduLength=8, SysTPduToFrameMappingRef=IemPropSignalIPdu08_map
        IemPropSignalIPdu08_58d82fd4_Tx: PduLength=8
        IemPropSignalIPdu09_2fdf1f42_Tx: PduLength=8
        IemPropSignalIPdu09_aee91317_Tx: PduLength=8, SysTPduToFrameMappingRef=IemPropSignalIPdu09_map
        IemPropSignalIPdu12_1ae9e24f_Tx: PduLength=8, SysTPduToFrameMappingRef=IemPropSignalIPdu12_map
        IemPropSignalIPdu12_a116f78b_Tx: PduLength=8
        IemPropSignalIPdu14_487552be_Tx: PduLength=8
        IemPropSignalIPdu14_8139e281_Tx: PduLength=8, SysTPduToFrameMappingRef=IemPropSignalIPdu14_map
        IemPropSignalIPdu16_41591f04_Tx: PduLength=8, SysTPduToFrameMappingRef=IemPropSignalIPdu16_map
        IemPropSignalIPdu16_a67b3392_Tx: PduLength=8
        IemToEtcJ1979OBDDiagDcmIpdu11_525ada58_Tx: PduLength=4000
        IemToEtcJ1979OBDDiagDcmIpdu11_da239b2d_Tx: PduLength=4000
        IemToEtcUudtDcmIpdu1_4ae85965_Tx: PduLength=8
        IemToEtcUudtDcmIpdu1_a0db6d78_Tx: PduLength=8
        IemToEtcUudtDcmIpdu2_07005902_Tx: PduLength=8
        IemToEtcUudtDcmIpdu2_39d23cc2_Tx: PduLength=8
        IemToEtcUudtDcmIpdu3_4ed50c54_Tx: PduLength=8
        IemToEtcUudtDcmIpdu3_8a88a4e0_Tx: PduLength=8
        IemToVddmPropDiagResNpdu_cef1039b_Tx: PduLength=8, SysTPduToFrameMappingRef=IemToVddmPropDiagResNpdu_map
        IemToVgmDiagDcmIpdu_411ec11e_Tx: PduLength=4000
        IemToVgmDiagDcmIpdu_ce8379a0_Tx: PduLength=4000
        IemToVgmJ1979OBDPropCanResNpdu11_72c85f7f_Tx: PduLength=8, SysTPduToFrameMappingRef=IemToVgmJ1979OBDPropCanResNpdu11_map
        PropulsionCAN_c71a5358_Rx: PduLength=6
        SrsPropSignalIPdu02_30ca6a16_Rx: PduLength=8, SysTPduToFrameMappingRef=SrsPropSignalIPdu02_map
        SrsPropSignalIPdu02_4fa2d123_Rx: PduLength=8
        UudtIemNPdu1_4b1dfe9b_Tx: PduLength=8, SysTPduToFrameMappingRef=UudtIemNPdu1_map
        UudtIemNPdu2_06f5fefc_Tx: PduLength=8, SysTPduToFrameMappingRef=UudtIemNPdu2_map
        UudtIemNPdu3_8b7d031e_Tx: PduLength=8, SysTPduToFrameMappingRef=UudtIemNPdu3_map
        VDDMPropSignalIPDU05_753dbccf_Rx: PduLength=8, SysTPduToFrameMappingRef=VDDMPropSignalIPDU05_map
        VDDMPropSignalIPDU05_e9cd0dca_Rx: PduLength=8
        VDDMPropSignalIPDU06_38d5bca8_Rx: PduLength=8, SysTPduToFrameMappingRef=VDDMPropSignalIPDU06_map
        VDDMPropSignalIPDU06_70c45c70_Rx: PduLength=8
        VDDMPropSignalIPDU08_146446f0_Rx: PduLength=8, SysTPduToFrameMappingRef=VDDMPropSignalIPDU08_map
        VDDMPropSignalIPDU08_977c7177_Rx: PduLength=8
        VDDMPropSignalIPDU11_60044a2d_Rx: PduLength=8, SysTPduToFrameMappingRef=VDDMPropSignalIPDU11_map
        VDDMPropSignalIPDU11_f7bbf892_Rx: PduLength=8
        VDDMPropSignalIPDU16_69df6d31_Rx: PduLength=8
        VDDMPropSignalIPDU16_765cb701_Rx: PduLength=8, SysTPduToFrameMappingRef=VDDMPropSignalIPDU16_map
        VDDMPropSignalIPDU17_1ed85da7_Rx: PduLength=8
        VDDMPropSignalIPDU17_fbd44ae3_Rx: PduLength=8, SysTPduToFrameMappingRef=VDDMPropSignalIPDU17_map
        VDDMPropSignalIPDU18_5aed4d59_Rx: PduLength=8, SysTPduToFrameMappingRef=VDDMPropSignalIPDU18_map
        VDDMPropSignalIPDU18_8e674036_Rx: PduLength=8
        VDDMPropSignalIPDU19_d765b0bb_Rx: PduLength=8, SysTPduToFrameMappingRef=VDDMPropSignalIPDU19_map
        VDDMPropSignalIPDU19_f96070a0_Rx: PduLength=8
        VDDMPropdTCSignalIPdu38_4bda4dd7_Rx: PduLength=8, SysTPduToFrameMappingRef=VDDMPropdTCSignalIPdu38_map
        VDDMPropdTCSignalIPdu38_808bfd3f_Rx: PduLength=8
        VddmBcmPropdTCSignalIPDU01_857b2e99_Rx: PduLength=8, SysTPduToFrameMappingRef=VddmBcmPropdTCSignalIPDU01_map
        VddmBcmPropdTCSignalIPDU01_886bd56f_Rx: PduLength=8
        VddmPropSignalIPdu26_893fed53_Rx: PduLength=8, SysTPduToFrameMappingRef=VddmPropSignalIPdu26_map
        VddmPropSignalIPdu26_8fec2bf2_Rx: PduLength=8
        VddmToAllFuncPropDiagReqNpdu_86e6f41a_Rx: PduLength=8, SysTPduToFrameMappingRef=VddmToAllFuncPropDiagReqNpdu_map
        VddmToIemPropDiagReqNpdu_b1f6d800_Rx: PduLength=8, SysTPduToFrameMappingRef=VddmToIemPropDiagReqNpdu_map
        VgmToAllFuncDiagDcmIpdu_030e2fcd_Rx: PduLength=6
        VgmToAllFuncDiagDcmIpdu_89c72e24_Rx: PduLength=6
        VgmToAllFuncJ1979OBDPropCanReqNpdu11_a7af92b3_Rx: PduLength=8, SysTPduToFrameMappingRef=VgmToAllFuncJ1979OBDPropCanReqNpdu11_map
        VgmToIemDiagDcmIpdu_81f41e2d_Rx: PduLength=4000
        VgmToIemDiagDcmIpdu_cbf08236_Rx: PduLength=4000
        VgmToIemJ1979OBDPropCanReqNpdu11_0f26f145_Rx: PduLength=8, SysTPduToFrameMappingRef=VgmToIemJ1979OBDPropCanReqNpdu11_map
  module config EcuM
    EcuMConfiguration
      EcuMCommonConfiguration
        EcuMDriverInitListOne
        EcuMDriverRestartList
        PropulsionCAN_IEM_19020f5a (EcuMWakeupSource): EcuMWakeupSourceId=5, EcuMComMChannelRef=ComMConfigSet/PropulsionCAN_IEM_19020f5a
      EcuMFlexConfiguration: EcuMFlexModuleConfigurationRef=CanConfigSet
  module config Nm
    PropulsionCAN_IEM_19020f5a (NmChannelConfig): NmChannelSleepMaster=false, NmPassiveModeEnabled=false, NmSynchronizingNetwork=false, NmComMChannelRef=ComMConfigSet/PropulsionCAN_IEM_19020f5a
      PropulsionCanNmCluster_99dff440 (NmBusType)
        NmStandardBusNmConfig: NmStandardBusType=NM_BUSNM_CANNM  # PropulsionCanNmCluster
    NmGlobalConfig
      NmGlobalFeatures:
        NmBusSynchronizationEnabled = false
        NmComControlEnabled = false
        NmNodeDetectionEnabled = true
        NmNodeIdEnabled = true
        NmPduRxIndicationEnabled = true
        NmRemoteSleepIndEnabled = false
        NmRepeatMsgIndEnabled = false
        NmStateChangeIndEnabled = false
        NmUserDataEnabled = true
      NmGlobalProperties
  module config PduR
    PduRGeneral
    PduRRoutingTables
      PduRRoutingTable
        49 x PduRRoutingPath:
          BecmPropSignalIpdu01_e4f1b6c7_Rx
            BecmPropSignalIpdu01_e4f1b6c7_Rx_d978c2f8_Rx (PduRDestPdu): PduRDestPduRef=EcucPduCollection/BecmPropSignalIpdu01_7a983997_Rx
            PduRSrcPdu_d978c2f8 (PduRSrcPdu): PduRSrcPduRef=EcucPduCollection/BecmPropSignalIpdu01_e4f1b6c7_Rx
          BecmPropSignalIpdu02_a919b6a0_Rx
            BecmPropSignalIpdu02_a919b6a0_Rx_03540ad7_Rx (PduRDestPdu): PduRDestPduRef=EcucPduCollection/BecmPropSignalIpdu02_e391682d_Rx
            PduRSrcPdu_03540ad7 (PduRSrcPdu): PduRSrcPduRef=EcucPduCollection/BecmPropSignalIpdu02_a919b6a0_Rx
          BecmPropSignalIpdu03_24914b42_Rx
            BecmPropSignalIpdu03_24914b42_Rx_2fbd4436_Rx (PduRDestPdu): PduRDestPduRef=EcucPduCollection/BecmPropSignalIpdu03_949658bb_Rx
            PduRSrcPdu_2fbd4436 (PduRSrcPdu): PduRSrcPduRef=EcucPduCollection/BecmPropSignalIpdu03_24914b42_Rx
          BecmPropSignalIpdu15_f1c84025_Rx
            BecmPropSignalIpdu15_f1c84025_Rx_97fbab59_Rx (PduRDestPdu): PduRDestPduRef=EcucPduCollection/BecmPropSignalIpdu15_64eecccf_Rx
            PduRSrcPdu_97fbab59 (PduRSrcPdu): PduRSrcPduRef=EcucPduCollection/BecmPropSignalIpdu15_f1c84025_Rx
          CddObcPropSignalIPdu01_1ee0577a_Rx
            CddObcPropSignalIPdu01_1ee0577a_Rx_9b6ba7e6_Rx (PduRDestPdu): PduRDestPduRef=EcucPduCollection/CddObcPropSignalIPdu01_003f0830_Rx
            PduRSrcPdu_9b6ba7e6 (PduRSrcPdu): PduRSrcPduRef=EcucPduCollection/CddObcPropSignalIPdu01_1ee0577a_Rx
          ECMPropSignalIPDU02_2a2da2a9_Rx
            ECMPropSignalIPDU02_2a2da2a9_Rx_c52842d9_Rx (PduRDestPdu): PduRDestPduRef=EcucPduCollection/ECMPropSignalIPDU02_bd22093c_Rx
            PduRSrcPdu_c52842d9 (PduRSrcPdu): PduRSrcPduRef=EcucPduCollection/ECMPropSignalIPDU02_2a2da2a9_Rx
          ECMPropSignalIPDU04_b1fda267_Rx
            ECMPropSignalIPDU04_b1fda267_Rx_e135b2fa_Rx (PduRDestPdu): PduRDestPduRef=EcucPduCollection/ECMPropSignalIPDU04_5441ac09_Rx
            PduRSrcPdu_e135b2fa (PduRSrcPdu): PduRSrcPduRef=EcucPduCollection/ECMPropSignalIPDU04_b1fda267_Rx
          ECMPropSignalIPDU05_3c755f85_Rx
            ECMPropSignalIPDU05_3c755f85_Rx_916b682c_Rx (PduRDestPdu): PduRDestPduRef=EcucPduCollection/ECMPropSignalIPDU05_23469c9f_Rx
            PduRSrcPdu_916b682c (PduRSrcPdu): PduRSrcPduRef=EcucPduCollection/ECMPropSignalIPDU05_3c755f85_Rx
          ECMPropSignalIPDU06_719d5fe2_Rx
            ECMPropSignalIPDU06_719d5fe2_Rx_2d833a1c_Rx (PduRDestPdu): PduRDestPduRef=EcucPduCollection/ECMPropSignalIPDU06_ba4fcd25_Rx
            PduRSrcPdu_2d833a1c (PduRSrcPdu): PduRSrcPduRef=EcucPduCollection/ECMPropSignalIPDU06_719d5fe2_Rx
          EcmPropSignalIPDU08_f2c9e4fc_Rx
            EcmPropSignalIPDU08_f2c9e4fc_Rx_cd8794a7_Rx (PduRDestPdu): PduRDestPduRef=EcucPduCollection/EcmPropSignalIPDU08_2e126ae8_Rx
            PduRSrcPdu_cd8794a7 (PduRSrcPdu): PduRSrcPduRef=EcucPduCollection/EcmPropSignalIPDU08_f2c9e4fc_Rx
          EcmPropSignalIPDU11_86a9e821_Rx
            EcmPropSignalIPDU11_86a9e821_Rx_019d6fbe_Rx (PduRDestPdu): PduRDestPduRef=EcucPduCollection/EcmPropSignalIPDU11_4ed5e30d_Rx
            PduRSrcPdu_019d6fbe (PduRSrcPdu): PduRSrcPduRef=EcucPduCollection/EcmPropSignalIPDU11_86a9e821_Rx
          EcmPropSignalIPDU28_6fdbf3ae_Rx
            EcmPropSignalIPDU28_6fdbf3ae_Rx_332380ac_Rx (PduRDestPdu): PduRDestPduRef=EcucPduCollection/EcmPropSignalIPDU28_1c24086a_Rx
            PduRSrcPdu_332380ac (PduRSrcPdu): PduRSrcPduRef=EcucPduCollection/EcmPropSignalIPDU28_6fdbf3ae_Rx
          EcmPropSignalIPdu24_045785fe_Rx
            EcmPropSignalIPdu24_045785fe_Rx_0c4be5f2_Rx (PduRDestPdu): PduRDestPduRef=EcucPduCollection/EcmPropSignalIPdu24_8dedad9f_Rx
            PduRSrcPdu_0c4be5f2 (PduRSrcPdu): PduRSrcPduRef=EcucPduCollection/EcmPropSignalIPdu24_045785fe_Rx
          EcmPropSignalIPdu25_89df781c_Rx
            EcmPropSignalIPdu25_89df781c_Rx_87cbdfdf_Rx (PduRDestPdu): PduRDestPduRef=EcucPduCollection/EcmPropSignalIPdu25_faea9d09_Rx
            PduRSrcPdu_87cbdfdf (PduRSrcPdu): PduRSrcPduRef=EcucPduCollection/EcmPropSignalIPdu25_89df781c_Rx
          EtcToAllJ1979OBDDiagDcmIpdu11_b7ab7660_Rx
            EtcToAllJ1979OBDDiagDcmIpdu11_b7ab7660_Rx_63335c9b_Rx (PduRDestPdu): PduRDestPduRef=EtcToAllJ1979OBDDiagDcmIpdu11_f3f7d8ab_Rx
            PduRSrcPdu_63335c9b (PduRSrcPdu): PduRSrcPduRef=EcucPduCollection/EtcToAllJ1979OBDDiagDcmIpdu11_b7ab7660_Rx
          EtcToIemJ1979OBDDiagDcmIpdu11_ac95f359_Rx
            EtcToIemJ1979OBDDiagDcmIpdu11_ac95f359_Rx_62791526_Rx (PduRDestPdu): PduRDestPduRef=EtcToIemJ1979OBDDiagDcmIpdu11_ad182927_Rx
            PduRSrcPdu_62791526 (PduRSrcPdu): PduRSrcPduRef=EcucPduCollection/EtcToIemJ1979OBDDiagDcmIpdu11_ac95f359_Rx
          IemEduPropSignalIPdu01_3346005e_Tx
            IemEduPropSignalIPdu01_a3cd4ce7_Tx (PduRDestPdu): PduRDestPduRef=EcucPduCollection/IemEduPropSignalIPdu01_a3cd4ce7_Tx
            PduRSrcPdu_5ecec422 (PduRSrcPdu): PduRSrcPduRef=EcucPduCollection/IemEduPropSignalIPdu01_3346005e_Tx
          IemEduPropSignalIPdu02_aa4f51e4_Tx
            IemEduPropSignalIPdu02_ee254c80_Tx (PduRDestPdu): PduRDestPduRef=EcucPduCollection/IemEduPropSignalIPdu02_ee254c80_Tx
            PduRSrcPdu_f9d732b4 (PduRSrcPdu): PduRSrcPduRef=EcucPduCollection/IemEduPropSignalIPdu02_aa4f51e4_Tx
          IemPropSignalIPdu01_21049770_Tx
            IemPropSignalIPdu01_1988e981_Tx (PduRDestPdu): PduRDestPduRef=EcucPduCollection/IemPropSignalIPdu01_1988e981_Tx
            PduRSrcPdu_0bf0194b (PduRSrcPdu): PduRSrcPduRef=EcucPduCollection/IemPropSignalIPdu01_21049770_Tx
          IemPropSignalIPdu02_b80dc6ca_Tx
            IemPropSignalIPdu02_5460e9e6_Tx (PduRDestPdu): PduRDestPduRef=EcucPduCollection/IemPropSignalIPdu02_5460e9e6_Tx
            PduRSrcPdu_956c143d (PduRSrcPdu): PduRSrcPduRef=EcucPduCollection/IemPropSignalIPdu02_b80dc6ca_Tx
          IemPropSignalIPdu03_cf0af65c_Tx
            IemPropSignalIPdu03_d9e81404_Tx (PduRDestPdu): PduRDestPduRef=EcucPduCollection/IemPropSignalIPdu03_d9e81404_Tx
            PduRSrcPdu_292b77a0 (PduRSrcPdu): PduRSrcPduRef=EcucPduCollection/IemPropSignalIPdu03_cf0af65c_Tx
          IemPropSignalIPdu04_516e63ff_Tx
            IemPropSignalIPdu04_cfb0e928_Tx (PduRDestPdu): PduRDestPduRef=EcucPduCollection/IemPropSignalIPdu04_cfb0e928_Tx
            PduRSrcPdu_53beb1f3 (PduRSrcPdu): PduRSrcPduRef=EcucPduCollection/IemPropSignalIPdu04_516e63ff_Tx
          IemPropSignalIPdu06_bf6002d3_Tx
            IemPropSignalIPdu06_0fd014ad_Tx (PduRDestPdu): PduRDestPduRef=EcucPduCollection/IemPropSignalIPdu06_0fd014ad_Tx
            PduRSrcPdu_0af6e6e3 (PduRSrcPdu): PduRSrcPduRef=EcucPduCollection/IemPropSignalIPdu06_bf6002d3_Tx
          IemPropSignalIPdu07_c8673245_Tx
            IemPropSignalIPdu07_8258e94f_Tx (PduRDestPdu): PduRDestPduRef=EcucPduCollection/IemPropSignalIPdu07_8258e94f_Tx
            PduRSrcPdu_9766d5ce (PduRSrcPdu): PduRSrcPduRef=EcucPduCollection/IemPropSignalIPdu07_c8673245_Tx
          IemPropSignalIPdu08_58d82fd4_Tx
            IemPropSignalIPdu08_2361eef5_Tx (PduRDestPdu): PduRDestPduRef=EcucPduCollection/IemPropSignalIPdu08_2361eef5_Tx
            PduRSrcPdu_145e853b (PduRSrcPdu): PduRSrcPduRef=EcucPduCollection/IemPropSignalIPdu08_58d82fd4_Tx
          IemPropSignalIPdu09_2fdf1f42_Tx
            IemPropSignalIPdu09_aee91317_Tx (PduRDestPdu): PduRDestPduRef=EcucPduCollection/IemPropSignalIPdu09_aee91317_Tx
            PduRSrcPdu_2b1294b8 (PduRSrcPdu): PduRSrcPduRef=EcucPduCollection/IemPropSignalIPdu09_2fdf1f42_Tx
          IemPropSignalIPdu12_a116f78b_Tx
            IemPropSignalIPdu12_1ae9e24f_Tx (PduRDestPdu): PduRDestPduRef=EcucPduCollection/IemPropSignalIPdu12_1ae9e24f_Tx
            PduRSrcPdu_a9fef54e (PduRSrcPdu): PduRSrcPduRef=EcucPduCollection/IemPropSignalIPdu12_a116f78b_Tx
          IemPropSignalIPdu14_487552be_Tx
            IemPropSignalIPdu14_8139e281_Tx (PduRDestPdu): PduRDestPduRef=EcucPduCollection/IemPropSignalIPdu14_8139e281_Tx
            PduRSrcPdu_acf6831c (PduRSrcPdu): PduRSrcPduRef=EcucPduCollection/IemPropSignalIPdu14_487552be_Tx
          IemPropSignalIPdu16_a67b3392_Tx
            IemPropSignalIPdu16_41591f04_Tx (PduRDestPdu): PduRDestPduRef=EcucPduCollection/IemPropSignalIPdu16_41591f04_Tx
            PduRSrcPdu_35fca203 (PduRSrcPdu): PduRSrcPduRef=EcucPduCollection/IemPropSignalIPdu16_a67b3392_Tx
          IemToEtcJ1979OBDDiagDcmIpdu11_da239b2d_Tx
            IemToEtcJ1979OBDDiagDcmIpdu11_525ada58_Tx (PduRDestPdu): PduRDestPduRef=EcucPduCollection/IemToEtcJ1979OBDDiagDcmIpdu11_525ada58_Tx
            PduRSrcPdu_75b2e816 (PduRSrcPdu): PduRSrcPduRef=EcucPduCollection/IemToEtcJ1979OBDDiagDcmIpdu11_da239b2d_Tx
          IemToEtcUudtDcmIpdu1_a0db6d78_Tx
            IemToEtcUudtDcmIpdu1_4ae85965_Tx (PduRDestPdu): PduRDestPduRef=EcucPduCollection/IemToEtcUudtDcmIpdu1_4ae85965_Tx
            PduRSrcPdu_c6a1321b (PduRSrcPdu): PduRSrcPduRef=EcucPduCollection/IemToEtcUudtDcmIpdu1_a0db6d78_Tx
          IemToEtcUudtDcmIpdu2_39d23cc2_Tx
            IemToEtcUudtDcmIpdu2_07005902_Tx (PduRDestPdu): PduRDestPduRef=EcucPduCollection/IemToEtcUudtDcmIpdu2_07005902_Tx
            PduRSrcPdu_1f99744c (PduRSrcPdu): PduRSrcPduRef=EcucPduCollection/IemToEtcUudtDcmIpdu2_39d23cc2_Tx
          IemToEtcUudtDcmIpdu3_4ed50c54_Tx
            IemToEtcUudtDcmIpdu3_8a88a4e0_Tx (PduRDestPdu): PduRDestPduRef=EcucPduCollection/IemToEtcUudtDcmIpdu3_8a88a4e0_Tx
            PduRSrcPdu_e109a8bf (PduRSrcPdu): PduRSrcPduRef=EcucPduCollection/IemToEtcUudtDcmIpdu3_4ed50c54_Tx
          IemToVgmDiagDcmIpdu_ce8379a0_Tx
            IemToVgmDiagDcmIpdu_411ec11e_Tx (PduRDestPdu): PduRDestPduRef=EcucPduCollection/IemToVgmDiagDcmIpdu_411ec11e_Tx
            PduRSrcPdu_a6ed57d5 (PduRSrcPdu): PduRSrcPduRef=EcucPduCollection/IemToVgmDiagDcmIpdu_ce8379a0_Tx
          PropulsionCAN_33157db4_Rx_d0a6735a_Rx
            PropulsionCAN_33157db4_Rx_d0a6735a_Rx_f30b45d0_Rx (PduRDestPdu): PduRDestPduRef=PropulsionCAN_c71a5358_Rx
            PduRSrcPdu_f30b45d0 (PduRSrcPdu): PduRSrcPduRef=PropulsionCAN_c71a5358_Rx
          SrsPropSignalIPdu02_30ca6a16_Rx
            SrsPropSignalIPdu02_30ca6a16_Rx_e6b4c0ad_Rx (PduRDestPdu): PduRDestPduRef=EcucPduCollection/SrsPropSignalIPdu02_4fa2d123_Rx
            PduRSrcPdu_e6b4c0ad (PduRSrcPdu): PduRSrcPduRef=EcucPduCollection/SrsPropSignalIPdu02_30ca6a16_Rx
          VDDMPropSignalIPDU05_753dbccf_Rx
            VDDMPropSignalIPDU05_753dbccf_Rx_8adb95b0_Rx (PduRDestPdu): PduRDestPduRef=EcucPduCollection/VDDMPropSignalIPDU05_e9cd0dca_Rx
            PduRSrcPdu_8adb95b0 (PduRSrcPdu): PduRSrcPduRef=EcucPduCollection/VDDMPropSignalIPDU05_753dbccf_Rx
          VDDMPropSignalIPDU06_38d5bca8_Rx
            VDDMPropSignalIPDU06_38d5bca8_Rx_ac9bf55a_Rx (PduRDestPdu): PduRDestPduRef=EcucPduCollection/VDDMPropSignalIPDU06_70c45c70_Rx
            PduRSrcPdu_ac9bf55a (PduRSrcPdu): PduRSrcPduRef=EcucPduCollection/VDDMPropSignalIPDU06_38d5bca8_Rx
          VDDMPropSignalIPDU08_146446f0_Rx
            VDDMPropSignalIPDU08_146446f0_Rx_eff178fd_Rx (PduRDestPdu): PduRDestPduRef=EcucPduCollection/VDDMPropSignalIPDU08_977c7177_Rx
            PduRSrcPdu_eff178fd (PduRSrcPdu): PduRSrcPduRef=EcucPduCollection/VDDMPropSignalIPDU08_146446f0_Rx
          VDDMPropSignalIPDU11_60044a2d_Rx
            VDDMPropSignalIPDU11_60044a2d_Rx_3ed696a1_Rx (PduRDestPdu): PduRDestPduRef=EcucPduCollection/VDDMPropSignalIPDU11_f7bbf892_Rx
            PduRSrcPdu_3ed696a1 (PduRSrcPdu): PduRSrcPduRef=EcucPduCollection/VDDMPropSignalIPDU11_60044a2d_Rx
          VDDMPropSignalIPDU16_765cb701_Rx
            VDDMPropSignalIPDU16_765cb701_Rx_86801b79_Rx (PduRDestPdu): PduRDestPduRef=EcucPduCollection/VDDMPropSignalIPDU16_69df6d31_Rx
            PduRSrcPdu_86801b79 (PduRSrcPdu): PduRSrcPduRef=EcucPduCollection/VDDMPropSignalIPDU16_765cb701_Rx
          VDDMPropSignalIPDU17_fbd44ae3_Rx
            VDDMPropSignalIPDU17_fbd44ae3_Rx_a83bf697_Rx (PduRDestPdu): PduRDestPduRef=EcucPduCollection/VDDMPropSignalIPDU17_1ed85da7_Rx
            PduRSrcPdu_a83bf697 (PduRSrcPdu): PduRSrcPduRef=EcucPduCollection/VDDMPropSignalIPDU17_fbd44ae3_Rx
          VDDMPropSignalIPDU18_5aed4d59_Rx
            VDDMPropSignalIPDU18_5aed4d59_Rx_c01e7a1d_Rx (PduRDestPdu): PduRDestPduRef=EcucPduCollection/VDDMPropSignalIPDU18_8e674036_Rx
            PduRSrcPdu_c01e7a1d (PduRSrcPdu): PduRSrcPduRef=EcucPduCollection/VDDMPropSignalIPDU18_5aed4d59_Rx
          VDDMPropSignalIPDU19_d765b0bb_Rx
            VDDMPropSignalIPDU19_d765b0bb_Rx_83c4d48c_Rx (PduRDestPdu): PduRDestPduRef=EcucPduCollection/VDDMPropSignalIPDU19_f96070a0_Rx
            PduRSrcPdu_83c4d48c (PduRSrcPdu): PduRSrcPduRef=EcucPduCollection/VDDMPropSignalIPDU19_d765b0bb_Rx
          VDDMPropdTCSignalIPdu38_4bda4dd7_Rx
            VDDMPropdTCSignalIPdu38_4bda4dd7_Rx_f7a62982_Rx (PduRDestPdu): PduRDestPduRef=EcucPduCollection/VDDMPropdTCSignalIPdu38_808bfd3f_Rx
            PduRSrcPdu_f7a62982 (PduRSrcPdu): PduRSrcPduRef=EcucPduCollection/VDDMPropdTCSignalIPdu38_4bda4dd7_Rx
          VddmBcmPropdTCSignalIPDU01_857b2e99_Rx
            VddmBcmPropdTCSignalIPDU01_857b2e99_Rx_f2322b88_Rx (PduRDestPdu): PduRDestPduRef=EcucPduCollection/VddmBcmPropdTCSignalIPDU01_886bd56f_Rx
            PduRSrcPdu_f2322b88 (PduRSrcPdu): PduRSrcPduRef=EcucPduCollection/VddmBcmPropdTCSignalIPDU01_857b2e99_Rx
          VddmPropSignalIPdu26_893fed53_Rx
            VddmPropSignalIPdu26_893fed53_Rx_21f2d8e6_Rx (PduRDestPdu): PduRDestPduRef=EcucPduCollection/VddmPropSignalIPdu26_8fec2bf2_Rx
            PduRSrcPdu_21f2d8e6 (PduRSrcPdu): PduRSrcPduRef=EcucPduCollection/VddmPropSignalIPdu26_893fed53_Rx
          VgmToAllFuncDiagDcmIpdu_030e2fcd_Rx
            VgmToAllFuncDiagDcmIpdu_030e2fcd_Rx_3ccfd7a6_Rx (PduRDestPdu): PduRDestPduRef=VgmToAllFuncDiagDcmIpdu_89c72e24_Rx
            PduRSrcPdu_3ccfd7a6 (PduRSrcPdu): PduRSrcPduRef=EcucPduCollection/VgmToAllFuncDiagDcmIpdu_030e2fcd_Rx
          VgmToIemDiagDcmIpdu_81f41e2d_Rx
            VgmToIemDiagDcmIpdu_81f41e2d_Rx_f62b73a4_Rx (PduRDestPdu): PduRDestPduRef=VgmToIemDiagDcmIpdu_cbf08236_Rx
            PduRSrcPdu_f62b73a4 (PduRSrcPdu): PduRSrcPduRef=EcucPduCollection/VgmToIemDiagDcmIpdu_81f41e2d_Rx

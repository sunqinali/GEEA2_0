[part 3 of 5: package /InitialEcuC]
AUTOSAR XML (schema 4-2-2)
package /InitialEcuC  (continued)
  module config Dcm  (continued)
    DcmConfigSet  (continued)
      DcmDsp: DcmDspMaxDidToRead=5  (continued)
        DataInfo_DID_E337_q_axis_current_setpoint_DID_E337_q_axis_current_setpoint (DcmDspDataInfo): DcmDspDataFixedLength=true  # Diagnostics Data Import
        DID_E337_q_axis_current_setpoint_DID_E337_q_axis_current_setpoint (DcmDspData): DcmDspDataSize=16, DcmDspDataType=UINT16, DcmDspDataInfoRef=DataInfo_DID_E337_q_axis_current_setpoint_DID_E337_q_axis_current_setpoint  # Diagnostics Data Import
        DataInfo_DID_E336_d_axis_current_feedback_DID_E336_d_axis_current_feedback (DcmDspDataInfo): DcmDspDataFixedLength=true  # Diagnostics Data Import
        DID_E336_d_axis_current_feedback_DID_E336_d_axis_current_feedback (DcmDspData): DcmDspDataSize=16, DcmDspDataType=UINT16, DcmDspDataInfoRef=DataInfo_DID_E336_d_axis_current_feedback_DID_E336_d_axis_current_feedback  # Diagnostics Data Import
        DataInfo_DID_E335_d_axis_current_setpoint_DID_E335_d_axis_current_setpoint (DcmDspDataInfo): DcmDspDataFixedLength=true  # Diagnostics Data Import
        DID_E335_d_axis_current_setpoint_DID_E335_d_axis_current_setpoint (DcmDspData): DcmDspDataSize=16, DcmDspDataType=UINT16, DcmDspDataInfoRef=DataInfo_DID_E335_d_axis_current_setpoint_DID_E335_d_axis_current_setpoint  # Diagnostics Data Import
        DataInfo_DID_E333_2002_State_2002_L_Ser (DcmDspDataInfo): DcmDspDataFixedLength=true  # Diagnostics Data Import
        DID_E333_2002_State_2002_L_Ser (DcmDspData): DcmDspDataSize=8, DcmDspDataType=UINT8, DcmDspDataInfoRef=DataInfo_DID_E333_2002_State_2002_L_Ser  # Diagnostics Data Import
        DataInfo_DID_E333_2002_State_2002_H_Ser (DcmDspDataInfo): DcmDspDataFixedLength=true  # Diagnostics Data Import
        DID_E333_2002_State_2002_H_Ser (DcmDspData): DcmDspDataSize=8, DcmDspDataType=UINT8, DcmDspDataInfoRef=DataInfo_DID_E333_2002_State_2002_H_Ser  # Diagnostics Data Import
        DataInfo_DID_E333_2002_State_2002_Lw (DcmDspDataInfo): DcmDspDataFixedLength=true  # Diagnostics Data Import
        DID_E333_2002_State_2002_Lw (DcmDspData): DcmDspDataSize=8, DcmDspDataType=UINT8_N, DcmDspDataInfoRef=DataInfo_DID_E333_2002_State_2002_Lw  # Diagnostics Data Import
        DataInfo_DID_E333_2002_State_2002_Lv (DcmDspDataInfo): DcmDspDataFixedLength=true  # Diagnostics Data Import
        DID_E333_2002_State_2002_Lv (DcmDspData): DcmDspDataSize=8, DcmDspDataType=UINT8_N, DcmDspDataInfoRef=DataInfo_DID_E333_2002_State_2002_Lv  # Diagnostics Data Import
        DataInfo_DID_E333_2002_State_2002_Lu (DcmDspDataInfo): DcmDspDataFixedLength=true  # Diagnostics Data Import
        DID_E333_2002_State_2002_Lu (DcmDspData): DcmDspDataSize=8, DcmDspDataType=UINT8_N, DcmDspDataInfoRef=DataInfo_DID_E333_2002_State_2002_Lu  # Diagnostics Data Import
        DataInfo_DID_E333_2002_State_2002_Hw (DcmDspDataInfo): DcmDspDataFixedLength=true  # Diagnostics Data Import
        DID_E333_2002_State_2002_Hw (DcmDspData): DcmDspDataSize=8, DcmDspDataType=UINT8_N, DcmDspDataInfoRef=DataInfo_DID_E333_2002_State_2002_Hw  # Diagnostics Data Import
        DataInfo_DID_E333_2002_State_2002_Hv (DcmDspDataInfo): DcmDspDataFixedLength=true  # Diagnostics Data Import
        DID_E333_2002_State_2002_Hv (DcmDspData): DcmDspDataSize=8, DcmDspDataType=UINT8_N, DcmDspDataInfoRef=DataInfo_DID_E333_2002_State_2002_Hv  # Diagnostics Data Import
        DataInfo_DID_E333_2002_State_2002_Hu (DcmDspDataInfo): DcmDspDataFixedLength=true  # Diagnostics Data Import
        DID_E333_2002_State_2002_Hu (DcmDspData): DcmDspDataSize=8, DcmDspDataType=UINT8_N, DcmDspDataInfoRef=DataInfo_DID_E333_2002_State_2002_Hu  # Diagnostics Data Import
        DataInfo_DID_E331_Software_Version_DID_E331_3_Calibration_Data_Software_Version (DcmDspDataInfo): DcmDspDataFixedLength=true  # Diagnostics Data Import
        DID_E331_Software_Version_DID_E331_3_Calibration_Data_Software_Version (DcmDspData): DcmDspDataSize=64, DcmDspDataType=UINT8_N, DcmDspDataInfoRef=DataInfo_DID_E331_Software_Version_DID_E331_3_Calibration_Data_Software_Version  # Diagnostics Data Import
        DataInfo_DID_E331_Software_Version_DID_E331_2_BSW_Software_Version (DcmDspDataInfo): DcmDspDataFixedLength=true  # Diagnostics Data Import
        DID_E331_Software_Version_DID_E331_2_BSW_Software_Version (DcmDspData): DcmDspDataSize=64, DcmDspDataType=UINT8_N, DcmDspDataInfoRef=DataInfo_DID_E331_Software_Version_DID_E331_2_BSW_Software_Version  # Diagnostics Data Import
        DataInfo_DID_E331_Software_Version_DID_E331_1_ASW_Software_Version (DcmDspDataInfo): DcmDspDataFixedLength=true  # Diagnostics Data Import
        DID_E331_Software_Version_DID_E331_1_ASW_Software_Version (DcmDspData): DcmDspDataSize=64, DcmDspDataType=UINT8_N, DcmDspDataInfoRef=DataInfo_DID_E331_Software_Version_DID_E331_1_ASW_Software_Version  # Diagnostics Data Import
        DataInfo_DID_E324_Motor_Derating_reason_of_IEM_MGM_DID_E324_Motor_Derating_reason_of_IEMMGM (DcmDspDataInfo): DcmDspDataFixedLength=true  # Diagnostics Data Import
        DID_E324_Motor_Derating_reason_of_IEM_MGM_DID_E324_Motor_Derating_reason_of_IEMMGM (DcmDspData):  # Diagnostics Data Import
          DcmDspDataSize = 8
          DcmDspDataType = UINT8
          DcmDspDataInfoRef = DataInfo_DID_E324_Motor_Derating_reason_of_IEM_MGM_DID_E324_Motor_Derating_reason_of_IEMMGM
        DataInfo_DID_E320_System_Mode_Mismatch_DID_E320_System_Mode_Mismatch (DcmDspDataInfo): DcmDspDataFixedLength=true  # Diagnostics Data Import
        DID_E320_System_Mode_Mismatch_DID_E320_System_Mode_Mismatch (DcmDspData): DcmDspDataSize=8, DcmDspDataType=UINT8, DcmDspDataInfoRef=DataInfo_DID_E320_System_Mode_Mismatch_DID_E320_System_Mode_Mismatch  # Diagnostics Data Import
        DataInfo_DID_E319_Torque_Direction_DID_E319_Torque_Direction (DcmDspDataInfo): DcmDspDataFixedLength=true  # Diagnostics Data Import
        DID_E319_Torque_Direction_DID_E319_Torque_Direction (DcmDspData): DcmDspDataSize=8, DcmDspDataType=UINT8, DcmDspDataInfoRef=DataInfo_DID_E319_Torque_Direction_DID_E319_Torque_Direction  # Diagnostics Data Import
        DataInfo_DID_E315_Available_Torque_minimum_DID_E315_Available_Torque_minimum (DcmDspDataInfo): DcmDspDataFixedLength=true  # Diagnostics Data Import
        DID_E315_Available_Torque_minimum_DID_E315_Available_Torque_minimum (DcmDspData): DcmDspDataSize=16, DcmDspDataType=UINT16, DcmDspDataInfoRef=DataInfo_DID_E315_Available_Torque_minimum_DID_E315_Available_Torque_minimum  # Diagnostics Data Import
        DataInfo_DID_E314_Available_Torque_maximum_DID_E314_Available_Torque_maximum (DcmDspDataInfo): DcmDspDataFixedLength=true  # Diagnostics Data Import
        DID_E314_Available_Torque_maximum_DID_E314_Available_Torque_maximum (DcmDspData): DcmDspDataSize=16, DcmDspDataType=UINT16, DcmDspDataInfoRef=DataInfo_DID_E314_Available_Torque_maximum_DID_E314_Available_Torque_maximum  # Diagnostics Data Import
        DataInfo_DID_E313_Active_discharge_status_DID_E313_Active_discharge_status (DcmDspDataInfo): DcmDspDataFixedLength=true  # Diagnostics Data Import
        DID_E313_Active_discharge_status_DID_E313_Active_discharge_status (DcmDspData): DcmDspDataSize=8, DcmDspDataType=UINT8, DcmDspDataInfoRef=DataInfo_DID_E313_Active_discharge_status_DID_E313_Active_discharge_status  # Diagnostics Data Import
        DataInfo_DID_E312_Wheel_Speed_DID_E312_Wheel_Speed (DcmDspDataInfo): DcmDspDataFixedLength=true  # Diagnostics Data Import
        DID_E312_Wheel_Speed_DID_E312_Wheel_Speed (DcmDspData): DcmDspDataSize=16, DcmDspDataType=UINT16, DcmDspDataInfoRef=DataInfo_DID_E312_Wheel_Speed_DID_E312_Wheel_Speed  # Diagnostics Data Import
        DataInfo_DID_E311_Crash_Status_DID_E311_Crash_Status (DcmDspDataInfo): DcmDspDataFixedLength=true  # Diagnostics Data Import
        DID_E311_Crash_Status_DID_E311_Crash_Status (DcmDspData): DcmDspDataSize=8, DcmDspDataType=UINT8, DcmDspDataInfoRef=DataInfo_DID_E311_Crash_Status_DID_E311_Crash_Status  # Diagnostics Data Import
        DataInfo_DID_E310_IEM_MGM_Derating_Status_DID_E310_IEMMGM_Derating_Status (DcmDspDataInfo): DcmDspDataFixedLength=true  # Diagnostics Data Import
        DID_E310_IEM_MGM_Derating_Status_DID_E310_IEMMGM_Derating_Status (DcmDspData): DcmDspDataSize=8, DcmDspDataType=UINT8, DcmDspDataInfoRef=DataInfo_DID_E310_IEM_MGM_Derating_Status_DID_E310_IEMMGM_Derating_Status  # Diagnostics Data Import
        DataInfo_DID_E309_ECM_Mode_Request_DID_E309_ECM_Mode_Request (DcmDspDataInfo): DcmDspDataFixedLength=true  # Diagnostics Data Import
        DID_E309_ECM_Mode_Request_DID_E309_ECM_Mode_Request (DcmDspData): DcmDspDataSize=8, DcmDspDataType=UINT8, DcmDspDataInfoRef=DataInfo_DID_E309_ECM_Mode_Request_DID_E309_ECM_Mode_Request  # Diagnostics Data Import
        DataInfo_DID_E308_ECM_Torque_Request_DID_E308_ECM_Torque_Request (DcmDspDataInfo): DcmDspDataFixedLength=true  # Diagnostics Data Import
        DID_E308_ECM_Torque_Request_DID_E308_ECM_Torque_Request (DcmDspData): DcmDspDataSize=16, DcmDspDataType=UINT16, DcmDspDataInfoRef=DataInfo_DID_E308_ECM_Torque_Request_DID_E308_ECM_Torque_Request  # Diagnostics Data Import
        DataInfo_DID_E307_System_Mode_DID_E307_System_Mode (DcmDspDataInfo): DcmDspDataFixedLength=true  # Diagnostics Data Import
        DID_E307_System_Mode_DID_E307_System_Mode (DcmDspData): DcmDspDataSize=8, DcmDspDataType=UINT8, DcmDspDataInfoRef=DataInfo_DID_E307_System_Mode_DID_E307_System_Mode  # Diagnostics Data Import
        DataInfo_DID_E306_Motor_Temperature_DID_E306_Motor_Temperature (DcmDspDataInfo): DcmDspDataFixedLength=true  # Diagnostics Data Import
        DID_E306_Motor_Temperature_DID_E306_Motor_Temperature (DcmDspData): DcmDspDataSize=8, DcmDspDataType=UINT8, DcmDspDataInfoRef=DataInfo_DID_E306_Motor_Temperature_DID_E306_Motor_Temperature  # Diagnostics Data Import
        DataInfo_DID_E305_Inverter_IGBT_Junction_Temp_DID_E305_Inverter_IGBT_Junction_Temp (DcmDspDataInfo): DcmDspDataFixedLength=true  # Diagnostics Data Import
        DID_E305_Inverter_IGBT_Junction_Temp_DID_E305_Inverter_IGBT_Junction_Temp (DcmDspData): DcmDspDataSize=8, DcmDspDataType=UINT8, DcmDspDataInfoRef=DataInfo_DID_E305_Inverter_IGBT_Junction_Temp_DID_E305_Inverter_IGBT_Junction_Temp  # Diagnostics Data Import
        DataInfo_DID_E304_Actual_Torque_DID_E304_Actual_Torque (DcmDspDataInfo): DcmDspDataFixedLength=true  # Diagnostics Data Import
        DID_E304_Actual_Torque_DID_E304_Actual_Torque (DcmDspData): DcmDspDataSize=16, DcmDspDataType=UINT16, DcmDspDataInfoRef=DataInfo_DID_E304_Actual_Torque_DID_E304_Actual_Torque  # Diagnostics Data Import
        DataInfo_DID_E303_Motor_Speed_DID_E303_Motor_Speed_ (DcmDspDataInfo): DcmDspDataFixedLength=true  # Diagnostics Data Import
        DID_E303_Motor_Speed_DID_E303_Motor_Speed_ (DcmDspData): DcmDspDataSize=16, DcmDspDataType=UINT16, DcmDspDataInfoRef=DataInfo_DID_E303_Motor_Speed_DID_E303_Motor_Speed_  # Diagnostics Data Import
        DataInfo_DID_E301_HVDC_Current_DID_E301_HVDC_Current_ (DcmDspDataInfo): DcmDspDataFixedLength=true  # Diagnostics Data Import
        DID_E301_HVDC_Current_DID_E301_HVDC_Current_ (DcmDspData): DcmDspDataSize=16, DcmDspDataType=UINT16, DcmDspDataInfoRef=DataInfo_DID_E301_HVDC_Current_DID_E301_HVDC_Current_  # Diagnostics Data Import
        DataInfo_DID_E300_HVDC_Voltage_DID_E300_HVDC_Voltage (DcmDspDataInfo): DcmDspDataFixedLength=true  # Diagnostics Data Import
        DID_E300_HVDC_Voltage_DID_E300_HVDC_Voltage (DcmDspData): DcmDspDataSize=16, DcmDspDataType=UINT16, DcmDspDataInfoRef=DataInfo_DID_E300_HVDC_Voltage_DID_E300_HVDC_Voltage  # Diagnostics Data Import
        DataInfo_DID_E103_Car_Configuration_Parameter_Faults_DID_E103_21_10th_parameter_invalid_value (DcmDspDataInfo): DcmDspDataFixedLength=true  # Diagnostics Data Import
        DID_E103_Car_Configuration_Parameter_Faults_DID_E103_21_10th_parameter_invalid_value (DcmDspData):  # Diagnostics Data Import
          DcmDspDataSize = 8
          DcmDspDataType = UINT8
          DcmDspDataInfoRef = DataInfo_DID_E103_Car_Configuration_Parameter_Faults_DID_E103_21_10th_parameter_invalid_value
        DataInfo_DID_E103_Car_Configuration_Parameter_Faults_DID_E103_20_10th_parameter_number_of_the_car_configuration_data_thace4964ec (DcmDspDataInfo): DcmDspDataFixedLength=true  # Diagnostics Data Import
        DID_E103_Car_Configuration_Parameter_Faults_DID_E103_20_10th_parameter_number_of_the_car_configuration_data_that_is_invalid (DcmDspData):  # Diagnostics Data Import
          DcmDspDataSize = 16
          DcmDspDataType = UINT16
          DcmDspDataInfoRef = DataInfo_DID_E103_Car_Configuration_Parameter_Faults_DID_E103_20_10th_parameter_number_of_the_car_configuration_data_thace4964ec
        DataInfo_DID_E103_Car_Configuration_Parameter_Faults_DID_E103_19_9th_parameter_invalid_value (DcmDspDataInfo): DcmDspDataFixedLength=true  # Diagnostics Data Import
        DID_E103_Car_Configuration_Parameter_Faults_DID_E103_19_9th_parameter_invalid_value (DcmDspData):  # Diagnostics Data Import
          DcmDspDataSize = 8
          DcmDspDataType = UINT8
          DcmDspDataInfoRef = DataInfo_DID_E103_Car_Configuration_Parameter_Faults_DID_E103_19_9th_parameter_invalid_value
        DataInfo_DID_E103_Car_Configuration_Parameter_Faults_DID_E103_18_9th_parameter_number_of_the_car_configuration_data_that4ae7c090 (DcmDspDataInfo): DcmDspDataFixedLength=true  # Diagnostics Data Import
        DID_E103_Car_Configuration_Parameter_Faults_DID_E103_18_9th_parameter_number_of_the_car_configuration_data_that_is_invalid (DcmDspData):  # Diagnostics Data Import
          DcmDspDataSize = 16
          DcmDspDataType = UINT16
          DcmDspDataInfoRef = DataInfo_DID_E103_Car_Configuration_Parameter_Faults_DID_E103_18_9th_parameter_number_of_the_car_configuration_data_that4ae7c090
        DataInfo_DID_E103_Car_Configuration_Parameter_Faults_DID_E103_17_8th_parameter_invalid_value (DcmDspDataInfo): DcmDspDataFixedLength=true  # Diagnostics Data Import
        DID_E103_Car_Configuration_Parameter_Faults_DID_E103_17_8th_parameter_invalid_value (DcmDspData):  # Diagnostics Data Import
          DcmDspDataSize = 8
          DcmDspDataType = UINT8
          DcmDspDataInfoRef = DataInfo_DID_E103_Car_Configuration_Parameter_Faults_DID_E103_17_8th_parameter_invalid_value
        DataInfo_DID_E103_Car_Configuration_Parameter_Faults_DID_E103_16_8th_parameter_number_of_the_car_configuration_data_that19fcf690 (DcmDspDataInfo): DcmDspDataFixedLength=true  # Diagnostics Data Import
        DID_E103_Car_Configuration_Parameter_Faults_DID_E103_16_8th_parameter_number_of_the_car_configuration_data_that_is_invalid (DcmDspData):  # Diagnostics Data Import
          DcmDspDataSize = 16
          DcmDspDataType = UINT16
          DcmDspDataInfoRef = DataInfo_DID_E103_Car_Configuration_Parameter_Faults_DID_E103_16_8th_parameter_number_of_the_car_configuration_data_that19fcf690
        DataInfo_DID_E103_Car_Configuration_Parameter_Faults_DID_E103_15_7th_parameter_invalid_value (DcmDspDataInfo): DcmDspDataFixedLength=true  # Diagnostics Data Import
        DID_E103_Car_Configuration_Parameter_Faults_DID_E103_15_7th_parameter_invalid_value (DcmDspData):  # Diagnostics Data Import
          DcmDspDataSize = 8
          DcmDspDataType = UINT8
          DcmDspDataInfoRef = DataInfo_DID_E103_Car_Configuration_Parameter_Faults_DID_E103_15_7th_parameter_invalid_value
        DataInfo_DID_E103_Car_Configuration_Parameter_Faults_DID_E103_14_7th_parameter_number_of_the_car_configuration_data_thatd7b4e1f3 (DcmDspDataInfo): DcmDspDataFixedLength=true  # Diagnostics Data Import
        DID_E103_Car_Configuration_Parameter_Faults_DID_E103_14_7th_parameter_number_of_the_car_configuration_data_that_is_invalid (DcmDspData):  # Diagnostics Data Import
          DcmDspDataSize = 16
          DcmDspDataType = UINT16
          DcmDspDataInfoRef = DataInfo_DID_E103_Car_Configuration_Parameter_Faults_DID_E103_14_7th_parameter_number_of_the_car_configuration_data_thatd7b4e1f3
        DataInfo_DID_E103_Car_Configuration_Parameter_Faults_DID_E103_13_6th_parameter_invalid_value (DcmDspDataInfo): DcmDspDataFixedLength=true  # Diagnostics Data Import
        DID_E103_Car_Configuration_Parameter_Faults_DID_E103_13_6th_parameter_invalid_value (DcmDspData):  # Diagnostics Data Import
          DcmDspDataSize = 8
          DcmDspDataType = UINT8
          DcmDspDataInfoRef = DataInfo_DID_E103_Car_Configuration_Parameter_Faults_DID_E103_13_6th_parameter_invalid_value
        DataInfo_DID_E103_Car_Configuration_Parameter_Faults_DID_E103_12_6th_parameter_number_of_the_car_configuration_data_that1ba11a61 (DcmDspDataInfo): DcmDspDataFixedLength=true  # Diagnostics Data Import
        DID_E103_Car_Configuration_Parameter_Faults_DID_E103_12_6th_parameter_number_of_the_car_configuration_data_that_is_invalid (DcmDspData):  # Diagnostics Data Import
          DcmDspDataSize = 16
          DcmDspDataType = UINT16
          DcmDspDataInfoRef = DataInfo_DID_E103_Car_Configuration_Parameter_Faults_DID_E103_12_6th_parameter_number_of_the_car_configuration_data_that1ba11a61
        DataInfo_DID_E103_Car_Configuration_Parameter_Faults_DID_E103_11_5th_parameter_invalid_value (DcmDspDataInfo): DcmDspDataFixedLength=true  # Diagnostics Data Import
        DID_E103_Car_Configuration_Parameter_Faults_DID_E103_11_5th_parameter_invalid_value (DcmDspData):  # Diagnostics Data Import
          DcmDspDataSize = 8
          DcmDspDataType = UINT8
          DcmDspDataInfoRef = DataInfo_DID_E103_Car_Configuration_Parameter_Faults_DID_E103_11_5th_parameter_invalid_value
        DataInfo_DID_E103_Car_Configuration_Parameter_Faults_DID_E103_10_5th_parameter_number_of_the_car_configuration_data_thatbe0dd04 (DcmDspDataInfo): DcmDspDataFixedLength=true  # Diagnostics Data Import
        DID_E103_Car_Configuration_Parameter_Faults_DID_E103_10_5th_parameter_number_of_the_car_configuration_data_that_is_invalid (DcmDspData):  # Diagnostics Data Import
          DcmDspDataSize = 16
          DcmDspDataType = UINT16
          DcmDspDataInfoRef = DataInfo_DID_E103_Car_Configuration_Parameter_Faults_DID_E103_10_5th_parameter_number_of_the_car_configuration_data_thatbe0dd04
        DataInfo_DID_E103_Car_Configuration_Parameter_Faults_DID_E103_9_4th_parameter_invalid_value (DcmDspDataInfo): DcmDspDataFixedLength=true  # Diagnostics Data Import
        DID_E103_Car_Configuration_Parameter_Faults_DID_E103_9_4th_parameter_invalid_value (DcmDspData):  # Diagnostics Data Import
          DcmDspDataSize = 8
          DcmDspDataType = UINT8
          DcmDspDataInfoRef = DataInfo_DID_E103_Car_Configuration_Parameter_Faults_DID_E103_9_4th_parameter_invalid_value
        DataInfo_DID_E103_Car_Configuration_Parameter_Faults_DID_E103_8_4th_parameter_number_of_the_car_configuration_data_that_6f100f46 (DcmDspDataInfo): DcmDspDataFixedLength=true  # Diagnostics Data Import
        DID_E103_Car_Configuration_Parameter_Faults_DID_E103_8_4th_parameter_number_of_the_car_configuration_data_that_is_invalid (DcmDspData):  # Diagnostics Data Import
          DcmDspDataSize = 16
          DcmDspDataType = UINT16
          DcmDspDataInfoRef = DataInfo_DID_E103_Car_Configuration_Parameter_Faults_DID_E103_8_4th_parameter_number_of_the_car_configuration_data_that_6f100f46
        DataInfo_DID_E103_Car_Configuration_Parameter_Faults_DID_E103_7_3rd_parameter_invalid_value (DcmDspDataInfo): DcmDspDataFixedLength=true  # Diagnostics Data Import
        DID_E103_Car_Configuration_Parameter_Faults_DID_E103_7_3rd_parameter_invalid_value (DcmDspData):  # Diagnostics Data Import
          DcmDspDataSize = 8
          DcmDspDataType = UINT8
          DcmDspDataInfoRef = DataInfo_DID_E103_Car_Configuration_Parameter_Faults_DID_E103_7_3rd_parameter_invalid_value
        DataInfo_DID_E103_Car_Configuration_Parameter_Faults_DID_E103_6_3rd_parameter_number_of_the_car_configuration_data_that_1458f62a (DcmDspDataInfo): DcmDspDataFixedLength=true  # Diagnostics Data Import
        DID_E103_Car_Configuration_Parameter_Faults_DID_E103_6_3rd_parameter_number_of_the_car_configuration_data_that_is_invalid (DcmDspData):  # Diagnostics Data Import
          DcmDspDataSize = 16
          DcmDspDataType = UINT16
          DcmDspDataInfoRef = DataInfo_DID_E103_Car_Configuration_Parameter_Faults_DID_E103_6_3rd_parameter_number_of_the_car_configuration_data_that_1458f62a
        DataInfo_DID_E103_Car_Configuration_Parameter_Faults_DID_E103_5_2nd_parameter_invalid_value (DcmDspDataInfo): DcmDspDataFixedLength=true  # Diagnostics Data Import
        DID_E103_Car_Configuration_Parameter_Faults_DID_E103_5_2nd_parameter_invalid_value (DcmDspData):  # Diagnostics Data Import
          DcmDspDataSize = 8
          DcmDspDataType = UINT8
          DcmDspDataInfoRef = DataInfo_DID_E103_Car_Configuration_Parameter_Faults_DID_E103_5_2nd_parameter_invalid_value
        DataInfo_DID_E103_Car_Configuration_Parameter_Faults_DID_E103_4_2nd_parameter_number_of_the_car_configuration_data_that_461cabb1 (DcmDspDataInfo): DcmDspDataFixedLength=true  # Diagnostics Data Import
        DID_E103_Car_Configuration_Parameter_Faults_DID_E103_4_2nd_parameter_number_of_the_car_configuration_data_that_is_invalid (DcmDspData):  # Diagnostics Data Import
          DcmDspDataSize = 16
          DcmDspDataType = UINT16
          DcmDspDataInfoRef = DataInfo_DID_E103_Car_Configuration_Parameter_Faults_DID_E103_4_2nd_parameter_number_of_the_car_configuration_data_that_461cabb1
        DataInfo_DID_E103_Car_Configuration_Parameter_Faults_DID_E103_3_1st_parameter_invalid_value (DcmDspDataInfo): DcmDspDataFixedLength=true  # Diagnostics Data Import
        DID_E103_Car_Configuration_Parameter_Faults_DID_E103_3_1st_parameter_invalid_value (DcmDspData):  # Diagnostics Data Import
          DcmDspDataSize = 8
          DcmDspDataType = UINT8
          DcmDspDataInfoRef = DataInfo_DID_E103_Car_Configuration_Parameter_Faults_DID_E103_3_1st_parameter_invalid_value
        DataInfo_DID_E103_Car_Configuration_Parameter_Faults_DID_E103_2_1st_parameter_number_of_the_car_configuration_data_that_d6896c26 (DcmDspDataInfo): DcmDspDataFixedLength=true  # Diagnostics Data Import
        DID_E103_Car_Configuration_Parameter_Faults_DID_E103_2_1st_parameter_number_of_the_car_configuration_data_that_is_invalid (DcmDspData):  # Diagnostics Data Import
          DcmDspDataSize = 16
          DcmDspDataType = UINT16
          DcmDspDataInfoRef = DataInfo_DID_E103_Car_Configuration_Parameter_Faults_DID_E103_2_1st_parameter_number_of_the_car_configuration_data_that_d6896c26
        DataInfo_DID_E103_Car_Configuration_Parameter_Faults_DID_E103_1_Number_of_invalid_car_configuration_parameter_values_recognised (DcmDspDataInfo): DcmDspDataFixedLength=true  # Diagnostics Data Import
        DID_E103_Car_Configuration_Parameter_Faults_DID_E103_1_Number_of_invalid_car_configuration_parameter_values_recognised (DcmDspData):  # Diagnostics Data Import
          DcmDspDataSize = 8
          DcmDspDataType = UINT8
          DcmDspDataInfoRef = DataInfo_DID_E103_Car_Configuration_Parameter_Faults_DID_E103_1_Number_of_invalid_car_configuration_parameter_values_recognised
        DataInfo_DID_DD0C_Electric_Power_Level_DID_DD0C_Electric_Power_Level (DcmDspDataInfo): DcmDspDataFixedLength=true  # Diagnostics Data Import
        DID_DD0C_Electric_Power_Level_DID_DD0C_Electric_Power_Level (DcmDspData): DcmDspDataSize=8, DcmDspDataType=UINT8, DcmDspDataInfoRef=DataInfo_DID_DD0C_Electric_Power_Level_DID_DD0C_Electric_Power_Level  # Diagnostics Data Import
        DataInfo_DID_DD0A_Usage_Mode_DID_DD0A_Usage_Mode (DcmDspDataInfo): DcmDspDataFixedLength=true  # Diagnostics Data Import
        DID_DD0A_Usage_Mode_DID_DD0A_Usage_Mode (DcmDspData): DcmDspDataSize=8, DcmDspDataType=UINT8, DcmDspDataInfoRef=DataInfo_DID_DD0A_Usage_Mode_DID_DD0A_Usage_Mode  # Diagnostics Data Import
        DataInfo_DID_DD02_Vehicle_Battery_Voltage_DID_DD02_Vehicle_Battery_Voltage (DcmDspDataInfo): DcmDspDataFixedLength=true  # Diagnostics Data Import
        DID_DD02_Vehicle_Battery_Voltage_DID_DD02_Vehicle_Battery_Voltage (DcmDspData): DcmDspDataSize=8, DcmDspDataType=UINT8, DcmDspDataInfoRef=DataInfo_DID_DD02_Vehicle_Battery_Voltage_DID_DD02_Vehicle_Battery_Voltage  # Diagnostics Data Import
        DataInfo_DID_DD01_Total_Distance_DID_DD01_Total_Distance (DcmDspDataInfo): DcmDspDataFixedLength=true  # Diagnostics Data Import
        DID_DD01_Total_Distance_DID_DD01_Total_Distance (DcmDspData): DcmDspDataSize=24, DcmDspDataType=UINT8_N, DcmDspDataInfoRef=DataInfo_DID_DD01_Total_Distance_DID_DD01_Total_Distance  # Diagnostics Data Import
        DataInfo_DID_DD00_Global_Real_Time_DID_DD00_Global_Real_Time (DcmDspDataInfo): DcmDspDataFixedLength=true  # Diagnostics Data Import
        DID_DD00_Global_Real_Time_DID_DD00_Global_Real_Time (DcmDspData): DcmDspDataSize=32, DcmDspDataType=UINT32, DcmDspDataInfoRef=DataInfo_DID_DD00_Global_Real_Time_DID_DD00_Global_Real_Time  # Diagnostics Data Import
        DataInfo_DID_D211_Network_Management_History_Propulsion_CAN_DID_D211_20_10th_Latest_State_Global_Real_Time (DcmDspDataInfo): DcmDspDataFixedLength=true  # Diagnostics Data Import
        DID_D211_Network_Management_History_Propulsion_CAN_DID_D211_20_10th_Latest_State_Global_Real_Time (DcmDspData):  # Diagnostics Data Import
          DcmDspDataSize = 32
          DcmDspDataType = UINT32
          DcmDspDataInfoRef = DataInfo_DID_D211_Network_Management_History_Propulsion_CAN_DID_D211_20_10th_Latest_State_Global_Real_Time
        DataInfo_DID_D211_Network_Management_History_Propulsion_CAN_DID_D211_19_10th_Latest_State_NM_History (DcmDspDataInfo): DcmDspDataFixedLength=true  # Diagnostics Data Import
        DID_D211_Network_Management_History_Propulsion_CAN_DID_D211_19_10th_Latest_State_NM_History (DcmDspData):  # Diagnostics Data Import
          DcmDspDataSize = 8
          DcmDspDataType = UINT8
          DcmDspDataInfoRef = DataInfo_DID_D211_Network_Management_History_Propulsion_CAN_DID_D211_19_10th_Latest_State_NM_History
        DataInfo_DID_D211_Network_Management_History_Propulsion_CAN_DID_D211_18_9th_Latest_State_Global_Real_Time (DcmDspDataInfo): DcmDspDataFixedLength=true  # Diagnostics Data Import
        DID_D211_Network_Management_History_Propulsion_CAN_DID_D211_18_9th_Latest_State_Global_Real_Time (DcmDspData):  # Diagnostics Data Import
          DcmDspDataSize = 32
          DcmDspDataType = UINT32
          DcmDspDataInfoRef = DataInfo_DID_D211_Network_Management_History_Propulsion_CAN_DID_D211_18_9th_Latest_State_Global_Real_Time
        DataInfo_DID_D211_Network_Management_History_Propulsion_CAN_DID_D211_17_9th_Latest_State_NM_History (DcmDspDataInfo): DcmDspDataFixedLength=true  # Diagnostics Data Import
        DID_D211_Network_Management_History_Propulsion_CAN_DID_D211_17_9th_Latest_State_NM_History (DcmDspData):  # Diagnostics Data Import
          DcmDspDataSize = 8
          DcmDspDataType = UINT8
          DcmDspDataInfoRef = DataInfo_DID_D211_Network_Management_History_Propulsion_CAN_DID_D211_17_9th_Latest_State_NM_History
        DataInfo_DID_D211_Network_Management_History_Propulsion_CAN_DID_D211_16_8th_Latest_State_Global_Real_Time (DcmDspDataInfo): DcmDspDataFixedLength=true  # Diagnostics Data Import
        DID_D211_Network_Management_History_Propulsion_CAN_DID_D211_16_8th_Latest_State_Global_Real_Time (DcmDspData):  # Diagnostics Data Import
          DcmDspDataSize = 32
          DcmDspDataType = UINT32
          DcmDspDataInfoRef = DataInfo_DID_D211_Network_Management_History_Propulsion_CAN_DID_D211_16_8th_Latest_State_Global_Real_Time
        DataInfo_DID_D211_Network_Management_History_Propulsion_CAN_DID_D211_15_8th_Latest_State_NM_History (DcmDspDataInfo): DcmDspDataFixedLength=true  # Diagnostics Data Import
        DID_D211_Network_Management_History_Propulsion_CAN_DID_D211_15_8th_Latest_State_NM_History (DcmDspData):  # Diagnostics Data Import
          DcmDspDataSize = 8
          DcmDspDataType = UINT8
          DcmDspDataInfoRef = DataInfo_DID_D211_Network_Management_History_Propulsion_CAN_DID_D211_15_8th_Latest_State_NM_History
        DataInfo_DID_D211_Network_Management_History_Propulsion_CAN_DID_D211_14_7th_Latest_State_Global_Real_Time (DcmDspDataInfo): DcmDspDataFixedLength=true  # Diagnostics Data Import
        DID_D211_Network_Management_History_Propulsion_CAN_DID_D211_14_7th_Latest_State_Global_Real_Time (DcmDspData):  # Diagnostics Data Import
          DcmDspDataSize = 32
          DcmDspDataType = UINT32
          DcmDspDataInfoRef = DataInfo_DID_D211_Network_Management_History_Propulsion_CAN_DID_D211_14_7th_Latest_State_Global_Real_Time
        DataInfo_DID_D211_Network_Management_History_Propulsion_CAN_DID_D211_13_7th_Latest_State_NM_History (DcmDspDataInfo): DcmDspDataFixedLength=true  # Diagnostics Data Import
        DID_D211_Network_Management_History_Propulsion_CAN_DID_D211_13_7th_Latest_State_NM_History (DcmDspData):  # Diagnostics Data Import
          DcmDspDataSize = 8
          DcmDspDataType = UINT8
          DcmDspDataInfoRef = DataInfo_DID_D211_Network_Management_History_Propulsion_CAN_DID_D211_13_7th_Latest_State_NM_History
        DataInfo_DID_D211_Network_Management_History_Propulsion_CAN_DID_D211_12_6th_Latest_State_Global_Real_Time (DcmDspDataInfo): DcmDspDataFixedLength=true  # Diagnostics Data Import
        DID_D211_Network_Management_History_Propulsion_CAN_DID_D211_12_6th_Latest_State_Global_Real_Time (DcmDspData):  # Diagnostics Data Import
          DcmDspDataSize = 32
          DcmDspDataType = UINT32
          DcmDspDataInfoRef = DataInfo_DID_D211_Network_Management_History_Propulsion_CAN_DID_D211_12_6th_Latest_State_Global_Real_Time
        DataInfo_DID_D211_Network_Management_History_Propulsion_CAN_DID_D211_11_6th_Latest_State_NM_History (DcmDspDataInfo): DcmDspDataFixedLength=true  # Diagnostics Data Import
        DID_D211_Network_Management_History_Propulsion_CAN_DID_D211_11_6th_Latest_State_NM_History (DcmDspData):  # Diagnostics Data Import
          DcmDspDataSize = 8
          DcmDspDataType = UINT8
          DcmDspDataInfoRef = DataInfo_DID_D211_Network_Management_History_Propulsion_CAN_DID_D211_11_6th_Latest_State_NM_History
        DataInfo_DID_D211_Network_Management_History_Propulsion_CAN_DID_D211_10_5th_Latest_State_Global_Real_Time (DcmDspDataInfo): DcmDspDataFixedLength=true  # Diagnostics Data Import
        DID_D211_Network_Management_History_Propulsion_CAN_DID_D211_10_5th_Latest_State_Global_Real_Time (DcmDspData):  # Diagnostics Data Import
          DcmDspDataSize = 32
          DcmDspDataType = UINT32
          DcmDspDataInfoRef = DataInfo_DID_D211_Network_Management_History_Propulsion_CAN_DID_D211_10_5th_Latest_State_Global_Real_Time
        DataInfo_DID_D211_Network_Management_History_Propulsion_CAN_DID_D211_9_5th_Latest_State_NM_History (DcmDspDataInfo): DcmDspDataFixedLength=true  # Diagnostics Data Import
        DID_D211_Network_Management_History_Propulsion_CAN_DID_D211_9_5th_Latest_State_NM_History (DcmDspData):  # Diagnostics Data Import
          DcmDspDataSize = 8
          DcmDspDataType = UINT8
          DcmDspDataInfoRef = DataInfo_DID_D211_Network_Management_History_Propulsion_CAN_DID_D211_9_5th_Latest_State_NM_History
        DataInfo_DID_D211_Network_Management_History_Propulsion_CAN_DID_D211_8_4th_Latest_State_Global_Real_Time (DcmDspDataInfo): DcmDspDataFixedLength=true  # Diagnostics Data Import
        DID_D211_Network_Management_History_Propulsion_CAN_DID_D211_8_4th_Latest_State_Global_Real_Time (DcmDspData):  # Diagnostics Data Import
          DcmDspDataSize = 32
          DcmDspDataType = UINT32
          DcmDspDataInfoRef = DataInfo_DID_D211_Network_Management_History_Propulsion_CAN_DID_D211_8_4th_Latest_State_Global_Real_Time
        DataInfo_DID_D211_Network_Management_History_Propulsion_CAN_DID_D211_7_4th_Latest_State_NM_History (DcmDspDataInfo): DcmDspDataFixedLength=true  # Diagnostics Data Import
        DID_D211_Network_Management_History_Propulsion_CAN_DID_D211_7_4th_Latest_State_NM_History (DcmDspData):  # Diagnostics Data Import
          DcmDspDataSize = 8
          DcmDspDataType = UINT8
          DcmDspDataInfoRef = DataInfo_DID_D211_Network_Management_History_Propulsion_CAN_DID_D211_7_4th_Latest_State_NM_History
        DataInfo_DID_D211_Network_Management_History_Propulsion_CAN_DID_D211_6_3rd_Latest_State_Global_Real_Time (DcmDspDataInfo): DcmDspDataFixedLength=true  # Diagnostics Data Import
        DID_D211_Network_Management_History_Propulsion_CAN_DID_D211_6_3rd_Latest_State_Global_Real_Time (DcmDspData):  # Diagnostics Data Import
          DcmDspDataSize = 32
          DcmDspDataType = UINT32
          DcmDspDataInfoRef = DataInfo_DID_D211_Network_Management_History_Propulsion_CAN_DID_D211_6_3rd_Latest_State_Global_Real_Time
        DataInfo_DID_D211_Network_Management_History_Propulsion_CAN_DID_D211_5_3rd_Latest_State_NM_History (DcmDspDataInfo): DcmDspDataFixedLength=true  # Diagnostics Data Import
        DID_D211_Network_Management_History_Propulsion_CAN_DID_D211_5_3rd_Latest_State_NM_History (DcmDspData):  # Diagnostics Data Import
          DcmDspDataSize = 8
          DcmDspDataType = UINT8
          DcmDspDataInfoRef = DataInfo_DID_D211_Network_Management_History_Propulsion_CAN_DID_D211_5_3rd_Latest_State_NM_History
        DataInfo_DID_D211_Network_Management_History_Propulsion_CAN_DID_D211_4_2nd_Latest_State_Global_Real_Time (DcmDspDataInfo): DcmDspDataFixedLength=true  # Diagnostics Data Import
        DID_D211_Network_Management_History_Propulsion_CAN_DID_D211_4_2nd_Latest_State_Global_Real_Time (DcmDspData):  # Diagnostics Data Import
          DcmDspDataSize = 32
          DcmDspDataType = UINT32
          DcmDspDataInfoRef = DataInfo_DID_D211_Network_Management_History_Propulsion_CAN_DID_D211_4_2nd_Latest_State_Global_Real_Time
        DataInfo_DID_D211_Network_Management_History_Propulsion_CAN_DID_D211_3_2nd_Latest_State_NM_History (DcmDspDataInfo): DcmDspDataFixedLength=true  # Diagnostics Data Import
        DID_D211_Network_Management_History_Propulsion_CAN_DID_D211_3_2nd_Latest_State_NM_History (DcmDspData):  # Diagnostics Data Import
          DcmDspDataSize = 8
          DcmDspDataType = UINT8
          DcmDspDataInfoRef = DataInfo_DID_D211_Network_Management_History_Propulsion_CAN_DID_D211_3_2nd_Latest_State_NM_History
        DataInfo_DID_D211_Network_Management_History_Propulsion_CAN_DID_D211_2_Latest_State_Global_Real_Time (DcmDspDataInfo): DcmDspDataFixedLength=true  # Diagnostics Data Import
        DID_D211_Network_Management_History_Propulsion_CAN_DID_D211_2_Latest_State_Global_Real_Time (DcmDspData):  # Diagnostics Data Import
          DcmDspDataSize = 32
          DcmDspDataType = UINT32
          DcmDspDataInfoRef = DataInfo_DID_D211_Network_Management_History_Propulsion_CAN_DID_D211_2_Latest_State_Global_Real_Time
        DataInfo_DID_D211_Network_Management_History_Propulsion_CAN_DID_D211_1_Latest_State_NM_History (DcmDspDataInfo): DcmDspDataFixedLength=true  # Diagnostics Data Import
        DID_D211_Network_Management_History_Propulsion_CAN_DID_D211_1_Latest_State_NM_History (DcmDspData):  # Diagnostics Data Import
          DcmDspDataSize = 8
          DcmDspDataType = UINT8
          DcmDspDataInfoRef = DataInfo_DID_D211_Network_Management_History_Propulsion_CAN_DID_D211_1_Latest_State_NM_History
        DataInfo_DID_D134_Car_Mode_DID_D134_Car_Mode (DcmDspDataInfo): DcmDspDataFixedLength=true  # Diagnostics Data Import
        DID_D134_Car_Mode_DID_D134_Car_Mode (DcmDspData): DcmDspDataSize=8, DcmDspDataType=UINT8, DcmDspDataInfoRef=DataInfo_DID_D134_Car_Mode_DID_D134_Car_Mode  # Diagnostics Data Import
        DataInfo_DID_D12F_Security_Constant_Level_11_12_DID_D12F_Security_Constant_Level_1112 (DcmDspDataInfo): DcmDspDataFixedLength=true  # Diagnostics Data Import
        DID_D12F_Security_Constant_Level_11_12_DID_D12F_Security_Constant_Level_1112 (DcmDspData):  # Diagnostics Data Import
          DcmDspDataSize = 40
          DcmDspDataType = UINT8_N
          DcmDspDataInfoRef = DataInfo_DID_D12F_Security_Constant_Level_11_12_DID_D12F_Security_Constant_Level_1112
        DataInfo_DID_D0B5_SDB_version_SDB_version (DcmDspDataInfo): DcmDspDataFixedLength=true  # Diagnostics Data Import
        DID_D0B5_SDB_version_SDB_version (DcmDspData): DcmDspDataSize=24, DcmDspDataType=UINT8_N, DcmDspDataInfoRef=DataInfo_DID_D0B5_SDB_version_SDB_version  # Diagnostics Data Import
        DataInfo_DID_D09A_High_Quiescent_Current_Function_Activation_Deactivation_DID_D09A_High_Quiescent_Current_Function_Activ93b79a05 (DcmDspDataInfo): DcmDspDataFixedLength=true  # Diagnostics Data Import
        DID_D09A_High_Quiescent_Current_Function_Activation_Deactivation_DID_D09A_High_Quiescent_Current_Function_ActivationDeactivation (DcmDspData):  # Diagnostics Data Import
          DcmDspDataSize = 8
          DcmDspDataType = UINT8
          DcmDspDataInfoRef = DataInfo_DID_D09A_High_Quiescent_Current_Function_Activation_Deactivation_DID_D09A_High_Quiescent_Current_Function_Activ93b79a05
        DataInfo_DID_D03A_swAuth_Public_Key_CheckSum_DID_D03A_swAuth_Public_Key_CheckSum (DcmDspDataInfo): DcmDspDataFixedLength=true  # Diagnostics Data Import
        DID_D03A_swAuth_Public_Key_CheckSum_DID_D03A_swAuth_Public_Key_CheckSum (DcmDspData): DcmDspDataSize=256, DcmDspDataType=UINT8_N, DcmDspDataInfoRef=DataInfo_DID_D03A_swAuth_Public_Key_CheckSum_DID_D03A_swAuth_Public_Key_CheckSum  # Diagnostics Data Import
        DataInfo_DID_D005_High_Quiescent_Current_Fault_Identification_Data_DID_D005_5st_Usage_Mode_when_DID_is_triggered (DcmDspDataInfo): DcmDspDataFixedLength=true  # Diagnostics Data Import
        DID_D005_High_Quiescent_Current_Fault_Identification_Data_DID_D005_5st_Usage_Mode_when_DID_is_triggered (DcmDspData):  # Diagnostics Data Import
          DcmDspDataSize = 8
          DcmDspDataType = UINT8
          DcmDspDataInfoRef = DataInfo_DID_D005_High_Quiescent_Current_Fault_Identification_Data_DID_D005_5st_Usage_Mode_when_DID_is_triggered
        DataInfo_DID_D005_High_Quiescent_Current_Fault_Identification_Data_Bitfield_5th (DcmDspDataInfo): DcmDspDataFixedLength=true  # Diagnostics Data Import
        DID_D005_High_Quiescent_Current_Fault_Identification_Data_Bitfield_5th (DcmDspData): DcmDspDataSize=8, DcmDspDataType=UINT8_N, DcmDspDataInfoRef=DataInfo_DID_D005_High_Quiescent_Current_Fault_Identification_Data_Bitfield_5th  # Diagnostics Data Import
        DataInfo_DID_D005_High_Quiescent_Current_Fault_Identification_Data_Reserved_Data_Field_5st (DcmDspDataInfo): DcmDspDataFixedLength=true  # Diagnostics Data Import
        DID_D005_High_Quiescent_Current_Fault_Identification_Data_Reserved_Data_Field_5st (DcmDspData):  # Diagnostics Data Import
          DcmDspDataSize = 176
          DcmDspDataType = UINT8_N
          DcmDspDataInfoRef = DataInfo_DID_D005_High_Quiescent_Current_Fault_Identification_Data_Reserved_Data_Field_5st
        DataInfo_DID_D005_High_Quiescent_Current_Fault_Identification_Data_Functionality_Activity_Level_Detect_DC_Bus_voltage_Ab8e570b1e (DcmDspDataInfo): DcmDspDataFixedLength=true  # Diagnostics Data Import
        DID_D005_High_Quiescent_Current_Fault_Identification_Data_Functionality_Activity_Level_Detect_DC_Bus_voltage_Abnormal_5st (DcmDspData):  # Diagnostics Data Import
          DcmDspDataSize = 8
          DcmDspDataType = UINT8
          DcmDspDataInfoRef = DataInfo_DID_D005_High_Quiescent_Current_Fault_Identification_Data_Functionality_Activity_Level_Detect_DC_Bus_voltage_Ab8e570b1e
        DataInfo_DID_D005_High_Quiescent_Current_Fault_Identification_Data_Functionality_Activity_Level_Detect_Motor_Speed_Abnormal_5st (DcmDspDataInfo): DcmDspDataFixedLength=true  # Diagnostics Data Import
        DID_D005_High_Quiescent_Current_Fault_Identification_Data_Functionality_Activity_Level_Detect_Motor_Speed_Abnormal_5st (DcmDspData):  # Diagnostics Data Import
          DcmDspDataSize = 8
          DcmDspDataType = UINT8
          DcmDspDataInfoRef = DataInfo_DID_D005_High_Quiescent_Current_Fault_Identification_Data_Functionality_Activity_Level_Detect_Motor_Speed_Abnormal_5st
        DataInfo_DID_D005_High_Quiescent_Current_Fault_Identification_Data_Functionality_Activity_Level_Detect_CPSR_Keep_Active_5st (DcmDspDataInfo): DcmDspDataFixedLength=true  # Diagnostics Data Import
        DID_D005_High_Quiescent_Current_Fault_Identification_Data_Functionality_Activity_Level_Detect_CPSR_Keep_Active_5st (DcmDspData):  # Diagnostics Data Import
          DcmDspDataSize = 8
          DcmDspDataType = UINT8
          DcmDspDataInfoRef = DataInfo_DID_D005_High_Quiescent_Current_Fault_Identification_Data_Functionality_Activity_Level_Detect_CPSR_Keep_Active_5st
        DataInfo_DID_D005_High_Quiescent_Current_Fault_Identification_Data_Reserved_PNC_5st (DcmDspDataInfo): DcmDspDataFixedLength=true  # Diagnostics Data Import
        DID_D005_High_Quiescent_Current_Fault_Identification_Data_Reserved_PNC_5st (DcmDspData): DcmDspDataSize=56, DcmDspDataType=UINT8_N, DcmDspDataInfoRef=DataInfo_DID_D005_High_Quiescent_Current_Fault_Identification_Data_Reserved_PNC_5st  # Diagnostics Data Import
        DataInfo_DID_D005_High_Quiescent_Current_Fault_Identification_Data_D005_5st_Functionality_Activity_Level_PNC39 (DcmDspDataInfo): DcmDspDataFixedLength=true  # Diagnostics Data Import
        DID_D005_High_Quiescent_Current_Fault_Identification_Data_D005_5st_Functionality_Activity_Level_PNC39 (DcmDspData):  # Diagnostics Data Import
          DcmDspDataSize = 8
          DcmDspDataType = UINT8
          DcmDspDataInfoRef = DataInfo_DID_D005_High_Quiescent_Current_Fault_Identification_Data_D005_5st_Functionality_Activity_Level_PNC39
        DataInfo_DID_D005_High_Quiescent_Current_Fault_Identification_Data_D005_5st_Functionality_Activity_Level_PNC35 (DcmDspDataInfo): DcmDspDataFixedLength=true  # Diagnostics Data Import
        DID_D005_High_Quiescent_Current_Fault_Identification_Data_D005_5st_Functionality_Activity_Level_PNC35 (DcmDspData):  # Diagnostics Data Import
          DcmDspDataSize = 8
          DcmDspDataType = UINT8
          DcmDspDataInfoRef = DataInfo_DID_D005_High_Quiescent_Current_Fault_Identification_Data_D005_5st_Functionality_Activity_Level_PNC35
        DataInfo_DID_D005_High_Quiescent_Current_Fault_Identification_Data_D005_5st_Functionality_Activity_Level_PNC30 (DcmDspDataInfo): DcmDspDataFixedLength=true  # Diagnostics Data Import
        DID_D005_High_Quiescent_Current_Fault_Identification_Data_D005_5st_Functionality_Activity_Level_PNC30 (DcmDspData):  # Diagnostics Data Import
          DcmDspDataSize = 8
          DcmDspDataType = UINT8
          DcmDspDataInfoRef = DataInfo_DID_D005_High_Quiescent_Current_Fault_Identification_Data_D005_5st_Functionality_Activity_Level_PNC30
        DataInfo_DID_D005_High_Quiescent_Current_Fault_Identification_Data_D005_5st_Functionality_Activity_Level_PNC29 (DcmDspDataInfo): DcmDspDataFixedLength=true  # Diagnostics Data Import
        DID_D005_High_Quiescent_Current_Fault_Identification_Data_D005_5st_Functionality_Activity_Level_PNC29 (DcmDspData):  # Diagnostics Data Import
          DcmDspDataSize = 8
          DcmDspDataType = UINT8
          DcmDspDataInfoRef = DataInfo_DID_D005_High_Quiescent_Current_Fault_Identification_Data_D005_5st_Functionality_Activity_Level_PNC29
        DataInfo_DID_D005_High_Quiescent_Current_Fault_Identification_Data_D005_5st_Functionality_Activity_Level_PNC27 (DcmDspDataInfo): DcmDspDataFixedLength=true  # Diagnostics Data Import
        DID_D005_High_Quiescent_Current_Fault_Identification_Data_D005_5st_Functionality_Activity_Level_PNC27 (DcmDspData):  # Diagnostics Data Import
          DcmDspDataSize = 8
          DcmDspDataType = UINT8
          DcmDspDataInfoRef = DataInfo_DID_D005_High_Quiescent_Current_Fault_Identification_Data_D005_5st_Functionality_Activity_Level_PNC27
        DataInfo_DID_D005_High_Quiescent_Current_Fault_Identification_Data_D005_5st_Functionality_Activity_Level_PNC26 (DcmDspDataInfo): DcmDspDataFixedLength=true  # Diagnostics Data Import
        DID_D005_High_Quiescent_Current_Fault_Identification_Data_D005_5st_Functionality_Activity_Level_PNC26 (DcmDspData):  # Diagnostics Data Import
          DcmDspDataSize = 8
          DcmDspDataType = UINT8
          DcmDspDataInfoRef = DataInfo_DID_D005_High_Quiescent_Current_Fault_Identification_Data_D005_5st_Functionality_Activity_Level_PNC26
        DataInfo_DID_D005_High_Quiescent_Current_Fault_Identification_Data_D005_5st_Functionality_Activity_Level_PNC25 (DcmDspDataInfo): DcmDspDataFixedLength=true  # Diagnostics Data Import
        DID_D005_High_Quiescent_Current_Fault_Identification_Data_D005_5st_Functionality_Activity_Level_PNC25 (DcmDspData):  # Diagnostics Data Import
          DcmDspDataSize = 8
          DcmDspDataType = UINT8
          DcmDspDataInfoRef = DataInfo_DID_D005_High_Quiescent_Current_Fault_Identification_Data_D005_5st_Functionality_Activity_Level_PNC25
        DataInfo_DID_D005_High_Quiescent_Current_Fault_Identification_Data_D005_5st_Functionality_Activity_Level_PNC24 (DcmDspDataInfo): DcmDspDataFixedLength=true  # Diagnostics Data Import
        DID_D005_High_Quiescent_Current_Fault_Identification_Data_D005_5st_Functionality_Activity_Level_PNC24 (DcmDspData):  # Diagnostics Data Import
          DcmDspDataSize = 8
          DcmDspDataType = UINT8
          DcmDspDataInfoRef = DataInfo_DID_D005_High_Quiescent_Current_Fault_Identification_Data_D005_5st_Functionality_Activity_Level_PNC24
        DataInfo_DID_D005_High_Quiescent_Current_Fault_Identification_Data_DID_D005_5st_Global_time_when_Functionality_Activity_e191be5a (DcmDspDataInfo): DcmDspDataFixedLength=true  # Diagnostics Data Import
        DID_D005_High_Quiescent_Current_Fault_Identification_Data_DID_D005_5st_Global_time_when_Functionality_Activity_level_Sle91c5dfd2 (DcmDspData):  # Diagnostics Data Import
          DcmDspDataSize = 32
          DcmDspDataType = UINT32
          DcmDspDataInfoRef = DataInfo_DID_D005_High_Quiescent_Current_Fault_Identification_Data_DID_D005_5st_Global_time_when_Functionality_Activity_e191be5a
        DataInfo_DID_D005_High_Quiescent_Current_Fault_Identification_Data_DID_D005_5st_System_Global_Time_the_time_when_the_DIDba8286b (DcmDspDataInfo): DcmDspDataFixedLength=true  # Diagnostics Data Import
        DID_D005_High_Quiescent_Current_Fault_Identification_Data_DID_D005_5st_System_Global_Time_the_time_when_the_DID_is_triggered (DcmDspData):  # Diagnostics Data Import
          DcmDspDataSize = 32
          DcmDspDataType = UINT32
          DcmDspDataInfoRef = DataInfo_DID_D005_High_Quiescent_Current_Fault_Identification_Data_DID_D005_5st_System_Global_Time_the_time_when_the_DIDba8286b
        DataInfo_DID_D005_High_Quiescent_Current_Fault_Identification_Data_DID_D005_4st_Usage_Mode_when_DID_is_triggered (DcmDspDataInfo): DcmDspDataFixedLength=true  # Diagnostics Data Import
        DID_D005_High_Quiescent_Current_Fault_Identification_Data_DID_D005_4st_Usage_Mode_when_DID_is_triggered (DcmDspData):  # Diagnostics Data Import
          DcmDspDataSize = 8
          DcmDspDataType = UINT8
          DcmDspDataInfoRef = DataInfo_DID_D005_High_Quiescent_Current_Fault_Identification_Data_DID_D005_4st_Usage_Mode_when_DID_is_triggered
        DataInfo_DID_D005_High_Quiescent_Current_Fault_Identification_Data_Bitfield_4th (DcmDspDataInfo): DcmDspDataFixedLength=true  # Diagnostics Data Import
        DID_D005_High_Quiescent_Current_Fault_Identification_Data_Bitfield_4th (DcmDspData): DcmDspDataSize=8, DcmDspDataType=UINT8_N, DcmDspDataInfoRef=DataInfo_DID_D005_High_Quiescent_Current_Fault_Identification_Data_Bitfield_4th  # Diagnostics Data Import
        DataInfo_DID_D005_High_Quiescent_Current_Fault_Identification_Data_Reserved_Data_Field_4st (DcmDspDataInfo): DcmDspDataFixedLength=true  # Diagnostics Data Import
        DID_D005_High_Quiescent_Current_Fault_Identification_Data_Reserved_Data_Field_4st (DcmDspData):  # Diagnostics Data Import
          DcmDspDataSize = 176
          DcmDspDataType = UINT8_N
          DcmDspDataInfoRef = DataInfo_DID_D005_High_Quiescent_Current_Fault_Identification_Data_Reserved_Data_Field_4st
        DataInfo_DID_D005_High_Quiescent_Current_Fault_Identification_Data_Functionality_Activity_Level_Detect_DC_Bus_voltage_Ab8f956129 (DcmDspDataInfo): DcmDspDataFixedLength=true  # Diagnostics Data Import
        DID_D005_High_Quiescent_Current_Fault_Identification_Data_Functionality_Activity_Level_Detect_DC_Bus_voltage_Abnormal_4st (DcmDspData):  # Diagnostics Data Import
          DcmDspDataSize = 8
          DcmDspDataType = UINT8
          DcmDspDataInfoRef = DataInfo_DID_D005_High_Quiescent_Current_Fault_Identification_Data_Functionality_Activity_Level_Detect_DC_Bus_voltage_Ab8f956129
        DataInfo_DID_D005_High_Quiescent_Current_Fault_Identification_Data_Functionality_Activity_Level_Detect_Motor_Speed_Abnormal_4st (DcmDspDataInfo): DcmDspDataFixedLength=true  # Diagnostics Data Import
        DID_D005_High_Quiescent_Current_Fault_Identification_Data_Functionality_Activity_Level_Detect_Motor_Speed_Abnormal_4st (DcmDspData):  # Diagnostics Data Import
          DcmDspDataSize = 8
          DcmDspDataType = UINT8
          DcmDspDataInfoRef = DataInfo_DID_D005_High_Quiescent_Current_Fault_Identification_Data_Functionality_Activity_Level_Detect_Motor_Speed_Abnormal_4st
        DataInfo_DID_D005_High_Quiescent_Current_Fault_Identification_Data_Functionality_Activity_Level_Detect_CPSR_Keep_Active_4st (DcmDspDataInfo): DcmDspDataFixedLength=true  # Diagnostics Data Import
        DID_D005_High_Quiescent_Current_Fault_Identification_Data_Functionality_Activity_Level_Detect_CPSR_Keep_Active_4st (DcmDspData):  # Diagnostics Data Import
          DcmDspDataSize = 8
          DcmDspDataType = UINT8
          DcmDspDataInfoRef = DataInfo_DID_D005_High_Quiescent_Current_Fault_Identification_Data_Functionality_Activity_Level_Detect_CPSR_Keep_Active_4st
        DataInfo_DID_D005_High_Quiescent_Current_Fault_Identification_Data_Reserved_PNC_4st (DcmDspDataInfo): DcmDspDataFixedLength=true  # Diagnostics Data Import
        DID_D005_High_Quiescent_Current_Fault_Identification_Data_Reserved_PNC_4st (DcmDspData): DcmDspDataSize=56, DcmDspDataType=UINT8_N, DcmDspDataInfoRef=DataInfo_DID_D005_High_Quiescent_Current_Fault_Identification_Data_Reserved_PNC_4st  # Diagnostics Data Import
        DataInfo_DID_D005_High_Quiescent_Current_Fault_Identification_Data_D005_4st_Functionality_Activity_Level_PNC39 (DcmDspDataInfo): DcmDspDataFixedLength=true  # Diagnostics Data Import
        DID_D005_High_Quiescent_Current_Fault_Identification_Data_D005_4st_Functionality_Activity_Level_PNC39 (DcmDspData):  # Diagnostics Data Import
          DcmDspDataSize = 8
          DcmDspDataType = UINT8
          DcmDspDataInfoRef = DataInfo_DID_D005_High_Quiescent_Current_Fault_Identification_Data_D005_4st_Functionality_Activity_Level_PNC39
        DataInfo_DID_D005_High_Quiescent_Current_Fault_Identification_Data_D005_4st_Functionality_Activity_Level_PNC35 (DcmDspDataInfo): DcmDspDataFixedLength=true  # Diagnostics Data Import
        DID_D005_High_Quiescent_Current_Fault_Identification_Data_D005_4st_Functionality_Activity_Level_PNC35 (DcmDspData):  # Diagnostics Data Import
          DcmDspDataSize = 8
          DcmDspDataType = UINT8
          DcmDspDataInfoRef = DataInfo_DID_D005_High_Quiescent_Current_Fault_Identification_Data_D005_4st_Functionality_Activity_Level_PNC35
        DataInfo_DID_D005_High_Quiescent_Current_Fault_Identification_Data_D005_4st_Functionality_Activity_Level_PNC30 (DcmDspDataInfo): DcmDspDataFixedLength=true  # Diagnostics Data Import
        DID_D005_High_Quiescent_Current_Fault_Identification_Data_D005_4st_Functionality_Activity_Level_PNC30 (DcmDspData):  # Diagnostics Data Import
          DcmDspDataSize = 8
          DcmDspDataType = UINT8
          DcmDspDataInfoRef = DataInfo_DID_D005_High_Quiescent_Current_Fault_Identification_Data_D005_4st_Functionality_Activity_Level_PNC30
        DataInfo_DID_D005_High_Quiescent_Current_Fault_Identification_Data_D005_4st_Functionality_Activity_Level_PNC29 (DcmDspDataInfo): DcmDspDataFixedLength=true  # Diagnostics Data Import
        DID_D005_High_Quiescent_Current_Fault_Identification_Data_D005_4st_Functionality_Activity_Level_PNC29 (DcmDspData):  # Diagnostics Data Import
          DcmDspDataSize = 8
          DcmDspDataType = UINT8
          DcmDspDataInfoRef = DataInfo_DID_D005_High_Quiescent_Current_Fault_Identification_Data_D005_4st_Functionality_Activity_Level_PNC29
        DataInfo_DID_D005_High_Quiescent_Current_Fault_Identification_Data_D005_4st_Functionality_Activity_Level_PNC27 (DcmDspDataInfo): DcmDspDataFixedLength=true  # Diagnostics Data Import
        DID_D005_High_Quiescent_Current_Fault_Identification_Data_D005_4st_Functionality_Activity_Level_PNC27 (DcmDspData):  # Diagnostics Data Import
          DcmDspDataSize = 8
          DcmDspDataType = UINT8
          DcmDspDataInfoRef = DataInfo_DID_D005_High_Quiescent_Current_Fault_Identification_Data_D005_4st_Functionality_Activity_Level_PNC27
        DataInfo_DID_D005_High_Quiescent_Current_Fault_Identification_Data_D005_4st_Functionality_Activity_Level_PNC26 (DcmDspDataInfo): DcmDspDataFixedLength=true  # Diagnostics Data Import
        DID_D005_High_Quiescent_Current_Fault_Identification_Data_D005_4st_Functionality_Activity_Level_PNC26 (DcmDspData):  # Diagnostics Data Import
          DcmDspDataSize = 8
          DcmDspDataType = UINT8
          DcmDspDataInfoRef = DataInfo_DID_D005_High_Quiescent_Current_Fault_Identification_Data_D005_4st_Functionality_Activity_Level_PNC26
        DataInfo_DID_D005_High_Quiescent_Current_Fault_Identification_Data_D005_4st_Functionality_Activity_Level_PNC25 (DcmDspDataInfo): DcmDspDataFixedLength=true  # Diagnostics Data Import
        DID_D005_High_Quiescent_Current_Fault_Identification_Data_D005_4st_Functionality_Activity_Level_PNC25 (DcmDspData):  # Diagnostics Data Import
          DcmDspDataSize = 8
          DcmDspDataType = UINT8
          DcmDspDataInfoRef = DataInfo_DID_D005_High_Quiescent_Current_Fault_Identification_Data_D005_4st_Functionality_Activity_Level_PNC25
        DataInfo_DID_D005_High_Quiescent_Current_Fault_Identification_Data_D005_4st_Functionality_Activity_Level_PNC24 (DcmDspDataInfo): DcmDspDataFixedLength=true  # Diagnostics Data Import
        DID_D005_High_Quiescent_Current_Fault_Identification_Data_D005_4st_Functionality_Activity_Level_PNC24 (DcmDspData):  # Diagnostics Data Import
          DcmDspDataSize = 8
          DcmDspDataType = UINT8
          DcmDspDataInfoRef = DataInfo_DID_D005_High_Quiescent_Current_Fault_Identification_Data_D005_4st_Functionality_Activity_Level_PNC24
        DataInfo_DID_D005_High_Quiescent_Current_Fault_Identification_Data_DID_D005_4st_Global_time_when_Functionality_Activity_a8781345 (DcmDspDataInfo): DcmDspDataFixedLength=true  # Diagnostics Data Import
        DID_D005_High_Quiescent_Current_Fault_Identification_Data_DID_D005_4st_Global_time_when_Functionality_Activity_level_Sled82c72cd (DcmDspData):  # Diagnostics Data Import
          DcmDspDataSize = 32
          DcmDspDataType = UINT32
          DcmDspDataInfoRef = DataInfo_DID_D005_High_Quiescent_Current_Fault_Identification_Data_DID_D005_4st_Global_time_when_Functionality_Activity_a8781345
        DataInfo_DID_D005_High_Quiescent_Current_Fault_Identification_Data_DID_D005_4st_System_Global_Time_the_time_when_the_DID1302fa0f (DcmDspDataInfo): DcmDspDataFixedLength=true  # Diagnostics Data Import
        DID_D005_High_Quiescent_Current_Fault_Identification_Data_DID_D005_4st_System_Global_Time_the_time_when_the_DID_is_triggered (DcmDspData):  # Diagnostics Data Import
          DcmDspDataSize = 32
          DcmDspDataType = UINT32
          DcmDspDataInfoRef = DataInfo_DID_D005_High_Quiescent_Current_Fault_Identification_Data_DID_D005_4st_System_Global_Time_the_time_when_the_DID1302fa0f
        DataInfo_DID_D005_High_Quiescent_Current_Fault_Identification_Data_DID_D005_3st_Usage_Mode_when_DID_is_triggered (DcmDspDataInfo): DcmDspDataFixedLength=true  # Diagnostics Data Import
        DID_D005_High_Quiescent_Current_Fault_Identification_Data_DID_D005_3st_Usage_Mode_when_DID_is_triggered (DcmDspData):  # Diagnostics Data Import
          DcmDspDataSize = 8
          DcmDspDataType = UINT8
          DcmDspDataInfoRef = DataInfo_DID_D005_High_Quiescent_Current_Fault_Identification_Data_DID_D005_3st_Usage_Mode_when_DID_is_triggered
        DataInfo_DID_D005_High_Quiescent_Current_Fault_Identification_Data_Bitfield_3th (DcmDspDataInfo): DcmDspDataFixedLength=true  # Diagnostics Data Import
        DID_D005_High_Quiescent_Current_Fault_Identification_Data_Bitfield_3th (DcmDspData): DcmDspDataSize=8, DcmDspDataType=UINT8_N, DcmDspDataInfoRef=DataInfo_DID_D005_High_Quiescent_Current_Fault_Identification_Data_Bitfield_3th  # Diagnostics Data Import
        DataInfo_DID_D005_High_Quiescent_Current_Fault_Identification_Data_Reserved_Data_Field_3st (DcmDspDataInfo): DcmDspDataFixedLength=true  # Diagnostics Data Import
        DID_D005_High_Quiescent_Current_Fault_Identification_Data_Reserved_Data_Field_3st (DcmDspData):  # Diagnostics Data Import
          DcmDspDataSize = 176
          DcmDspDataType = UINT8_N
          DcmDspDataInfoRef = DataInfo_DID_D005_High_Quiescent_Current_Fault_Identification_Data_Reserved_Data_Field_3st
        DataInfo_DID_D005_High_Quiescent_Current_Fault_Identification_Data_Functionality_Activity_Level_Detect_DC_Bus_voltage_Ab9f04d8ab (DcmDspDataInfo): DcmDspDataFixedLength=true  # Diagnostics Data Import
        DID_D005_High_Quiescent_Current_Fault_Identification_Data_Functionality_Activity_Level_Detect_DC_Bus_voltage_Abnormal3st (DcmDspData):  # Diagnostics Data Import
          DcmDspDataSize = 8
          DcmDspDataType = UINT8
          DcmDspDataInfoRef = DataInfo_DID_D005_High_Quiescent_Current_Fault_Identification_Data_Functionality_Activity_Level_Detect_DC_Bus_voltage_Ab9f04d8ab
        DataInfo_DID_D005_High_Quiescent_Current_Fault_Identification_Data_Functionality_Activity_Level_Detect_Motor_Speed_Abnormal_3st (DcmDspDataInfo): DcmDspDataFixedLength=true  # Diagnostics Data Import
        DID_D005_High_Quiescent_Current_Fault_Identification_Data_Functionality_Activity_Level_Detect_Motor_Speed_Abnormal_3st (DcmDspData):  # Diagnostics Data Import
          DcmDspDataSize = 8
          DcmDspDataType = UINT8
          DcmDspDataInfoRef = DataInfo_DID_D005_High_Quiescent_Current_Fault_Identification_Data_Functionality_Activity_Level_Detect_Motor_Speed_Abnormal_3st
        DataInfo_DID_D005_High_Quiescent_Current_Fault_Identification_Data_Functionality_Activity_Level_Detect_CPSR_Keep_Active_3st (DcmDspDataInfo): DcmDspDataFixedLength=true  # Diagnostics Data Import
        DID_D005_High_Quiescent_Current_Fault_Identification_Data_Functionality_Activity_Level_Detect_CPSR_Keep_Active_3st (DcmDspData):  # Diagnostics Data Import
          DcmDspDataSize = 8
          DcmDspDataType = UINT8
          DcmDspDataInfoRef = DataInfo_DID_D005_High_Quiescent_Current_Fault_Identification_Data_Functionality_Activity_Level_Detect_CPSR_Keep_Active_3st
        DataInfo_DID_D005_High_Quiescent_Current_Fault_Identification_Data_Reserved_PNC_3st (DcmDspDataInfo): DcmDspDataFixedLength=true  # Diagnostics Data Import
        DID_D005_High_Quiescent_Current_Fault_Identification_Data_Reserved_PNC_3st (DcmDspData): DcmDspDataSize=56, DcmDspDataType=UINT8_N, DcmDspDataInfoRef=DataInfo_DID_D005_High_Quiescent_Current_Fault_Identification_Data_Reserved_PNC_3st  # Diagnostics Data Import
        DataInfo_DID_D005_High_Quiescent_Current_Fault_Identification_Data_D005_3st_Functionality_Activity_Level_PNC39 (DcmDspDataInfo): DcmDspDataFixedLength=true  # Diagnostics Data Import
        DID_D005_High_Quiescent_Current_Fault_Identification_Data_D005_3st_Functionality_Activity_Level_PNC39 (DcmDspData):  # Diagnostics Data Import
          DcmDspDataSize = 8
          DcmDspDataType = UINT8
          DcmDspDataInfoRef = DataInfo_DID_D005_High_Quiescent_Current_Fault_Identification_Data_D005_3st_Functionality_Activity_Level_PNC39
        DataInfo_DID_D005_High_Quiescent_Current_Fault_Identification_Data_D005_3st_Functionality_Activity_Level_PNC35 (DcmDspDataInfo): DcmDspDataFixedLength=true  # Diagnostics Data Import
        DID_D005_High_Quiescent_Current_Fault_Identification_Data_D005_3st_Functionality_Activity_Level_PNC35 (DcmDspData):  # Diagnostics Data Import
          DcmDspDataSize = 8
          DcmDspDataType = UINT8
          DcmDspDataInfoRef = DataInfo_DID_D005_High_Quiescent_Current_Fault_Identification_Data_D005_3st_Functionality_Activity_Level_PNC35
        DataInfo_DID_D005_High_Quiescent_Current_Fault_Identification_Data_D005_3st_Functionality_Activity_Level_PNC30 (DcmDspDataInfo): DcmDspDataFixedLength=true  # Diagnostics Data Import
        DID_D005_High_Quiescent_Current_Fault_Identification_Data_D005_3st_Functionality_Activity_Level_PNC30 (DcmDspData):  # Diagnostics Data Import
          DcmDspDataSize = 8
          DcmDspDataType = UINT8
          DcmDspDataInfoRef = DataInfo_DID_D005_High_Quiescent_Current_Fault_Identification_Data_D005_3st_Functionality_Activity_Level_PNC30
        DataInfo_DID_D005_High_Quiescent_Current_Fault_Identification_Data_D005_3st_Functionality_Activity_Level_PNC29 (DcmDspDataInfo): DcmDspDataFixedLength=true  # Diagnostics Data Import
        DID_D005_High_Quiescent_Current_Fault_Identification_Data_D005_3st_Functionality_Activity_Level_PNC29 (DcmDspData):  # Diagnostics Data Import
          DcmDspDataSize = 8
          DcmDspDataType = UINT8
          DcmDspDataInfoRef = DataInfo_DID_D005_High_Quiescent_Current_Fault_Identification_Data_D005_3st_Functionality_Activity_Level_PNC29
        DataInfo_DID_D005_High_Quiescent_Current_Fault_Identification_Data_D005_3st_Functionality_Activity_Level_PNC27 (DcmDspDataInfo): DcmDspDataFixedLength=true  # Diagnostics Data Import
        DID_D005_High_Quiescent_Current_Fault_Identification_Data_D005_3st_Functionality_Activity_Level_PNC27 (DcmDspData):  # Diagnostics Data Import
          DcmDspDataSize = 8
          DcmDspDataType = UINT8
          DcmDspDataInfoRef = DataInfo_DID_D005_High_Quiescent_Current_Fault_Identification_Data_D005_3st_Functionality_Activity_Level_PNC27
        DataInfo_DID_D005_High_Quiescent_Current_Fault_Identification_Data_D005_3st_Functionality_Activity_Level_PNC26 (DcmDspDataInfo): DcmDspDataFixedLength=true  # Diagnostics Data Import
        DID_D005_High_Quiescent_Current_Fault_Identification_Data_D005_3st_Functionality_Activity_Level_PNC26 (DcmDspData):  # Diagnostics Data Import
          DcmDspDataSize = 8
          DcmDspDataType = UINT8
          DcmDspDataInfoRef = DataInfo_DID_D005_High_Quiescent_Current_Fault_Identification_Data_D005_3st_Functionality_Activity_Level_PNC26
        DataInfo_DID_D005_High_Quiescent_Current_Fault_Identification_Data_D005_3st_Functionality_Activity_Level_PNC25 (DcmDspDataInfo): DcmDspDataFixedLength=true  # Diagnostics Data Import
        DID_D005_High_Quiescent_Current_Fault_Identification_Data_D005_3st_Functionality_Activity_Level_PNC25 (DcmDspData):  # Diagnostics Data Import
          DcmDspDataSize = 8
          DcmDspDataType = UINT8
          DcmDspDataInfoRef = DataInfo_DID_D005_High_Quiescent_Current_Fault_Identification_Data_D005_3st_Functionality_Activity_Level_PNC25
        DataInfo_DID_D005_High_Quiescent_Current_Fault_Identification_Data_D005_3st_Functionality_Activity_Level_PNC24 (DcmDspDataInfo): DcmDspDataFixedLength=true  # Diagnostics Data Import
        DID_D005_High_Quiescent_Current_Fault_Identification_Data_D005_3st_Functionality_Activity_Level_PNC24 (DcmDspData):  # Diagnostics Data Import
          DcmDspDataSize = 8
          DcmDspDataType = UINT8
          DcmDspDataInfoRef = DataInfo_DID_D005_High_Quiescent_Current_Fault_Identification_Data_D005_3st_Functionality_Activity_Level_PNC24
        DataInfo_DID_D005_High_Quiescent_Current_Fault_Identification_Data_DID_D005_3st_Global_time_when_Functionality_Activity_8e955659 (DcmDspDataInfo): DcmDspDataFixedLength=true  # Diagnostics Data Import
        DID_D005_High_Quiescent_Current_Fault_Identification_Data_DID_D005_3st_Global_time_when_Functionality_Activity_level_Slefec137d1 (DcmDspData):  # Diagnostics Data Import
          DcmDspDataSize = 32
          DcmDspDataType = UINT32
          DcmDspDataInfoRef = DataInfo_DID_D005_High_Quiescent_Current_Fault_Identification_Data_DID_D005_3st_Global_time_when_Functionality_Activity_8e955659
        DataInfo_DID_D005_High_Quiescent_Current_Fault_Identification_Data_DID_D005_3st_System_Global_Time_the_time_when_the_DID5856c533 (DcmDspDataInfo): DcmDspDataFixedLength=true  # Diagnostics Data Import
        DID_D005_High_Quiescent_Current_Fault_Identification_Data_DID_D005_3st_System_Global_Time_the_time_when_the_DID_is_triggered (DcmDspData):  # Diagnostics Data Import
          DcmDspDataSize = 32
          DcmDspDataType = UINT32
          DcmDspDataInfoRef = DataInfo_DID_D005_High_Quiescent_Current_Fault_Identification_Data_DID_D005_3st_System_Global_Time_the_time_when_the_DID5856c533
        DataInfo_DID_D005_High_Quiescent_Current_Fault_Identification_Data_DID_D005_2st_Usage_Mode_when_DID_is_triggered (DcmDspDataInfo): DcmDspDataFixedLength=true  # Diagnostics Data Import
        DID_D005_High_Quiescent_Current_Fault_Identification_Data_DID_D005_2st_Usage_Mode_when_DID_is_triggered (DcmDspData):  # Diagnostics Data Import
          DcmDspDataSize = 8
          DcmDspDataType = UINT8
          DcmDspDataInfoRef = DataInfo_DID_D005_High_Quiescent_Current_Fault_Identification_Data_DID_D005_2st_Usage_Mode_when_DID_is_triggered
        DataInfo_DID_D005_High_Quiescent_Current_Fault_Identification_Data_Bitfield_2th (DcmDspDataInfo): DcmDspDataFixedLength=true  # Diagnostics Data Import
        DID_D005_High_Quiescent_Current_Fault_Identification_Data_Bitfield_2th (DcmDspData): DcmDspDataSize=8, DcmDspDataType=UINT8_N, DcmDspDataInfoRef=DataInfo_DID_D005_High_Quiescent_Current_Fault_Identification_Data_Bitfield_2th  # Diagnostics Data Import
        DataInfo_DID_D005_High_Quiescent_Current_Fault_Identification_Data_Reserved_Data_Field_2st (DcmDspDataInfo): DcmDspDataFixedLength=true  # Diagnostics Data Import
        DID_D005_High_Quiescent_Current_Fault_Identification_Data_Reserved_Data_Field_2st (DcmDspData):  # Diagnostics Data Import
          DcmDspDataSize = 176
          DcmDspDataType = UINT8_N
          DcmDspDataInfoRef = DataInfo_DID_D005_High_Quiescent_Current_Fault_Identification_Data_Reserved_Data_Field_2st
        DataInfo_DID_D005_High_Quiescent_Current_Fault_Identification_Data_Functionality_Activity_Level_Detect_DC_Bus_voltage_Ab8b181d9b (DcmDspDataInfo): DcmDspDataFixedLength=true  # Diagnostics Data Import
        DID_D005_High_Quiescent_Current_Fault_Identification_Data_Functionality_Activity_Level_Detect_DC_Bus_voltage_Abnormal_2st (DcmDspData):  # Diagnostics Data Import
          DcmDspDataSize = 8
          DcmDspDataType = UINT8
          DcmDspDataInfoRef = DataInfo_DID_D005_High_Quiescent_Current_Fault_Identification_Data_Functionality_Activity_Level_Detect_DC_Bus_voltage_Ab8b181d9b
        DataInfo_DID_D005_High_Quiescent_Current_Fault_Identification_Data_Functionality_Activity_Level_Detect_Motor_Speed_Abnormal_2st (DcmDspDataInfo): DcmDspDataFixedLength=true  # Diagnostics Data Import
        DID_D005_High_Quiescent_Current_Fault_Identification_Data_Functionality_Activity_Level_Detect_Motor_Speed_Abnormal_2st (DcmDspData):  # Diagnostics Data Import
          DcmDspDataSize = 8
          DcmDspDataType = UINT8
          DcmDspDataInfoRef = DataInfo_DID_D005_High_Quiescent_Current_Fault_Identification_Data_Functionality_Activity_Level_Detect_Motor_Speed_Abnormal_2st
        DataInfo_DID_D005_High_Quiescent_Current_Fault_Identification_Data_Functionality_Activity_Level_Detect_CPSR_Keep_Active_2st (DcmDspDataInfo): DcmDspDataFixedLength=true  # Diagnostics Data Import
        DID_D005_High_Quiescent_Current_Fault_Identification_Data_Functionality_Activity_Level_Detect_CPSR_Keep_Active_2st (DcmDspData):  # Diagnostics Data Import
          DcmDspDataSize = 8
          DcmDspDataType = UINT8
          DcmDspDataInfoRef = DataInfo_DID_D005_High_Quiescent_Current_Fault_Identification_Data_Functionality_Activity_Level_Detect_CPSR_Keep_Active_2st
        DataInfo_DID_D005_High_Quiescent_Current_Fault_Identification_Data_Reserved_PNC_2st (DcmDspDataInfo): DcmDspDataFixedLength=true  # Diagnostics Data Import
        DID_D005_High_Quiescent_Current_Fault_Identification_Data_Reserved_PNC_2st (DcmDspData): DcmDspDataSize=56, DcmDspDataType=UINT8_N, DcmDspDataInfoRef=DataInfo_DID_D005_High_Quiescent_Current_Fault_Identification_Data_Reserved_PNC_2st  # Diagnostics Data Import
        DataInfo_DID_D005_High_Quiescent_Current_Fault_Identification_Data_D005_2st_Functionality_Activity_Level_PNC39 (DcmDspDataInfo): DcmDspDataFixedLength=true  # Diagnostics Data Import
        DID_D005_High_Quiescent_Current_Fault_Identification_Data_D005_2st_Functionality_Activity_Level_PNC39 (DcmDspData):  # Diagnostics Data Import
          DcmDspDataSize = 8
          DcmDspDataType = UINT8
          DcmDspDataInfoRef = DataInfo_DID_D005_High_Quiescent_Current_Fault_Identification_Data_D005_2st_Functionality_Activity_Level_PNC39
        DataInfo_DID_D005_High_Quiescent_Current_Fault_Identification_Data_D005_2st_Functionality_Activity_Level_PNC35 (DcmDspDataInfo): DcmDspDataFixedLength=true  # Diagnostics Data Import
        DID_D005_High_Quiescent_Current_Fault_Identification_Data_D005_2st_Functionality_Activity_Level_PNC35 (DcmDspData):  # Diagnostics Data Import
          DcmDspDataSize = 8
          DcmDspDataType = UINT8
          DcmDspDataInfoRef = DataInfo_DID_D005_High_Quiescent_Current_Fault_Identification_Data_D005_2st_Functionality_Activity_Level_PNC35
        DataInfo_DID_D005_High_Quiescent_Current_Fault_Identification_Data_D005_2st_Functionality_Activity_Level_PNC30 (DcmDspDataInfo): DcmDspDataFixedLength=true  # Diagnostics Data Import
        DID_D005_High_Quiescent_Current_Fault_Identification_Data_D005_2st_Functionality_Activity_Level_PNC30 (DcmDspData):  # Diagnostics Data Import
          DcmDspDataSize = 8
          DcmDspDataType = UINT8
          DcmDspDataInfoRef = DataInfo_DID_D005_High_Quiescent_Current_Fault_Identification_Data_D005_2st_Functionality_Activity_Level_PNC30
        DataInfo_DID_D005_High_Quiescent_Current_Fault_Identification_Data_D005_2st_Functionality_Activity_Level_PNC29 (DcmDspDataInfo): DcmDspDataFixedLength=true  # Diagnostics Data Import
        DID_D005_High_Quiescent_Current_Fault_Identification_Data_D005_2st_Functionality_Activity_Level_PNC29 (DcmDspData):  # Diagnostics Data Import
          DcmDspDataSize = 8
          DcmDspDataType = UINT8
          DcmDspDataInfoRef = DataInfo_DID_D005_High_Quiescent_Current_Fault_Identification_Data_D005_2st_Functionality_Activity_Level_PNC29
        DataInfo_DID_D005_High_Quiescent_Current_Fault_Identification_Data_D005_2st_Functionality_Activity_Level_PNC27 (DcmDspDataInfo): DcmDspDataFixedLength=true  # Diagnostics Data Import
        DID_D005_High_Quiescent_Current_Fault_Identification_Data_D005_2st_Functionality_Activity_Level_PNC27 (DcmDspData):  # Diagnostics Data Import
          DcmDspDataSize = 8
          DcmDspDataType = UINT8
          DcmDspDataInfoRef = DataInfo_DID_D005_High_Quiescent_Current_Fault_Identification_Data_D005_2st_Functionality_Activity_Level_PNC27
        DataInfo_DID_D005_High_Quiescent_Current_Fault_Identification_Data_D005_2st_Functionality_Activity_Level_PNC26 (DcmDspDataInfo): DcmDspDataFixedLength=true  # Diagnostics Data Import
        DID_D005_High_Quiescent_Current_Fault_Identification_Data_D005_2st_Functionality_Activity_Level_PNC26 (DcmDspData):  # Diagnostics Data Import
          DcmDspDataSize = 8
          DcmDspDataType = UINT8
          DcmDspDataInfoRef = DataInfo_DID_D005_High_Quiescent_Current_Fault_Identification_Data_D005_2st_Functionality_Activity_Level_PNC26
        DataInfo_DID_D005_High_Quiescent_Current_Fault_Identification_Data_D005_2st_Functionality_Activity_Level_PNC25 (DcmDspDataInfo): DcmDspDataFixedLength=true  # Diagnostics Data Import
        DID_D005_High_Quiescent_Current_Fault_Identification_Data_D005_2st_Functionality_Activity_Level_PNC25 (DcmDspData):  # Diagnostics Data Import
          DcmDspDataSize = 8
          DcmDspDataType = UINT8
          DcmDspDataInfoRef = DataInfo_DID_D005_High_Quiescent_Current_Fault_Identification_Data_D005_2st_Functionality_Activity_Level_PNC25
        DataInfo_DID_D005_High_Quiescent_Current_Fault_Identification_Data_D005_2st_Functionality_Activity_Level_PNC24 (DcmDspDataInfo): DcmDspDataFixedLength=true  # Diagnostics Data Import
        DID_D005_High_Quiescent_Current_Fault_Identification_Data_D005_2st_Functionality_Activity_Level_PNC24 (DcmDspData):  # Diagnostics Data Import
          DcmDspDataSize = 8
          DcmDspDataType = UINT8
          DcmDspDataInfoRef = DataInfo_DID_D005_High_Quiescent_Current_Fault_Identification_Data_D005_2st_Functionality_Activity_Level_PNC24
        DataInfo_DID_D005_High_Quiescent_Current_Fault_Identification_Data_DID_D005_2st_Global_time_when_Functionality_Activity_c77cfb46 (DcmDspDataInfo): DcmDspDataFixedLength=true  # Diagnostics Data Import
        DID_D005_High_Quiescent_Current_Fault_Identification_Data_DID_D005_2st_Global_time_when_Functionality_Activity_level_Sleb7289ace (DcmDspData):  # Diagnostics Data Import
          DcmDspDataSize = 32
          DcmDspDataType = UINT32
          DcmDspDataInfoRef = DataInfo_DID_D005_High_Quiescent_Current_Fault_Identification_Data_DID_D005_2st_Global_time_when_Functionality_Activity_c77cfb46
        DataInfo_DID_D005_High_Quiescent_Current_Fault_Identification_Data_DID_D005_2st_System_Global_Time_the_time_when_the_DID40fc1757 (DcmDspDataInfo): DcmDspDataFixedLength=true  # Diagnostics Data Import
        DID_D005_High_Quiescent_Current_Fault_Identification_Data_DID_D005_2st_System_Global_Time_the_time_when_the_DID_is_triggered (DcmDspData):  # Diagnostics Data Import
          DcmDspDataSize = 32
          DcmDspDataType = UINT32
          DcmDspDataInfoRef = DataInfo_DID_D005_High_Quiescent_Current_Fault_Identification_Data_DID_D005_2st_System_Global_Time_the_time_when_the_DID40fc1757
        DataInfo_DID_D005_High_Quiescent_Current_Fault_Identification_Data_DID_D005_1st_Usage_Mode_when_DID_is_triggered (DcmDspDataInfo): DcmDspDataFixedLength=true  # Diagnostics Data Import
        DID_D005_High_Quiescent_Current_Fault_Identification_Data_DID_D005_1st_Usage_Mode_when_DID_is_triggered (DcmDspData):  # Diagnostics Data Import
          DcmDspDataSize = 8
          DcmDspDataType = UINT8
          DcmDspDataInfoRef = DataInfo_DID_D005_High_Quiescent_Current_Fault_Identification_Data_DID_D005_1st_Usage_Mode_when_DID_is_triggered
        DataInfo_DID_D005_High_Quiescent_Current_Fault_Identification_Data_Bitfield_1th (DcmDspDataInfo): DcmDspDataFixedLength=true  # Diagnostics Data Import
        DID_D005_High_Quiescent_Current_Fault_Identification_Data_Bitfield_1th (DcmDspData): DcmDspDataSize=8, DcmDspDataType=UINT8_N, DcmDspDataInfoRef=DataInfo_DID_D005_High_Quiescent_Current_Fault_Identification_Data_Bitfield_1th  # Diagnostics Data Import
        DataInfo_DID_D005_High_Quiescent_Current_Fault_Identification_Data_Reserved_Data_Field_1st (DcmDspDataInfo): DcmDspDataFixedLength=true  # Diagnostics Data Import
        DID_D005_High_Quiescent_Current_Fault_Identification_Data_Reserved_Data_Field_1st (DcmDspData):  # Diagnostics Data Import
          DcmDspDataSize = 176
          DcmDspDataType = UINT8_N
          DcmDspDataInfoRef = DataInfo_DID_D005_High_Quiescent_Current_Fault_Identification_Data_Reserved_Data_Field_1st
        DataInfo_DID_D005_High_Quiescent_Current_Fault_Identification_Data_Functionality_Activity_Level_Detect_DC_Bus_voltage_Ab895ea3c2 (DcmDspDataInfo): DcmDspDataFixedLength=true  # Diagnostics Data Import
        DID_D005_High_Quiescent_Current_Fault_Identification_Data_Functionality_Activity_Level_Detect_DC_Bus_voltage_Abnormal_1st (DcmDspData):  # Diagnostics Data Import
          DcmDspDataSize = 8
          DcmDspDataType = UINT8
          DcmDspDataInfoRef = DataInfo_DID_D005_High_Quiescent_Current_Fault_Identification_Data_Functionality_Activity_Level_Detect_DC_Bus_voltage_Ab895ea3c2
        DataInfo_DID_D005_High_Quiescent_Current_Fault_Identification_Data_Functionality_Activity_Level_Detect_Motor_Speed_Abnormal_1st (DcmDspDataInfo): DcmDspDataFixedLength=true  # Diagnostics Data Import
        DID_D005_High_Quiescent_Current_Fault_Identification_Data_Functionality_Activity_Level_Detect_Motor_Speed_Abnormal_1st (DcmDspData):  # Diagnostics Data Import
          DcmDspDataSize = 8
          DcmDspDataType = UINT8
          DcmDspDataInfoRef = DataInfo_DID_D005_High_Quiescent_Current_Fault_Identification_Data_Functionality_Activity_Level_Detect_Motor_Speed_Abnormal_1st
        DataInfo_DID_D005_High_Quiescent_Current_Fault_Identification_Data_Functionality_Activity_Level_Detect_CPSR_Keep_Active_1st (DcmDspDataInfo): DcmDspDataFixedLength=true  # Diagnostics Data Import
        DID_D005_High_Quiescent_Current_Fault_Identification_Data_Functionality_Activity_Level_Detect_CPSR_Keep_Active_1st (DcmDspData):  # Diagnostics Data Import
          DcmDspDataSize = 8
          DcmDspDataType = UINT8
          DcmDspDataInfoRef = DataInfo_DID_D005_High_Quiescent_Current_Fault_Identification_Data_Functionality_Activity_Level_Detect_CPSR_Keep_Active_1st
        DataInfo_DID_D005_High_Quiescent_Current_Fault_Identification_Data_Reserved_PNC_1st (DcmDspDataInfo): DcmDspDataFixedLength=true  # Diagnostics Data Import
        DID_D005_High_Quiescent_Current_Fault_Identification_Data_Reserved_PNC_1st (DcmDspData): DcmDspDataSize=56, DcmDspDataType=UINT8_N, DcmDspDataInfoRef=DataInfo_DID_D005_High_Quiescent_Current_Fault_Identification_Data_Reserved_PNC_1st  # Diagnostics Data Import
        DataInfo_DID_D005_High_Quiescent_Current_Fault_Identification_Data_D005_1st_Functionality_Activity_Level_PNC39 (DcmDspDataInfo): DcmDspDataFixedLength=true  # Diagnostics Data Import
        DID_D005_High_Quiescent_Current_Fault_Identification_Data_D005_1st_Functionality_Activity_Level_PNC39 (DcmDspData):  # Diagnostics Data Import
          DcmDspDataSize = 8
          DcmDspDataType = UINT8
          DcmDspDataInfoRef = DataInfo_DID_D005_High_Quiescent_Current_Fault_Identification_Data_D005_1st_Functionality_Activity_Level_PNC39
        DataInfo_DID_D005_High_Quiescent_Current_Fault_Identification_Data_D005_1st_Functionality_Activity_Level_PNC35 (DcmDspDataInfo): DcmDspDataFixedLength=true  # Diagnostics Data Import
        DID_D005_High_Quiescent_Current_Fault_Identification_Data_D005_1st_Functionality_Activity_Level_PNC35 (DcmDspData):  # Diagnostics Data Import
          DcmDspDataSize = 8
          DcmDspDataType = UINT8
          DcmDspDataInfoRef = DataInfo_DID_D005_High_Quiescent_Current_Fault_Identification_Data_D005_1st_Functionality_Activity_Level_PNC35
        DataInfo_DID_D005_High_Quiescent_Current_Fault_Identification_Data_D005_1st_Functionality_Activity_Level_PNC30 (DcmDspDataInfo): DcmDspDataFixedLength=true  # Diagnostics Data Import
        DID_D005_High_Quiescent_Current_Fault_Identification_Data_D005_1st_Functionality_Activity_Level_PNC30 (DcmDspData):  # Diagnostics Data Import
          DcmDspDataSize = 8
          DcmDspDataType = UINT8
          DcmDspDataInfoRef = DataInfo_DID_D005_High_Quiescent_Current_Fault_Identification_Data_D005_1st_Functionality_Activity_Level_PNC30
        DataInfo_DID_D005_High_Quiescent_Current_Fault_Identification_Data_D005_1st_Functionality_Activity_Level_PNC29 (DcmDspDataInfo): DcmDspDataFixedLength=true  # Diagnostics Data Import
        DID_D005_High_Quiescent_Current_Fault_Identification_Data_D005_1st_Functionality_Activity_Level_PNC29 (DcmDspData):  # Diagnostics Data Import
          DcmDspDataSize = 8
          DcmDspDataType = UINT8
          DcmDspDataInfoRef = DataInfo_DID_D005_High_Quiescent_Current_Fault_Identification_Data_D005_1st_Functionality_Activity_Level_PNC29
        DataInfo_DID_D005_High_Quiescent_Current_Fault_Identification_Data_D005_1st_Functionality_Activity_Level_PNC27 (DcmDspDataInfo): DcmDspDataFixedLength=true  # Diagnostics Data Import
        DID_D005_High_Quiescent_Current_Fault_Identification_Data_D005_1st_Functionality_Activity_Level_PNC27 (DcmDspData):  # Diagnostics Data Import
          DcmDspDataSize = 8
          DcmDspDataType = UINT8
          DcmDspDataInfoRef = DataInfo_DID_D005_High_Quiescent_Current_Fault_Identification_Data_D005_1st_Functionality_Activity_Level_PNC27
        DataInfo_DID_D005_High_Quiescent_Current_Fault_Identification_Data_D005_1st_Functionality_Activity_Level_PNC26 (DcmDspDataInfo): DcmDspDataFixedLength=true  # Diagnostics Data Import
        DID_D005_High_Quiescent_Current_Fault_Identification_Data_D005_1st_Functionality_Activity_Level_PNC26 (DcmDspData):  # Diagnostics Data Import
          DcmDspDataSize = 8
          DcmDspDataType = UINT8
          DcmDspDataInfoRef = DataInfo_DID_D005_High_Quiescent_Current_Fault_Identification_Data_D005_1st_Functionality_Activity_Level_PNC26
        DataInfo_DID_D005_High_Quiescent_Current_Fault_Identification_Data_D005_1st_Functionality_Activity_Level_PNC25 (DcmDspDataInfo): DcmDspDataFixedLength=true  # Diagnostics Data Import
        DID_D005_High_Quiescent_Current_Fault_Identification_Data_D005_1st_Functionality_Activity_Level_PNC25 (DcmDspData):  # Diagnostics Data Import
          DcmDspDataSize = 8
          DcmDspDataType = UINT8
          DcmDspDataInfoRef = DataInfo_DID_D005_High_Quiescent_Current_Fault_Identification_Data_D005_1st_Functionality_Activity_Level_PNC25
        DataInfo_DID_D005_High_Quiescent_Current_Fault_Identification_Data_D005_1st_Functionality_Activity_Level_PNC24 (DcmDspDataInfo): DcmDspDataFixedLength=true  # Diagnostics Data Import
        DID_D005_High_Quiescent_Current_Fault_Identification_Data_D005_1st_Functionality_Activity_Level_PNC24 (DcmDspData):  # Diagnostics Data Import
          DcmDspDataSize = 8
          DcmDspDataType = UINT8
          DcmDspDataInfoRef = DataInfo_DID_D005_High_Quiescent_Current_Fault_Identification_Data_D005_1st_Functionality_Activity_Level_PNC24
        DataInfo_DID_D005_High_Quiescent_Current_Fault_Identification_Data_DID_D005_2_1st_Global_time_when_Functionality_Activit6a6f0b62 (DcmDspDataInfo): DcmDspDataFixedLength=true  # Diagnostics Data Import
        DID_D005_High_Quiescent_Current_Fault_Identification_Data_DID_D005_2_1st_Global_time_when_Functionality_Activity_level_Sa38038bb (DcmDspData):  # Diagnostics Data Import
          DcmDspDataSize = 32
          DcmDspDataType = UINT32
          DcmDspDataInfoRef = DataInfo_DID_D005_High_Quiescent_Current_Fault_Identification_Data_DID_D005_2_1st_Global_time_when_Functionality_Activit6a6f0b62
        DataInfo_DID_D005_High_Quiescent_Current_Fault_Identification_Data_DID_D005_1_1st_System_Global_Time_the_time_when_the_D1ec8d60e (DcmDspDataInfo): DcmDspDataFixedLength=true  # Diagnostics Data Import
        DID_D005_High_Quiescent_Current_Fault_Identification_Data_DID_D005_1_1st_System_Global_Time_the_time_when_the_DID_is_triggered (DcmDspData):  # Diagnostics Data Import
          DcmDspDataSize = 32
          DcmDspDataType = UINT32
          DcmDspDataInfoRef = DataInfo_DID_D005_High_Quiescent_Current_Fault_Identification_Data_DID_D005_1_1st_System_Global_Time_the_time_when_the_D1ec8d60e
        DataInfo_DID_D003_Vehicle_Speed_DID_D003_Vehicle_Speed (DcmDspDataInfo): DcmDspDataFixedLength=true  # Diagnostics Data Import
        DID_D003_Vehicle_Speed_DID_D003_Vehicle_Speed (DcmDspData): DcmDspDataSize=16, DcmDspDataType=UINT16, DcmDspDataInfoRef=DataInfo_DID_D003_Vehicle_Speed_DID_D003_Vehicle_Speed  # Diagnostics Data Import
        DataInfo_DID_40E0_Secret_Key_Immobilizer_Target_3_DID_40DF_Secret_Key_Immobilizer_Target_2 (DcmDspDataInfo): DcmDspDataFixedLength=true  # Diagnostics Data Import
        DID_40E0_Secret_Key_Immobilizer_Target_3_DID_40DF_Secret_Key_Immobilizer_Target_2 (DcmDspData):  # Diagnostics Data Import
          DcmDspDataSize = 256
          DcmDspDataType = UINT8_N
          DcmDspDataInfoRef = DataInfo_DID_40E0_Secret_Key_Immobilizer_Target_3_DID_40DF_Secret_Key_Immobilizer_Target_2
      DcmDsd  # Diagnostics Data Import
        DcmDsdServiceTable  # Diagnostics Data Import
          9 x DcmDsdService:
            TesterPresent: DcmDsdSidTabServiceId=62, DcmDsdSidTabSubfuncAvail=true  # Diagnostics Data Import
              TesterPresent (DcmDsdSubService): DcmDsdSubServiceId=0  # Diagnostics Data Import
            RoutineControl: DcmDsdSidTabServiceId=49, DcmDsdSidTabSubfuncAvail=true, DcmDsdSidTabSessionLevelRef=defaultSession, DcmDsdSidTabSessionLevelRef=extendedDiagnosticSession  # Diagnostics Data Import
            WriteDataById: DcmDsdSidTabServiceId=46, DcmDsdSidTabSubfuncAvail=false, DcmDsdSidTabSessionLevelRef=extendedDiagnosticSession  # Diagnostics Data Import
            SecurityAccess: DcmDsdSidTabServiceId=39, DcmDsdSidTabSubfuncAvail=true, DcmDsdSidTabSessionLevelRef=extendedDiagnosticSession  # Diagnostics Data Import
              4 x DcmDsdSubService, all with DcmDsdSubServiceSessionLevelRef=extendedDiagnosticSession:
                Level_4_SendKeyImmo_Send: DcmDsdSubServiceId=18  # Diagnostics Data Import
                Level_4_RequestSeedImmo_Request: DcmDsdSubServiceId=17  # Diagnostics Data Import
                KeyLevel1_Send: DcmDsdSubServiceId=6  # Diagnostics Data Import
                SeedLevel1_Request: DcmDsdSubServiceId=5  # Diagnostics Data Import
            ReadDataById: DcmDsdSidTabServiceId=34, DcmDsdSidTabSubfuncAvail=false  # Diagnostics Data Import
            ReadDtcInfo: DcmDsdSidTabServiceId=25, DcmDsdSidTabSubfuncAvail=true, DcmDsdSidTabSessionLevelRef=defaultSession, DcmDsdSidTabSessionLevelRef=extendedDiagnosticSession  # Diagnostics Data Import
              5 x DcmDsdSubService, all with DcmDsdSubServiceSessionLevelRef=defaultSession, DcmDsdSubServiceSessionLevelRef=extendedDiagnosticSession:
                RSUPDTC: DcmDsdSubServiceId=10  # Diagnostics Data Import
                RDTCEDRBDN: DcmDsdSubServiceId=6  # Diagnostics Data Import
                RDTCSSBDTC: DcmDsdSubServiceId=4  # Diagnostics Data Import
                RDTCSSI: DcmDsdSubServiceId=3  # Diagnostics Data Import
                RDTCBSM: DcmDsdSubServiceId=2  # Diagnostics Data Import
            ClearDiagInfo: DcmDsdSidTabServiceId=20, DcmDsdSidTabSubfuncAvail=false, DcmDsdSidTabSessionLevelRef=defaultSession, DcmDsdSidTabSessionLevelRef=extendedDiagnosticSession  # Diagnostics Data Import
            EcuReset: DcmDsdSidTabServiceId=17, DcmDsdSidTabSubfuncAvail=true  # Diagnostics Data Import
              Hard (DcmDsdSubService): DcmDsdSubServiceId=1  # Diagnostics Data Import
            DiagSessionControl: DcmDsdSidTabServiceId=16, DcmDsdSidTabSubfuncAvail=true  # Diagnostics Data Import
              3 x DcmDsdSubService:
                Extended: DcmDsdSubServiceId=3, DcmDsdSubServiceSessionLevelRef=defaultSession, DcmDsdSubServiceSessionLevelRef=extendedDiagnosticSession  # Diagnostics Data Import
                Programming: DcmDsdSubServiceId=2  # Diagnostics Data Import
                Default: DcmDsdSubServiceId=1  # Diagnostics Data Import
      DcmGeneral  # Diagnostics Data Import
  module config Dem
    DemGeneral:  # Diagnostics Data Import
      DemAgingCycleCounterProcessing = DEM_PROCESS_AGINGCTR_INTERN
      DemDebounceCounterBasedSupport = true
      DemDtcStatusAvailabilityMask = 255
      DemEnableConditionSupport = true
      DemMaxNumberEventEntryMirror = 0
      DemPTOSupport = false
      DemTypeOfFreezeFrameRecordNumeration = DEM_FF_RECNUM_CALCULATED
      82 x DemDataClass:
        MaxDTCSinClear_MaxDTCSinClear: DemDataElementDataSize=1, DemDataElementInternalData=DEM_MAX_FDC_SINCE_LAST_CLEAR, DemDataElementUsePort=USE_DATA_INTERNAL  # Diagnostics Data Import
        MaxDTCDetCntThisCycle_MaxDTCDetCntThisCycle: DemDataElementDataSize=1, DemDataElementInternalData=DEM_MAX_FDC_DURING_CURRENT_CYCLE, DemDataElementUsePort=USE_DATA_INTERNAL  # Diagnostics Data Import
        DTCfaultdetectioncounter_DTCFltDetCnt: DemDataElementDataSize=1, DemDataElementInternalData=DEM_CURRENT_FDC, DemDataElementUsePort=USE_DATA_INTERNAL  # Diagnostics Data Import
        OperCycCnt6_OperCycCnt6: DemDataElementDataSize=1, DemDataElementInternalData=DEM_OCCCTR, DemDataElementUsePort=USE_DATA_INTERNAL  # Diagnostics Data Import
        OperCycCnt5_OperCycCnt5: DemDataElementDataSize=1, DemDataElementInternalData=DEM_OCCCTR, DemDataElementUsePort=USE_DATA_INTERNAL  # Diagnostics Data Import
        OperCycCnt4_OperCycCnt4: DemDataElementDataSize=1, DemDataElementInternalData=DEM_OCCCTR, DemDataElementUsePort=USE_DATA_INTERNAL  # Diagnostics Data Import
        OperCycCnt3_OperCycCnt3: DemDataElementDataSize=1, DemDataElementInternalData=DEM_OCCCTR, DemDataElementUsePort=USE_DATA_INTERNAL  # Diagnostics Data Import
        OperCycCnt2_OperCycCnt2: DemDataElementDataSize=1, DemDataElementInternalData=DEM_OCCCTR, DemDataElementUsePort=USE_DATA_INTERNAL  # Diagnostics Data Import
        OperCycCnt1_OperCycCnt1: DemDataElementDataSize=1, DemDataElementInternalData=DEM_OCCCTR, DemDataElementUsePort=USE_DATA_INTERNAL  # Diagnostics Data Import
        DID_0xe333_2002_Lw: DemDataElementDataSize=1, DemDataElementDataType=UINT8_N, DemDataElementEndianness=opaque, DemDataElementUsePort=USE_DATA_CLIENT_SERVER_PORT, DemDataElementStoreNonVolatile=true  # Diagnostics Data Import
        DID_0xe333_2002_Lv: DemDataElementDataSize=1, DemDataElementDataType=UINT8_N, DemDataElementEndianness=opaque, DemDataElementUsePort=USE_DATA_CLIENT_SERVER_PORT, DemDataElementStoreNonVolatile=true  # Diagnostics Data Import
        DID_0xe333_2002_Lu: DemDataElementDataSize=1, DemDataElementDataType=UINT8_N, DemDataElementEndianness=opaque, DemDataElementUsePort=USE_DATA_CLIENT_SERVER_PORT, DemDataElementStoreNonVolatile=true  # Diagnostics Data Import
        DID_0xe333_2002_Hw: DemDataElementDataSize=1, DemDataElementDataType=UINT8_N, DemDataElementEndianness=opaque, DemDataElementUsePort=USE_DATA_CLIENT_SERVER_PORT, DemDataElementStoreNonVolatile=true  # Diagnostics Data Import
        DID_0xe333_2002_Hv: DemDataElementDataSize=1, DemDataElementDataType=UINT8_N, DemDataElementEndianness=opaque, DemDataElementUsePort=USE_DATA_CLIENT_SERVER_PORT, DemDataElementStoreNonVolatile=true  # Diagnostics Data Import
        DID_0xe333_2002_Hu: DemDataElementDataSize=1, DemDataElementDataType=UINT8_N, DemDataElementEndianness=opaque, DemDataElementUsePort=USE_DATA_CLIENT_SERVER_PORT, DemDataElementStoreNonVolatile=true  # Diagnostics Data Import
        DID_0xeed5_EED5_Safety_Torque_Quality_factor: DemDataElementDataSize=1, DemDataElementDataType=UINT8_N, DemDataElementEndianness=opaque, DemDataElementUsePort=USE_DATA_CLIENT_SERVER_PORT, DemDataElementStoreNonVolatile=true  # Diagnostics Data Import
        DID_0xeed4_DID_EED4_Safty_Function_Mode: DemDataElementDataSize=1, DemDataElementDataType=UINT8_N, DemDataElementEndianness=opaque, DemDataElementUsePort=USE_DATA_CLIENT_SERVER_PORT, DemDataElementStoreNonVolatile=true  # Diagnostics Data Import
        DID_0xe364_DID_E364_AURIX_Fault_Indication: DemDataElementDataSize=1, DemDataElementDataType=UINT8_N, DemDataElementEndianness=opaque, DemDataElementUsePort=USE_DATA_CLIENT_SERVER_PORT, DemDataElementStoreNonVolatile=true  # Diagnostics Data Import
        DID_0xdd01_DID_DD01_Total_Distance: DemDataElementDataSize=3, DemDataElementDataType=UINT8_N, DemDataElementEndianness=opaque, DemDataElementUsePort=USE_DATA_CLIENT_SERVER_PORT, DemDataElementStoreNonVolatile=true  # Diagnostics Data Import
        DTCTimeStamp21_DTCTimeStamp21: DemDataElementDataSize=4, DemDataElementDataType=UINT32, DemDataElementEndianness=BIG_ENDIAN, DemDataElementUsePort=USE_DATA_CLIENT_SERVER_PORT, DemDataElementStoreNonVolatile=true  # Diagnostics Data Import
        DTCTimeStamp20_DTCTimeStamp20: DemDataElementDataSize=4, DemDataElementDataType=UINT32, DemDataElementEndianness=BIG_ENDIAN, DemDataElementUsePort=USE_DATA_CLIENT_SERVER_PORT, DemDataElementStoreNonVolatile=true  # Diagnostics Data Import
        DID_0xdd00_DID_DD00_Global_Real_Time: DemDataElementDataSize=4, DemDataElementDataType=UINT32, DemDataElementEndianness=BIG_ENDIAN, DemDataElementUsePort=USE_DATA_CLIENT_SERVER_PORT, DemDataElementStoreNonVolatile=true  # Diagnostics Data Import
        DID_0xeed3_DID_EED3_Safety_speed: DemDataElementDataSize=2, DemDataElementDataType=UINT16, DemDataElementEndianness=BIG_ENDIAN, DemDataElementUsePort=USE_DATA_CLIENT_SERVER_PORT, DemDataElementStoreNonVolatile=true  # Diagnostics Data Import
        DID_0xeed2_DID_EED2_SaftyTorque: DemDataElementDataSize=2, DemDataElementDataType=UINT16, DemDataElementEndianness=BIG_ENDIAN, DemDataElementUsePort=USE_DATA_CLIENT_SERVER_PORT, DemDataElementStoreNonVolatile=true  # Diagnostics Data Import
        DID_0xeeb8_DID_EEB8_HV_voltage_received_from_BECM: DemDataElementDataSize=2, DemDataElementDataType=UINT16, DemDataElementEndianness=BIG_ENDIAN, DemDataElementUsePort=USE_DATA_CLIENT_SERVER_PORT, DemDataElementStoreNonVolatile=true  # Diagnostics Data Import
        DID_0xeeb7_DID_EEB7_ECM_Power_Limitation_minimum: DemDataElementDataSize=2, DemDataElementDataType=UINT16, DemDataElementEndianness=BIG_ENDIAN, DemDataElementUsePort=USE_DATA_CLIENT_SERVER_PORT, DemDataElementStoreNonVolatile=true  # Diagnostics Data Import
        DID_0xeeb6_DID_EEB6_ECM_Power_Limitation_maximum: DemDataElementDataSize=2, DemDataElementDataType=UINT16, DemDataElementEndianness=BIG_ENDIAN, DemDataElementUsePort=USE_DATA_CLIENT_SERVER_PORT, DemDataElementStoreNonVolatile=true  # Diagnostics Data Import
        DID_0xeeb5_DID_EEB5_IEMMGM_current_torque: DemDataElementDataSize=2, DemDataElementDataType=UINT16, DemDataElementEndianness=BIG_ENDIAN, DemDataElementUsePort=USE_DATA_CLIENT_SERVER_PORT, DemDataElementStoreNonVolatile=true  # Diagnostics Data Import
        DID_0xeeb2_DID_EEB2_Three_Phase_Motor_Current_RMS_Current: DemDataElementDataSize=2, DemDataElementDataType=UINT16, DemDataElementEndianness=BIG_ENDIAN, DemDataElementUsePort=USE_DATA_CLIENT_SERVER_PORT, DemDataElementStoreNonVolatile=true  # Diagnostics Data Import
        DID_0xee9e_DID_EE9E_Transient_Phase_Current_C: DemDataElementDataSize=2, DemDataElementDataType=UINT16, DemDataElementEndianness=BIG_ENDIAN, DemDataElementUsePort=USE_DATA_CLIENT_SERVER_PORT, DemDataElementStoreNonVolatile=true  # Diagnostics Data Import
        DID_0xee9d_DID_EE9D_Transient_Phase_Current_B: DemDataElementDataSize=2, DemDataElementDataType=UINT16, DemDataElementEndianness=BIG_ENDIAN, DemDataElementUsePort=USE_DATA_CLIENT_SERVER_PORT, DemDataElementStoreNonVolatile=true  # Diagnostics Data Import
        DID_0xee9c_DID_EE9C_Transient_Phase_Current_A: DemDataElementDataSize=2, DemDataElementDataType=UINT16, DemDataElementEndianness=BIG_ENDIAN, DemDataElementUsePort=USE_DATA_CLIENT_SERVER_PORT, DemDataElementStoreNonVolatile=true  # Diagnostics Data Import
        DID_0xe358_DID_E358_Resolve_angle: DemDataElementDataSize=2, DemDataElementDataType=UINT16, DemDataElementEndianness=BIG_ENDIAN, DemDataElementUsePort=USE_DATA_CLIENT_SERVER_PORT, DemDataElementStoreNonVolatile=true  # Diagnostics Data Import
        DID_0xe353_DID_E353_Flux_weakening_correction_factor: DemDataElementDataSize=2, DemDataElementDataType=UINT16, DemDataElementEndianness=BIG_ENDIAN, DemDataElementUsePort=USE_DATA_CLIENT_SERVER_PORT, DemDataElementStoreNonVolatile=true  # Diagnostics Data Import
        DID_0xe341_DID_E341_q_axis_voltage: DemDataElementDataSize=2, DemDataElementDataType=UINT16, DemDataElementEndianness=BIG_ENDIAN, DemDataElementUsePort=USE_DATA_CLIENT_SERVER_PORT, DemDataElementStoreNonVolatile=true  # Diagnostics Data Import
        DID_0xe339_DID_E339_d_axis_voltage: DemDataElementDataSize=2, DemDataElementDataType=UINT16, DemDataElementEndianness=BIG_ENDIAN, DemDataElementUsePort=USE_DATA_CLIENT_SERVER_PORT, DemDataElementStoreNonVolatile=true  # Diagnostics Data Import
        DID_0xe338_DID_E338_q_axis_current_feedback: DemDataElementDataSize=2, DemDataElementDataType=UINT16, DemDataElementEndianness=BIG_ENDIAN, DemDataElementUsePort=USE_DATA_CLIENT_SERVER_PORT, DemDataElementStoreNonVolatile=true  # Diagnostics Data Import
        DID_0xe337_DID_E337_q_axis_current_setpoint: DemDataElementDataSize=2, DemDataElementDataType=UINT16, DemDataElementEndianness=BIG_ENDIAN, DemDataElementUsePort=USE_DATA_CLIENT_SERVER_PORT, DemDataElementStoreNonVolatile=true  # Diagnostics Data Import
        DID_0xe336_DID_E336_d_axis_current_feedback: DemDataElementDataSize=2, DemDataElementDataType=UINT16, DemDataElementEndianness=BIG_ENDIAN, DemDataElementUsePort=USE_DATA_CLIENT_SERVER_PORT, DemDataElementStoreNonVolatile=true  # Diagnostics Data Import
        DID_0xe335_DID_E335_d_axis_current_setpoint: DemDataElementDataSize=2, DemDataElementDataType=UINT16, DemDataElementEndianness=BIG_ENDIAN, DemDataElementUsePort=USE_DATA_CLIENT_SERVER_PORT, DemDataElementStoreNonVolatile=true  # Diagnostics Data Import
        DID_0xe315_DID_E315_Available_Torque_minimum: DemDataElementDataSize=2, DemDataElementDataType=UINT16, DemDataElementEndianness=BIG_ENDIAN, DemDataElementUsePort=USE_DATA_CLIENT_SERVER_PORT, DemDataElementStoreNonVolatile=true  # Diagnostics Data Import
        DID_0xe314_DID_E314_Available_Torque_maximum: DemDataElementDataSize=2, DemDataElementDataType=UINT16, DemDataElementEndianness=BIG_ENDIAN, DemDataElementUsePort=USE_DATA_CLIENT_SERVER_PORT, DemDataElementStoreNonVolatile=true  # Diagnostics Data Import
        DID_0xe312_DID_E312_Wheel_Speed: DemDataElementDataSize=2, DemDataElementDataType=UINT16, DemDataElementEndianness=BIG_ENDIAN, DemDataElementUsePort=USE_DATA_CLIENT_SERVER_PORT, DemDataElementStoreNonVolatile=true  # Diagnostics Data Import
        DID_0xe308_DID_E308_ECM_Torque_Request: DemDataElementDataSize=2, DemDataElementDataType=UINT16, DemDataElementEndianness=BIG_ENDIAN, DemDataElementUsePort=USE_DATA_CLIENT_SERVER_PORT, DemDataElementStoreNonVolatile=true  # Diagnostics Data Import
        DID_0xe304_DID_E304_Actual_Torque: DemDataElementDataSize=2, DemDataElementDataType=UINT16, DemDataElementEndianness=BIG_ENDIAN, DemDataElementUsePort=USE_DATA_CLIENT_SERVER_PORT, DemDataElementStoreNonVolatile=true  # Diagnostics Data Import
        DID_0xe303_DID_E303_Motor_Speed_: DemDataElementDataSize=2, DemDataElementDataType=UINT16, DemDataElementEndianness=BIG_ENDIAN, DemDataElementUsePort=USE_DATA_CLIENT_SERVER_PORT, DemDataElementStoreNonVolatile=true  # Diagnostics Data Import
        DID_0xe301_DID_E301_HVDC_Current_: DemDataElementDataSize=2, DemDataElementDataType=UINT16, DemDataElementEndianness=BIG_ENDIAN, DemDataElementUsePort=USE_DATA_CLIENT_SERVER_PORT, DemDataElementStoreNonVolatile=true  # Diagnostics Data Import
        DID_0xe300_DID_E300_HVDC_Voltage: DemDataElementDataSize=2, DemDataElementDataType=UINT16, DemDataElementEndianness=BIG_ENDIAN, DemDataElementUsePort=USE_DATA_CLIENT_SERVER_PORT, DemDataElementStoreNonVolatile=true  # Diagnostics Data Import
        DID_0xd003_DID_D003_Vehicle_Speed: DemDataElementDataSize=2, DemDataElementDataType=UINT16, DemDataElementEndianness=BIG_ENDIAN, DemDataElementUsePort=USE_DATA_CLIENT_SERVER_PORT, DemDataElementStoreNonVolatile=true  # Diagnostics Data Import
        DID_0xe333_2002_L_Ser: DemDataElementDataSize=1, DemDataElementDataType=UINT8, DemDataElementUsePort=USE_DATA_CLIENT_SERVER_PORT, DemDataElementStoreNonVolatile=true  # Diagnostics Data Import
        DID_0xe333_2002_H_Ser: DemDataElementDataSize=1, DemDataElementDataType=UINT8, DemDataElementUsePort=USE_DATA_CLIENT_SERVER_PORT, DemDataElementStoreNonVolatile=true  # Diagnostics Data Import
        DID_0xeed1_EED1_3: DemDataElementDataSize=1, DemDataElementDataType=UINT8, DemDataElementUsePort=USE_DATA_CLIENT_SERVER_PORT, DemDataElementStoreNonVolatile=true  # Diagnostics Data Import
        DID_0xeed1_EED1_2: DemDataElementDataSize=1, DemDataElementDataType=UINT8, DemDataElementUsePort=USE_DATA_CLIENT_SERVER_PORT, DemDataElementStoreNonVolatile=true  # Diagnostics Data Import
        DID_0xeed1_EED1_1: DemDataElementDataSize=1, DemDataElementDataType=UINT8, DemDataElementUsePort=USE_DATA_CLIENT_SERVER_PORT, DemDataElementStoreNonVolatile=true  # Diagnostics Data Import
        DID_0xeed1_EED1_0: DemDataElementDataSize=1, DemDataElementDataType=UINT8, DemDataElementUsePort=USE_DATA_CLIENT_SERVER_PORT, DemDataElementStoreNonVolatile=true  # Diagnostics Data Import
        DTCStatusindicator30_DTCStatusindicator30: DemDataElementDataSize=1, DemDataElementDataType=UINT8, DemDataElementUsePort=USE_DATA_CLIENT_SERVER_PORT, DemDataElementStoreNonVolatile=true  # Diagnostics Data Import
        DID_0xeec4_DID_EEC4_Charging_Power_Sustain_RelayCPSR_Voltage: DemDataElementDataSize=1, DemDataElementDataType=UINT8, DemDataElementUsePort=USE_DATA_CLIENT_SERVER_PORT, DemDataElementStoreNonVolatile=true  # Diagnostics Data Import
        DID_0xeec3_DID_EEC3_ECU_power_supply_Voltage: DemDataElementDataSize=1, DemDataElementDataType=UINT8, DemDataElementUsePort=USE_DATA_CLIENT_SERVER_PORT, DemDataElementStoreNonVolatile=true  # Diagnostics Data Import
        DID_0xeebf_DID_EEBF_HV_Main_Relay_Status: DemDataElementDataSize=1, DemDataElementDataType=UINT8, DemDataElementUsePort=USE_DATA_CLIENT_SERVER_PORT, DemDataElementStoreNonVolatile=true  # Diagnostics Data Import
        DID_0xeebe_DID_EEBE_Offset_angle_status: DemDataElementDataSize=1, DemDataElementDataType=UINT8, DemDataElementUsePort=USE_DATA_CLIENT_SERVER_PORT, DemDataElementStoreNonVolatile=true  # Diagnostics Data Import
        DID_0xee9f_DID_EE9F_Gate_Status: DemDataElementDataSize=1, DemDataElementDataType=UINT8, DemDataElementUsePort=USE_DATA_CLIENT_SERVER_PORT, DemDataElementStoreNonVolatile=true  # Diagnostics Data Import
        DID_0xee9a_DID_EE9A_Inverter_Coolant_Temperature: DemDataElementDataSize=1, DemDataElementDataType=UINT8, DemDataElementUsePort=USE_DATA_CLIENT_SERVER_PORT, DemDataElementStoreNonVolatile=true  # Diagnostics Data Import
        DID_0xe363_DID_E363_Modulation_index: DemDataElementDataSize=1, DemDataElementDataType=UINT8, DemDataElementUsePort=USE_DATA_CLIENT_SERVER_PORT, DemDataElementStoreNonVolatile=true  # Diagnostics Data Import
        DID_0xe357_DID_E357_Resolve_compensated_angle: DemDataElementDataSize=1, DemDataElementDataType=UINT8, DemDataElementUsePort=USE_DATA_CLIENT_SERVER_PORT, DemDataElementStoreNonVolatile=true  # Diagnostics Data Import
        DID_0xe350_DID_E350_Phase_W_PWM_duty: DemDataElementDataSize=1, DemDataElementDataType=UINT8, DemDataElementUsePort=USE_DATA_CLIENT_SERVER_PORT, DemDataElementStoreNonVolatile=true  # Diagnostics Data Import
        DID_0xe349_DID_E349_Phase_V_PWM_duty: DemDataElementDataSize=1, DemDataElementDataType=UINT8, DemDataElementUsePort=USE_DATA_CLIENT_SERVER_PORT, DemDataElementStoreNonVolatile=true  # Diagnostics Data Import
        DID_0xe348_DID_E348_Phase_U_PWM_duty: DemDataElementDataSize=1, DemDataElementDataType=UINT8, DemDataElementUsePort=USE_DATA_CLIENT_SERVER_PORT, DemDataElementStoreNonVolatile=true  # Diagnostics Data Import
        DID_0xe347_DID_E347_IGBT_Max_Temperature: DemDataElementDataSize=1, DemDataElementDataType=UINT8, DemDataElementUsePort=USE_DATA_CLIENT_SERVER_PORT, DemDataElementStoreNonVolatile=true  # Diagnostics Data Import
        DID_0xe346_DID_E346_ECM_Torque_Allowed_Status: DemDataElementDataSize=1, DemDataElementDataType=UINT8, DemDataElementUsePort=USE_DATA_CLIENT_SERVER_PORT, DemDataElementStoreNonVolatile=true  # Diagnostics Data Import
        DID_0xe324_DID_E324_Motor_Derating_reason_of_IEMMGM: DemDataElementDataSize=1, DemDataElementDataType=UINT8, DemDataElementUsePort=USE_DATA_CLIENT_SERVER_PORT, DemDataElementStoreNonVolatile=true  # Diagnostics Data Import
        DID_0xe320_DID_E320_System_Mode_Mismatch: DemDataElementDataSize=1, DemDataElementDataType=UINT8, DemDataElementUsePort=USE_DATA_CLIENT_SERVER_PORT, DemDataElementStoreNonVolatile=true  # Diagnostics Data Import
        DID_0xe319_DID_E319_Torque_Direction: DemDataElementDataSize=1, DemDataElementDataType=UINT8, DemDataElementUsePort=USE_DATA_CLIENT_SERVER_PORT, DemDataElementStoreNonVolatile=true  # Diagnostics Data Import
        DID_0xe313_DID_E313_Active_discharge_status: DemDataElementDataSize=1, DemDataElementDataType=UINT8, DemDataElementUsePort=USE_DATA_CLIENT_SERVER_PORT, DemDataElementStoreNonVolatile=true  # Diagnostics Data Import
        DID_0xe311_DID_E311_Crash_Status: DemDataElementDataSize=1, DemDataElementDataType=UINT8, DemDataElementUsePort=USE_DATA_CLIENT_SERVER_PORT, DemDataElementStoreNonVolatile=true  # Diagnostics Data Import
        DID_0xe310_DID_E310_IEMMGM_Derating_Status: DemDataElementDataSize=1, DemDataElementDataType=UINT8, DemDataElementUsePort=USE_DATA_CLIENT_SERVER_PORT, DemDataElementStoreNonVolatile=true  # Diagnostics Data Import
        DID_0xe309_DID_E309_ECM_Mode_Request: DemDataElementDataSize=1, DemDataElementDataType=UINT8, DemDataElementUsePort=USE_DATA_CLIENT_SERVER_PORT, DemDataElementStoreNonVolatile=true  # Diagnostics Data Import
        DID_0xe307_DID_E307_System_Mode: DemDataElementDataSize=1, DemDataElementDataType=UINT8, DemDataElementUsePort=USE_DATA_CLIENT_SERVER_PORT, DemDataElementStoreNonVolatile=true  # Diagnostics Data Import
        DID_0xe306_DID_E306_Motor_Temperature: DemDataElementDataSize=1, DemDataElementDataType=UINT8, DemDataElementUsePort=USE_DATA_CLIENT_SERVER_PORT, DemDataElementStoreNonVolatile=true  # Diagnostics Data Import
        DID_0xe305_DID_E305_Inverter_IGBT_Junction_Temp: DemDataElementDataSize=1, DemDataElementDataType=UINT8, DemDataElementUsePort=USE_DATA_CLIENT_SERVER_PORT, DemDataElementStoreNonVolatile=true  # Diagnostics Data Import
        DID_0xdd0c_DID_DD0C_Electric_Power_Level: DemDataElementDataSize=1, DemDataElementDataType=UINT8, DemDataElementUsePort=USE_DATA_CLIENT_SERVER_PORT, DemDataElementStoreNonVolatile=true  # Diagnostics Data Import
        DID_0xdd0a_DID_DD0A_Usage_Mode: DemDataElementDataSize=1, DemDataElementDataType=UINT8, DemDataElementUsePort=USE_DATA_CLIENT_SERVER_PORT, DemDataElementStoreNonVolatile=true  # Diagnostics Data Import
        DID_0xdd02_DID_DD02_Vehicle_Battery_Voltage: DemDataElementDataSize=1, DemDataElementDataType=UINT8, DemDataElementUsePort=USE_DATA_CLIENT_SERVER_PORT, DemDataElementStoreNonVolatile=true  # Diagnostics Data Import
      IgnitionCycle (DemOperationCycle): DemOperationCycleType=DEM_OPCYC_IGNITION  # Diagnostics Data Import
      PowerCycle (DemOperationCycle): DemOperationCycleType=DEM_OPCYC_POWER  # Diagnostics Data Import
      WarningIndicator (DemIndicator)  # Diagnostics Data Import
      4 x DemFreezeFrameClass, all with DemDidClassRef=DemGeneral/DID_D003_Vehicle_Speed, DemDidClassRef=DemGeneral/DID_DD00_Global_Real_Time, DemDidClassRef=DemGeneral/DID_DD01_Total_Distance, DemDidClassRef=DemGeneral/DID_DD0A_Usage_Mode, DemDidClassRef=DemGeneral/DID_DD0C_Electric_Power_Level, DemDidClassRef=DemGeneral/DID_E303_Motor_Speed, DemDidClassRef=DemGeneral/DID_E304_Actual_Torque, DemDidClassRef=DemGeneral/DID_E307_System_Mode, DemDidClassRef=DemGeneral/DID_E308_ECM_Torque_Request, DemDidClassRef=DemGeneral/DID_E309_ECM_Mode_Request, DemDidClassRef=DemGeneral/DID_E310_IEM_MGM_Derating_Status, DemDidClassRef=DemGeneral/DID_E312_Wheel_Speed, DemDidClassRef=DemGeneral/DID_E314_Available_Torque_maximum, DemDidClassRef=DemGeneral/DID_E315_Available_Torque_minimum, DemDidClassRef=DemGeneral/DID_E333_2002_State, DemDidClassRef=DemGeneral/DID_E335_d_axis_current_setpoint, DemDidClassRef=DemGeneral/DID_E336_d_axis_current_feedback, DemDidClassRef=DemGeneral/DID_E337_q_axis_current_setpoint, DemDidClassRef=DemGeneral/DID_E338_q_axis_current_feedback, DemDidClassRef=DemGeneral/DID_E346_ECM_Torque_Allowed_Status, DemDidClassRef=DemGeneral/DID_EE9A_Inverter_Coolant_Temperature, DemDidClassRef=DemGeneral/DID_EEB2_Three_Phase_Motor_Current_RMS_Current:
        FreezeFrameClass_dc4c3f47: DemDidClassRef=DemGeneral/DID_EEB8_HV_voltage_received_from_BECM, DemDidClassRef=DemGeneral/DID_EEBF_HV_Main_Relay_Status, DemDidClassRef=DemGeneral/DID_EEC3_ECU_power_supply_Voltage, DemDidClassRef=DemGeneral/DID_EEC4_Charging_Power_Sustain_Relay_CPSR_Voltage  # Diagnostics Data Import
        FreezeFrameClass_c3111450: DemDidClassRef=DemGeneral/DID_DD02_Vehicle_Battery_Voltage, DemDidClassRef=DemGeneral/DID_E300_HVDC_Voltage, DemDidClassRef=DemGeneral/DID_E301_HVDC_Current, DemDidClassRef=DemGeneral/DID_E305_Inverter_IGBT_Junction_Temp, DemDidClassRef=DemGeneral/DID_E306_Motor_Temperature, DemDidClassRef=DemGeneral/DID_E311_Crash_Status, DemDidClassRef=DemGeneral/DID_E313_Active_discharge_status, DemDidClassRef=DemGeneral/DID_E319_Torque_Direction, DemDidClassRef=DemGeneral/DID_E320_System_Mode_Mismatch, DemDidClassRef=DemGeneral/DID_E324_Motor_Derating_reason_of_IEM_MGM, DemDidClassRef=DemGeneral/DID_E339_d_axis_voltage, DemDidClassRef=DemGeneral/DID_E341_q_axis_voltage, DemDidClassRef=DemGeneral/DID_E347_IGBT_Max_Temperature, DemDidClassRef=DemGeneral/DID_E348_Phase_U_PWM_duty, DemDidClassRef=DemGeneral/DID_E349_Phase_V_PWM_duty, DemDidClassRef=DemGeneral/DID_E350_Phase_W_PWM_duty, DemDidClassRef=DemGeneral/DID_E353_Flux_weakening_correction_factor, DemDidClassRef=DemGeneral/DID_E357_Resolve_compensated_angle, DemDidClassRef=DemGeneral/DID_E358_Resolve_angle, DemDidClassRef=DemGeneral/DID_E363_Modulation_index, DemDidClassRef=DemGeneral/DID_E364_AURIX_Fault_Indication, DemDidClassRef=DemGeneral/DID_EE9C_Transient_Phase_Current_A, DemDidClassRef=DemGeneral/DID_EE9D_Transient_Phase_Current_B, DemDidClassRef=DemGeneral/DID_EE9E_Transient_Phase_Current_C, DemDidClassRef=DemGeneral/DID_EE9F_Gate_Status, DemDidClassRef=DemGeneral/DID_EEB5_IEM_MGM_current_torque, DemDidClassRef=DemGeneral/DID_EEB6_ECM_Power_Limitation_maximum, DemDidClassRef=DemGeneral/DID_EEB7_ECM_Power_Limitation_minimum, DemDidClassRef=DemGeneral/DID_EEB8_HV_voltage_received_from_BECM, DemDidClassRef=DemGeneral/DID_EEBE_Offset_angle_status, DemDidClassRef=DemGeneral/DID_EEBF_HV_Main_Relay_Status, DemDidClassRef=DemGeneral/DID_EEC3_ECU_power_supply_Voltage, DemDidClassRef=DemGeneral/DID_EEC4_Charging_Power_Sustain_Relay_CPSR_Voltage  # Diagnostics Data Import
        FreezeFrameClass_79980272: DemDidClassRef=DemGeneral/DID_DD02_Vehicle_Battery_Voltage, DemDidClassRef=DemGeneral/DID_E300_HVDC_Voltage, DemDidClassRef=DemGeneral/DID_E301_HVDC_Current, DemDidClassRef=DemGeneral/DID_E305_Inverter_IGBT_Junction_Temp, DemDidClassRef=DemGeneral/DID_E306_Motor_Temperature, DemDidClassRef=DemGeneral/DID_E311_Crash_Status, DemDidClassRef=DemGeneral/DID_E313_Active_discharge_status, DemDidClassRef=DemGeneral/DID_E319_Torque_Direction, DemDidClassRef=DemGeneral/DID_E320_System_Mode_Mismatch, DemDidClassRef=DemGeneral/DID_E324_Motor_Derating_reason_of_IEM_MGM, DemDidClassRef=DemGeneral/DID_E339_d_axis_voltage, DemDidClassRef=DemGeneral/DID_E341_q_axis_voltage, DemDidClassRef=DemGeneral/DID_E347_IGBT_Max_Temperature, DemDidClassRef=DemGeneral/DID_E348_Phase_U_PWM_duty, DemDidClassRef=DemGeneral/DID_E349_Phase_V_PWM_duty, DemDidClassRef=DemGeneral/DID_E350_Phase_W_PWM_duty, DemDidClassRef=DemGeneral/DID_E353_Flux_weakening_correction_factor, DemDidClassRef=DemGeneral/DID_E357_Resolve_compensated_angle, DemDidClassRef=DemGeneral/DID_E358_Resolve_angle, DemDidClassRef=DemGeneral/DID_E363_Modulation_index, DemDidClassRef=DemGeneral/DID_E364_AURIX_Fault_Indication, DemDidClassRef=DemGeneral/DID_EE9C_Transient_Phase_Current_A, DemDidClassRef=DemGeneral/DID_EE9D_Transient_Phase_Current_B, DemDidClassRef=DemGeneral/DID_EE9E_Transient_Phase_Current_C, DemDidClassRef=DemGeneral/DID_EE9F_Gate_Status, DemDidClassRef=DemGeneral/DID_EEB5_IEM_MGM_current_torque  # Diagnostics Data Import
        FreezeFrameClass_5b6f811c: DemDidClassRef=DemGeneral/DID_DD02_Vehicle_Battery_Voltage, DemDidClassRef=DemGeneral/DID_E300_HVDC_Voltage, DemDidClassRef=DemGeneral/DID_E301_HVDC_Current, DemDidClassRef=DemGeneral/DID_E305_Inverter_IGBT_Junction_Temp, DemDidClassRef=DemGeneral/DID_E306_Motor_Temperature, DemDidClassRef=DemGeneral/DID_E311_Crash_Status, DemDidClassRef=DemGeneral/DID_E313_Active_discharge_status, DemDidClassRef=DemGeneral/DID_E319_Torque_Direction, DemDidClassRef=DemGeneral/DID_E320_System_Mode_Mismatch, DemDidClassRef=DemGeneral/DID_E324_Motor_Derating_reason_of_IEM_MGM, DemDidClassRef=DemGeneral/DID_E339_d_axis_voltage, DemDidClassRef=DemGeneral/DID_E341_q_axis_voltage, DemDidClassRef=DemGeneral/DID_E347_IGBT_Max_Temperature, DemDidClassRef=DemGeneral/DID_E348_Phase_U_PWM_duty, DemDidClassRef=DemGeneral/DID_E349_Phase_V_PWM_duty, DemDidClassRef=DemGeneral/DID_E350_Phase_W_PWM_duty, DemDidClassRef=DemGeneral/DID_E353_Flux_weakening_correction_factor, DemDidClassRef=DemGeneral/DID_E357_Resolve_compensated_angle, DemDidClassRef=DemGeneral/DID_E358_Resolve_angle, DemDidClassRef=DemGeneral/DID_E363_Modulation_index, DemDidClassRef=DemGeneral/DID_E364_AURIX_Fault_Indication, DemDidClassRef=DemGeneral/DID_EE9C_Transient_Phase_Current_A, DemDidClassRef=DemGeneral/DID_EE9D_Transient_Phase_Current_B, DemDidClassRef=DemGeneral/DID_EE9E_Transient_Phase_Current_C, DemDidClassRef=DemGeneral/DID_EE9F_Gate_Status, DemDidClassRef=DemGeneral/DID_EEB5_IEM_MGM_current_torque, DemDidClassRef=DemGeneral/DID_EEB6_ECM_Power_Limitation_maximum, DemDidClassRef=DemGeneral/DID_EEB7_ECM_Power_Limitation_minimum, DemDidClassRef=DemGeneral/DID_EEB8_HV_voltage_received_from_BECM, DemDidClassRef=DemGeneral/DID_EEBE_Offset_angle_status, DemDidClassRef=DemGeneral/DID_EEBF_HV_Main_Relay_Status, DemDidClassRef=DemGeneral/DID_EEC3_ECU_power_supply_Voltage, DemDidClassRef=DemGeneral/DID_EEC4_Charging_Power_Sustain_Relay_CPSR_Voltage, DemDidClassRef=DemGeneral/DID_EED1_Safty_monitor_Fault_Indication, DemDidClassRef=DemGeneral/DID_0xEEC7_1, DemDidClassRef=DemGeneral/DID_EED3_Safety_speed, DemDidClassRef=DemGeneral/DID_EED4_Safty_Function_Mode, DemDidClassRef=DemGeneral/DID_EED5_Safety_Torque_QF_factor  # Diagnostics Data Import
      12 x DemExtendedDataRecordClass:
        DTCStatusindicator30: DemExtendedDataRecordNumber=48, DemDataClassRef=DTCStatusindicator30_DTCStatusindicator30  # Diagnostics Data Import
        DTCTimeStamp21: DemExtendedDataRecordNumber=33, DemDataClassRef=DTCTimeStamp21_DTCTimeStamp21  # Diagnostics Data Import
        DTCTimeStamp20: DemExtendedDataRecordNumber=32, DemDataClassRef=DTCTimeStamp20_DTCTimeStamp20  # Diagnostics Data Import
        MaxDTCSinClear: DemExtendedDataRecordNumber=18, DemDataClassRef=MaxDTCSinClear_MaxDTCSinClear  # Diagnostics Data Import
        MaxDTCDetCntThisCycle: DemExtendedDataRecordNumber=17, DemDataClassRef=MaxDTCDetCntThisCycle_MaxDTCDetCntThisCycle  # Diagnostics Data Import
        DTCfaultdetectioncounter: DemExtendedDataRecordNumber=16, DemDataClassRef=DTCfaultdetectioncounter_DTCFltDetCnt  # Diagnostics Data Import
        OperCycCnt6: DemExtendedDataRecordNumber=6, DemDataClassRef=OperCycCnt6_OperCycCnt6  # Diagnostics Data Import
        OperCycCnt5: DemExtendedDataRecordNumber=5, DemDataClassRef=OperCycCnt5_OperCycCnt5  # Diagnostics Data Import
        OperCycCnt4: DemExtendedDataRecordNumber=4, DemDataClassRef=OperCycCnt4_OperCycCnt4  # Diagnostics Data Import
        OperCycCnt3: DemExtendedDataRecordNumber=3, DemDataClassRef=OperCycCnt3_OperCycCnt3  # Diagnostics Data Import
        OperCycCnt2: DemExtendedDataRecordNumber=2, DemDataClassRef=OperCycCnt2_OperCycCnt2  # Diagnostics Data Import
        OperCycCnt1: DemExtendedDataRecordNumber=1, DemDataClassRef=OperCycCnt1_OperCycCnt1  # Diagnostics Data Import
      34 x DemEnableConditionGroup:
        EnableConditionGroup_fecd1d5c: DemEnableConditionRef=KL15, DemEnableConditionRef=SPI, DemEnableConditionRef=active, DemEnableConditionRef=faults, DemEnableConditionRef=no_001  # Diagnostics Data Import
        EnableConditionGroup_f496e085: DemEnableConditionRef=KL15, DemEnableConditionRef=active  # Diagnostics Data Import
        EnableConditionGroup_f2368ecb: DemEnableConditionRef=CU, DemEnableConditionRef=CU, DemEnableConditionRef=Inverter, DemEnableConditionRef=KL15, DemEnableConditionRef=LV, DemEnableConditionRef=No, DemEnableConditionRef=No, DemEnableConditionRef=active, DemEnableConditionRef=done, DemEnableConditionRef=fault, DemEnableConditionRef=fault, DemEnableConditionRef=high, DemEnableConditionRef=initliazation, DemEnableConditionRef=is, DemEnableConditionRef=low, DemEnableConditionRef=range, DemEnableConditionRef=range, DemEnableConditionRef=temp, DemEnableConditionRef=temp  # Diagnostics Data Import
        EnableConditionGroup_e2fc0f3d: DemEnableConditionRef=DemGeneral/INV_IAC_U_ELEC_HI, DemEnableConditionRef=DemGeneral/INV_IAC_U_ELEC_LO, DemEnableConditionRef=DemGeneral/INV_IAC_V_ELEC_HI, DemEnableConditionRef=DemGeneral/INV_IAC_V_ELEC_LO, DemEnableConditionRef=DemGeneral/INV_IAC_W_ELEC_HI, DemEnableConditionRef=DemGeneral/INV_IAC_W_ELEC_LO, DemEnableConditionRef=Inverter, DemEnableConditionRef=LV, DemEnableConditionRef=No, DemEnableConditionRef=No, DemEnableConditionRef=No, DemEnableConditionRef=done, DemEnableConditionRef=initliazation, DemEnableConditionRef=is  # Diagnostics Data Import
        EnableConditionGroup_d8c05f30: DemEnableConditionRef=HVAC, DemEnableConditionRef=Inverter, DemEnableConditionRef=KL15, DemEnableConditionRef=LV, DemEnableConditionRef=NO_002, DemEnableConditionRef=SpdAct, DemEnableConditionRef=abs, DemEnableConditionRef=active, DemEnableConditionRef=current, DemEnableConditionRef=done, DemEnableConditionRef=fault, DemEnableConditionRef=initliazation, DemEnableConditionRef=is, DemEnableConditionRef=rpm, DemEnableConditionRef=sensor  # Diagnostics Data Import
        EnableConditionGroup_d38dfb27: DemEnableConditionRef=Inverter, DemEnableConditionRef=KL15, DemEnableConditionRef=LV, DemEnableConditionRef=P5, DemEnableConditionRef=active, DemEnableConditionRef=done, DemEnableConditionRef=initliazation, DemEnableConditionRef=is, DemEnableConditionRef=normallye, DemEnableConditionRef=work  # Diagnostics Data Import
        EnableConditionGroup_d13c1487: DemEnableConditionRef=E, DemEnableConditionRef=Inverter, DemEnableConditionRef=KL15, DemEnableConditionRef=LV, DemEnableConditionRef=No, DemEnableConditionRef=active, DemEnableConditionRef=done, DemEnableConditionRef=faults, DemEnableConditionRef=initliazation, DemEnableConditionRef=is, DemEnableConditionRef=motor, DemEnableConditionRef=sensor  # Diagnostics Data Import
        EnableConditionGroup_c56dc4a6: DemEnableConditionRef=KL15, DemEnableConditionRef=active, DemEnableConditionRef=init, DemEnableConditionRef=test  # Diagnostics Data Import
        EnableConditionGroup_b321d2d1: DemEnableConditionRef=Bulk, DemEnableConditionRef=Car_001, DemEnableConditionRef=Configuration, DemEnableConditionRef=ECU, DemEnableConditionRef=Enabled, DemEnableConditionRef=Test_001, DemEnableConditionRef=Test_001, DemEnableConditionRef=a_001, DemEnableConditionRef=block, DemEnableConditionRef=each, DemEnableConditionRef=in, DemEnableConditionRef=inhibited, DemEnableConditionRef=is, DemEnableConditionRef=is, DemEnableConditionRef=is, DemEnableConditionRef=once, DemEnableConditionRef=passed, DemEnableConditionRef=received, DemEnableConditionRef=runs, DemEnableConditionRef=state, DemEnableConditionRef=time, DemEnableConditionRef=while  # Diagnostics Data Import
        EnableConditionGroup_9e78dd86: DemEnableConditionRef=Inverter, DemEnableConditionRef=KL15, DemEnableConditionRef=LV, DemEnableConditionRef=No, DemEnableConditionRef=P5, DemEnableConditionRef=active, DemEnableConditionRef=current, DemEnableConditionRef=done, DemEnableConditionRef=faults, DemEnableConditionRef=initliazation, DemEnableConditionRef=is, DemEnableConditionRef=normally, DemEnableConditionRef=sensor, DemEnableConditionRef=work  # Diagnostics Data Import
        EnableConditionGroup_90577524: DemEnableConditionRef=DemGeneral/INV_EM_STATOR_TEMP_RNG_HI, DemEnableConditionRef=DemGeneral/INV_EM_STATOR_TEMP_RNG_LO, DemEnableConditionRef=Inverter, DemEnableConditionRef=KL15, DemEnableConditionRef=LV, DemEnableConditionRef=No, DemEnableConditionRef=No, DemEnableConditionRef=active, DemEnableConditionRef=done, DemEnableConditionRef=initliazation, DemEnableConditionRef=is  # Diagnostics Data Import
        EnableConditionGroup_87177a06: DemEnableConditionRef=CU, DemEnableConditionRef=Inverter, DemEnableConditionRef=KL15, DemEnableConditionRef=LV, DemEnableConditionRef=active, DemEnableConditionRef=done, DemEnableConditionRef=faulte, DemEnableConditionRef=initliazation, DemEnableConditionRef=is, DemEnableConditionRef=no_001, DemEnableConditionRef=sensor, DemEnableConditionRef=temp  # Diagnostics Data Import
        EnableConditionGroup_830522f7: DemEnableConditionRef=AND, DemEnableConditionRef=Driving, DemEnableConditionRef=Ubat, DemEnableConditionRef=UsageMode, DemEnableConditionRef=V  # Diagnostics Data Import
        EnableConditionGroup_7cfce1b1: DemEnableConditionRef=Inverter, DemEnableConditionRef=LV, DemEnableConditionRef=PS, DemEnableConditionRef=V, DemEnableConditionRef=done, DemEnableConditionRef=fault, DemEnableConditionRef=initliazation, DemEnableConditionRef=is, DemEnableConditionRef=no_001  # Diagnostics Data Import
        EnableConditionGroup_7ab46a93: DemEnableConditionRef=Inverter, DemEnableConditionRef=KL15, DemEnableConditionRef=LV, DemEnableConditionRef=active, DemEnableConditionRef=done, DemEnableConditionRef=initliazation, DemEnableConditionRef=is  # Diagnostics Data Import
        EnableConditionGroup_6f8868bd: DemEnableConditionRef=BusOff, DemEnableConditionRef=CAN, DemEnableConditionRef=KL15, DemEnableConditionRef=KL30, DemEnableConditionRef=Prop, DemEnableConditionRef=V, DemEnableConditionRef=Voltage9, DemEnableConditionRef=active, DemEnableConditionRef=no_001  # Diagnostics Data Import
        EnableConditionGroup_6698c395: DemEnableConditionRef=Inverter, DemEnableConditionRef=KL15, DemEnableConditionRef=LV, DemEnableConditionRef=active, DemEnableConditionRef=done, DemEnableConditionRef=error, DemEnableConditionRef=initliazation, DemEnableConditionRef=is, DemEnableConditionRef=no_001, DemEnableConditionRef=resolver  # Diagnostics Data Import
        EnableConditionGroup_5ab64ab8: DemEnableConditionRef=Inverter, DemEnableConditionRef=KL15, DemEnableConditionRef=LV, DemEnableConditionRef=P5, DemEnableConditionRef=active, DemEnableConditionRef=done, DemEnableConditionRef=fault, DemEnableConditionRef=initliazation, DemEnableConditionRef=is, DemEnableConditionRef=no_001  # Diagnostics Data Import
        EnableConditionGroup_57b85250: DemEnableConditionRef=CU_temp, DemEnableConditionRef=Inverter, DemEnableConditionRef=KL15, DemEnableConditionRef=LV, DemEnableConditionRef=No, DemEnableConditionRef=active, DemEnableConditionRef=done, DemEnableConditionRef=fault, DemEnableConditionRef=initliazation, DemEnableConditionRef=is  # Diagnostics Data Import
        EnableConditionGroup_500f9dc2: DemEnableConditionRef=Inverter, DemEnableConditionRef=KL15, DemEnableConditionRef=LV, DemEnableConditionRef=active, DemEnableConditionRef=control, DemEnableConditionRef=done, DemEnableConditionRef=in, DemEnableConditionRef=initliazation, DemEnableConditionRef=is, DemEnableConditionRef=mode, DemEnableConditionRef=system, DemEnableConditionRef=torque  # Diagnostics Data Import
        EnableConditionGroup_4c1ef766: DemEnableConditionRef=Inverter, DemEnableConditionRef=KL15, DemEnableConditionRef=LV, DemEnableConditionRef=No, DemEnableConditionRef=P15, DemEnableConditionRef=P5, DemEnableConditionRef=active, DemEnableConditionRef=current, DemEnableConditionRef=done, DemEnableConditionRef=faults, DemEnableConditionRef=initliazation, DemEnableConditionRef=is, DemEnableConditionRef=normally, DemEnableConditionRef=sensor, DemEnableConditionRef=work  # Diagnostics Data Import
        EnableConditionGroup_3b30fb61: DemEnableConditionRef=Request, DemEnableConditionRef=active, DemEnableConditionRef=active, DemEnableConditionRef=discharge, DemEnableConditionRef=for, DemEnableConditionRef=is  # Diagnostics Data Import
        EnableConditionGroup_377893c9: DemEnableConditionRef=A, DemEnableConditionRef=A, DemEnableConditionRef=All_001, DemEnableConditionRef=All_001, DemEnableConditionRef=Crash, DemEnableConditionRef=DTC, DemEnableConditionRef=DTC, DemEnableConditionRef=DTC, DemEnableConditionRef=DTC, DemEnableConditionRef=ECU, DemEnableConditionRef=ECU, DemEnableConditionRef=ElPowerLevel, DemEnableConditionRef=Factory, DemEnableConditionRef=The_001, DemEnableConditionRef=The_001, DemEnableConditionRef=The_001, DemEnableConditionRef=Transport, DemEnableConditionRef=When, DemEnableConditionRef=a_001, DemEnableConditionRef=according, DemEnableConditionRef=active, DemEnableConditionRef=all, DemEnableConditionRef=and_001, DemEnableConditionRef=another, DemEnableConditionRef=any, DemEnableConditionRef=any, DemEnableConditionRef=as, DemEnableConditionRef=at, DemEnableConditionRef=availability, DemEnableConditionRef=be, DemEnableConditionRef=be, DemEnableConditionRef=be, DemEnableConditionRef=be, DemEnableConditionRef=be, DemEnableConditionRef=below, DemEnableConditionRef=below, DemEnableConditionRef=bus, DemEnableConditionRef=by, DemEnableConditionRef=car, DemEnableConditionRef=car, DemEnableConditionRef=car, DemEnableConditionRef=car, DemEnableConditionRef=change, DemEnableConditionRef=consumption, DemEnableConditionRef=criteria, DemEnableConditionRef=during, DemEnableConditionRef=electrical, DemEnableConditionRef=enters, DemEnableConditionRef=exceptions, DemEnableConditionRef=exit, DemEnableConditionRef=for, DemEnableConditionRef=from, DemEnableConditionRef=from, DemEnableConditionRef=fulfilled, DemEnableConditionRef=generic, DemEnableConditionRef=in, DemEnableConditionRef=in, DemEnableConditionRef=indicated, DemEnableConditionRef=inhibited, DemEnableConditionRef=inhibited, DemEnableConditionRef=inhibited, DemEnableConditionRef=inhibition, DemEnableConditionRef=is, DemEnableConditionRef=is, DemEnableConditionRef=is, DemEnableConditionRef=is, DemEnableConditionRef=limited, DemEnableConditionRef=mode, DemEnableConditionRef=mode, DemEnableConditionRef=mode, DemEnableConditionRef=modes, DemEnableConditionRef=notational, DemEnableConditionRef=of, DemEnableConditionRef=of, DemEnableConditionRef=of, DemEnableConditionRef=off, DemEnableConditionRef=one, DemEnableConditionRef=operation, DemEnableConditionRef=or, DemEnableConditionRef=or, DemEnableConditionRef=power, DemEnableConditionRef=requested, DemEnableConditionRef=run, DemEnableConditionRef=run, DemEnableConditionRef=s, DemEnableConditionRef=s, DemEnableConditionRef=seconds, DemEnableConditionRef=set, DemEnableConditionRef=shall, DemEnableConditionRef=shall, DemEnableConditionRef=shall, DemEnableConditionRef=shall, DemEnableConditionRef=shall, DemEnableConditionRef=shall, DemEnableConditionRef=shall, DemEnableConditionRef=signal, DemEnableConditionRef=start, DemEnableConditionRef=state, DemEnableConditionRef=test, DemEnableConditionRef=tests, DemEnableConditionRef=tests, DemEnableConditionRef=tests, DemEnableConditionRef=tests, DemEnableConditionRef=that, DemEnableConditionRef=the, DemEnableConditionRef=the, DemEnableConditionRef=the, DemEnableConditionRef=the, DemEnableConditionRef=the, DemEnableConditionRef=the, DemEnableConditionRef=the, DemEnableConditionRef=time, DemEnableConditionRef=to, DemEnableConditionRef=to, DemEnableConditionRef=transition, DemEnableConditionRef=vehicle, DemEnableConditionRef=when_001, DemEnableConditionRef=when_001, DemEnableConditionRef=when_001, DemEnableConditionRef=with  # Diagnostics Data Import
        EnableConditionGroup_361fad53: DemEnableConditionRef=IGBT, DemEnableConditionRef=Inverter, DemEnableConditionRef=LV, DemEnableConditionRef=No, DemEnableConditionRef=No, DemEnableConditionRef=control, DemEnableConditionRef=current, DemEnableConditionRef=done, DemEnableConditionRef=error, DemEnableConditionRef=faults, DemEnableConditionRef=faults, DemEnableConditionRef=in, DemEnableConditionRef=initliazation, DemEnableConditionRef=is, DemEnableConditionRef=mode, DemEnableConditionRef=no_001, DemEnableConditionRef=resolver, DemEnableConditionRef=sensor, DemEnableConditionRef=system, DemEnableConditionRef=torque  # Diagnostics Data Import
        EnableConditionGroup_30df4d87: DemEnableConditionRef=Inverter, DemEnableConditionRef=KL15, DemEnableConditionRef=LV, DemEnableConditionRef=No, DemEnableConditionRef=active, DemEnableConditionRef=done, DemEnableConditionRef=fault, DemEnableConditionRef=initliazation, DemEnableConditionRef=is, DemEnableConditionRef=resolver  # Diagnostics Data Import
        EnableConditionGroup_2747052a: DemEnableConditionRef=Inverter, DemEnableConditionRef=KL15, DemEnableConditionRef=LV, DemEnableConditionRef=P5, DemEnableConditionRef=active, DemEnableConditionRef=done, DemEnableConditionRef=initliazation, DemEnableConditionRef=is, DemEnableConditionRef=normally, DemEnableConditionRef=work  # Diagnostics Data Import
        EnableConditionGroup_16bf7de5: DemEnableConditionRef=ECU, DemEnableConditionRef=Every, DemEnableConditionRef=a_001, DemEnableConditionRef=configuration_001, DemEnableConditionRef=configuration_001, DemEnableConditionRef=for, DemEnableConditionRef=global, DemEnableConditionRef=is, DemEnableConditionRef=of, DemEnableConditionRef=parameter, DemEnableConditionRef=passed, DemEnableConditionRef=received, DemEnableConditionRef=test, DemEnableConditionRef=the, DemEnableConditionRef=time, DemEnableConditionRef=until, DemEnableConditionRef=used  # Diagnostics Data Import
        EnableConditionGroup_14eabb2c: DemEnableConditionRef=Inverter, DemEnableConditionRef=LV, DemEnableConditionRef=done, DemEnableConditionRef=initliazation, DemEnableConditionRef=is  # Diagnostics Data Import
        EnableConditionGroup_1027fc3a: DemEnableConditionRef=Inverter, DemEnableConditionRef=KL15, DemEnableConditionRef=LV, DemEnableConditionRef=P15, DemEnableConditionRef=active, DemEnableConditionRef=done, DemEnableConditionRef=fault, DemEnableConditionRef=initliazation, DemEnableConditionRef=is, DemEnableConditionRef=no_001  # Diagnostics Data Import
        EnableConditionGroup_0e207db3: DemEnableConditionRef=ASC, DemEnableConditionRef=IGBT, DemEnableConditionRef=Inverter, DemEnableConditionRef=LV, DemEnableConditionRef=Nm, DemEnableConditionRef=No, DemEnableConditionRef=No, DemEnableConditionRef=Not, DemEnableConditionRef=Request, DemEnableConditionRef=control, DemEnableConditionRef=current, DemEnableConditionRef=done, DemEnableConditionRef=error, DemEnableConditionRef=faults, DemEnableConditionRef=faults, DemEnableConditionRef=in, DemEnableConditionRef=in, DemEnableConditionRef=initliazation, DemEnableConditionRef=is, DemEnableConditionRef=mode, DemEnableConditionRef=no_001, DemEnableConditionRef=not_001, DemEnableConditionRef=resolver, DemEnableConditionRef=sensor, DemEnableConditionRef=system, DemEnableConditionRef=torque, DemEnableConditionRef=toruqe  # Diagnostics Data Import
        EnableConditionGroup_0d30bf3f: DemEnableConditionRef=AND, DemEnableConditionRef=Inverter, DemEnableConditionRef=KL15, DemEnableConditionRef=LV, DemEnableConditionRef=SpdAct, DemEnableConditionRef=abs, DemEnableConditionRef=active, DemEnableConditionRef=any, DemEnableConditionRef=done, DemEnableConditionRef=error, DemEnableConditionRef=in, DemEnableConditionRef=initliazation, DemEnableConditionRef=is, DemEnableConditionRef=no_001, DemEnableConditionRef=offset, DemEnableConditionRef=phase, DemEnableConditionRef=rpm  # Diagnostics Data Import
        EnableConditionGroup_0cc796ea: DemEnableConditionRef=KL15, DemEnableConditionRef=active, DemEnableConditionRef=in, DemEnableConditionRef=mode, DemEnableConditionRef=mode, DemEnableConditionRef=operation  # Diagnostics Data Import
        EnableConditionGroup_06a6aa19: DemEnableConditionRef=KL15, DemEnableConditionRef=KL30, DemEnableConditionRef=V, DemEnableConditionRef=Voltage9, DemEnableConditionRef=active  # Diagnostics Data Import
        EnableConditionGroup_02c4dcbd: DemEnableConditionRef=Inverter, DemEnableConditionRef=LV, DemEnableConditionRef=control, DemEnableConditionRef=done, DemEnableConditionRef=in, DemEnableConditionRef=initliazation, DemEnableConditionRef=is, DemEnableConditionRef=mode, DemEnableConditionRef=system, DemEnableConditionRef=torque  # Diagnostics Data Import
      ExtendedDataClass_5ecd55b9 (DemExtendedDataClass):  # Diagnostics Data Import
        DemExtendedDataRecordClassRef = OperCycCnt{1..6}
        DemExtendedDataRecordClassRef = DTCfaultdetectioncounter
        DemExtendedDataRecordClassRef = MaxDTCDetCntThisCycle
        DemExtendedDataRecordClassRef = MaxDTCSinClear
        DemExtendedDataRecordClassRef = DTCTimeStamp20
        DemExtendedDataRecordClassRef = DTCTimeStamp21
        DemExtendedDataRecordClassRef = DTCStatusindicator30
      155 x DemEnableCondition:
        until  # Diagnostics Data Import
        used  # Diagnostics Data Import
        parameter  # Diagnostics Data Import
        configuration_001  # Diagnostics Data Import
        global  # Diagnostics Data Import
        Every  # Diagnostics Data Import
        passed  # Diagnostics Data Import
        once  # Diagnostics Data Import
        received  # Diagnostics Data Import
        block  # Diagnostics Data Import
        Configuration  # Diagnostics Data Import
        Car_001  # Diagnostics Data Import
        each  # Diagnostics Data Import
        runs  # Diagnostics Data Import
        Test_001  # Diagnostics Data Import
        Bulk  # Diagnostics Data Import
        while  # Diagnostics Data Import
        Enabled  # Diagnostics Data Import
        Crash  # Diagnostics Data Import
        Transport  # Diagnostics Data Import
        Factory  # Diagnostics Data Import
        modes  # Diagnostics Data Import
        set  # Diagnostics Data Import
        vehicle  # Diagnostics Data Import
        s  # Diagnostics Data Import
        and_001  # Diagnostics Data Import
        requested  # Diagnostics Data Import
        change  # Diagnostics Data Import
        a_001  # Diagnostics Data Import
        signal  # Diagnostics Data Import
        of  # Diagnostics Data Import
        consumption  # Diagnostics Data Import
        notational  # Diagnostics Data Import
        at  # Diagnostics Data Import
        start  # Diagnostics Data Import
        inhibition  # Diagnostics Data Import
        another  # Diagnostics Data Import
        car  # Diagnostics Data Import
        one  # Diagnostics Data Import
        transition  # Diagnostics Data Import
        from  # Diagnostics Data Import
        seconds  # Diagnostics Data Import
        during  # Diagnostics Data Import
        All_001  # Diagnostics Data Import
        ElPowerLevel  # Diagnostics Data Import
        by  # Diagnostics Data Import
        indicated  # Diagnostics Data Import
        as  # Diagnostics Data Import
        limited  # Diagnostics Data Import
        availability  # Diagnostics Data Import
        power  # Diagnostics Data Import
        electrical  # Diagnostics Data Import
        when_001  # Diagnostics Data Import
        inhibited  # Diagnostics Data Import
        to  # Diagnostics Data Import
        according  # Diagnostics Data Import
        exceptions  # Diagnostics Data Import
        with  # Diagnostics Data Import
        that  # Diagnostics Data Import
        time  # Diagnostics Data Import
        all  # Diagnostics Data Import
        tests  # Diagnostics Data Import
        DTC  # Diagnostics Data Import
        fulfilled  # Diagnostics Data Import
        be  # Diagnostics Data Import
        shall  # Diagnostics Data Import
        below  # Diagnostics Data Import
        A  # Diagnostics Data Import
        criteria  # Diagnostics Data Import
        run  # Diagnostics Data Import
        generic  # Diagnostics Data Import
        The_001  # Diagnostics Data Import
        state  # Diagnostics Data Import
        off  # Diagnostics Data Import
        bus  # Diagnostics Data Import
        exit  # Diagnostics Data Import
        or  # Diagnostics Data Import
        enters  # Diagnostics Data Import
        ECU  # Diagnostics Data Import
        the  # Diagnostics Data Import
        When  # Diagnostics Data Import
        BusOff  # Diagnostics Data Import
        CAN  # Diagnostics Data Import
        Prop  # Diagnostics Data Import
        test  # Diagnostics Data Import
        init  # Diagnostics Data Import
        operation  # Diagnostics Data Import
        HVAC  # Diagnostics Data Import
        NO_002  # Diagnostics Data Import
        discharge  # Diagnostics Data Import
        for  # Diagnostics Data Import
        PS  # Diagnostics Data Import
        faulte  # Diagnostics Data Import
        CU_temp  # Diagnostics Data Import
        low  # Diagnostics Data Import
        high  # Diagnostics Data Import
        range  # Diagnostics Data Import
        temp  # Diagnostics Data Import
        CU  # Diagnostics Data Import
        motor  # Diagnostics Data Import
        E  # Diagnostics Data Import
        SPI  # Diagnostics Data Import
        fault  # Diagnostics Data Import
        P15  # Diagnostics Data Import
        not_001  # Diagnostics Data Import
        Nm  # Diagnostics Data Import
        toruqe  # Diagnostics Data Import
        Request  # Diagnostics Data Import
        ASC  # Diagnostics Data Import
        Not  # Diagnostics Data Import
        resolver  # Diagnostics Data Import
        IGBT  # Diagnostics Data Import
        faults  # Diagnostics Data Import
        sensor  # Diagnostics Data Import
        current  # Diagnostics Data Import
        Driving  # Diagnostics Data Import
        UsageMode  # Diagnostics Data Import
        Ubat  # Diagnostics Data Import
        INV_IAC_W_ELEC_LO  # Diagnostics Data Import
        INV_IAC_W_ELEC_HI  # Diagnostics Data Import
        INV_IAC_V_ELEC_LO  # Diagnostics Data Import
        INV_IAC_V_ELEC_HI  # Diagnostics Data Import
        INV_IAC_U_ELEC_LO  # Diagnostics Data Import
        INV_IAC_U_ELEC_HI  # Diagnostics Data Import
        normallye  # Diagnostics Data Import
        normally  # Diagnostics Data Import
        work  # Diagnostics Data Import
        P5  # Diagnostics Data Import
        mode  # Diagnostics Data Import
        control  # Diagnostics Data Import
        torque  # Diagnostics Data Import
        system  # Diagnostics Data Import
        phase  # Diagnostics Data Import
        any  # Diagnostics Data Import
        in  # Diagnostics Data Import
        error  # Diagnostics Data Import
        offset  # Diagnostics Data Import
        no_001  # Diagnostics Data Import
        AND  # Diagnostics Data Import
        rpm  # Diagnostics Data Import
        SpdAct  # Diagnostics Data Import
        abs  # Diagnostics Data Import
        INV_EM_STATOR_TEMP_RNG_LO  # Diagnostics Data Import
        INV_EM_STATOR_TEMP_RNG_HI  # Diagnostics Data Import
        No  # Diagnostics Data Import
        V  # Diagnostics Data Import
        Voltage9  # Diagnostics Data Import
        KL30  # Diagnostics Data Import
        done  # Diagnostics Data Import
        is  # Diagnostics Data Import
        initliazation  # Diagnostics Data Import
        LV  # Diagnostics Data Import
        Inverter  # Diagnostics Data Import
        active  # Diagnostics Data Import
        KL15  # Diagnostics Data Import
      60 x DemDidClass:
        DID_EED5_Safety_Torque_QF_factor: DemDidIdentifier=61141, DemDidDataClassRef=DID_0xeed5_EED5_Safety_Torque_Quality_factor  # Diagnostics Data Import
        DID_EED4_Safty_Function_Mode: DemDidIdentifier=61140, DemDidDataClassRef=DID_0xeed4_DID_EED4_Safty_Function_Mode  # Diagnostics Data Import
        DID_EED3_Safety_speed: DemDidIdentifier=61139, DemDidDataClassRef=DID_0xeed3_DID_EED3_Safety_speed  # Diagnostics Data Import
        DID_0xEEC7_1: DemDidIdentifier=61138, DemDidDataClassRef=DID_0xeed2_DID_EED2_SaftyTorque  # Diagnostics Data Import
        DID_EED1_Safty_monitor_Fault_Indication: DemDidIdentifier=61137, DemDidDataClassRef=DID_0xeed1_EED1_0, DemDidDataClassRef=DID_0xeed1_EED1_1, DemDidDataClassRef=DID_0xeed1_EED1_2, DemDidDataClassRef=DID_0xeed1_EED1_3  # Diagnostics Data Import
        DID_EEC4_Charging_Power_Sustain_Relay_CPSR_Voltage: DemDidIdentifier=61124, DemDidDataClassRef=DID_0xeec4_DID_EEC4_Charging_Power_Sustain_RelayCPSR_Voltage  # Diagnostics Data Import
        DID_EEC3_ECU_power_supply_Voltage: DemDidIdentifier=61123, DemDidDataClassRef=DID_0xeec3_DID_EEC3_ECU_power_supply_Voltage  # Diagnostics Data Import
        DID_EEBF_HV_Main_Relay_Status: DemDidIdentifier=61119, DemDidDataClassRef=DID_0xeebf_DID_EEBF_HV_Main_Relay_Status  # Diagnostics Data Import
        DID_EEBE_Offset_angle_status: DemDidIdentifier=61118, DemDidDataClassRef=DID_0xeebe_DID_EEBE_Offset_angle_status  # Diagnostics Data Import
        DID_EEB8_HV_voltage_received_from_BECM: DemDidIdentifier=61112, DemDidDataClassRef=DID_0xeeb8_DID_EEB8_HV_voltage_received_from_BECM  # Diagnostics Data Import
        DID_EEB7_ECM_Power_Limitation_minimum: DemDidIdentifier=61111, DemDidDataClassRef=DID_0xeeb7_DID_EEB7_ECM_Power_Limitation_minimum  # Diagnostics Data Import
        DID_EEB6_ECM_Power_Limitation_maximum: DemDidIdentifier=61110, DemDidDataClassRef=DID_0xeeb6_DID_EEB6_ECM_Power_Limitation_maximum  # Diagnostics Data Import
        DID_EEB5_IEM_MGM_current_torque: DemDidIdentifier=61109, DemDidDataClassRef=DID_0xeeb5_DID_EEB5_IEMMGM_current_torque  # Diagnostics Data Import
        DID_EEB2_Three_Phase_Motor_Current_RMS_Current: DemDidIdentifier=61106, DemDidDataClassRef=DID_0xeeb2_DID_EEB2_Three_Phase_Motor_Current_RMS_Current  # Diagnostics Data Import
        DID_EE9F_Gate_Status: DemDidIdentifier=61087, DemDidDataClassRef=DID_0xee9f_DID_EE9F_Gate_Status  # Diagnostics Data Import
        DID_EE9E_Transient_Phase_Current_C: DemDidIdentifier=61086, DemDidDataClassRef=DID_0xee9e_DID_EE9E_Transient_Phase_Current_C  # Diagnostics Data Import
        DID_EE9D_Transient_Phase_Current_B: DemDidIdentifier=61085, DemDidDataClassRef=DID_0xee9d_DID_EE9D_Transient_Phase_Current_B  # Diagnostics Data Import
        DID_EE9C_Transient_Phase_Current_A: DemDidIdentifier=61084, DemDidDataClassRef=DID_0xee9c_DID_EE9C_Transient_Phase_Current_A  # Diagnostics Data Import
        DID_EE9A_Inverter_Coolant_Temperature: DemDidIdentifier=61082, DemDidDataClassRef=DID_0xee9a_DID_EE9A_Inverter_Coolant_Temperature  # Diagnostics Data Import
        DID_E364_AURIX_Fault_Indication: DemDidIdentifier=58212, DemDidDataClassRef=DID_0xe364_DID_E364_AURIX_Fault_Indication  # Diagnostics Data Import
        DID_E363_Modulation_index: DemDidIdentifier=58211, DemDidDataClassRef=DID_0xe363_DID_E363_Modulation_index  # Diagnostics Data Import
        DID_E358_Resolve_angle: DemDidIdentifier=58200, DemDidDataClassRef=DID_0xe358_DID_E358_Resolve_angle  # Diagnostics Data Import
        DID_E357_Resolve_compensated_angle: DemDidIdentifier=58199, DemDidDataClassRef=DID_0xe357_DID_E357_Resolve_compensated_angle  # Diagnostics Data Import
        DID_E353_Flux_weakening_correction_factor: DemDidIdentifier=58195, DemDidDataClassRef=DID_0xe353_DID_E353_Flux_weakening_correction_factor  # Diagnostics Data Import
        DID_E350_Phase_W_PWM_duty: DemDidIdentifier=58192, DemDidDataClassRef=DID_0xe350_DID_E350_Phase_W_PWM_duty  # Diagnostics Data Import
        DID_E349_Phase_V_PWM_duty: DemDidIdentifier=58185, DemDidDataClassRef=DID_0xe349_DID_E349_Phase_V_PWM_duty  # Diagnostics Data Import
        DID_E348_Phase_U_PWM_duty: DemDidIdentifier=58184, DemDidDataClassRef=DID_0xe348_DID_E348_Phase_U_PWM_duty  # Diagnostics Data Import
        DID_E347_IGBT_Max_Temperature: DemDidIdentifier=58183, DemDidDataClassRef=DID_0xe347_DID_E347_IGBT_Max_Temperature  # Diagnostics Data Import
        DID_E346_ECM_Torque_Allowed_Status: DemDidIdentifier=58182, DemDidDataClassRef=DID_0xe346_DID_E346_ECM_Torque_Allowed_Status  # Diagnostics Data Import
        DID_E341_q_axis_voltage: DemDidIdentifier=58177, DemDidDataClassRef=DID_0xe341_DID_E341_q_axis_voltage  # Diagnostics Data Import
        DID_E339_d_axis_voltage: DemDidIdentifier=58169, DemDidDataClassRef=DID_0xe339_DID_E339_d_axis_voltage  # Diagnostics Data Import
        DID_E338_q_axis_current_feedback: DemDidIdentifier=58168, DemDidDataClassRef=DID_0xe338_DID_E338_q_axis_current_feedback  # Diagnostics Data Import
        DID_E337_q_axis_current_setpoint: DemDidIdentifier=58167, DemDidDataClassRef=DID_0xe337_DID_E337_q_axis_current_setpoint  # Diagnostics Data Import
        DID_E336_d_axis_current_feedback: DemDidIdentifier=58166, DemDidDataClassRef=DID_0xe336_DID_E336_d_axis_current_feedback  # Diagnostics Data Import
        DID_E335_d_axis_current_setpoint: DemDidIdentifier=58165, DemDidDataClassRef=DID_0xe335_DID_E335_d_axis_current_setpoint  # Diagnostics Data Import
        DID_E333_2002_State: DemDidIdentifier=58163, DemDidDataClassRef=DID_0xe333_2002_Hu, DemDidDataClassRef=DID_0xe333_2002_Hv, DemDidDataClassRef=DID_0xe333_2002_Hw, DemDidDataClassRef=DID_0xe333_2002_Lu, DemDidDataClassRef=DID_0xe333_2002_Lv, DemDidDataClassRef=DID_0xe333_2002_Lw, DemDidDataClassRef=DID_0xe333_2002_H_Ser, DemDidDataClassRef=DID_0xe333_2002_L_Ser  # Diagnostics Data Import
        DID_E324_Motor_Derating_reason_of_IEM_MGM: DemDidIdentifier=58148, DemDidDataClassRef=DID_0xe324_DID_E324_Motor_Derating_reason_of_IEMMGM  # Diagnostics Data Import
        DID_E320_System_Mode_Mismatch: DemDidIdentifier=58144, DemDidDataClassRef=DID_0xe320_DID_E320_System_Mode_Mismatch  # Diagnostics Data Import
        DID_E319_Torque_Direction: DemDidIdentifier=58137, DemDidDataClassRef=DID_0xe319_DID_E319_Torque_Direction  # Diagnostics Data Import
        DID_E315_Available_Torque_minimum: DemDidIdentifier=58133, DemDidDataClassRef=DID_0xe315_DID_E315_Available_Torque_minimum  # Diagnostics Data Import
        DID_E314_Available_Torque_maximum: DemDidIdentifier=58132, DemDidDataClassRef=DID_0xe314_DID_E314_Available_Torque_maximum  # Diagnostics Data Import
        DID_E313_Active_discharge_status: DemDidIdentifier=58131, DemDidDataClassRef=DID_0xe313_DID_E313_Active_discharge_status  # Diagnostics Data Import
        DID_E312_Wheel_Speed: DemDidIdentifier=58130, DemDidDataClassRef=DID_0xe312_DID_E312_Wheel_Speed  # Diagnostics Data Import
        DID_E311_Crash_Status: DemDidIdentifier=58129, DemDidDataClassRef=DID_0xe311_DID_E311_Crash_Status  # Diagnostics Data Import
        DID_E310_IEM_MGM_Derating_Status: DemDidIdentifier=58128, DemDidDataClassRef=DID_0xe310_DID_E310_IEMMGM_Derating_Status  # Diagnostics Data Import
        DID_E309_ECM_Mode_Request: DemDidIdentifier=58121, DemDidDataClassRef=DID_0xe309_DID_E309_ECM_Mode_Request  # Diagnostics Data Import
        DID_E308_ECM_Torque_Request: DemDidIdentifier=58120, DemDidDataClassRef=DID_0xe308_DID_E308_ECM_Torque_Request  # Diagnostics Data Import
        DID_E307_System_Mode: DemDidIdentifier=58119, DemDidDataClassRef=DID_0xe307_DID_E307_System_Mode  # Diagnostics Data Import
        DID_E306_Motor_Temperature: DemDidIdentifier=58118, DemDidDataClassRef=DID_0xe306_DID_E306_Motor_Temperature  # Diagnostics Data Import
        DID_E305_Inverter_IGBT_Junction_Temp: DemDidIdentifier=58117, DemDidDataClassRef=DID_0xe305_DID_E305_Inverter_IGBT_Junction_Temp  # Diagnostics Data Import
        DID_E304_Actual_Torque: DemDidIdentifier=58116, DemDidDataClassRef=DID_0xe304_DID_E304_Actual_Torque  # Diagnostics Data Import
        DID_E303_Motor_Speed: DemDidIdentifier=58115, DemDidDataClassRef=DID_0xe303_DID_E303_Motor_Speed_  # Diagnostics Data Import
        DID_E301_HVDC_Current: DemDidIdentifier=58113, DemDidDataClassRef=DID_0xe301_DID_E301_HVDC_Current_  # Diagnostics Data Import
        DID_E300_HVDC_Voltage: DemDidIdentifier=58112, DemDidDataClassRef=DID_0xe300_DID_E300_HVDC_Voltage  # Diagnostics Data Import
        DID_DD0C_Electric_Power_Level: DemDidIdentifier=56588, DemDidDataClassRef=DID_0xdd0c_DID_DD0C_Electric_Power_Level  # Diagnostics Data Import
        DID_DD0A_Usage_Mode: DemDidIdentifier=56586, DemDidDataClassRef=DID_0xdd0a_DID_DD0A_Usage_Mode  # Diagnostics Data Import
        DID_DD02_Vehicle_Battery_Voltage: DemDidIdentifier=56578, DemDidDataClassRef=DID_0xdd02_DID_DD02_Vehicle_Battery_Voltage  # Diagnostics Data Import
        DID_DD01_Total_Distance: DemDidIdentifier=56577, DemDidDataClassRef=DID_0xdd01_DID_DD01_Total_Distance  # Diagnostics Data Import
        DID_DD00_Global_Real_Time: DemDidIdentifier=56576, DemDidDataClassRef=DID_0xdd00_DID_DD00_Global_Real_Time  # Diagnostics Data Import
        DID_D003_Vehicle_Speed: DemDidIdentifier=53251, DemDidDataClassRef=DID_0xd003_DID_D003_Vehicle_Speed  # Diagnostics Data Import
    DemConfigSet  # Diagnostics Data Import
      PS_KL30_PLAUS (DemEventParameter):  # Diagnostics Data Import
        DemEventKind = DEM_EVENT_KIND_SWC
        DemMaxNumberFreezeFrameRecords = 2
        DemDTCClassRef = DTCClass_PS_KL30_PLAUS
        DemExtendedDataClassRef = ExtendedDataClass_5ecd55b9
        DemFreezeFrameClassRef = FreezeFrameClass_c3111450
        DemEventClass:  # Diagnostics Data Import
          DemAgingAllowed = true
          DemAgingCycleCounterThreshold = 255
          DemEventDestination = DEM_DTC_ORIGIN_PRIMARY_MEMORY
          DemEventPriority = 2
          DemEventFailureCycleCounterThreshold = 0
          DemAgingCycleRef = PowerCycle
          DemEnableConditionGroupRef = EnableConditionGroup_830522f7
          DemOperationCycleRef = PowerCycle
          IndicatorAttribute_WarningIndicator (DemIndicatorAttribute): DemIndicatorFailureCycleSource=DEM_FAILURE_CYCLE_EVENT, DemIndicatorHealingCycleRef=PowerCycle, DemIndicatorRef=WarningIndicator  # Diagnostics Data Import
          DemDebounceAlgorithmClass  # Diagnostics Data Import
            DemDebounceCounterBased: DemDebounceCounterDecrementStepSize=128, DemDebounceCounterIncrementStepSize=127, DemDebounceCounterJumpDown=true, DemDebounceCounterJumpUp=true  # Diagnostics Data Import
      DTCClass_PS_KL30_PLAUS (DemDTCClass): DemDTCSeverity=DEM_DTC_SEV_MAINTENANCE_ONLY, DemUdsDTC=15729506  # Diagnostics Data Import
      VcEvChkSumHvSysRlySts (DemEventParameter):  # Diagnostics Data Import
        DemEventKind = DEM_EVENT_KIND_SWC
        DemMaxNumberFreezeFrameRecords = 2
        DemDTCClassRef = DTCClass_VcEvChkSumHvSysRlySts
        DemExtendedDataClassRef = ExtendedDataClass_5ecd55b9
        DemFreezeFrameClassRef = FreezeFrameClass_c3111450
        DemEventClass:  # Diagnostics Data Import
          DemAgingAllowed = true
          DemAgingCycleCounterThreshold = 40
          DemEventDestination = DEM_DTC_ORIGIN_PRIMARY_MEMORY
          DemEventPriority = 1
          DemEventFailureCycleCounterThreshold = 0
          DemAgingCycleRef = PowerCycle
          DemEnableConditionGroupRef = EnableConditionGroup_06a6aa19
          DemOperationCycleRef = PowerCycle
          IndicatorAttribute_WarningIndicator (DemIndicatorAttribute): DemIndicatorFailureCycleSource=DEM_FAILURE_CYCLE_EVENT, DemIndicatorHealingCycleRef=PowerCycle, DemIndicatorRef=WarningIndicator  # Diagnostics Data Import
          DemDebounceAlgorithmClass  # Diagnostics Data Import
            DemDebounceCounterBased: DemDebounceCounterDecrementStepSize=128, DemDebounceCounterIncrementStepSize=127, DemDebounceCounterJumpDown=true, DemDebounceCounterJumpUp=true  # Diagnostics Data Import
      DTCClass_VcEvChkSumHvSysRlySts (DemDTCClass): DemDTCSeverity=DEM_DTC_SEV_IMMEDIATELY, DemUdsDTC=15672195  # Diagnostics Data Import
      VcEvCntrHvSysRlySts (DemEventParameter):  # Diagnostics Data Import
        DemEventKind = DEM_EVENT_KIND_SWC
        DemMaxNumberFreezeFrameRecords = 2
        DemDTCClassRef = DTCClass_VcEvCntrHvSysRlySts
        DemExtendedDataClassRef = ExtendedDataClass_5ecd55b9
        DemFreezeFrameClassRef = FreezeFrameClass_c3111450
        DemEventClass:  # Diagnostics Data Import
          DemAgingAllowed = true
          DemAgingCycleCounterThreshold = 40
          DemEventDestination = DEM_DTC_ORIGIN_PRIMARY_MEMORY
          DemEventPriority = 1
          DemEventFailureCycleCounterThreshold = 0
          DemAgingCycleRef = PowerCycle
          DemEnableConditionGroupRef = EnableConditionGroup_06a6aa19
          DemOperationCycleRef = PowerCycle
          IndicatorAttribute_WarningIndicator (DemIndicatorAttribute): DemIndicatorFailureCycleSource=DEM_FAILURE_CYCLE_EVENT, DemIndicatorHealingCycleRef=PowerCycle, DemIndicatorRef=WarningIndicator  # Diagnostics Data Import
          DemDebounceAlgorithmClass  # Diagnostics Data Import
            DemDebounceCounterBased: DemDebounceCounterDecrementStepSize=128, DemDebounceCounterIncrementStepSize=127, DemDebounceCounterJumpDown=true, DemDebounceCounterJumpUp=true  # Diagnostics Data Import
      DTCClass_VcEvCntrHvSysRlySts (DemDTCClass): DemDTCSeverity=DEM_DTC_SEV_MAINTENANCE_ONLY, DemUdsDTC=15672194  # Diagnostics Data Import

[part 1 of 5: package /InitialEcuC]
AUTOSAR XML (schema 4-2-2)
package /InitialEcuC
  ecuc value collection InitialEcuC: ecuc-values=[Can, CanIf, CanNm, CanSM, CanTp, Com, ComM, Dcm, Dem, EcuC, EcuM, Nm, PduR]
  module config Can
    CanConfigSet
      PropulsionCAN_6c6185ef (CanController):
        CanControllerActivation = true
        CanControllerDefaultBaudrate = CanControllerBaudrateConfig
        CanControllerSystemRef = PropulsionCAN
        CanWakeupSourceRef = EcuMCommonConfiguration/PropulsionCAN_IEM_19020f5a
        CanControllerBaudrateConfig: CanControllerBaudRate=500
      PropulsionCAN_IEM_19020f5a_Tx (CanHardwareObject): CanHandleType=BASIC, CanIdValue=0, CanObjectType=TRANSMIT, CanControllerRef=CanConfigSet/PropulsionCAN_6c6185ef
      PropulsionCAN_IEM_751e9595_Rx (CanHardwareObject): CanHandleType=BASIC, CanIdType=STANDARD, CanIdValue=0, CanObjectType=RECEIVE, CanControllerRef=CanConfigSet/PropulsionCAN_6c6185ef
    CanGeneral: CanIndex=0
  module config CanIf
    CanIfCtrlDrvCfg_7d254554 (CanIfCtrlDrvCfg): CanIfCtrlDrvInitHohConfigRef=CanIfInitHohCfg, CanIfCtrlDrvNameRef=CanGeneral
      PropulsionCAN_6c6185ef (CanIfCtrlCfg): CanIfCtrlCanCtrlRef=CanConfigSet/PropulsionCAN_6c6185ef
    CanIfInitCfg
      PropulsionCAN_c77d42b7 (CanIfBufferCfg): CanIfBufferSize=0, CanIfBufferHthRef=CanIfInitHohCfg/PropulsionCAN_IEM_19020f5a_Tx
      CanIfInitHohCfg: CanIfInitRefCfgSet=CanConfigSet
        PropulsionCAN_IEM_751e9595_Rx (CanIfHrhCfg): CanIfHrhCanCtrlIdRef=CanIfCtrlDrvCfg_7d254554/PropulsionCAN_6c6185ef, CanIfHrhIdSymRef=CanConfigSet/PropulsionCAN_IEM_751e9595_Rx
        PropulsionCAN_IEM_19020f5a_Tx (CanIfHthCfg): CanIfHthCanCtrlIdRef=CanIfCtrlDrvCfg_7d254554/PropulsionCAN_6c6185ef, CanIfHthIdSymRef=CanConfigSet/PropulsionCAN_IEM_19020f5a_Tx
      31 x CanIfRxPduCfg, all with CanIfRxPduCanIdType=STANDARD_NO_FD_CAN, CanIfRxPduDlc=8, CanIfRxPduHrhIdRef=CanIfInitHohCfg/PropulsionCAN_IEM_751e9595_Rx:
        BecmPropSignalIpdu01_76d31607_Rx: CanIfRxPduCanId=321, CanIfRxPduUserRxIndicationName=PduR_CanIfRxIndication, CanIfRxPduUserRxIndicationUL=PDUR, CanIfRxPduRef=EcucPduCollection/BecmPropSignalIpdu01_e4f1b6c7_Rx
        BecmPropSignalIpdu02_4ba4c578_Rx: CanIfRxPduCanId=373, CanIfRxPduUserRxIndicationName=PduR_CanIfRxIndication, CanIfRxPduUserRxIndicationUL=PDUR, CanIfRxPduRef=EcucPduCollection/BecmPropSignalIpdu02_a919b6a0_Rx
        BecmPropSignalIpdu03_e9a68992_Rx: CanIfRxPduCanId=376, CanIfRxPduUserRxIndicationName=PduR_CanIfRxIndication, CanIfRxPduUserRxIndicationUL=PDUR, CanIfRxPduRef=EcucPduCollection/BecmPropSignalIpdu03_24914b42_Rx
        BecmPropSignalIpdu15_d3342646_Rx: CanIfRxPduCanId=323, CanIfRxPduUserRxIndicationName=PduR_CanIfRxIndication, CanIfRxPduUserRxIndicationUL=PDUR, CanIfRxPduRef=EcucPduCollection/BecmPropSignalIpdu15_f1c84025_Rx
        CddObcPropSignalIPdu01_e083acac_Rx: CanIfRxPduCanId=536, CanIfRxPduUserRxIndicationName=PduR_CanIfRxIndication, CanIfRxPduUserRxIndicationUL=PDUR, CanIfRxPduRef=EcucPduCollection/CddObcPropSignalIPdu01_1ee0577a_Rx
        ECMPropSignalIPDU02_51c8c183_Rx: CanIfRxPduCanId=102, CanIfRxPduUserRxIndicationName=PduR_CanIfRxIndication, CanIfRxPduUserRxIndicationUL=PDUR, CanIfRxPduRef=EcucPduCollection/ECMPropSignalIPDU02_2a2da2a9_Rx
        ECMPropSignalIPDU04_3d57323b_Rx: CanIfRxPduCanId=305, CanIfRxPduUserRxIndicationName=PduR_CanIfRxIndication, CanIfRxPduUserRxIndicationUL=PDUR, CanIfRxPduRef=EcucPduCollection/ECMPropSignalIPDU04_b1fda267_Rx
        ECMPropSignalIPDU05_2f6d9a8f_Rx: CanIfRxPduCanId=132, CanIfRxPduUserRxIndicationName=PduR_CanIfRxIndication, CanIfRxPduUserRxIndicationUL=PDUR, CanIfRxPduRef=EcucPduCollection/ECMPropSignalIPDU05_3c755f85_Rx
        ECMPropSignalIPDU06_d83cf7f3_Rx: CanIfRxPduCanId=328, CanIfRxPduUserRxIndicationName=PduR_CanIfRxIndication, CanIfRxPduUserRxIndicationUL=PDUR, CanIfRxPduRef=EcucPduCollection/ECMPropSignalIPDU06_719d5fe2_Rx
        EcmPropSignalIPDU08_d4897b05_Rx: CanIfRxPduCanId=369, CanIfRxPduUserRxIndicationName=PduR_CanIfRxIndication, CanIfRxPduUserRxIndicationUL=PDUR, CanIfRxPduRef=EcucPduCollection/EcmPropSignalIPDU08_f2c9e4fc_Rx
        EcmPropSignalIPDU11_9b78db2c_Rx: CanIfRxPduCanId=647, CanIfRxPduUserRxIndicationName=PduR_CanIfRxIndication, CanIfRxPduUserRxIndicationUL=PDUR, CanIfRxPduRef=EcucPduCollection/EcmPropSignalIPDU11_86a9e821_Rx
        EcmPropSignalIPDU28_97c4e73e_Rx: CanIfRxPduCanId=401, CanIfRxPduUserRxIndicationName=PduR_CanIfRxIndication, CanIfRxPduUserRxIndicationUL=PDUR, CanIfRxPduRef=EcucPduCollection/EcmPropSignalIPDU28_6fdbf3ae_Rx
        EcmPropSignalIPdu24_ff7d8ab4_Rx: CanIfRxPduCanId=75, CanIfRxPduUserRxIndicationName=PduR_CanIfRxIndication, CanIfRxPduUserRxIndicationUL=PDUR, CanIfRxPduRef=EcucPduCollection/EcmPropSignalIPdu24_045785fe_Rx
        EcmPropSignalIPdu25_ed472200_Rx: CanIfRxPduCanId=634, CanIfRxPduUserRxIndicationName=PduR_CanIfRxIndication, CanIfRxPduUserRxIndicationUL=PDUR, CanIfRxPduRef=EcucPduCollection/EcmPropSignalIPdu25_89df781c_Rx
        IemPropCanNmNode_9021399f_Rx: CanIfRxPduUserRxIndicationName=CanNm_RxIndication, CanIfRxPduUserRxIndicationUL=CAN_NM, CanIfRxPduRef=IemPropCanNmNode_6342b4e7_Rx
          PropulsionCAN_3689664c (CanIfRxPduCanIdRange): CanIfRxPduCanIdRangeLowerCanId=1280, CanIfRxPduCanIdRangeUpperCanId=1343
        SrsPropSignalIPdu02_67d0f726_Rx: CanIfRxPduCanId=53, CanIfRxPduUserRxIndicationName=PduR_CanIfRxIndication, CanIfRxPduUserRxIndicationUL=PDUR, CanIfRxPduRef=EcucPduCollection/SrsPropSignalIPdu02_30ca6a16_Rx
        VDDMPropSignalIPDU05_c80f18fa_Rx: CanIfRxPduCanId=118, CanIfRxPduUserRxIndicationName=PduR_CanIfRxIndication, CanIfRxPduUserRxIndicationUL=PDUR, CanIfRxPduRef=EcucPduCollection/VDDMPropSignalIPDU05_753dbccf_Rx
        VDDMPropSignalIPDU06_f578cb85_Rx: CanIfRxPduCanId=565, CanIfRxPduUserRxIndicationName=PduR_CanIfRxIndication, CanIfRxPduUserRxIndicationUL=PDUR, CanIfRxPduRef=EcucPduCollection/VDDMPropSignalIPDU06_38d5bca8_Rx
        VDDMPropSignalIPDU08_9fd219ec_Rx: CanIfRxPduCanId=65, CanIfRxPduUserRxIndicationName=PduR_CanIfRxIndication, CanIfRxPduUserRxIndicationUL=PDUR, CanIfRxPduRef=EcucPduCollection/VDDMPropSignalIPDU08_146446f0_Rx
        VDDMPropSignalIPDU11_6de828bb_Rx: CanIfRxPduCanId=313, CanIfRxPduUserRxIndicationName=PduR_CanIfRxIndication, CanIfRxPduUserRxIndicationUL=PDUR, CanIfRxPduRef=EcucPduCollection/VDDMPropSignalIPDU11_60044a2d_Rx
        VDDMPropSignalIPDU16_b505c2af_Rx: CanIfRxPduCanId=597, CanIfRxPduUserRxIndicationName=PduR_CanIfRxIndication, CanIfRxPduUserRxIndicationUL=PDUR, CanIfRxPduRef=EcucPduCollection/VDDMPropSignalIPDU16_765cb701_Rx
        VDDMPropSignalIPDU17_17078e45_Rx: CanIfRxPduCanId=354, CanIfRxPduUserRxIndicationName=PduR_CanIfRxIndication, CanIfRxPduUserRxIndicationUL=PDUR, CanIfRxPduRef=EcucPduCollection/VDDMPropSignalIPDU17_fbd44ae3_Rx
        VDDMPropSignalIPDU18_dfaf10c6_Rx: CanIfRxPduCanId=86, CanIfRxPduUserRxIndicationName=PduR_CanIfRxIndication, CanIfRxPduUserRxIndicationUL=PDUR, CanIfRxPduRef=EcucPduCollection/VDDMPropSignalIPDU18_5aed4d59_Rx
        VDDMPropSignalIPDU19_7dad5c2c_Rx: CanIfRxPduCanId=645, CanIfRxPduUserRxIndicationName=PduR_CanIfRxIndication, CanIfRxPduUserRxIndicationUL=PDUR, CanIfRxPduRef=EcucPduCollection/VDDMPropSignalIPDU19_d765b0bb_Rx
        VDDMPropdTCSignalIPdu38_c1b9326a_Rx: CanIfRxPduCanId=282, CanIfRxPduUserRxIndicationName=PduR_CanIfRxIndication, CanIfRxPduUserRxIndicationUL=PDUR, CanIfRxPduRef=EcucPduCollection/VDDMPropdTCSignalIPdu38_4bda4dd7_Rx
        VddmBcmPropdTCSignalIPDU01_bdf43e36_Rx: CanIfRxPduCanId=302, CanIfRxPduUserRxIndicationName=PduR_CanIfRxIndication, CanIfRxPduUserRxIndicationUL=PDUR, CanIfRxPduRef=EcucPduCollection/VddmBcmPropdTCSignalIPDU01_857b2e99_Rx
        VddmPropSignalIPdu26_dc850ebd_Rx: CanIfRxPduCanId=566, CanIfRxPduUserRxIndicationName=PduR_CanIfRxIndication, CanIfRxPduUserRxIndicationUL=PDUR, CanIfRxPduRef=EcucPduCollection/VddmPropSignalIPdu26_893fed53_Rx
        VddmToAllFuncPropDiagReqNpdu_b900be48_Rx: CanIfRxPduCanId=2047, CanIfRxPduUserRxIndicationName=CanTp_RxIndication, CanIfRxPduUserRxIndicationType=PDUID_PDUINFOPTR, CanIfRxPduUserRxIndicationUL=CAN_TP, CanIfRxPduRef=VddmToAllFuncPropDiagReqNpdu_86e6f41a_Rx
        VddmToIemPropDiagReqNpdu_0145b13a_Rx: CanIfRxPduCanId=1847, CanIfRxPduUserRxIndicationName=CanTp_RxIndication, CanIfRxPduUserRxIndicationType=PDUID_PDUINFOPTR, CanIfRxPduUserRxIndicationUL=CAN_TP, CanIfRxPduRef=VddmToIemPropDiagReqNpdu_b1f6d800_Rx
        VgmToAllFuncJ1979OBDPropCanReqNpdu11_68e7dbfc_Rx: CanIfRxPduCanId=2015, CanIfRxPduUserRxIndicationName=CanTp_RxIndication, CanIfRxPduUserRxIndicationType=PDUID_PDUINFOPTR, CanIfRxPduUserRxIndicationUL=CAN_TP, CanIfRxPduRef=VgmToAllFuncJ1979OBDPropCanReqNpdu11_a7af92b3_Rx
        VgmToIemJ1979OBDPropCanReqNpdu11_a6f3d656_Rx: CanIfRxPduCanId=2019, CanIfRxPduUserRxIndicationName=CanTp_RxIndication, CanIfRxPduUserRxIndicationType=PDUID_PDUINFOPTR, CanIfRxPduUserRxIndicationUL=CAN_TP, CanIfRxPduRef=VgmToIemJ1979OBDPropCanReqNpdu11_0f26f145_Rx
      19 x CanIfTxPduCfg, all with CanIfTxPduCanIdType=STANDARD_CAN, CanIfTxPduDlc=8, CanIfTxPduBufferRef=CanIfInitCfg/PropulsionCAN_c77d42b7:
        IemEduPropSignalIPdu01_45a04f59_Tx: CanIfTxPduCanId=76, CanIfTxPduUserTxConfirmationName=PduR_CanIfTxConfirmation, CanIfTxPduUserTxConfirmationUL=PDUR, CanIfTxPduRef=EcucPduCollection/IemEduPropSignalIPdu01_a3cd4ce7_Tx
        IemEduPropSignalIPdu02_69927b9a_Tx: CanIfTxPduCanId=96, CanIfTxPduUserTxConfirmationName=PduR_CanIfTxConfirmation, CanIfTxPduUserTxConfirmationUL=PDUR, CanIfTxPduRef=EcucPduCollection/IemEduPropSignalIPdu02_ee254c80_Tx
        IemPropNmPdu1_1cf32a7f_Tx: CanIfTxPduCanId=1308, CanIfTxPduUserTxConfirmationName=CanNm_TxConfirmation, CanIfTxPduUserTxConfirmationUL=CAN_NM, CanIfTxPduRef=EcucPduCollection/IemPropNmPdu1_277f9a9b_Tx
        IemPropSignalIPdu01_d12470d0_Tx: CanIfTxPduCanId=1111, CanIfTxPduUserTxConfirmationName=PduR_CanIfTxConfirmation, CanIfTxPduUserTxConfirmationUL=PDUR, CanIfTxPduRef=EcucPduCollection/IemPropSignalIPdu01_1988e981_Tx
        IemPropSignalIPdu02_e76b890c_Tx: CanIfTxPduCanId=1125, CanIfTxPduUserTxConfirmationName=PduR_CanIfTxConfirmation, CanIfTxPduUserTxConfirmationUL=PDUR, CanIfTxPduRef=EcucPduCollection/IemPropSignalIPdu02_5460e9e6_Tx
        IemPropSignalIPdu03_f55121b8_Tx: CanIfTxPduCanId=773, CanIfTxPduUserTxConfirmationName=PduR_CanIfTxConfirmation, CanIfTxPduUserTxConfirmationUL=PDUR, CanIfTxPduRef=EcucPduCollection/IemPropSignalIPdu03_d9e81404_Tx
        IemPropSignalIPdu04_8bf47ab4_Tx: CanIfTxPduCanId=613, CanIfTxPduUserTxConfirmationName=PduR_CanIfTxConfirmation, CanIfTxPduUserTxConfirmationUL=PDUR, CanIfTxPduRef=EcucPduCollection/IemPropSignalIPdu04_cfb0e928_Tx
        IemPropSignalIPdu06_af812bdc_Tx: CanIfTxPduCanId=626, CanIfTxPduUserTxConfirmationName=PduR_CanIfTxConfirmation, CanIfTxPduUserTxConfirmationUL=PDUR, CanIfTxPduRef=EcucPduCollection/IemPropSignalIPdu06_0fd014ad_Tx
        IemPropSignalIPdu07_bdbb8368_Tx: CanIfTxPduCanId=643, CanIfTxPduUserTxConfirmationName=PduR_CanIfTxConfirmation, CanIfTxPduUserTxConfirmationUL=PDUR, CanIfTxPduRef=EcucPduCollection/IemPropSignalIPdu07_8258e94f_Tx
        IemPropSignalIPdu08_52cb9dc4_Tx: CanIfTxPduCanId=99, CanIfTxPduUserTxConfirmationName=PduR_CanIfTxConfirmation, CanIfTxPduUserTxConfirmationUL=PDUR, CanIfTxPduRef=EcucPduCollection/IemPropSignalIPdu08_2361eef5_Tx
        IemPropSignalIPdu09_40f13570_Tx: CanIfTxPduCanId=1126, CanIfTxPduUserTxConfirmationName=PduR_CanIfTxConfirmation, CanIfTxPduUserTxConfirmationUL=PDUR, CanIfTxPduRef=EcucPduCollection/IemPropSignalIPdu09_aee91317_Tx
        IemPropSignalIPdu12_2b75c431_Tx: CanIfTxPduCanId=393, CanIfTxPduUserTxConfirmationName=PduR_CanIfTxConfirmation, CanIfTxPduUserTxConfirmationUL=PDUR, CanIfTxPduRef=EcucPduCollection/IemPropSignalIPdu12_1ae9e24f_Tx
        IemPropSignalIPdu14_47ea3789_Tx: CanIfTxPduCanId=544, CanIfTxPduUserTxConfirmationName=PduR_CanIfTxConfirmation, CanIfTxPduUserTxConfirmationUL=PDUR, CanIfTxPduRef=EcucPduCollection/IemPropSignalIPdu14_8139e281_Tx
        IemPropSignalIPdu16_3b1ed2aa_Tx: CanIfTxPduCanId=272, CanIfTxPduUserTxConfirmationName=PduR_CanIfTxConfirmation, CanIfTxPduUserTxConfirmationUL=PDUR, CanIfTxPduRef=EcucPduCollection/IemPropSignalIPdu16_41591f04_Tx
        IemToVddmPropDiagResNpdu_1dd128ca_Tx: CanIfTxPduCanId=1591, CanIfTxPduUserTxConfirmationName=CanTp_TxConfirmation, CanIfTxPduUserTxConfirmationUL=CAN_TP, CanIfTxPduRef=IemToVddmPropDiagResNpdu_cef1039b_Tx
        IemToVgmJ1979OBDPropCanResNpdu11_d809dece_Tx: CanIfTxPduCanId=2027, CanIfTxPduUserTxConfirmationName=CanTp_TxConfirmation, CanIfTxPduUserTxConfirmationUL=CAN_TP, CanIfTxPduRef=IemToVgmJ1979OBDPropCanResNpdu11_72c85f7f_Tx
        UudtIemNPdu1_b38ffc6e_Tx: CanIfTxPduCanId=1776, CanIfTxPduUserTxConfirmationName=CanTp_TxConfirmation, CanIfTxPduUserTxConfirmationUL=CAN_TP, CanIfTxPduRef=UudtIemNPdu1_4b1dfe9b_Tx
        UudtIemNPdu2_85c005b2_Tx: CanIfTxPduCanId=1777, CanIfTxPduUserTxConfirmationName=CanTp_TxConfirmation, CanIfTxPduUserTxConfirmationUL=CAN_TP, CanIfTxPduRef=UudtIemNPdu2_06f5fefc_Tx
        UudtIemNPdu3_97faad06_Tx: CanIfTxPduCanId=1778, CanIfTxPduUserTxConfirmationName=CanTp_TxConfirmation, CanIfTxPduUserTxConfirmationUL=CAN_TP, CanIfTxPduRef=UudtIemNPdu3_8b7d031e_Tx
    CanIfPrivateCfg: CanIfPrivateSoftwareFilterType=LINEAR
    CanIfPublicCfg: CanIfPublicPnSupport=true
  module config CanNm
    CanNmGlobalConfig:
      CanNmBusLoadReductionEnabled = false
      CanNmBusSynchronizationEnabled = false
      CanNmComControlEnabled = false
      CanNmImmediateRestartEnabled = false
      CanNmNodeDetectionEnabled = true
      CanNmPduRxIndicationEnabled = true
      CanNmPnEiraCalcEnabled = true
      CanNmRemoteSleepIndEnabled = false
      CanNmRepeatMsgIndEnabled = false
      CanNmStateChangeIndEnabled = false
      CanNmUserDataEnabled = true
      CanNmPnEiraRxNSduRef = PropulsionCAN_c71a5358_Rx
      PropulsionCanNmCluster_99dff440 (CanNmChannelConfig):
        CanNmBusLoadReductionActive = false
        CanNmCarWakeUpRxEnabled = false
        CanNmImmediateNmCycleTime = 0.02
        CanNmImmediateNmTransmissions = 20
        CanNmMsgCycleOffset = 0.1
        CanNmMsgCycleTime = 1
        CanNmMsgReducedTime = 0.5
        CanNmMsgTimeoutTime = 0.5
        CanNmNodeId = 28
        CanNmPduCbvPosition = CANNM_PDU_BYTE_1
        CanNmPduNidPosition = CANNM_PDU_BYTE_0
        CanNmPnEnabled = true
        CanNmPnEraCalcEnabled = false
        CanNmRemoteSleepIndTime = 0
        CanNmRepeatMessageTime = 1
        CanNmTimeoutTime = 3
        CanNmUserDataLength = 6
        CanNmWaitBusSleepTime = 4
        CanNmComMNetworkHandleRef = ComMConfigSet/PropulsionCAN_IEM_19020f5a
        PropulsionCanNmCluster_99dff440_Rx (CanNmRxPdu): CanNmRxPduRef=IemPropCanNmNode_6342b4e7_Rx
        IemPropNmPdu1_277f9a9b_Tx (CanNmTxPdu): CanNmTxPduRef=EcucPduCollection/IemPropNmPdu1_277f9a9b_Tx
      CanNmPnInfo: CanNmPnInfoLength=6, CanNmPnInfoOffset=2
        6 x CanNmPnFilterMaskByte:
          CanNmPnFilterMaskByte_0: CanNmPnFilterMaskByteIndex=0, CanNmPnFilterMaskByteValue=1
          CanNmPnFilterMaskByte_1: CanNmPnFilterMaskByteIndex=1, CanNmPnFilterMaskByteValue=111
          CanNmPnFilterMaskByte_2: CanNmPnFilterMaskByteIndex=2, CanNmPnFilterMaskByteValue=138
          CanNmPnFilterMaskByte_{3..5}: CanNmPnFilterMaskByteIndex={3..5}, CanNmPnFilterMaskByteValue=0
  module config CanSM
    CanSMConfiguration
      PropulsionCAN_c77d42b7 (CanSMManagerNetwork): CanSMComMNetworkHandleRef=ComMConfigSet/PropulsionCAN_IEM_19020f5a
        PropulsionCAN_2f5e3e32 (CanSMController): CanSMControllerId=CanIfCtrlDrvCfg_7d254554/PropulsionCAN_6c6185ef
  module config CanTp
    CanTpConfig: CanTpMainFunctionPeriod=0.005
      7 x CanTpChannel, all with CanTpChannelMode=CANTP_MODE_HALF_DUPLEX:
        IemEtcUUDTPropCha1_2495fbf5
          CanTpTxNSdu_46d88454 (CanTpTxNSdu):
            CanTpNas = 1
            CanTpNbs = 1
            CanTpNcs = 0.9
            CanTpTc = false
            CanTpTxAddressingFormat = CANTP_STANDARD
            CanTpTxDl = 8
            CanTpTxPaddingActivation = CANTP_ON
            CanTpTxTaType = CANTP_PHYSICAL
            CanTpTxNSduRef = EcucPduCollection/IemToEtcUudtDcmIpdu1_4ae85965_Tx
            CanTpTxNPdu_8431c063 (CanTpTxNPdu): CanTpTxNPduRef=UudtIemNPdu1_4b1dfe9b_Tx
        IemEtcUUDTPropCha2_0b8ad8e1
          CanTpTxNSdu_4e62aa3e (CanTpTxNSdu):
            CanTpNas = 1
            CanTpNbs = 1
            CanTpNcs = 0.9
            CanTpTc = false
            CanTpTxAddressingFormat = CANTP_STANDARD
            CanTpTxDl = 8
            CanTpTxPaddingActivation = CANTP_ON
            CanTpTxTaType = CANTP_PHYSICAL
            CanTpTxNSduRef = EcucPduCollection/IemToEtcUudtDcmIpdu2_07005902_Tx
            CanTpTxNPdu_6f36b3fb (CanTpTxNPdu): CanTpTxNPduRef=UudtIemNPdu2_06f5fefc_Tx
        IemEtcUUDTPropCha3_a7af3bd2
          CanTpTxNSdu_67838de1 (CanTpTxNSdu):
            CanTpNas = 1
            CanTpNbs = 1
            CanTpNcs = 0.9
            CanTpTc = false
            CanTpTxAddressingFormat = CANTP_STANDARD
            CanTpTxDl = 8
            CanTpTxPaddingActivation = CANTP_ON
            CanTpTxTaType = CANTP_PHYSICAL
            CanTpTxNSduRef = EcucPduCollection/IemToEtcUudtDcmIpdu3_8a88a4e0_Tx
            CanTpTxNPdu_173b30c5 (CanTpTxNPdu): CanTpTxNPduRef=UudtIemNPdu3_8b7d031e_Tx
        VddmIemPropDiagCha_48ac995b
          CanTpRxNSdu_183e09ee (CanTpRxNSdu):
            CanTpBs = 0
            CanTpNar = 1
            CanTpNbr = 0.9
            CanTpNcr = 1
            CanTpRxAddressingFormat = CANTP_STANDARD
            CanTpRxDl = 8
            CanTpRxPaddingActivation = CANTP_ON
            CanTpRxTaType = CANTP_PHYSICAL
            CanTpRxWftMax = 255
            CanTpSTmin = 0.005
            CanTpRxNSduRef = EcucPduCollection/VgmToIemDiagDcmIpdu_81f41e2d_Rx
            CanTpRxNPdu_17ec4684 (CanTpRxNPdu): CanTpRxNPduRef=VddmToIemPropDiagReqNpdu_b1f6d800_Rx
            CanTpTxFcNPdu_17ec4684 (CanTpTxFcNPdu): CanTpTxFcNPduRef=IemToVddmPropDiagResNpdu_cef1039b_Tx
          CanTpTxNSdu_183e09ee (CanTpTxNSdu):
            CanTpNas = 1
            CanTpNbs = 1
            CanTpNcs = 0.9
            CanTpTc = false
            CanTpTxAddressingFormat = CANTP_STANDARD
            CanTpTxDl = 8
            CanTpTxPaddingActivation = CANTP_ON
            CanTpTxTaType = CANTP_PHYSICAL
            CanTpTxNSduRef = EcucPduCollection/IemToVgmDiagDcmIpdu_411ec11e_Tx
            CanTpRxFcNPdu_35169276 (CanTpRxFcNPdu): CanTpRxFcNPduRef=VddmToIemPropDiagReqNpdu_b1f6d800_Rx
            CanTpTxNPdu_35169276 (CanTpTxNPdu): CanTpTxNPduRef=IemToVddmPropDiagResNpdu_cef1039b_Tx
        VddmToAllFuncPropDiagCha_11278746
          CanTpRxNSdu_c024ac3e (CanTpRxNSdu):
            CanTpBs = 0
            CanTpNar = 1
            CanTpNbr = 0.9
            CanTpNcr = 1
            CanTpRxAddressingFormat = CANTP_STANDARD
            CanTpRxDl = 8
            CanTpRxPaddingActivation = CANTP_ON
            CanTpRxTaType = CANTP_FUNCTIONAL
            CanTpRxWftMax = 255
            CanTpSTmin = 0.005
            CanTpRxNSduRef = EcucPduCollection/VgmToAllFuncDiagDcmIpdu_030e2fcd_Rx
            CanTpRxNPdu_9726b6f8 (CanTpRxNPdu): CanTpRxNPduRef=VddmToAllFuncPropDiagReqNpdu_86e6f41a_Rx
        VgmIemJ1979OBDDiagCha11_7badfeec
          CanTpRxNSdu_f73faffe (CanTpRxNSdu):
            CanTpBs = 0
            CanTpNar = 1
            CanTpNbr = 0.9
            CanTpNcr = 1
            CanTpRxAddressingFormat = CANTP_STANDARD
            CanTpRxDl = 8
            CanTpRxPaddingActivation = CANTP_ON
            CanTpRxTaType = CANTP_PHYSICAL
            CanTpRxWftMax = 255
            CanTpSTmin = 0.005
            CanTpRxNSduRef = EcucPduCollection/EtcToIemJ1979OBDDiagDcmIpdu11_ac95f359_Rx
            CanTpRxNPdu_106c7114 (CanTpRxNPdu): CanTpRxNPduRef=VgmToIemJ1979OBDPropCanReqNpdu11_0f26f145_Rx
            CanTpTxFcNPdu_106c7114 (CanTpTxFcNPdu): CanTpTxFcNPduRef=IemToVgmJ1979OBDPropCanResNpdu11_72c85f7f_Tx
          CanTpTxNSdu_f73faffe (CanTpTxNSdu):
            CanTpNas = 1
            CanTpNbs = 1
            CanTpNcs = 0.9
            CanTpTc = false
            CanTpTxAddressingFormat = CANTP_STANDARD
            CanTpTxDl = 8
            CanTpTxPaddingActivation = CANTP_ON
            CanTpTxTaType = CANTP_PHYSICAL
            CanTpTxNSduRef = EcucPduCollection/IemToEtcJ1979OBDDiagDcmIpdu11_525ada58_Tx
            CanTpRxFcNPdu_3296a5e6 (CanTpRxFcNPdu): CanTpRxFcNPduRef=VgmToIemJ1979OBDPropCanReqNpdu11_0f26f145_Rx
            CanTpTxNPdu_3296a5e6 (CanTpTxNPdu): CanTpTxNPduRef=IemToVgmJ1979OBDPropCanResNpdu11_72c85f7f_Tx
        VgmToAllJ1979OBDDiagCha11_2cd66346
          CanTpRxNSdu_0d429961 (CanTpRxNSdu):
            CanTpBs = 0
            CanTpNar = 1
            CanTpNbr = 0.9
            CanTpNcr = 1
            CanTpRxAddressingFormat = CANTP_STANDARD
            CanTpRxDl = 8
            CanTpRxPaddingActivation = CANTP_ON
            CanTpRxTaType = CANTP_FUNCTIONAL
            CanTpRxWftMax = 255
            CanTpSTmin = 0.005
            CanTpRxNSduRef = EcucPduCollection/EtcToAllJ1979OBDDiagDcmIpdu11_b7ab7660_Rx
            CanTpRxNPdu_8f524760 (CanTpRxNPdu): CanTpRxNPduRef=VgmToAllFuncJ1979OBDPropCanReqNpdu11_a7af92b3_Rx
  module config Com
    ComConfig
      40 x ComIPdu:
        BecmPropSignalIpdu01_7a983997_Rx: ComIPduDirection=RECEIVE, ComIPduType=NORMAL, ComIPduGroupRef=RxSPG_PropulsionCAN_PNC24_f9c65551, ComIPduGroupRef=RxSPG_PropulsionCAN_PNC25_8ec165c7, ComIPduGroupRef=RxSPG_PropulsionCAN_PNC26_17c8347d, ComIPduGroupRef=RxSPG_PropulsionCAN_PNC29_877729ec, ComIPduGroupRef=RxSPG_PropulsionCAN_PNC30_e7b0a009, ComIPduGroupRef=RxSPG_PropulsionCAN_PNC35_97da5486, ComIPduGroupRef=RxSPG_PropulsionCAN_PNC39_9e6c18ad, ComIPduSignalGroupRef=igHvSysRlySts_760c5326_Rx, ComIPduSignalRef=isHvBattUDc_bcd9ade4_Rx, ComIPduSignalRef=isHvBattUDynMaxLim_6d11df88_Rx, ComPduIdRef=EcucPduCollection/BecmPropSignalIpdu01_7a983997_Rx
        BecmPropSignalIpdu02_e391682d_Rx: ComIPduDirection=RECEIVE, ComIPduType=NORMAL, ComIPduGroupRef=RxSPG_PropulsionCAN_PNC24_f9c65551, ComIPduGroupRef=RxSPG_PropulsionCAN_PNC25_8ec165c7, ComIPduGroupRef=RxSPG_PropulsionCAN_PNC26_17c8347d, ComIPduGroupRef=RxSPG_PropulsionCAN_PNC29_877729ec, ComIPduGroupRef=RxSPG_PropulsionCAN_PNC30_e7b0a009, ComIPduGroupRef=RxSPG_PropulsionCAN_PNC35_97da5486, ComIPduGroupRef=RxSPG_PropulsionCAN_PNC39_9e6c18ad, ComIPduSignalRef=isHvBattUDynMinLim_28139c0a_Rx, ComPduIdRef=EcucPduCollection/BecmPropSignalIpdu02_e391682d_Rx
        BecmPropSignalIpdu03_949658bb_Rx: ComIPduDirection=RECEIVE, ComIPduType=NORMAL, ComIPduGroupRef=RxSPG_PropulsionCAN_PNC24_f9c65551, ComIPduGroupRef=RxSPG_PropulsionCAN_PNC25_8ec165c7, ComIPduGroupRef=RxSPG_PropulsionCAN_PNC26_17c8347d, ComIPduGroupRef=RxSPG_PropulsionCAN_PNC29_877729ec, ComIPduGroupRef=RxSPG_PropulsionCAN_PNC30_e7b0a009, ComIPduGroupRef=RxSPG_PropulsionCAN_PNC35_97da5486, ComIPduGroupRef=RxSPG_PropulsionCAN_PNC39_9e6c18ad, ComIPduSignalRef=isHvBattSoc_ce242c3f_Rx, ComPduIdRef=EcucPduCollection/BecmPropSignalIpdu03_949658bb_Rx
        BecmPropSignalIpdu15_64eecccf_Rx: ComIPduDirection=RECEIVE, ComIPduType=NORMAL, ComIPduGroupRef=RxSPG_PropulsionCAN_PNC24_f9c65551, ComIPduGroupRef=RxSPG_PropulsionCAN_PNC25_8ec165c7, ComIPduGroupRef=RxSPG_PropulsionCAN_PNC26_17c8347d, ComIPduGroupRef=RxSPG_PropulsionCAN_PNC29_877729ec, ComIPduGroupRef=RxSPG_PropulsionCAN_PNC30_e7b0a009, ComIPduGroupRef=RxSPG_PropulsionCAN_PNC35_97da5486, ComIPduGroupRef=RxSPG_PropulsionCAN_PNC39_9e6c18ad, ComIPduSignalRef=isDCChrgnHndlSts_7439a8f3_Rx, ComPduIdRef=EcucPduCollection/BecmPropSignalIpdu15_64eecccf_Rx
        CddObcPropSignalIPdu01_003f0830_Rx: ComIPduDirection=RECEIVE, ComIPduType=NORMAL, ComIPduGroupRef=RxSPG_PropulsionCAN_PNC24_f9c65551, ComIPduGroupRef=RxSPG_PropulsionCAN_PNC25_8ec165c7, ComIPduGroupRef=RxSPG_PropulsionCAN_PNC26_17c8347d, ComIPduGroupRef=RxSPG_PropulsionCAN_PNC27_60cf04eb, ComIPduGroupRef=RxSPG_PropulsionCAN_PNC29_877729ec, ComIPduGroupRef=RxSPG_PropulsionCAN_PNC30_e7b0a009, ComIPduSignalRef=isOnBdChrgrHndlSts1_677311c9_Rx, ComPduIdRef=EcucPduCollection/CddObcPropSignalIPdu01_003f0830_Rx
        ECMPropSignalIPDU02_bd22093c_Rx: ComIPduDirection=RECEIVE, ComIPduType=NORMAL, ComIPduGroupRef=RxSPG_PropulsionCAN_PNC24_f9c65551, ComIPduGroupRef=RxSPG_PropulsionCAN_PNC25_8ec165c7, ComIPduGroupRef=RxSPG_PropulsionCAN_PNC26_17c8347d, ComIPduGroupRef=RxSPG_PropulsionCAN_PNC29_877729ec, ComIPduSignalRef=isWhlMotSysModReq_0153ebfe_Rx, ComPduIdRef=EcucPduCollection/ECMPropSignalIPDU02_bd22093c_Rx
        ECMPropSignalIPDU04_5441ac09_Rx: ComIPduDirection=RECEIVE, ComIPduType=NORMAL, ComIPduGroupRef=RxSPG_PropulsionCAN_PNC24_f9c65551, ComIPduGroupRef=RxSPG_PropulsionCAN_PNC25_8ec165c7, ComIPduGroupRef=RxSPG_PropulsionCAN_PNC26_17c8347d, ComIPduGroupRef=RxSPG_PropulsionCAN_PNC29_877729ec, ComIPduSignalRef=isWhlMotSysPwrLimMax_45b5505a_Rx, ComPduIdRef=EcucPduCollection/ECMPropSignalIPDU04_5441ac09_Rx
        ECMPropSignalIPDU05_23469c9f_Rx: ComIPduDirection=RECEIVE, ComIPduType=NORMAL, ComIPduGroupRef=RxSPG_PropulsionCAN_PNC24_f9c65551, ComIPduGroupRef=RxSPG_PropulsionCAN_PNC25_8ec165c7, ComIPduGroupRef=RxSPG_PropulsionCAN_PNC26_17c8347d, ComIPduGroupRef=RxSPG_PropulsionCAN_PNC29_877729ec, ComIPduSignalGroupRef=igWhlMotSysTqAllwd_20f5846f_Rx, ComPduIdRef=EcucPduCollection/ECMPropSignalIPDU05_23469c9f_Rx
        ECMPropSignalIPDU06_ba4fcd25_Rx: ComIPduDirection=RECEIVE, ComIPduType=NORMAL, ComIPduGroupRef=RxSPG_PropulsionCAN_PNC24_f9c65551, ComIPduGroupRef=RxSPG_PropulsionCAN_PNC25_8ec165c7, ComIPduGroupRef=RxSPG_PropulsionCAN_PNC26_17c8347d, ComIPduGroupRef=RxSPG_PropulsionCAN_PNC29_877729ec, ComIPduSignalRef=isPLockParkReq_5b6f1b96_Rx, ComIPduSignalRef=isWhlMotSysActvDampgModReq_1c578291_Rx, ComIPduSignalRef=isWhlMotSysPwrLimMin_79b86f03_Rx, ComPduIdRef=EcucPduCollection/ECMPropSignalIPDU06_ba4fcd25_Rx
        EcmPropSignalIPDU08_2e126ae8_Rx: ComIPduDirection=RECEIVE, ComIPduType=NORMAL, ComIPduGroupRef=RxSPG_PropulsionCAN_PNC24_f9c65551, ComIPduGroupRef=RxSPG_PropulsionCAN_PNC25_8ec165c7, ComIPduGroupRef=RxSPG_PropulsionCAN_PNC26_17c8347d, ComIPduGroupRef=RxSPG_PropulsionCAN_PNC29_877729ec, ComIPduGroupRef=RxSPG_PropulsionCAN_PNC35_97da5486, ComIPduSignalRef=isPrpsnFbLimnIndcn_5674da6b_Rx, ComPduIdRef=EcucPduCollection/EcmPropSignalIPDU08_2e126ae8_Rx
        EcmPropSignalIPDU11_4ed5e30d_Rx: ComIPduDirection=RECEIVE, ComIPduType=NORMAL, ComIPduGroupRef=RxSPG_PropulsionCAN_PNC26_17c8347d, ComIPduGroupRef=RxSPG_PropulsionCAN_PNC29_877729ec, ComIPduGroupRef=RxSPG_PropulsionCAN_PNC35_97da5486, ComIPduGroupRef=RxSPG_PropulsionCAN_PNC39_9e6c18ad, ComIPduSignalRef=isCooltFlowForDtElec_89c7c93c_Rx, ComIPduSignalRef=isCooltTSigForDtElec_f43a3873_Rx, ComPduIdRef=EcucPduCollection/EcmPropSignalIPDU11_4ed5e30d_Rx
        EcmPropSignalIPDU28_1c24086a_Rx: ComIPduDirection=RECEIVE, ComIPduType=NORMAL, ComIPduGroupRef=RxSPG_PropulsionCAN_PNC26_17c8347d, ComIPduGroupRef=RxSPG_PropulsionCAN_PNC29_877729ec, ComIPduSignalRef=isRearHeatModEnad_a110df41_Rx, ComIPduSignalRef=isRearHeatPwrAllwd_c919804a_Rx, ComPduIdRef=EcucPduCollection/EcmPropSignalIPDU28_1c24086a_Rx
        EcmPropSignalIPdu24_8dedad9f_Rx: ComIPduDirection=RECEIVE, ComIPduType=NORMAL, ComIPduGroupRef=RxSPG_PropulsionCAN_PNC24_f9c65551, ComIPduGroupRef=RxSPG_PropulsionCAN_PNC25_8ec165c7, ComIPduGroupRef=RxSPG_PropulsionCAN_PNC26_17c8347d, ComIPduGroupRef=RxSPG_PropulsionCAN_PNC29_877729ec, ComIPduSignalGroupRef=igEngSt1WdSts_adcf75d2_Rx, ComIPduSignalRef=isGearLvrIndcn_bb4b951e_Rx, ComIPduSignalRef=isWhlMotSysTqReq_f0fdb022_Rx, ComPduIdRef=EcucPduCollection/EcmPropSignalIPdu24_8dedad9f_Rx
        EcmPropSignalIPdu25_faea9d09_Rx: ComIPduDirection=RECEIVE, ComIPduType=NORMAL, ComIPduGroupRef=RxSPG_PropulsionCAN_PNC24_f9c65551, ComIPduGroupRef=RxSPG_PropulsionCAN_PNC25_8ec165c7, ComIPduGroupRef=RxSPG_PropulsionCAN_PNC26_17c8347d, ComIPduGroupRef=RxSPG_PropulsionCAN_PNC29_877729ec, ComIPduGroupRef=RxSPG_PropulsionCAN_PNC39_9e6c18ad, ComIPduSignalRef=isDrvgCyc_edb7d721_Rx, ComPduIdRef=EcucPduCollection/EcmPropSignalIPdu25_faea9d09_Rx
        IemEduPropSignalIPdu01_3346005e_Tx: ComIPduDirection=SEND, ComIPduType=NORMAL, ComIPduGroupRef=TxSPG_PropulsionCAN_PNC16_573e0b18, ComIPduGroupRef=TxSPG_PropulsionCAN_PNC24_921d39f7, ComIPduGroupRef=TxSPG_PropulsionCAN_PNC25_e51a0961, ComIPduGroupRef=TxSPG_PropulsionCAN_PNC26_7c1358db, ComIPduGroupRef=TxSPG_PropulsionCAN_PNC27_0b14684d, ComIPduGroupRef=TxSPG_PropulsionCAN_PNC29_ecac454a, ComIPduGroupRef=TxSPG_PropulsionCAN_PNC30_8c6bccaf, ComIPduGroupRef=TxSPG_PropulsionCAN_PNC33_15629d15, ComIPduGroupRef=TxSPG_PropulsionCAN_PNC35_fc013820, ComIPduGroupRef=TxSPG_PropulsionCAN_PNC39_f5b7740b, ComIPduSignalGroupRef=igWhlMotSysTqAvl_6ba13f42_Tx, ComIPduSignalGroupRef=igWhlMotSysTqEst_02b3fb8d_Tx, ComIPduSignalRef=isWhlMotSysModSts_bd46c3f5_Tx, ComPduIdRef=EcucPduCollection/IemEduPropSignalIPdu01_3346005e_Tx
          ComTxIPdu: ComTxIPduUnusedAreasDefault=0
            ComTxModeTrue
              ComTxMode: ComTxModeMode=PERIODIC, ComTxModeTimeOffset=0, ComTxModeTimePeriod=0.01
        IemEduPropSignalIPdu02_aa4f51e4_Tx: ComIPduDirection=SEND, ComIPduType=NORMAL, ComIPduGroupRef=TxSPG_PropulsionCAN_617cc08d, ComIPduSignalRef=isImobEngSts2_5f8745c8_Tx, ComIPduSignalRef=isWhlMotSysCooltT_da703242_Tx, ComIPduSignalRef=isWhlMotSysLimnIndcn_9f88a06a_Tx, ComIPduSignalRef=isWhlMotSysSpdAct_e26fc666_Tx, ComIPduSignalRef=isWhlMotSysUdc_432c4140_Tx, ComPduIdRef=EcucPduCollection/IemEduPropSignalIPdu02_aa4f51e4_Tx
          ComTxIPdu: ComTxIPduUnusedAreasDefault=0
            ComTxModeTrue
              ComTxMode: ComTxModeMode=PERIODIC, ComTxModeTimeOffset=0, ComTxModeTimePeriod=0.02
        IemPropSignalIPdu01_21049770_Tx: ComIPduDirection=SEND, ComIPduType=NORMAL, ComIPduGroupRef=TxSPG_PropulsionCAN_617cc08d, ComIPduSignalGroupRef=igIEMTestFr1_f9c0b06a_Tx, ComPduIdRef=EcucPduCollection/IemPropSignalIPdu01_21049770_Tx
          ComTxIPdu: ComTxIPduUnusedAreasDefault=0
            ComTxModeTrue
              ComTxMode: ComTxModeMode=PERIODIC, ComTxModeTimeOffset=0, ComTxModeTimePeriod=0.8
        IemPropSignalIPdu02_b80dc6ca_Tx: ComIPduDirection=SEND, ComIPduType=NORMAL, ComIPduGroupRef=TxSPG_PropulsionCAN_617cc08d, ComIPduSignalGroupRef=igIEMTestFr2_60c9e1d0_Tx, ComPduIdRef=EcucPduCollection/IemPropSignalIPdu02_b80dc6ca_Tx
          ComTxIPdu: ComTxIPduUnusedAreasDefault=0
            ComTxModeTrue
              ComTxMode: ComTxModeMode=PERIODIC, ComTxModeTimeOffset=0, ComTxModeTimePeriod=0.8
        IemPropSignalIPdu03_cf0af65c_Tx: ComIPduDirection=SEND, ComIPduType=NORMAL, ComIPduGroupRef=TxSPG_PropulsionCAN_PNC24_921d39f7, ComIPduGroupRef=TxSPG_PropulsionCAN_PNC25_e51a0961, ComIPduGroupRef=TxSPG_PropulsionCAN_PNC26_7c1358db, ComIPduGroupRef=TxSPG_PropulsionCAN_PNC27_0b14684d, ComIPduGroupRef=TxSPG_PropulsionCAN_PNC29_ecac454a, ComIPduGroupRef=TxSPG_PropulsionCAN_PNC35_fc013820, ComIPduGroupRef=TxSPG_PropulsionCAN_PNC39_f5b7740b, ComIPduSignalRef=isWhlMotClrRdyReq_189c9369_Tx, ComIPduSignalRef=isWhlMotSysCoolgReq_32e8ee03_Tx, ComIPduSignalRef=isWhlMotSysErrIndcnReq_d5e6edc2_Tx, ComIPduSignalRef=isWhlMotSysInvrT_11341a35_Tx, ComIPduSignalRef=isWhlMotSysMotT_54e003b6_Tx, ComPduIdRef=EcucPduCollection/IemPropSignalIPdu03_cf0af65c_Tx
          ComTxIPdu: ComTxIPduUnusedAreasDefault=0
            ComTxModeTrue
              ComTxMode: ComTxModeMode=PERIODIC, ComTxModeTimeOffset=0, ComTxModeTimePeriod=0.6
        IemPropSignalIPdu04_516e63ff_Tx: ComIPduDirection=SEND, ComIPduType=NORMAL, ComIPduGroupRef=TxSPG_PropulsionCAN_PNC24_921d39f7, ComIPduGroupRef=TxSPG_PropulsionCAN_PNC26_7c1358db, ComIPduGroupRef=TxSPG_PropulsionCAN_PNC29_ecac454a, ComIPduSignalGroupRef=igImobEngChk2_35eae3c1_Tx, ComPduIdRef=EcucPduCollection/IemPropSignalIPdu04_516e63ff_Tx
          ComTxIPdu: ComTxIPduUnusedAreasDefault=0
            ComTxModeTrue
              ComTxMode: ComTxModeMode=PERIODIC, ComTxModeTimeOffset=0, ComTxModeTimePeriod=0.08
        IemPropSignalIPdu06_bf6002d3_Tx: ComIPduDirection=SEND, ComIPduType=NORMAL, ComIPduGroupRef=TxSPG_PropulsionCAN_PNC24_921d39f7, ComIPduGroupRef=TxSPG_PropulsionCAN_PNC25_e51a0961, ComIPduGroupRef=TxSPG_PropulsionCAN_PNC26_7c1358db, ComIPduGroupRef=TxSPG_PropulsionCAN_PNC27_0b14684d, ComIPduGroupRef=TxSPG_PropulsionCAN_PNC29_ecac454a, ComIPduSignalGroupRef=igIemGeneric_ab95030b_Tx, ComPduIdRef=EcucPduCollection/IemPropSignalIPdu06_bf6002d3_Tx
          ComTxIPdu: ComTxIPduUnusedAreasDefault=0
            ComTxModeTrue
              ComTxMode: ComTxModeMode=PERIODIC, ComTxModeTimeOffset=0, ComTxModeTimePeriod=0.1
        IemPropSignalIPdu07_c8673245_Tx: ComIPduDirection=SEND, ComIPduType=NORMAL, ComIPduGroupRef=TxSPG_PropulsionCAN_PNC24_921d39f7, ComIPduGroupRef=TxSPG_PropulsionCAN_PNC25_e51a0961, ComIPduGroupRef=TxSPG_PropulsionCAN_PNC26_7c1358db, ComIPduGroupRef=TxSPG_PropulsionCAN_PNC29_ecac454a, ComIPduGroupRef=TxSPG_PropulsionCAN_PNC35_fc013820, ComIPduGroupRef=TxSPG_PropulsionCAN_PNC39_f5b7740b, ComIPduSignalRef=isPLockFltIndcRe_f756fd30_Tx, ComIPduSignalRef=isPLockFltLvlRe_167e1ed2_Tx, ComIPduSignalRef=isWhlMotCooltFlowMinReq_102e8fa4_Tx, ComPduIdRef=EcucPduCollection/IemPropSignalIPdu07_c8673245_Tx
          ComTxIPdu: ComTxIPduUnusedAreasDefault=0
            ComTxModeTrue
              ComTxMode: ComTxModeMode=PERIODIC, ComTxModeTimeOffset=0, ComTxModeTimePeriod=0.15
        IemPropSignalIPdu08_58d82fd4_Tx: ComIPduDirection=SEND, ComIPduType=NORMAL, ComIPduGroupRef=TxSPG_PropulsionCAN_PNC16_573e0b18, ComIPduGroupRef=TxSPG_PropulsionCAN_PNC24_921d39f7, ComIPduGroupRef=TxSPG_PropulsionCAN_PNC25_e51a0961, ComIPduGroupRef=TxSPG_PropulsionCAN_PNC26_7c1358db, ComIPduGroupRef=TxSPG_PropulsionCAN_PNC27_0b14684d, ComIPduGroupRef=TxSPG_PropulsionCAN_PNC29_ecac454a, ComIPduGroupRef=TxSPG_PropulsionCAN_PNC33_15629d15, ComIPduGroupRef=TxSPG_PropulsionCAN_PNC35_fc013820, ComIPduGroupRef=TxSPG_PropulsionCAN_PNC39_f5b7740b, ComIPduSignalRef=isPLockParkStsRe_8fb3cac5_Tx, ComIPduSignalRef=isWhlMotSysHeatPwrAct_e1709dcf_Tx, ComIPduSignalRef=isWhlMotSysIdc_56101b54_Tx, ComPduIdRef=EcucPduCollection/IemPropSignalIPdu08_58d82fd4_Tx
          ComTxIPdu: ComTxIPduUnusedAreasDefault=0
            ComTxModeTrue
              ComTxMode: ComTxModeMode=PERIODIC, ComTxModeTimeOffset=0, ComTxModeTimePeriod=0.02
        IemPropSignalIPdu09_2fdf1f42_Tx: ComIPduDirection=SEND, ComIPduType=NORMAL, ComIPduGroupRef=TxSPG_PropulsionCAN_617cc08d, ComIPduSignalGroupRef=igIEMTestFr3_17ced146_Tx, ComPduIdRef=EcucPduCollection/IemPropSignalIPdu09_2fdf1f42_Tx
          ComTxIPdu: ComTxIPduUnusedAreasDefault=0
            ComTxModeTrue
              ComTxMode: ComTxModeMode=PERIODIC, ComTxModeTimeOffset=0, ComTxModeTimePeriod=0.8
        IemPropSignalIPdu12_a116f78b_Tx: ComIPduDirection=SEND, ComIPduType=NORMAL, ComIPduGroupRef=TxSPG_PropulsionCAN_PNC16_573e0b18, ComIPduGroupRef=TxSPG_PropulsionCAN_PNC25_e51a0961, ComIPduGroupRef=TxSPG_PropulsionCAN_PNC29_ecac454a, ComIPduGroupRef=TxSPG_PropulsionCAN_PNC30_8c6bccaf, ComIPduGroupRef=TxSPG_PropulsionCAN_PNC33_15629d15, ComIPduGroupRef=TxSPG_PropulsionCAN_PNC39_f5b7740b, ComIPduSignalGroupRef=igWhlMotSysSpdActSafe_58c9c55b_Tx, ComPduIdRef=EcucPduCollection/IemPropSignalIPdu12_a116f78b_Tx
          ComTxIPdu: ComTxIPduUnusedAreasDefault=0
            ComTxModeTrue
              ComTxMode: ComTxModeMode=PERIODIC, ComTxModeTimeOffset=0, ComTxModeTimePeriod=0.04
        IemPropSignalIPdu14_487552be_Tx: ComIPduDirection=SEND, ComIPduType=NORMAL, ComIPduGroupRef=TxSPG_PropulsionCAN_PNC24_921d39f7, ComIPduGroupRef=TxSPG_PropulsionCAN_PNC25_e51a0961, ComIPduGroupRef=TxSPG_PropulsionCAN_PNC26_7c1358db, ComIPduGroupRef=TxSPG_PropulsionCAN_PNC29_ecac454a, ComIPduSignalRef=isWhlMotSysHeatFdBck_516116c8_Tx, ComIPduSignalRef=isWhlMotSysHeatPwrMax_d3ea4a02_Tx, ComPduIdRef=EcucPduCollection/IemPropSignalIPdu14_487552be_Tx
          ComTxIPdu: ComTxIPduUnusedAreasDefault=0
            ComTxModeTrue
              ComTxMode: ComTxModeMode=PERIODIC, ComTxModeTimeOffset=0, ComTxModeTimePeriod=0.08
        IemPropSignalIPdu16_a67b3392_Tx: ComIPduDirection=SEND, ComIPduType=NORMAL, ComIPduGroupRef=TxSPG_PropulsionCAN_617cc08d, ComIPduSignalGroupRef=igDmcStsRearToEsc_5d8e0053_Tx, ComPduIdRef=EcucPduCollection/IemPropSignalIPdu16_a67b3392_Tx
          ComTxIPdu: ComTxIPduUnusedAreasDefault=0
            ComTxModeTrue
              ComTxMode: ComTxModeMode=PERIODIC, ComTxModeTimeOffset=0, ComTxModeTimePeriod=0.02
        PropulsionCAN_33157db4_Rx: ComIPduDirection=RECEIVE, ComIPduSignalRef=PropulsionCAN_db9c2837_Rx, ComPduIdRef=PropulsionCAN_c71a5358_Rx
        SrsPropSignalIPdu02_4fa2d123_Rx: ComIPduDirection=RECEIVE, ComIPduType=NORMAL, ComIPduGroupRef=RxSPG_PropulsionCAN_PNC26_17c8347d, ComIPduGroupRef=RxSPG_PropulsionCAN_PNC29_877729ec, ComIPduGroupRef=RxSPG_PropulsionCAN_PNC30_e7b0a009, ComIPduGroupRef=RxSPG_PropulsionCAN_PNC39_9e6c18ad, ComIPduSignalGroupRef=igCrashStsSafe_0a09c5f2_Rx, ComPduIdRef=EcucPduCollection/SrsPropSignalIPdu02_4fa2d123_Rx
        VDDMPropSignalIPDU05_e9cd0dca_Rx: ComIPduDirection=RECEIVE, ComIPduType=NORMAL, ComIPduGroupRef=RxSPG_PropulsionCAN_PNC26_17c8347d, ComIPduGroupRef=RxSPG_PropulsionCAN_PNC29_877729ec, ComIPduGroupRef=RxSPG_PropulsionCAN_PNC30_e7b0a009, ComIPduSignalGroupRef=igVehMtnSt_68a0f345_Rx, ComIPduSignalGroupRef=igVehSpdLgt_56c0cfd4_Rx, ComPduIdRef=EcucPduCollection/VDDMPropSignalIPDU05_e9cd0dca_Rx
        VDDMPropSignalIPDU06_70c45c70_Rx: ComIPduDirection=RECEIVE, ComIPduType=NORMAL, ComIPduGroupRef=RxSPG_PropulsionCAN_fca0cb9e, ComIPduSignalGroupRef=igVehCfgPrm_eee11443_Rx, ComPduIdRef=EcucPduCollection/VDDMPropSignalIPDU06_70c45c70_Rx
        VDDMPropSignalIPDU08_977c7177_Rx: ComIPduDirection=RECEIVE, ComIPduType=NORMAL, ComIPduGroupRef=RxSPG_PropulsionCAN_PNC29_877729ec, ComIPduGroupRef=RxSPG_PropulsionCAN_PNC39_9e6c18ad, ComIPduSignalGroupRef=igPtTqAtAxleMaxReq_e1a6f04e_Rx, ComPduIdRef=EcucPduCollection/VDDMPropSignalIPDU08_977c7177_Rx
        VDDMPropSignalIPDU11_f7bbf892_Rx: ComIPduDirection=RECEIVE, ComIPduType=NORMAL, ComIPduGroupRef=RxSPG_PropulsionCAN_PNC26_17c8347d, ComIPduGroupRef=RxSPG_PropulsionCAN_PNC29_877729ec, ComIPduGroupRef=RxSPG_PropulsionCAN_PNC30_e7b0a009, ComIPduSignalRef=isSpdRotlForWhlsAtAxleRe_cda9e459_Rx, ComPduIdRef=EcucPduCollection/VDDMPropSignalIPDU11_f7bbf892_Rx
        VDDMPropSignalIPDU16_69df6d31_Rx: ComIPduDirection=RECEIVE, ComIPduType=NORMAL, ComIPduGroupRef=RxSPG_PropulsionCAN_PNC24_f9c65551, ComIPduGroupRef=RxSPG_PropulsionCAN_PNC26_17c8347d, ComIPduGroupRef=RxSPG_PropulsionCAN_PNC29_877729ec, ComIPduSignalGroupRef=igImobEngMgrReq2_1df0559d_Rx, ComPduIdRef=EcucPduCollection/VDDMPropSignalIPDU16_69df6d31_Rx
        VDDMPropSignalIPDU17_1ed85da7_Rx: ComIPduDirection=RECEIVE, ComIPduType=NORMAL, ComIPduGroupRef=RxSPG_PropulsionCAN_fca0cb9e, ComIPduSignalRef=isCarTiGlb_7a3bdc75_Rx, ComPduIdRef=EcucPduCollection/VDDMPropSignalIPDU17_1ed85da7_Rx
        VDDMPropSignalIPDU18_8e674036_Rx: ComIPduDirection=RECEIVE, ComIPduType=NORMAL, ComIPduGroupRef=RxSPG_PropulsionCAN_fca0cb9e, ComIPduSignalGroupRef=igVehModMngtGlbSafe1_d1f2be1a_Rx, ComPduIdRef=EcucPduCollection/VDDMPropSignalIPDU18_8e674036_Rx
        VDDMPropSignalIPDU19_f96070a0_Rx: ComIPduDirection=RECEIVE, ComIPduType=NORMAL, ComIPduGroupRef=RxSPG_PropulsionCAN_fca0cb9e, ComIPduSignalGroupRef=igVehBattU_0a2a47a4_Rx, ComIPduSignalRef=isBkpOfDstTrvld_1c9ea633_Rx, ComPduIdRef=EcucPduCollection/VDDMPropSignalIPDU19_f96070a0_Rx
        VDDMPropdTCSignalIPdu38_808bfd3f_Rx: ComIPduDirection=RECEIVE, ComIPduType=NORMAL, ComIPduGroupRef=RxSPG_PropulsionCAN_fca0cb9e, ComIPduSignalGroupRef=igStcStsToDmc_cb036148_Rx, ComPduIdRef=EcucPduCollection/VDDMPropdTCSignalIPdu38_808bfd3f_Rx
        VddmBcmPropdTCSignalIPDU01_886bd56f_Rx: ComIPduDirection=RECEIVE, ComIPduType=NORMAL, ComIPduGroupRef=RxSPG_PropulsionCAN_fca0cb9e, ComIPduSignalGroupRef=igEscVariantToDmc_3c205019_Rx, ComPduIdRef=EcucPduCollection/VddmBcmPropdTCSignalIPDU01_886bd56f_Rx
        VddmPropSignalIPdu26_8fec2bf2_Rx: ComIPduDirection=RECEIVE, ComIPduType=NORMAL, ComIPduGroupRef=RxSPG_PropulsionCAN_fca0cb9e, ComIPduSignalGroupRef=igVehCfgPrmExt_b2e1e62e_Rx, ComPduIdRef=EcucPduCollection/VddmPropSignalIPdu26_8fec2bf2_Rx
      22 x ComIPduGroup:
        RxMPG_PropulsionCAN_aad5aa75
        RxSPG_PropulsionCAN_PNC24_f9c65551: ComIPduGroupGroupRef=RxMPG_PropulsionCAN_aad5aa75
        RxSPG_PropulsionCAN_PNC25_8ec165c7: ComIPduGroupGroupRef=RxMPG_PropulsionCAN_aad5aa75
        RxSPG_PropulsionCAN_PNC26_17c8347d: ComIPduGroupGroupRef=RxMPG_PropulsionCAN_aad5aa75
        RxSPG_PropulsionCAN_PNC27_60cf04eb: ComIPduGroupGroupRef=RxMPG_PropulsionCAN_aad5aa75
        RxSPG_PropulsionCAN_PNC29_877729ec: ComIPduGroupGroupRef=RxMPG_PropulsionCAN_aad5aa75
        RxSPG_PropulsionCAN_PNC30_e7b0a009: ComIPduGroupGroupRef=RxMPG_PropulsionCAN_aad5aa75
        RxSPG_PropulsionCAN_PNC35_97da5486: ComIPduGroupGroupRef=RxMPG_PropulsionCAN_aad5aa75
        RxSPG_PropulsionCAN_PNC39_9e6c18ad: ComIPduGroupGroupRef=RxMPG_PropulsionCAN_aad5aa75
        RxSPG_PropulsionCAN_fca0cb9e: ComIPduGroupGroupRef=RxMPG_PropulsionCAN_aad5aa75
        TxMPG_PropulsionCAN_3709a166
        TxSPG_PropulsionCAN_617cc08d: ComIPduGroupGroupRef=TxMPG_PropulsionCAN_3709a166
        TxSPG_PropulsionCAN_PNC16_573e0b18: ComIPduGroupGroupRef=TxMPG_PropulsionCAN_3709a166
        TxSPG_PropulsionCAN_PNC24_921d39f7: ComIPduGroupGroupRef=TxMPG_PropulsionCAN_3709a166
        TxSPG_PropulsionCAN_PNC25_e51a0961: ComIPduGroupGroupRef=TxMPG_PropulsionCAN_3709a166
        TxSPG_PropulsionCAN_PNC26_7c1358db: ComIPduGroupGroupRef=TxMPG_PropulsionCAN_3709a166
        TxSPG_PropulsionCAN_PNC27_0b14684d: ComIPduGroupGroupRef=TxMPG_PropulsionCAN_3709a166
        TxSPG_PropulsionCAN_PNC29_ecac454a: ComIPduGroupGroupRef=TxMPG_PropulsionCAN_3709a166
        TxSPG_PropulsionCAN_PNC30_8c6bccaf: ComIPduGroupGroupRef=TxMPG_PropulsionCAN_3709a166
        TxSPG_PropulsionCAN_PNC33_15629d15: ComIPduGroupGroupRef=TxMPG_PropulsionCAN_3709a166
        TxSPG_PropulsionCAN_PNC35_fc013820: ComIPduGroupGroupRef=TxMPG_PropulsionCAN_3709a166
        TxSPG_PropulsionCAN_PNC39_f5b7740b: ComIPduGroupGroupRef=TxMPG_PropulsionCAN_3709a166
      42 x ComSignal:
        PropulsionCAN_db9c2837_Rx: ComSignalLength=6, ComSignalType=UINT8_N
        isBkpOfDstTrvld_1c9ea633_Rx: ComBitPosition=20, ComBitSize=21, ComSignalEndianness=BIG_ENDIAN, ComSignalInitValue=0, ComSignalType=UINT32, ComUpdateBitPosition=21, ComSystemTemplateSystemSignalRef=isBkpOfDstTrvld_mrx
        isCarTiGlb_7a3bdc75_Rx: ComBitPosition=7, ComBitSize=32, ComSignalEndianness=BIG_ENDIAN, ComSignalInitValue=0, ComSignalType=UINT32, ComUpdateBitPosition=39, ComSystemTemplateSystemSignalRef=isCarTiGlb_mrx
        isCooltFlowForDtElec_89c7c93c_Rx: ComBitPosition=41, ComBitSize=9, ComSignalEndianness=BIG_ENDIAN, ComSignalInitValue=0, ComSignalType=UINT16, ComUpdateBitPosition=6, ComSystemTemplateSystemSignalRef=isCooltFlowForDtElec_mrx
        isCooltTSigForDtElec_f43a3873_Rx: ComBitPosition=39, ComBitSize=11, ComSignalEndianness=BIG_ENDIAN, ComSignalInitValue=400, ComSignalType=UINT16, ComUpdateBitPosition=5, ComSystemTemplateSystemSignalRef=isCooltTSigForDtElec_mrx
        isDCChrgnHndlSts_7439a8f3_Rx: ComBitPosition=23, ComBitSize=3, ComSignalEndianness=BIG_ENDIAN, ComSignalInitValue=0, ComSignalType=UINT8, ComUpdateBitPosition=35, ComSystemTemplateSystemSignalRef=isDCChrgnHndlSts_mrx
        isDrvgCyc_edb7d721_Rx: ComBitPosition=5, ComBitSize=1, ComSignalEndianness=BIG_ENDIAN, ComSignalInitValue=0, ComSignalType=UINT8, ComUpdateBitPosition=4, ComSystemTemplateSystemSignalRef=isDrvgCyc_mrx
        isGearLvrIndcn_bb4b951e_Rx: ComBitPosition=27, ComBitSize=3, ComSignalEndianness=BIG_ENDIAN, ComSignalInitValue=7, ComSignalType=UINT8, ComUpdateBitPosition=24, ComSystemTemplateSystemSignalRef=isGearLvrIndcn_mrx
        isHvBattSoc_ce242c3f_Rx: ComBitPosition=47, ComBitSize=11, ComSignalEndianness=BIG_ENDIAN, ComSignalInitValue=0, ComSignalType=UINT16, ComUpdateBitPosition=52, ComSystemTemplateSystemSignalRef=isHvBattSoc_mrx
        isHvBattUDc_bcd9ade4_Rx: ComBitPosition=18, ComBitSize=11, ComSignalEndianness=BIG_ENDIAN, ComSignalInitValue=0, ComSignalType=UINT16, ComUpdateBitPosition=19, ComSystemTemplateSystemSignalRef=isHvBattUDc_mrx
        isHvBattUDynMaxLim_6d11df88_Rx: ComBitPosition=34, ComBitSize=11, ComSignalEndianness=BIG_ENDIAN, ComSignalInitValue=0, ComSignalType=UINT16, ComUpdateBitPosition=35, ComSystemTemplateSystemSignalRef=isHvBattUDynMaxLim_mrx
        isHvBattUDynMinLim_28139c0a_Rx: ComBitPosition=26, ComBitSize=11, ComSignalEndianness=BIG_ENDIAN, ComSignalInitValue=0, ComSignalType=UINT16, ComUpdateBitPosition=27, ComSystemTemplateSystemSignalRef=isHvBattUDynMinLim_mrx
        isImobEngSts2_5f8745c8_Tx: ComBitPosition=36, ComBitSize=2, ComSignalEndianness=BIG_ENDIAN, ComSignalInitValue=0, ComSignalType=UINT8, ComTransferProperty=PENDING, ComUpdateBitPosition=37, ComSystemTemplateSystemSignalRef=isImobEngSts2_mtx
        isOnBdChrgrHndlSts1_677311c9_Rx: ComBitPosition=19, ComBitSize=4, ComSignalEndianness=BIG_ENDIAN, ComSignalInitValue=8, ComSignalType=UINT8, ComUpdateBitPosition=20, ComSystemTemplateSystemSignalRef=isOnBdChrgrHndlSts1_mrx
        isPLockFltIndcRe_f756fd30_Tx: ComBitPosition=4, ComBitSize=3, ComSignalEndianness=BIG_ENDIAN, ComSignalInitValue=0, ComSignalType=UINT8, ComTransferProperty=PENDING, ComUpdateBitPosition=5, ComSystemTemplateSystemSignalRef=isPLockFltIndcRe_mtx
        isPLockFltLvlRe_167e1ed2_Tx: ComBitPosition=7, ComBitSize=2, ComSignalEndianness=BIG_ENDIAN, ComSignalInitValue=0, ComSignalType=UINT8, ComTransferProperty=PENDING, ComUpdateBitPosition=55, ComSystemTemplateSystemSignalRef=isPLockFltLvlRe_mtx
        isPLockParkReq_5b6f1b96_Rx: ComBitPosition=53, ComBitSize=2, ComSignalEndianness=BIG_ENDIAN, ComSignalInitValue=0, ComSignalType=UINT8, ComUpdateBitPosition=51, ComSystemTemplateSystemSignalRef=isPLockParkReq_mrx
        isPLockParkStsRe_8fb3cac5_Tx: ComBitPosition=23, ComBitSize=4, ComSignalEndianness=BIG_ENDIAN, ComSignalInitValue=7, ComSignalType=UINT8, ComTransferProperty=PENDING, ComUpdateBitPosition=7, ComSystemTemplateSystemSignalRef=isPLockParkStsRe_mtx
        isPrpsnFbLimnIndcn_5674da6b_Rx: ComBitPosition=22, ComBitSize=4, ComSignalEndianness=BIG_ENDIAN, ComSignalInitValue=0, ComSignalType=UINT8, ComUpdateBitPosition=23, ComSystemTemplateSystemSignalRef=isPrpsnFbLimnIndcn_mrx
        isRearHeatModEnad_a110df41_Rx: ComBitPosition=11, ComBitSize=2, ComSignalEndianness=BIG_ENDIAN, ComSignalInitValue=2, ComSignalType=UINT8, ComUpdateBitPosition=14, ComSystemTemplateSystemSignalRef=isRearHeatModEnad_mrx
        isRearHeatPwrAllwd_c919804a_Rx: ComBitPosition=23, ComBitSize=8, ComSignalEndianness=BIG_ENDIAN, ComSignalInitValue=0, ComSignalType=UINT8, ComUpdateBitPosition=15, ComSystemTemplateSystemSignalRef=isRearHeatPwrAllwd_mrx
        isSpdRotlForWhlsAtAxleRe_cda9e459_Rx: ComBitPosition=38, ComBitSize=15, ComSignalEndianness=BIG_ENDIAN, ComSignalInitValue=0, ComSignalType=UINT16, ComUpdateBitPosition=39, ComSystemTemplateSystemSignalRef=isSpdRotlForWhlsAtAxleRe_mrx
        isWhlMotClrRdyReq_189c9369_Tx: ComBitPosition=24, ComBitSize=1, ComSignalEndianness=BIG_ENDIAN, ComSignalInitValue=0, ComSignalType=UINT8, ComTransferProperty=PENDING, ComUpdateBitPosition=25, ComSystemTemplateSystemSignalRef=isWhlMotClrRdyReq_mtx
        isWhlMotCooltFlowMinReq_102e8fa4_Tx: ComBitPosition=1, ComBitSize=10, ComSignalEndianness=BIG_ENDIAN, ComSignalInitValue=0, ComSignalType=UINT16, ComTransferProperty=PENDING, ComUpdateBitPosition=54, ComSystemTemplateSystemSignalRef=isWhlMotCooltFlowMinReq_mtx
          ComFilter: ComFilterAlgorithm=ALWAYS
        isWhlMotSysActvDampgModReq_1c578291_Rx: ComBitPosition=50, ComBitSize=2, ComSignalEndianness=BIG_ENDIAN, ComSignalInitValue=0, ComSignalType=UINT8, ComUpdateBitPosition=48, ComSystemTemplateSystemSignalRef=isWhlMotSysActvDampgModReq_mrx
        isWhlMotSysCoolgReq_32e8ee03_Tx: ComBitPosition=14, ComBitSize=3, ComSignalEndianness=BIG_ENDIAN, ComSignalInitValue=0, ComSignalType=UINT8, ComTransferProperty=PENDING, ComUpdateBitPosition=11, ComSystemTemplateSystemSignalRef=isWhlMotSysCoolgReq_mtx
        isWhlMotSysCooltT_da703242_Tx: ComBitPosition=31, ComBitSize=8, ComSignalEndianness=BIG_ENDIAN, ComSignalInitValue=40, ComSignalType=UINT8, ComTransferProperty=PENDING, ComUpdateBitPosition=16, ComSystemTemplateSystemSignalRef=isWhlMotSysCooltT_mtx
        isWhlMotSysErrIndcnReq_d5e6edc2_Tx: ComBitPosition=10, ComBitSize=1, ComSignalEndianness=BIG_ENDIAN, ComSignalInitValue=0, ComSignalType=UINT8, ComTransferProperty=PENDING, ComUpdateBitPosition=9, ComSystemTemplateSystemSignalRef=isWhlMotSysErrIndcnReq_mtx
        isWhlMotSysHeatFdBck_516116c8_Tx: ComBitPosition=15, ComBitSize=2, ComSignalEndianness=BIG_ENDIAN, ComSignalInitValue=1, ComSignalType=UINT8, ComTransferProperty=PENDING, ComUpdateBitPosition=13, ComSystemTemplateSystemSignalRef=isWhlMotSysHeatFdBck_mtx
        isWhlMotSysHeatPwrAct_e1709dcf_Tx: ComBitPosition=31, ComBitSize=8, ComSignalEndianness=BIG_ENDIAN, ComSignalInitValue=0, ComSignalType=UINT8, ComTransferProperty=PENDING, ComUpdateBitPosition=19, ComSystemTemplateSystemSignalRef=isWhlMotSysHeatPwrAct_mtx
        isWhlMotSysHeatPwrMax_d3ea4a02_Tx: ComBitPosition=7, ComBitSize=8, ComSignalEndianness=BIG_ENDIAN, ComSignalInitValue=0, ComSignalType=UINT8, ComTransferProperty=PENDING, ComUpdateBitPosition=12, ComSystemTemplateSystemSignalRef=isWhlMotSysHeatPwrMax_mtx
          ComFilter: ComFilterAlgorithm=ALWAYS
        isWhlMotSysIdc_56101b54_Tx: ComBitPosition=5, ComBitSize=14, ComSignalEndianness=BIG_ENDIAN, ComSignalInitValue=8188, ComSignalType=UINT16, ComTransferProperty=PENDING, ComUpdateBitPosition=6, ComSystemTemplateSystemSignalRef=isWhlMotSysIdc_mtx
          ComFilter: ComFilterAlgorithm=ALWAYS
        isWhlMotSysInvrT_11341a35_Tx: ComBitPosition=7, ComBitSize=8, ComSignalEndianness=BIG_ENDIAN, ComSignalInitValue=50, ComSignalType=UINT8, ComTransferProperty=PENDING, ComUpdateBitPosition=15, ComSystemTemplateSystemSignalRef=isWhlMotSysInvrT_mtx
          ComFilter: ComFilterAlgorithm=ALWAYS
        isWhlMotSysLimnIndcn_9f88a06a_Tx: ComBitPosition=55, ComBitSize=16, ComSignalEndianness=BIG_ENDIAN, ComSignalInitValue=0, ComSignalType=UINT16, ComTransferProperty=PENDING, ComUpdateBitPosition=39, ComSystemTemplateSystemSignalRef=isWhlMotSysLimnIndcn_mtx
        isWhlMotSysModReq_0153ebfe_Rx: ComBitPosition=58, ComBitSize=3, ComSignalEndianness=BIG_ENDIAN, ComSignalInitValue=0, ComSignalType=UINT8, ComUpdateBitPosition=59, ComSystemTemplateSystemSignalRef=isWhlMotSysModReq_mrx
        isWhlMotSysModSts_bd46c3f5_Tx: ComBitPosition=35, ComBitSize=4, ComSignalEndianness=BIG_ENDIAN, ComSignalInitValue=0, ComSignalType=UINT8, ComTransferProperty=PENDING, ComUpdateBitPosition=36, ComSystemTemplateSystemSignalRef=isWhlMotSysModSts_mtx
        isWhlMotSysMotT_54e003b6_Tx: ComBitPosition=23, ComBitSize=8, ComSignalEndianness=BIG_ENDIAN, ComSignalInitValue=50, ComSignalType=UINT8, ComTransferProperty=PENDING, ComUpdateBitPosition=8, ComSystemTemplateSystemSignalRef=isWhlMotSysMotT_mtx
        isWhlMotSysPwrLimMax_45b5505a_Rx: ComBitPosition=41, ComBitSize=10, ComSignalEndianness=BIG_ENDIAN, ComSignalInitValue=0, ComSignalType=UINT16, ComUpdateBitPosition=45, ComSystemTemplateSystemSignalRef=isWhlMotSysPwrLimMax_mrx
        isWhlMotSysPwrLimMin_79b86f03_Rx: ComBitPosition=23, ComBitSize=10, ComSignalEndianness=BIG_ENDIAN, ComSignalInitValue=1022, ComSignalType=UINT16, ComUpdateBitPosition=29, ComSystemTemplateSystemSignalRef=isWhlMotSysPwrLimMin_mrx
        isWhlMotSysSpdAct_e26fc666_Tx: ComBitPosition=6, ComBitSize=15, ComSignalEndianness=BIG_ENDIAN, ComSignalInitValue=0, ComSignalType=SINT16, ComTransferProperty=PENDING, ComUpdateBitPosition=7, ComSystemTemplateSystemSignalRef=isWhlMotSysSpdAct_mtx
          ComFilter: ComFilterAlgorithm=ALWAYS
        isWhlMotSysTqReq_f0fdb022_Rx: ComBitPosition=11, ComBitSize=12, ComSignalEndianness=BIG_ENDIAN, ComSignalInitValue=2047, ComSignalType=UINT16, ComUpdateBitPosition=12, ComSystemTemplateSystemSignalRef=isWhlMotSysTqReq_mrx
        isWhlMotSysUdc_432c4140_Tx: ComBitPosition=34, ComBitSize=11, ComSignalEndianness=BIG_ENDIAN, ComSignalInitValue=0, ComSignalType=UINT16, ComTransferProperty=PENDING, ComUpdateBitPosition=38, ComSystemTemplateSystemSignalRef=isWhlMotSysUdc_mtx
      23 x ComSignalGroup:
        igCrashStsSafe_0a09c5f2_Rx: ComUpdateBitPosition=5, ComSystemTemplateSignalGroupRef=igCrashStsSafe_mrx
          3 x ComGroupSignal, all with ComSignalEndianness=BIG_ENDIAN, ComSignalType=UINT8:
            isCrashStsSafeChks_42d0b327_Rx: ComBitPosition=15, ComBitSize=8, ComSignalInitValue=255, ComSystemTemplateSystemSignalRef=isCrashStsSafeChks_mrx
            isCrashStsSafeCntr_fc00f19d_Rx: ComBitPosition=3, ComBitSize=4, ComSignalInitValue=0, ComSystemTemplateSystemSignalRef=isCrashStsSafeCntr_mrx
            isCrashStsSafeSts_847c5d07_Rx: ComBitPosition=4, ComBitSize=1, ComSignalInitValue=0, ComSystemTemplateSystemSignalRef=isCrashStsSafeSts_mrx
        igDmcStsRearToEsc_5d8e0053_Tx: ComTransferProperty=PENDING, ComUpdateBitPosition=56, ComSystemTemplateSignalGroupRef=igDmcStsRearToEsc_mtx
          5 x ComGroupSignal, all with ComSignalEndianness=BIG_ENDIAN, ComSignalInitValue=0:
            isDmcStsRearToEscChks_0817ec86_Tx: ComBitPosition=7, ComBitSize=8, ComSignalType=UINT8, ComSystemTemplateSystemSignalRef=isDmcStsRearToEscChks_mtx
              ComFilter: ComFilterAlgorithm=ALWAYS
            isDmcStsRearToEscCntr_b6c7ae3c_Tx: ComBitPosition=15, ComBitSize=4, ComSignalType=UINT8, ComSystemTemplateSystemSignalRef=isDmcStsRearToEscCntr_mtx
            isDmcStsRearToEscDmcActAppTarTq_eaa126f0_Tx: ComBitPosition=23, ComBitSize=16, ComSignalType=SINT16, ComSystemTemplateSystemSignalRef=isDmcStsRearToEscDmcActAppTarTq_mtx
            isDmcStsRearToEscDmcSWInfo_6d930900_Tx: ComBitPosition=39, ComBitSize=16, ComSignalType=UINT16, ComSystemTemplateSystemSignalRef=isDmcStsRearToEscDmcSWInfo_mtx
            isDmcStsRearToEscDmcSts_2fffc6c5_Tx: ComBitPosition=11, ComBitSize=4, ComSignalType=UINT8, ComSystemTemplateSystemSignalRef=isDmcStsRearToEscDmcSts_mtx
        igEngSt1WdSts_adcf75d2_Rx: ComUpdateBitPosition=31, ComSystemTemplateSignalGroupRef=igEngSt1WdSts_mrx
          3 x ComGroupSignal, all with ComSignalEndianness=BIG_ENDIAN, ComSignalInitValue=0, ComSignalType=UINT8:
            isEngSt1WdStsChks_75cf5b53_Rx: ComBitPosition=39, ComBitSize=8, ComSystemTemplateSystemSignalRef=isEngSt1WdStsChks_mrx
            isEngSt1WdStsCntr_cb1f19e9_Rx: ComBitPosition=47, ComBitSize=4, ComSystemTemplateSystemSignalRef=isEngSt1WdStsCntr_mrx
            isEngSt1WdStsEngSt1WdSts_21868fa0_Rx: ComBitPosition=43, ComBitSize=4, ComSystemTemplateSystemSignalRef=isEngSt1WdStsEngSt1WdSts_mrx
        igEscVariantToDmc_3c205019_Rx: ComUpdateBitPosition=4, ComSystemTemplateSignalGroupRef=igEscVariantToDmc_mrx
          3 x ComGroupSignal, all with ComSignalEndianness=BIG_ENDIAN, ComSignalInitValue=0, ComSignalType=UINT8:
            isEscVariantToDmcChks_9a33bac6_Rx: ComBitPosition=15, ComBitSize=8, ComSystemTemplateSystemSignalRef=isEscVariantToDmcChks_mrx
            isEscVariantToDmcCntr_24e3f87c_Rx: ComBitPosition=3, ComBitSize=4, ComSystemTemplateSystemSignalRef=isEscVariantToDmcCntr_mrx
            isEscVariantToDmcEscVariantToDmc_daa2c955_Rx: ComBitPosition=23, ComBitSize=8, ComSystemTemplateSystemSignalRef=isEscVariantToDmcEscVariantToDmc_mrx
        igHvSysRlySts_760c5326_Rx: ComUpdateBitPosition=22, ComSystemTemplateSignalGroupRef=igHvSysRlySts_mrx
          3 x ComGroupSignal, all with ComSignalEndianness=BIG_ENDIAN, ComSignalType=UINT8:
            isHvSysRlyStsChks_b1dd6f20_Rx: ComBitPosition=15, ComBitSize=8, ComSignalInitValue=0, ComSystemTemplateSystemSignalRef=isHvSysRlyStsChks_mrx
            isHvSysRlyStsCntr_0f0d2d9a_Rx: ComBitPosition=3, ComBitSize=4, ComSignalInitValue=0, ComSystemTemplateSystemSignalRef=isHvSysRlyStsCntr_mrx
            isHvSysRlyStsHvSysRlySts_5b219bea_Rx: ComBitPosition=5, ComBitSize=2, ComSignalInitValue=2, ComSystemTemplateSystemSignalRef=isHvSysRlyStsHvSysRlySts_mrx
        igIEMTestFr1_f9c0b06a_Tx: ComTransferProperty=TRIGGERED, ComSystemTemplateSignalGroupRef=igIEMTestFr1_mtx
          8 x ComGroupSignal, all with ComBitSize=8, ComSignalEndianness=BIG_ENDIAN, ComSignalInitValue=0, ComSignalType=UINT8:
            isIEMTestFr1Byte0_eb2525b1_Tx: ComBitPosition=7, ComSystemTemplateSystemSignalRef=isIEMTestFr1Byte0_mtx
              ComFilter: ComFilterAlgorithm=ALWAYS
            isIEMTestFr1Byte1_9c221527_Tx: ComBitPosition=15, ComSystemTemplateSystemSignalRef=isIEMTestFr1Byte1_mtx
            isIEMTestFr1Byte2_052b449d_Tx: ComBitPosition=23, ComSystemTemplateSystemSignalRef=isIEMTestFr1Byte2_mtx
            isIEMTestFr1Byte3_722c740b_Tx: ComBitPosition=31, ComSystemTemplateSystemSignalRef=isIEMTestFr1Byte3_mtx
            isIEMTestFr1Byte4_ec48e1a8_Tx: ComBitPosition=39, ComSystemTemplateSystemSignalRef=isIEMTestFr1Byte4_mtx
            isIEMTestFr1Byte5_9b4fd13e_Tx: ComBitPosition=47, ComSystemTemplateSystemSignalRef=isIEMTestFr1Byte5_mtx
            isIEMTestFr1Byte6_02468084_Tx: ComBitPosition=55, ComSystemTemplateSystemSignalRef=isIEMTestFr1Byte6_mtx
            isIEMTestFr1Byte7_7541b012_Tx: ComBitPosition=63, ComSystemTemplateSystemSignalRef=isIEMTestFr1Byte7_mtx
        igIEMTestFr2_60c9e1d0_Tx: ComTransferProperty=TRIGGERED, ComSystemTemplateSignalGroupRef=igIEMTestFr2_mtx
          8 x ComGroupSignal, all with ComBitSize=8, ComSignalEndianness=BIG_ENDIAN, ComSignalInitValue=0, ComSignalType=UINT8:
            isIEMTestFr2Byte0_6db1571f_Tx: ComBitPosition=7, ComSystemTemplateSystemSignalRef=isIEMTestFr2Byte0_mtx
              ComFilter: ComFilterAlgorithm=ALWAYS
            isIEMTestFr2Byte1_1ab66789_Tx: ComBitPosition=15, ComSystemTemplateSystemSignalRef=isIEMTestFr2Byte1_mtx
            isIEMTestFr2Byte2_83bf3633_Tx: ComBitPosition=23, ComSystemTemplateSystemSignalRef=isIEMTestFr2Byte2_mtx
            isIEMTestFr2Byte3_f4b806a5_Tx: ComBitPosition=31, ComSystemTemplateSystemSignalRef=isIEMTestFr2Byte3_mtx
            isIEMTestFr2Byte4_6adc9306_Tx: ComBitPosition=39, ComSystemTemplateSystemSignalRef=isIEMTestFr2Byte4_mtx
            isIEMTestFr2Byte5_1ddba390_Tx: ComBitPosition=47, ComSystemTemplateSystemSignalRef=isIEMTestFr2Byte5_mtx
            isIEMTestFr2Byte6_84d2f22a_Tx: ComBitPosition=55, ComSystemTemplateSystemSignalRef=isIEMTestFr2Byte6_mtx
            isIEMTestFr2Byte7_f3d5c2bc_Tx: ComBitPosition=63, ComSystemTemplateSystemSignalRef=isIEMTestFr2Byte7_mtx
        igIEMTestFr3_17ced146_Tx: ComTransferProperty=TRIGGERED, ComSystemTemplateSignalGroupRef=igIEMTestFr3_mtx
          8 x ComGroupSignal, all with ComBitSize=8, ComSignalEndianness=BIG_ENDIAN, ComSignalInitValue=0, ComSignalType=UINT8:
            isIEMTestFr3Byte0_a6ed84ba_Tx: ComBitPosition=7, ComSystemTemplateSystemSignalRef=isIEMTestFr3Byte0_mtx
              ComFilter: ComFilterAlgorithm=ALWAYS
            isIEMTestFr3Byte1_d1eab42c_Tx: ComBitPosition=15, ComSystemTemplateSystemSignalRef=isIEMTestFr3Byte1_mtx
            isIEMTestFr3Byte2_48e3e596_Tx: ComBitPosition=23, ComSystemTemplateSystemSignalRef=isIEMTestFr3Byte2_mtx
            isIEMTestFr3Byte3_3fe4d500_Tx: ComBitPosition=31, ComSystemTemplateSystemSignalRef=isIEMTestFr3Byte3_mtx
            isIEMTestFr3Byte4_a18040a3_Tx: ComBitPosition=39, ComSystemTemplateSystemSignalRef=isIEMTestFr3Byte4_mtx
            isIEMTestFr3Byte5_d6877035_Tx: ComBitPosition=47, ComSystemTemplateSystemSignalRef=isIEMTestFr3Byte5_mtx
            isIEMTestFr3Byte6_4f8e218f_Tx: ComBitPosition=55, ComSystemTemplateSystemSignalRef=isIEMTestFr3Byte6_mtx
            isIEMTestFr3Byte7_38891119_Tx: ComBitPosition=63, ComSystemTemplateSystemSignalRef=isIEMTestFr3Byte7_mtx
        igIemGeneric_ab95030b_Tx: ComTransferProperty=PENDING, ComSystemTemplateSignalGroupRef=igIemGeneric_mtx
          16 x ComGroupSignal, all with ComSignalEndianness=BIG_ENDIAN, ComSignalType=UINT8:
            isIemGenericADAlrmSt_2216fde0_Tx: ComBitPosition=55, ComBitSize=2, ComSignalInitValue=0, ComSystemTemplateSystemSignalRef=isIemGenericADAlrmSt_mtx
            isIemGenericDTCHig_6365ed22_Tx: ComBitPosition=7, ComBitSize=8, ComSignalInitValue=0, ComSystemTemplateSystemSignalRef=isIemGenericDTCHig_mtx
              ComFilter: ComFilterAlgorithm=ALWAYS
            isIemGenericDTCLow_2f81f21c_Tx: ComBitPosition=15, ComBitSize=8, ComSignalInitValue=0, ComSystemTemplateSystemSignalRef=isIemGenericDTCLow_mtx
            isIemGenericDTCMid_fca77e73_Tx: ComBitPosition=23, ComBitSize=8, ComSignalInitValue=0, ComSystemTemplateSystemSignalRef=isIemGenericDTCMid_mtx
            isIemGenericDTCSts_96a019d2_Tx: ComBitPosition=31, ComBitSize=8, ComSignalInitValue=0, ComSystemTemplateSystemSignalRef=isIemGenericDTCSts_mtx
            isIemGenericEMQnty_067a3f4d_Tx: ComBitPosition=39, ComBitSize=4, ComSignalInitValue=0, ComSystemTemplateSystemSignalRef=isIemGenericEMQnty_mtx
            isIemGenericEMSeqNr_5f6f0e31_Tx: ComBitPosition=35, ComBitSize=4, ComSignalInitValue=0, ComSystemTemplateSystemSignalRef=isIemGenericEMSeqNr_mtx
            isIemGenericFltAlrmSt_094332cf_Tx: ComBitPosition=53, ComBitSize=2, ComSignalInitValue=0, ComSystemTemplateSystemSignalRef=isIemGenericFltAlrmSt_mtx
            isIemGenericIacAlrmSt_ef864a8f_Tx: ComBitPosition=51, ComBitSize=2, ComSignalInitValue=0, ComSystemTemplateSystemSignalRef=isIemGenericIacAlrmSt_mtx
            isIemGenericInvrtTAlrmSt_ad103698_Tx: ComBitPosition=49, ComBitSize=2, ComSignalInitValue=0, ComSystemTemplateSystemSignalRef=isIemGenericInvrtTAlrmSt_mtx
            isIemGenericModStatusRms_527fb71c_Tx: ComBitPosition=47, ComBitSize=4, ComSignalInitValue=3, ComSystemTemplateSystemSignalRef=isIemGenericModStatusRms_mtx
            isIemGenericMotTAlrmSt_e29bb0dd_Tx: ComBitPosition=63, ComBitSize=2, ComSignalInitValue=0, ComSystemTemplateSystemSignalRef=isIemGenericMotTAlrmSt_mtx
            isIemGenericRslAlrmSt_09c5d09c_Tx: ComBitPosition=61, ComBitSize=2, ComSignalInitValue=0, ComSystemTemplateSystemSignalRef=isIemGenericRslAlrmSt_mtx
            isIemGenericSpdAlrmSt_a3de8d5b_Tx: ComBitPosition=59, ComBitSize=2, ComSignalInitValue=0, ComSystemTemplateSystemSignalRef=isIemGenericSpdAlrmSt_mtx
            isIemGenericTypeInfo_10f77ae7_Tx: ComBitPosition=43, ComBitSize=4, ComSignalInitValue=0, ComSystemTemplateSystemSignalRef=isIemGenericTypeInfo_mtx
            isIemGenericUDcAlrmSt_14e497d8_Tx: ComBitPosition=57, ComBitSize=2, ComSignalInitValue=0, ComSystemTemplateSystemSignalRef=isIemGenericUDcAlrmSt_mtx
        igImobEngChk2_35eae3c1_Tx: ComTransferProperty=PENDING, ComUpdateBitPosition=1, ComSystemTemplateSignalGroupRef=igImobEngChk2_mtx
          8 x ComGroupSignal, all with ComSignalEndianness=BIG_ENDIAN, ComSignalInitValue=0, ComSignalType=UINT8:
            isImobEngChk2ImobEngChkSts_8e88c5e4_Tx: ComBitPosition=0, ComBitSize=1, ComSystemTemplateSystemSignalRef=isImobEngChk2ImobEngChkSts_mtx
              ComFilter: ComFilterAlgorithm=ALWAYS
            isImobEngChk2ImobEngDataChk0_fba6858b_Tx: ComBitPosition=15, ComBitSize=8, ComSystemTemplateSystemSignalRef=isImobEngChk2ImobEngDataChk0_mtx
            isImobEngChk2ImobEngDataChk1_8ca1b51d_Tx: ComBitPosition=23, ComBitSize=8, ComSystemTemplateSystemSignalRef=isImobEngChk2ImobEngDataChk1_mtx
            isImobEngChk2ImobEngDataChk2_15a8e4a7_Tx: ComBitPosition=31, ComBitSize=8, ComSystemTemplateSystemSignalRef=isImobEngChk2ImobEngDataChk2_mtx
            isImobEngChk2ImobEngDataChk3_62afd431_Tx: ComBitPosition=39, ComBitSize=8, ComSystemTemplateSystemSignalRef=isImobEngChk2ImobEngDataChk3_mtx
            isImobEngChk2ImobEngDataChk4_fccb4192_Tx: ComBitPosition=47, ComBitSize=8, ComSystemTemplateSystemSignalRef=isImobEngChk2ImobEngDataChk4_mtx
            isImobEngChk2ImobEngDataChk5_8bcc7104_Tx: ComBitPosition=55, ComBitSize=8, ComSystemTemplateSystemSignalRef=isImobEngChk2ImobEngDataChk5_mtx
            isImobEngChk2ImobEngDataChk6_12c520be_Tx: ComBitPosition=63, ComBitSize=8, ComSystemTemplateSystemSignalRef=isImobEngChk2ImobEngDataChk6_mtx
        igImobEngMgrReq2_1df0559d_Rx: ComUpdateBitPosition=2, ComSystemTemplateSignalGroupRef=igImobEngMgrReq2_mrx
          8 x ComGroupSignal, all with ComSignalEndianness=BIG_ENDIAN, ComSignalInitValue=0, ComSignalType=UINT8:
            isImobEngMgrReq2ImobEngDataMgrReq0_9c0677f3_Rx: ComBitPosition=15, ComBitSize=8, ComSystemTemplateSystemSignalRef=isImobEngMgrReq2ImobEngDataMgrReq0_mrx
            isImobEngMgrReq2ImobEngDataMgrReq1_eb014765_Rx: ComBitPosition=23, ComBitSize=8, ComSystemTemplateSystemSignalRef=isImobEngMgrReq2ImobEngDataMgrReq1_mrx
            isImobEngMgrReq2ImobEngDataMgrReq2_720816df_Rx: ComBitPosition=31, ComBitSize=8, ComSystemTemplateSystemSignalRef=isImobEngMgrReq2ImobEngDataMgrReq2_mrx
            isImobEngMgrReq2ImobEngDataMgrReq3_050f2649_Rx: ComBitPosition=39, ComBitSize=8, ComSystemTemplateSystemSignalRef=isImobEngMgrReq2ImobEngDataMgrReq3_mrx
            isImobEngMgrReq2ImobEngDataMgrReq4_9b6bb3ea_Rx: ComBitPosition=47, ComBitSize=8, ComSystemTemplateSystemSignalRef=isImobEngMgrReq2ImobEngDataMgrReq4_mrx
            isImobEngMgrReq2ImobEngDataMgrReq5_ec6c837c_Rx: ComBitPosition=55, ComBitSize=8, ComSystemTemplateSystemSignalRef=isImobEngMgrReq2ImobEngDataMgrReq5_mrx
            isImobEngMgrReq2ImobEngDataMgrReq6_7565d2c6_Rx: ComBitPosition=63, ComBitSize=8, ComSystemTemplateSystemSignalRef=isImobEngMgrReq2ImobEngDataMgrReq6_mrx
            isImobEngMgrReq2ImobEngMgrCmdTar1_817e486b_Rx: ComBitPosition=1, ComBitSize=2, ComSystemTemplateSystemSignalRef=isImobEngMgrReq2ImobEngMgrCmdTar1_mrx
        igPtTqAtAxleMaxReq_e1a6f04e_Rx: ComUpdateBitPosition=20, ComSystemTemplateSignalGroupRef=igPtTqAtAxleMaxReq_mrx
          4 x ComGroupSignal, all with ComSignalEndianness=BIG_ENDIAN:
            isPtTqAtAxleMaxReqChks_6ad4cf82_Rx: ComBitPosition=31, ComBitSize=8, ComSignalInitValue=0, ComSignalType=UINT8, ComSystemTemplateSystemSignalRef=isPtTqAtAxleMaxReqChks_mrx
            isPtTqAtAxleMaxReqCntr_d4048d38_Rx: ComBitPosition=19, ComBitSize=4, ComSignalInitValue=0, ComSignalType=UINT8, ComSystemTemplateSystemSignalRef=isPtTqAtAxleMaxReqCntr_mrx
            isPtTqAtAxleMaxReqPtTqAtAxleFrntReq_8c330c00_Rx: ComBitPosition=39, ComBitSize=16, ComSignalInitValue=20000, ComSignalType=SINT16, ComSystemTemplateSystemSignalRef=isPtTqAtAxleMaxReqPtTqAtAxleFrntReq_mrx
            isPtTqAtAxleMaxReqPtTqAtAxleReReq_449843f2_Rx: ComBitPosition=55, ComBitSize=16, ComSignalInitValue=20000, ComSignalType=SINT16, ComSystemTemplateSystemSignalRef=isPtTqAtAxleMaxReqPtTqAtAxleReReq_mrx
        igStcStsToDmc_cb036148_Rx: ComUpdateBitPosition=4, ComSystemTemplateSignalGroupRef=igStcStsToDmc_mrx
          6 x ComGroupSignal, all with ComSignalEndianness=BIG_ENDIAN, ComSignalInitValue=0:
            isStcStsToDmcChks_7f830d10_Rx: ComBitPosition=15, ComBitSize=8, ComSignalType=UINT8, ComSystemTemplateSystemSignalRef=isStcStsToDmcChks_mrx
            isStcStsToDmcCntr_c1534faa_Rx: ComBitPosition=3, ComBitSize=4, ComSignalType=UINT8, ComSystemTemplateSystemSignalRef=isStcStsToDmcCntr_mrx
            isStcStsToDmcEngRotTarSpdDMCFrnt_46c9d05b_Rx: ComBitPosition=23, ComBitSize=16, ComSignalType=UINT16, ComSystemTemplateSystemSignalRef=isStcStsToDmcEngRotTarSpdDMCFrnt_mrx
            isStcStsToDmcEngRotTarSpdDMCRear_ee201c9c_Rx: ComBitPosition=39, ComBitSize=16, ComSignalType=UINT16, ComSystemTemplateSystemSignalRef=isStcStsToDmcEngRotTarSpdDMCRear_mrx
            isStcStsToDmcFrnt_baffba62_Rx: ComBitPosition=55, ComBitSize=8, ComSignalType=UINT8, ComSystemTemplateSystemSignalRef=isStcStsToDmcFrnt_mrx
            isStcStsToDmcRear_121676a5_Rx: ComBitPosition=63, ComBitSize=8, ComSignalType=UINT8, ComSystemTemplateSystemSignalRef=isStcStsToDmcRear_mrx
        igVehBattU_0a2a47a4_Rx: ComUpdateBitPosition=2, ComSystemTemplateSignalGroupRef=igVehBattU_mrx
          isVehBattUSysUQf_f605b03a_Rx (ComGroupSignal):
            ComBitPosition = 1
            ComBitSize = 2
            ComSignalEndianness = BIG_ENDIAN
            ComSignalInitValue = 1
            ComSignalType = UINT8
            ComSystemTemplateSystemSignalRef = isVehBattUSysUQf_mrx
          isVehBattUSysU_9501cb8f_Rx (ComGroupSignal):
            ComBitPosition = 15
            ComBitSize = 8
            ComSignalEndianness = BIG_ENDIAN
            ComSignalInitValue = 0
            ComSignalType = UINT8
            ComSystemTemplateSystemSignalRef = isVehBattUSysU_mrx
        igVehCfgPrmExt_b2e1e62e_Rx: ComSystemTemplateSignalGroupRef=igVehCfgPrmExt_mrx
          8 x ComGroupSignal, all with ComBitSize=8, ComSignalEndianness=BIG_ENDIAN, ComSignalInitValue=0, ComSignalType=UINT8:
            isVehCfgPrmExtBlkIDBytePosn1_6585aabf_Rx: ComBitPosition=7, ComSystemTemplateSystemSignalRef=isVehCfgPrmExtBlkIDBytePosn1_mrx
            isVehCfgPrmExtCCPBytePosn2_e7ede43f_Rx: ComBitPosition=15, ComSystemTemplateSystemSignalRef=isVehCfgPrmExtCCPBytePosn2_mrx
            isVehCfgPrmExtCCPBytePosn3_90ead4a9_Rx: ComBitPosition=23, ComSystemTemplateSystemSignalRef=isVehCfgPrmExtCCPBytePosn3_mrx
            isVehCfgPrmExtCCPBytePosn4_0e8e410a_Rx: ComBitPosition=31, ComSystemTemplateSystemSignalRef=isVehCfgPrmExtCCPBytePosn4_mrx
            isVehCfgPrmExtCCPBytePosn5_7989719c_Rx: ComBitPosition=39, ComSystemTemplateSystemSignalRef=isVehCfgPrmExtCCPBytePosn5_mrx
            isVehCfgPrmExtCCPBytePosn6_e0802026_Rx: ComBitPosition=47, ComSystemTemplateSystemSignalRef=isVehCfgPrmExtCCPBytePosn6_mrx
            isVehCfgPrmExtCCPBytePosn7_978710b0_Rx: ComBitPosition=55, ComSystemTemplateSystemSignalRef=isVehCfgPrmExtCCPBytePosn7_mrx
            isVehCfgPrmExtCCPBytePosn8_07380d21_Rx: ComBitPosition=63, ComSystemTemplateSystemSignalRef=isVehCfgPrmExtCCPBytePosn8_mrx
        igVehCfgPrm_eee11443_Rx: ComSystemTemplateSignalGroupRef=igVehCfgPrm_mrx
          8 x ComGroupSignal, all with ComBitSize=8, ComSignalEndianness=BIG_ENDIAN, ComSignalInitValue=0, ComSignalType=UINT8:
            isVehCfgPrmBlkIDBytePosn1_16ee2fa8_Rx: ComBitPosition=7, ComSystemTemplateSystemSignalRef=isVehCfgPrmBlkIDBytePosn1_mrx
            isVehCfgPrmCCPBytePosn2_c9255841_Rx: ComBitPosition=15, ComSystemTemplateSystemSignalRef=isVehCfgPrmCCPBytePosn2_mrx
            isVehCfgPrmCCPBytePosn3_be2268d7_Rx: ComBitPosition=23, ComSystemTemplateSystemSignalRef=isVehCfgPrmCCPBytePosn3_mrx
            isVehCfgPrmCCPBytePosn4_2046fd74_Rx: ComBitPosition=31, ComSystemTemplateSystemSignalRef=isVehCfgPrmCCPBytePosn4_mrx
            isVehCfgPrmCCPBytePosn5_5741cde2_Rx: ComBitPosition=39, ComSystemTemplateSystemSignalRef=isVehCfgPrmCCPBytePosn5_mrx
            isVehCfgPrmCCPBytePosn6_ce489c58_Rx: ComBitPosition=47, ComSystemTemplateSystemSignalRef=isVehCfgPrmCCPBytePosn6_mrx
            isVehCfgPrmCCPBytePosn7_b94facce_Rx: ComBitPosition=55, ComSystemTemplateSystemSignalRef=isVehCfgPrmCCPBytePosn7_mrx
            isVehCfgPrmCCPBytePosn8_29f0b15f_Rx: ComBitPosition=63, ComSystemTemplateSystemSignalRef=isVehCfgPrmCCPBytePosn8_mrx
        igVehModMngtGlbSafe1_d1f2be1a_Rx: ComUpdateBitPosition=32, ComSystemTemplateSignalGroupRef=igVehModMngtGlbSafe1_mrx
          10 x ComGroupSignal, all with ComSignalEndianness=BIG_ENDIAN, ComSignalType=UINT8:
            isVehModMngtGlbSafe1CarModSts1_a7324f03_Rx: ComBitPosition=39, ComBitSize=3, ComSignalInitValue=0, ComSystemTemplateSystemSignalRef=isVehModMngtGlbSafe1CarModSts1_mrx
            isVehModMngtGlbSafe1CarModSubtypWdCarModSubtyp_e21ae44e_Rx: ComBitPosition=36, ComBitSize=3, ComSignalInitValue=0, ComSystemTemplateSystemSignalRef=isVehModMngtGlbSafe1CarModSubtypWdCarModSubtyp_mrx
            isVehModMngtGlbSafe1Chks_5333fc0b_Rx: ComBitPosition=7, ComBitSize=8, ComSignalInitValue=0, ComSystemTemplateSystemSignalRef=isVehModMngtGlbSafe1Chks_mrx
            isVehModMngtGlbSafe1Cntr_ede3beb1_Rx: ComBitPosition=15, ComBitSize=4, ComSignalInitValue=0, ComSystemTemplateSystemSignalRef=isVehModMngtGlbSafe1Cntr_mrx
            isVehModMngtGlbSafe1EgyLvlElecMai_47690dfe_Rx: ComBitPosition=27, ComBitSize=4, ComSignalInitValue=0, ComSystemTemplateSystemSignalRef=isVehModMngtGlbSafe1EgyLvlElecMai_mrx
            isVehModMngtGlbSafe1EgyLvlElecSubtyp_47668699_Rx: ComBitPosition=31, ComBitSize=4, ComSignalInitValue=0, ComSystemTemplateSystemSignalRef=isVehModMngtGlbSafe1EgyLvlElecSubtyp_mrx
            isVehModMngtGlbSafe1FltEgyCnsWdSts_c45a6bde_Rx: ComBitPosition=33, ComBitSize=1, ComSignalInitValue=0, ComSystemTemplateSystemSignalRef=isVehModMngtGlbSafe1FltEgyCnsWdSts_mrx
            isVehModMngtGlbSafe1PwrLvlElecMai_c178728f_Rx: ComBitPosition=19, ComBitSize=4, ComSignalInitValue=0, ComSystemTemplateSystemSignalRef=isVehModMngtGlbSafe1PwrLvlElecMai_mrx
            isVehModMngtGlbSafe1PwrLvlElecSubtyp_d042c1b3_Rx: ComBitPosition=23, ComBitSize=4, ComSignalInitValue=0, ComSystemTemplateSystemSignalRef=isVehModMngtGlbSafe1PwrLvlElecSubtyp_mrx
            isVehModMngtGlbSafe1UsgModSts_8ea1ac37_Rx: ComBitPosition=11, ComBitSize=4, ComSignalInitValue=1, ComSystemTemplateSystemSignalRef=isVehModMngtGlbSafe1UsgModSts_mrx
        igVehMtnSt_68a0f345_Rx: ComUpdateBitPosition=57, ComSystemTemplateSignalGroupRef=igVehMtnSt_mrx
          3 x ComGroupSignal, all with ComSignalEndianness=BIG_ENDIAN, ComSignalInitValue=0, ComSignalType=UINT8:
            isVehMtnStChks_46ae48d7_Rx: ComBitPosition=31, ComBitSize=8, ComSystemTemplateSystemSignalRef=isVehMtnStChks_mrx
            isVehMtnStCntr_f87e0a6d_Rx: ComBitPosition=22, ComBitSize=4, ComSystemTemplateSystemSignalRef=isVehMtnStCntr_mrx
            isVehMtnStVehMtnSt_e696b713_Rx: ComBitPosition=18, ComBitSize=3, ComSystemTemplateSystemSignalRef=isVehMtnStVehMtnSt_mrx
        igVehSpdLgt_56c0cfd4_Rx: ComUpdateBitPosition=39, ComSystemTemplateSignalGroupRef=igVehSpdLgt_mrx
          4 x ComGroupSignal, all with ComSignalEndianness=BIG_ENDIAN:
            isVehSpdLgtA_668ad5e3_Rx: ComBitPosition=38, ComBitSize=15, ComSignalInitValue=0, ComSignalType=UINT16, ComSystemTemplateSystemSignalRef=isVehSpdLgtA_mrx
            isVehSpdLgtChks_060f2c10_Rx: ComBitPosition=55, ComBitSize=8, ComSignalInitValue=0, ComSignalType=UINT8, ComSystemTemplateSystemSignalRef=isVehSpdLgtChks_mrx
            isVehSpdLgtCntr_b8df6eaa_Rx: ComBitPosition=63, ComBitSize=4, ComSignalInitValue=0, ComSignalType=UINT8, ComSystemTemplateSystemSignalRef=isVehSpdLgtCntr_mrx
            isVehSpdLgtQf_057400a6_Rx: ComBitPosition=59, ComBitSize=2, ComSignalInitValue=1, ComSignalType=UINT8, ComSystemTemplateSystemSignalRef=isVehSpdLgtQf_mrx
        igWhlMotSysSpdActSafe_58c9c55b_Tx: ComTransferProperty=PENDING, ComUpdateBitPosition=24, ComSystemTemplateSignalGroupRef=igWhlMotSysSpdActSafe_mtx
          4 x ComGroupSignal, all with ComSignalEndianness=BIG_ENDIAN:
            isWhlMotSysSpdActSafeChks_8eaaad7b_Tx: ComBitPosition=15, ComBitSize=8, ComSignalInitValue=0, ComSignalType=UINT8, ComSystemTemplateSystemSignalRef=isWhlMotSysSpdActSafeChks_mtx
            isWhlMotSysSpdActSafeCntr_307aefc1_Tx: ComBitPosition=3, ComBitSize=4, ComSignalInitValue=0, ComSignalType=UINT8, ComSystemTemplateSystemSignalRef=isWhlMotSysSpdActSafeCntr_mtx
              ComFilter: ComFilterAlgorithm=ALWAYS
            isWhlMotSysSpdActSafeIsgSpdWSgnTyp_9d8822c6_Tx: ComBitPosition=23, ComBitSize=15, ComSignalInitValue=0, ComSignalType=SINT16, ComSystemTemplateSystemSignalRef=isWhlMotSysSpdActSafeIsgSpdWSgnTyp_mtx
            isWhlMotSysSpdActSafeQf_b9719ecc_Tx: ComBitPosition=5, ComBitSize=2, ComSignalInitValue=1, ComSignalType=UINT8, ComSystemTemplateSystemSignalRef=isWhlMotSysSpdActSafeQf_mtx
        igWhlMotSysTqAllwd_20f5846f_Rx: ComUpdateBitPosition=6, ComSystemTemplateSignalGroupRef=igWhlMotSysTqAllwd_mrx
          3 x ComGroupSignal, all with ComSignalEndianness=BIG_ENDIAN, ComSignalInitValue=0, ComSignalType=UINT8:
            isWhlMotSysTqAllwdChks_5c573be4_Rx: ComBitPosition=15, ComBitSize=8, ComSystemTemplateSystemSignalRef=isWhlMotSysTqAllwdChks_mrx
            isWhlMotSysTqAllwdCntr_e287795e_Rx: ComBitPosition=3, ComBitSize=4, ComSystemTemplateSystemSignalRef=isWhlMotSysTqAllwdCntr_mrx
            isWhlMotSysTqAllwdWhlMotSysTqAllwd_0ecd7abd_Rx: ComBitPosition=5, ComBitSize=2, ComSystemTemplateSystemSignalRef=isWhlMotSysTqAllwdWhlMotSysTqAllwd_mrx
        igWhlMotSysTqAvl_6ba13f42_Tx: ComTransferProperty=PENDING, ComUpdateBitPosition=37, ComSystemTemplateSignalGroupRef=igWhlMotSysTqAvl_mtx
          isWhlMotSysTqAvlTqAvlMax_bb518dba_Tx (ComGroupSignal):
            ComBitPosition = 47
            ComBitSize = 12
            ComSignalEndianness = BIG_ENDIAN
            ComSignalInitValue = 2047
            ComSignalType = UINT16
            ComSystemTemplateSystemSignalRef = isWhlMotSysTqAvlTqAvlMax_mtx
          isWhlMotSysTqAvlTqAvlMin_875cb2e3_Tx (ComGroupSignal):
            ComBitPosition = 51
            ComBitSize = 12
            ComSignalEndianness = BIG_ENDIAN
            ComSignalInitValue = 2047
            ComSignalType = UINT16
            ComSystemTemplateSystemSignalRef = isWhlMotSysTqAvlTqAvlMin_mtx
        igWhlMotSysTqEst_02b3fb8d_Tx: ComTransferProperty=PENDING, ComUpdateBitPosition=27, ComSystemTemplateSignalGroupRef=igWhlMotSysTqEst_mtx
          4 x ComGroupSignal, all with ComSignalEndianness=BIG_ENDIAN:
            isWhlMotSysTqEstChks_cdf81842_Tx: ComBitPosition=7, ComBitSize=8, ComSignalInitValue=0, ComSignalType=UINT8, ComSystemTemplateSystemSignalRef=isWhlMotSysTqEstChks_mtx
              ComFilter: ComFilterAlgorithm=ALWAYS
            isWhlMotSysTqEstCntr_73285af8_Tx: ComBitPosition=31, ComBitSize=4, ComSignalInitValue=0, ComSignalType=UINT8, ComSystemTemplateSystemSignalRef=isWhlMotSysTqEstCntr_mtx
            isWhlMotSysTqEstIsgTqAct_70852206_Tx: ComBitPosition=15, ComBitSize=14, ComSignalInitValue=8188, ComSignalType=UINT16, ComSystemTemplateSystemSignalRef=isWhlMotSysTqEstIsgTqAct_mtx
            isWhlMotSysTqEstQualityFactor_cb4e64ff_Tx: ComBitPosition=17, ComBitSize=2, ComSignalInitValue=1, ComSignalType=UINT8, ComSystemTemplateSystemSignalRef=isWhlMotSysTqEstQualityFactor_mtx
      ComTimeBase: ComGwTimeBase=0.005, ComRxTimeBase=0.005, ComTxTimeBase=0.005
    ComGeneral
  module config ComM
    ComMConfigSet: ComMPncEnabled=true
      PropulsionCAN_IEM_19020f5a (ComMChannel): ComMBusType=COMM_BUS_TYPE_CAN, ComMChannelId=0, ComMPncGatewayType=COMM_GATEWAY_TYPE_NONE
        ComMNetworkManagement: ComMNmVariant=FULL
        PropulsionCAN_IEM_1d9bb637 (ComMUserPerChannel): ComMUserChannel=PropulsionCAN_IEM_04f8de22
        PropulsionCAN_IEM_ee33faf5 (ComMUserPerChannel): ComMUserChannel=PropulsionCAN_IEM_78c1505e
      10 x ComMPnc, all with ComMChannelPerPnc=ComMConfigSet/PropulsionCAN_IEM_19020f5a, ComMUserPerPnc=PropulsionCAN_IEM_78c1505e:
        System_MAPPING_06a14eda: ComMPncId=30
          PropulsionCAN_db9c2837_Rx_c1d6a06c (ComMPncComSignal):
            ComMPncComSignalDirection = RX
            ComMPncComSignalKind = EIRA
            ComMPncComSignalChannelRef = ComMConfigSet/PropulsionCAN_IEM_19020f5a
            ComMPncComSignalRef = PropulsionCAN_db9c2837_Rx
        System_MAPPING_18d7bb82: ComMPncId=24
          PropulsionCAN_db9c2837_Rx_c1d6a06c (ComMPncComSignal):
            ComMPncComSignalDirection = RX
            ComMPncComSignalKind = EIRA
            ComMPncComSignalChannelRef = ComMConfigSet/PropulsionCAN_IEM_19020f5a
            ComMPncComSignalRef = PropulsionCAN_db9c2837_Rx
        System_MAPPING_6666c73f: ComMPncId=29
          PropulsionCAN_db9c2837_Rx_c1d6a06c (ComMPncComSignal):
            ComMPncComSignalDirection = RX
            ComMPncComSignalKind = EIRA
            ComMPncComSignalChannelRef = ComMConfigSet/PropulsionCAN_IEM_19020f5a
            ComMPncComSignalRef = PropulsionCAN_db9c2837_Rx
        System_MAPPING_6fd08b14: ComMPncId=25
          PropulsionCAN_db9c2837_Rx_c1d6a06c (ComMPncComSignal):
            ComMPncComSignalDirection = RX
            ComMPncComSignalKind = EIRA
            ComMPncComSignalChannelRef = ComMConfigSet/PropulsionCAN_IEM_19020f5a
            ComMPncComSignalRef = PropulsionCAN_db9c2837_Rx
        System_MAPPING_76cbba55: ComMPncId=35
          PropulsionCAN_db9c2837_Rx_c1d6a06c (ComMPncComSignal):
            ComMPncComSignalDirection = RX
            ComMPncComSignalKind = EIRA
            ComMPncComSignalChannelRef = ComMConfigSet/PropulsionCAN_IEM_19020f5a
            ComMPncComSignalRef = PropulsionCAN_db9c2837_Rx
        System_MAPPING_7f7df67e: ComMPncId=39
          PropulsionCAN_db9c2837_Rx_c1d6a06c (ComMPncComSignal):
            ComMPncComSignalDirection = RX
            ComMPncComSignalKind = EIRA
            ComMPncComSignalChannelRef = ComMConfigSet/PropulsionCAN_IEM_19020f5a
            ComMPncComSignalRef = PropulsionCAN_db9c2837_Rx
        System_MAPPING_81deea38: ComMPncId=27
          PropulsionCAN_db9c2837_Rx_c1d6a06c (ComMPncComSignal):
            ComMPncComSignalDirection = RX
            ComMPncComSignalKind = EIRA
            ComMPncComSignalChannelRef = ComMConfigSet/PropulsionCAN_IEM_19020f5a
            ComMPncComSignalRef = PropulsionCAN_db9c2837_Rx
        System_MAPPING_9fa81f60: ComMPncId=33
          PropulsionCAN_db9c2837_Rx_c1d6a06c (ComMPncComSignal):
            ComMPncComSignalDirection = RX
            ComMPncComSignalKind = EIRA
            ComMPncComSignalChannelRef = ComMConfigSet/PropulsionCAN_IEM_19020f5a
            ComMPncComSignalRef = PropulsionCAN_db9c2837_Rx
        System_MAPPING_ddf4896d: ComMPncId=16
          PropulsionCAN_db9c2837_Rx_c1d6a06c (ComMPncComSignal):
            ComMPncComSignalDirection = RX
            ComMPncComSignalKind = EIRA
            ComMPncComSignalChannelRef = ComMConfigSet/PropulsionCAN_IEM_19020f5a
            ComMPncComSignalRef = PropulsionCAN_db9c2837_Rx
        System_MAPPING_f6d9daae: ComMPncId=26
          PropulsionCAN_db9c2837_Rx_c1d6a06c (ComMPncComSignal):
            ComMPncComSignalDirection = RX
            ComMPncComSignalKind = EIRA
            ComMPncComSignalChannelRef = ComMConfigSet/PropulsionCAN_IEM_19020f5a
            ComMPncComSignalRef = PropulsionCAN_db9c2837_Rx
      PropulsionCAN_IEM_04f8de22 (ComMUser): ComMUserIdentifier=0
      PropulsionCAN_IEM_78c1505e (ComMUser): ComMUserIdentifier=1
    ComMGeneral: ComMPncGatewayEnabled=false, ComMPncIdCounting=COMM_PNC_ID_COUNT_FROM_NM_MESSAGE, ComMPncSupport=true
  module config Dcm
    DcmConfigSet  # Diagnostics Data Import
      DcmDsl
        DcmDslProtocol
          DcmDslProtocolRow_29812fbf (DcmDslProtocolRow)
            5 x DcmDslConnection:
              DcmDslConnection_138b1ed2
                DcmDslMainConnection: DcmDslProtocolRxTesterSourceAddr=128
                  IemToEtcUudtDcmIpdu3_4ed50c54_Tx_e71950c0 (DcmDslProtocolTx): DcmDslTxConfirmationPduId=0, DcmDslProtocolTxPduRef=EcucPduCollection/IemToEtcUudtDcmIpdu3_4ed50c54_Tx
              DcmDslConnection_2be1d41b
                DcmDslMainConnection: DcmDslProtocolRxTesterSourceAddr=128
                  VgmToIemDiagDcmIpdu_cbf08236_Rx_05e7e935 (DcmDslProtocolRx):
                    DcmDslProtocolRxAddrType = DCM_PHYSICAL_TYPE
                    DcmDslProtocolRxPduId = 2
                    DcmDslProtocolRxComMChannelRef = ComMConfigSet/PropulsionCAN_IEM_19020f5a
                    DcmDslProtocolRxPduRef = VgmToIemDiagDcmIpdu_cbf08236_Rx
                  IemToVgmDiagDcmIpdu_ce8379a0_Tx_00a03790 (DcmDslProtocolTx): DcmDslTxConfirmationPduId=1, DcmDslProtocolTxPduRef=EcucPduCollection/IemToVgmDiagDcmIpdu_ce8379a0_Tx
              DcmDslConnection_95fe38cc
                DcmDslMainConnection: DcmDslProtocolRxTesterSourceAddr=128
                  EtcToAllJ1979OBDDiagDcmIpdu11_f3f7d8ab_Rx_d2b52588 (DcmDslProtocolRx):
                    DcmDslProtocolRxAddrType = DCM_FUNCTIONAL_TYPE
                    DcmDslProtocolRxPduId = 4
                    DcmDslProtocolRxComMChannelRef = ComMConfigSet/PropulsionCAN_IEM_19020f5a
                    DcmDslProtocolRxPduRef = EtcToAllJ1979OBDDiagDcmIpdu11_f3f7d8ab_Rx
                  EtcToIemJ1979OBDDiagDcmIpdu11_ad182927_Rx_3695805f (DcmDslProtocolRx):
                    DcmDslProtocolRxAddrType = DCM_PHYSICAL_TYPE
                    DcmDslProtocolRxPduId = 5
                    DcmDslProtocolRxComMChannelRef = ComMConfigSet/PropulsionCAN_IEM_19020f5a
                    DcmDslProtocolRxPduRef = EtcToIemJ1979OBDDiagDcmIpdu11_ad182927_Rx
                  IemToEtcJ1979OBDDiagDcmIpdu11_da239b2d_Tx_c7a1943e (DcmDslProtocolTx): DcmDslTxConfirmationPduId=3, DcmDslProtocolTxPduRef=EcucPduCollection/IemToEtcJ1979OBDDiagDcmIpdu11_da239b2d_Tx
              DcmDslConnection_a514db1e
                DcmDslMainConnection: DcmDslProtocolRxTesterSourceAddr=128
                  IemToEtcUudtDcmIpdu1_a0db6d78_Tx_c0b1ca64 (DcmDslProtocolTx): DcmDslTxConfirmationPduId=6, DcmDslProtocolTxPduRef=EcucPduCollection/IemToEtcUudtDcmIpdu1_a0db6d78_Tx
              DcmDslConnection_eb9dd0b7
                DcmDslMainConnection: DcmDslProtocolRxTesterSourceAddr=128
                  IemToEtcUudtDcmIpdu2_39d23cc2_Tx_19898c33 (DcmDslProtocolTx): DcmDslTxConfirmationPduId=7, DcmDslProtocolTxPduRef=EcucPduCollection/IemToEtcUudtDcmIpdu2_39d23cc2_Tx
      DcmDsp: DcmDspMaxDidToRead=5  # Diagnostics Data Import
        DcmDspSession  # Diagnostics Data Import
          3 x DcmDspSessionRow, all with DcmDspSessionP2ServerMax=0.05, DcmDspSessionP2StarServerMax=5:
            extendedDiagnosticSession: DcmDspSessionLevel=3, DcmDspSessionForBoot=DCM_NO_BOOT  # Diagnostics Data Import
            programmingSession: DcmDspSessionLevel=2  # Diagnostics Data Import
            defaultSession: DcmDspSessionLevel=1, DcmDspSessionForBoot=DCM_NO_BOOT  # Diagnostics Data Import
        DcmDspSecurity  # Diagnostics Data Import
          ImmoUnlocked_Level_4 (DcmDspSecurityRow):  # Diagnostics Data Import
            DcmDspSecurityDelayTime = 10
            DcmDspSecurityDelayTimeOnBoot = 0
            DcmDspSecurityKeySize = 3
            DcmDspSecurityLevel = 9
            DcmDspSecurityNumAttDelay = 3
            DcmDspSecuritySeedSize = 3
          CommonUnlock_Level_3 (DcmDspSecurityRow):  # Diagnostics Data Import
            DcmDspSecurityDelayTime = 10
            DcmDspSecurityDelayTimeOnBoot = 0
            DcmDspSecurityKeySize = 3
            DcmDspSecurityLevel = 3
            DcmDspSecurityNumAttDelay = 3
            DcmDspSecuritySeedSize = 3
        6 x DcmDspRoutineInfo:
          RoutineInfo_Routine_Reserved_3  # Diagnostics Data Import
            DcmDspRoutineRequestResOut  # Diagnostics Data Import
              3 x DcmDspRoutineRequestResOutSignal, all with DcmDspRoutineSignalLength=8, DcmDspRoutineSignalType=UINT8:
                Out_Data_03_3: DcmDspRoutineSignalPos=16  # Diagnostics Data Import
                Out_Data_03_2: DcmDspRoutineSignalPos=8  # Diagnostics Data Import
                Out_Data_03_1: DcmDspRoutineSignalPos=0  # Diagnostics Data Import
            DcmDspRoutineStopOut  # Diagnostics Data Import
              Out_New_Bit_Field (DcmDspRoutineStopOutSignal): DcmDspRoutineSignalLength=8, DcmDspRoutineSignalType=UINT8, DcmDspRoutineSignalPos=0  # Diagnostics Data Import
            DcmDspStartRoutineOut  # Diagnostics Data Import
              3 x DcmDspStartRoutineOutSignal, all with DcmDspRoutineSignalLength=8, DcmDspRoutineSignalType=UINT8:
                Out_Data_01_3: DcmDspRoutineSignalPos=16  # Diagnostics Data Import
                Out_Data_01_2: DcmDspRoutineSignalPos=8  # Diagnostics Data Import
                Out_Data_01_1: DcmDspRoutineSignalPos=0  # Diagnostics Data Import
            DcmDspStartRoutineIn  # Diagnostics Data Import
              3 x DcmDspStartRoutineInSignal, all with DcmDspRoutineSignalLength=8, DcmDspRoutineSignalType=UINT8:
                In_InputData3: DcmDspRoutineSignalPos=16  # Diagnostics Data Import
                In_InputData2: DcmDspRoutineSignalPos=8  # Diagnostics Data Import
                In_InputData1: DcmDspRoutineSignalPos=0  # Diagnostics Data Import
            DcmDspRoutineAuthorization: DcmDspRoutineSessionRef=extendedDiagnosticSession  # Diagnostics Data Import
          RoutineInfo_Routine_Reserved_2  # Diagnostics Data Import
            DcmDspRoutineRequestResOut  # Diagnostics Data Import
              3 x DcmDspRoutineRequestResOutSignal, all with DcmDspRoutineSignalLength=8, DcmDspRoutineSignalType=UINT8:
                Out_Data_03_3: DcmDspRoutineSignalPos=16  # Diagnostics Data Import
                Out_Data_03_2: DcmDspRoutineSignalPos=8  # Diagnostics Data Import
                Out_Data_03_1: DcmDspRoutineSignalPos=0  # Diagnostics Data Import
            DcmDspRoutineStopOut  # Diagnostics Data Import
              Out_New_Bit_Field (DcmDspRoutineStopOutSignal): DcmDspRoutineSignalLength=8, DcmDspRoutineSignalType=UINT8, DcmDspRoutineSignalPos=0  # Diagnostics Data Import
            DcmDspStartRoutineOut  # Diagnostics Data Import
              3 x DcmDspStartRoutineOutSignal, all with DcmDspRoutineSignalLength=8, DcmDspRoutineSignalType=UINT8:
                Out_Data_01_3: DcmDspRoutineSignalPos=16  # Diagnostics Data Import
                Out_Data_01_2: DcmDspRoutineSignalPos=8  # Diagnostics Data Import
                Out_Data_01_1: DcmDspRoutineSignalPos=0  # Diagnostics Data Import
            DcmDspStartRoutineIn  # Diagnostics Data Import
              3 x DcmDspStartRoutineInSignal, all with DcmDspRoutineSignalLength=8, DcmDspRoutineSignalType=UINT8:
                In_InputData3: DcmDspRoutineSignalPos=16  # Diagnostics Data Import
                In_InputData2: DcmDspRoutineSignalPos=8  # Diagnostics Data Import
                In_InputData1: DcmDspRoutineSignalPos=0  # Diagnostics Data Import
            DcmDspRoutineAuthorization: DcmDspRoutineSessionRef=extendedDiagnosticSession, DcmDspRoutineSecurityLevelRef=CommonUnlock_Level_3  # Diagnostics Data Import
          RoutineInfo_Routine_Reserved_1  # Diagnostics Data Import
            DcmDspRoutineRequestResOut  # Diagnostics Data Import
              3 x DcmDspRoutineRequestResOutSignal, all with DcmDspRoutineSignalLength=8, DcmDspRoutineSignalType=UINT8:
                Out_Data_03_3: DcmDspRoutineSignalPos=16  # Diagnostics Data Import
                Out_Data_03_2: DcmDspRoutineSignalPos=8  # Diagnostics Data Import
                Out_Data_03_1: DcmDspRoutineSignalPos=0  # Diagnostics Data Import
            DcmDspRoutineStopOut  # Diagnostics Data Import
              Out_New_Bit_Field (DcmDspRoutineStopOutSignal): DcmDspRoutineSignalLength=8, DcmDspRoutineSignalType=UINT8, DcmDspRoutineSignalPos=0  # Diagnostics Data Import
            DcmDspStartRoutineOut  # Diagnostics Data Import
              3 x DcmDspStartRoutineOutSignal, all with DcmDspRoutineSignalLength=8, DcmDspRoutineSignalType=UINT8:
                Out_Data_01_3: DcmDspRoutineSignalPos=16  # Diagnostics Data Import
                Out_Data_01_2: DcmDspRoutineSignalPos=8  # Diagnostics Data Import
                Out_Data_01_1: DcmDspRoutineSignalPos=0  # Diagnostics Data Import
            DcmDspStartRoutineIn  # Diagnostics Data Import
              3 x DcmDspStartRoutineInSignal, all with DcmDspRoutineSignalLength=8, DcmDspRoutineSignalType=UINT8:
                In_InputData3: DcmDspRoutineSignalPos=16  # Diagnostics Data Import
                In_InputData2: DcmDspRoutineSignalPos=8  # Diagnostics Data Import
                In_InputData1: DcmDspRoutineSignalPos=0  # Diagnostics Data Import
            DcmDspRoutineAuthorization: DcmDspRoutineSessionRef=extendedDiagnosticSession, DcmDspRoutineSecurityLevelRef=CommonUnlock_Level_3  # Diagnostics Data Import
          RoutineInfo_Starter_Generator_Position_Sensors_Calibration  # Diagnostics Data Import
            DcmDspRoutineRequestResOut  # Diagnostics Data Import
              Out_RID_4001_RequestResult_Pr_3_Calibration_result (DcmDspRoutineRequestResOutSignal): DcmDspRoutineSignalLength=16, DcmDspRoutineSignalType=UINT16, DcmDspRoutineSignalEndianness=BIG_ENDIAN, DcmDspRoutineSignalPos=8  # Diagnostics Data Import
              Out_Bitfield (DcmDspRoutineRequestResOutSignal): DcmDspRoutineSignalLength=8, DcmDspRoutineSignalType=UINT8, DcmDspRoutineSignalPos=0  # Diagnostics Data Import
            DcmDspRoutineStopOut  # Diagnostics Data Import
              Out_Bitfield (DcmDspRoutineStopOutSignal): DcmDspRoutineSignalLength=8, DcmDspRoutineSignalType=UINT8, DcmDspRoutineSignalPos=0  # Diagnostics Data Import
            DcmDspStartRoutineOut  # Diagnostics Data Import
              Out_Bitfield (DcmDspStartRoutineOutSignal): DcmDspRoutineSignalLength=8, DcmDspRoutineSignalType=UINT8, DcmDspRoutineSignalPos=0  # Diagnostics Data Import
            DcmDspRoutineAuthorization: DcmDspRoutineSessionRef=extendedDiagnosticSession, DcmDspRoutineSecurityLevelRef=CommonUnlock_Level_3  # Diagnostics Data Import
          RoutineInfo_P_Lock  # Diagnostics Data Import
            DcmDspRoutineRequestResOut  # Diagnostics Data Import
              Out_P_Lock_Status (DcmDspRoutineRequestResOutSignal): DcmDspRoutineSignalLength=8, DcmDspRoutineSignalType=UINT8, DcmDspRoutineSignalPos=8  # Diagnostics Data Import
              Out_New_Bit_Field (DcmDspRoutineRequestResOutSignal): DcmDspRoutineSignalLength=8, DcmDspRoutineSignalType=UINT8, DcmDspRoutineSignalPos=0  # Diagnostics Data Import
            DcmDspRoutineStopOut  # Diagnostics Data Import
              Out_New_Bit_Field (DcmDspRoutineStopOutSignal): DcmDspRoutineSignalLength=8, DcmDspRoutineSignalType=UINT8, DcmDspRoutineSignalPos=0  # Diagnostics Data Import
            DcmDspStartRoutineOut  # Diagnostics Data Import
              Out_New_Bit_Field (DcmDspStartRoutineOutSignal): DcmDspRoutineSignalLength=8, DcmDspRoutineSignalType=UINT8, DcmDspRoutineSignalPos=0  # Diagnostics Data Import
            DcmDspStartRoutineIn  # Diagnostics Data Import
              In_P_Lock_State_Request (DcmDspStartRoutineInSignal): DcmDspRoutineSignalLength=8, DcmDspRoutineSignalType=UINT8, DcmDspRoutineSignalPos=0  # Diagnostics Data Import
            DcmDspRoutineAuthorization: DcmDspRoutineSessionRef=extendedDiagnosticSession, DcmDspRoutineSecurityLevelRef=CommonUnlock_Level_3  # Diagnostics Data Import
          RoutineInfo_Check_programming_pre_conditions  # Diagnostics Data Import
            DcmDspStartRoutineOut  # Diagnostics Data Import
              Out_RID_0206_Start_Pr_3_Condition_Fullfilled_To_Enter_Programming_Session (DcmDspStartRoutineOutSignal): DcmDspRoutineSignalLength=8, DcmDspRoutineSignalType=UINT8, DcmDspRoutineSignalPos=8  # Diagnostics Data Import
              Out_New_Bit_Field (DcmDspStartRoutineOutSignal): DcmDspRoutineSignalLength=8, DcmDspRoutineSignalType=UINT8, DcmDspRoutineSignalPos=0  # Diagnostics Data Import
            DcmDspRoutineAuthorization: DcmDspRoutineSessionRef=defaultSession  # Diagnostics Data Import
        6 x DcmDspRoutine:
          Routine_Reserved_3: DcmDspRequestResultsRoutineSupported=true, DcmDspStopRoutineSupported=true, DcmDspRoutineIdentifier=16399, DcmDspRoutineInfoRef=RoutineInfo_Routine_Reserved_3  # Diagnostics Data Import
          Routine_Reserved_2: DcmDspRequestResultsRoutineSupported=true, DcmDspStopRoutineSupported=true, DcmDspRoutineIdentifier=16398, DcmDspRoutineInfoRef=RoutineInfo_Routine_Reserved_2  # Diagnostics Data Import
          Routine_Reserved_1: DcmDspRequestResultsRoutineSupported=true, DcmDspStopRoutineSupported=true, DcmDspRoutineIdentifier=16397, DcmDspRoutineInfoRef=RoutineInfo_Routine_Reserved_1  # Diagnostics Data Import
          Starter_Generator_Position_Sensors_Calibration: DcmDspRequestResultsRoutineSupported=true, DcmDspStopRoutineSupported=true, DcmDspRoutineIdentifier=16385, DcmDspRoutineInfoRef=RoutineInfo_Starter_Generator_Position_Sensors_Calibration  # Diagnostics Data Import
          P_Lock: DcmDspRequestResultsRoutineSupported=true, DcmDspStopRoutineSupported=true, DcmDspRoutineIdentifier=12389, DcmDspRoutineInfoRef=RoutineInfo_P_Lock  # Diagnostics Data Import
          Check_programming_pre_conditions: DcmDspRequestResultsRoutineSupported=false, DcmDspStopRoutineSupported=false, DcmDspRoutineIdentifier=518, DcmDspRoutineInfoRef=RoutineInfo_Check_programming_pre_conditions  # Diagnostics Data Import
        96 x DcmDspDidInfo:
          DidInfo_DID_F1AF_ECU_Software_Extended_Part_Numbers_Geely  # Diagnostics Data Import
            DcmDspDidAccess  # Diagnostics Data Import
              DcmDspDidRead: DcmDspDidReadSessionRef=defaultSession, DcmDspDidReadSessionRef=extendedDiagnosticSession  # Diagnostics Data Import
          DidInfo_DID_F1AE_ECU_Software_Part_Numbers_Geely  # Diagnostics Data Import
            DcmDspDidAccess  # Diagnostics Data Import
              DcmDspDidRead: DcmDspDidReadSessionRef=defaultSession, DcmDspDidReadSessionRef=extendedDiagnosticSession  # Diagnostics Data Import
          DidInfo_DID_F1AB_ECU_Delivery_Assembly_Part_Number_Geely  # Diagnostics Data Import
            DcmDspDidAccess  # Diagnostics Data Import
              DcmDspDidRead: DcmDspDidReadSessionRef=defaultSession, DcmDspDidReadSessionRef=extendedDiagnosticSession  # Diagnostics Data Import
          DidInfo_DID_F1AA_ECU_Core_Assembly_Part_Number_Geely  # Diagnostics Data Import
            DcmDspDidAccess  # Diagnostics Data Import
              DcmDspDidRead: DcmDspDidReadSessionRef=defaultSession, DcmDspDidReadSessionRef=extendedDiagnosticSession  # Diagnostics Data Import
          DidInfo_DID_F1A5_Primary_Bootloader_Software_Part_Number_Geely  # Diagnostics Data Import
            DcmDspDidAccess  # Diagnostics Data Import
              DcmDspDidRead: DcmDspDidReadSessionRef=defaultSession, DcmDspDidReadSessionRef=extendedDiagnosticSession  # Diagnostics Data Import
          DidInfo_DID_F1A1_Primary_Bootloader_Diagnostic_Database_Part_Number_Geely  # Diagnostics Data Import
            DcmDspDidAccess  # Diagnostics Data Import
              DcmDspDidRead: DcmDspDidReadSessionRef=defaultSession, DcmDspDidReadSessionRef=extendedDiagnosticSession  # Diagnostics Data Import
          DidInfo_DID_F1A0_Application_Diagnostic_Database_Part_Number_Geely  # Diagnostics Data Import
            DcmDspDidAccess  # Diagnostics Data Import
              DcmDspDidRead: DcmDspDidReadSessionRef=defaultSession, DcmDspDidReadSessionRef=extendedDiagnosticSession  # Diagnostics Data Import
          DidInfo_DID_F18C_ECU_Serial_Number  # Diagnostics Data Import
            DcmDspDidAccess  # Diagnostics Data Import
              DcmDspDidRead: DcmDspDidReadSessionRef=defaultSession, DcmDspDidReadSessionRef=extendedDiagnosticSession  # Diagnostics Data Import
          DidInfo_DID_F186_Active_Diagnostic_Session  # Diagnostics Data Import
            DcmDspDidAccess  # Diagnostics Data Import
              DcmDspDidRead: DcmDspDidReadSessionRef=defaultSession, DcmDspDidReadSessionRef=extendedDiagnosticSession  # Diagnostics Data Import
          DidInfo_DID_F12F_ECU_Software_Extended_Part_Numbers  # Diagnostics Data Import
            DcmDspDidAccess  # Diagnostics Data Import
              DcmDspDidRead: DcmDspDidReadSessionRef=defaultSession, DcmDspDidReadSessionRef=extendedDiagnosticSession  # Diagnostics Data Import
          DidInfo_DID_F12E_ECU_Software_Part_Numbers  # Diagnostics Data Import
            DcmDspDidAccess  # Diagnostics Data Import
              DcmDspDidRead: DcmDspDidReadSessionRef=defaultSession, DcmDspDidReadSessionRef=extendedDiagnosticSession  # Diagnostics Data Import
          DidInfo_DID_F12B_ECU_Delivery_Assembly_Part_Number  # Diagnostics Data Import
            DcmDspDidAccess  # Diagnostics Data Import
              DcmDspDidRead: DcmDspDidReadSessionRef=defaultSession, DcmDspDidReadSessionRef=extendedDiagnosticSession  # Diagnostics Data Import
          DidInfo_DID_F12A_ECU_Core_Assembly_Part_Number  # Diagnostics Data Import
            DcmDspDidAccess  # Diagnostics Data Import
              DcmDspDidRead: DcmDspDidReadSessionRef=defaultSession, DcmDspDidReadSessionRef=extendedDiagnosticSession  # Diagnostics Data Import
          DidInfo_DID_F126_Autosar_BSW_Cluster_Versions  # Diagnostics Data Import
            DcmDspDidAccess  # Diagnostics Data Import
              DcmDspDidRead: DcmDspDidReadSessionRef=defaultSession, DcmDspDidReadSessionRef=extendedDiagnosticSession  # Diagnostics Data Import
          DidInfo_DID_F125_Primary_Bootloader_Software_Part_Number  # Diagnostics Data Import
            DcmDspDidAccess  # Diagnostics Data Import
              DcmDspDidRead: DcmDspDidReadSessionRef=defaultSession, DcmDspDidReadSessionRef=extendedDiagnosticSession  # Diagnostics Data Import
          DidInfo_DID_F121_Primary_Bootloader_Diagnostic_Database_Part_Number  # Diagnostics Data Import
            DcmDspDidAccess  # Diagnostics Data Import
              DcmDspDidRead: DcmDspDidReadSessionRef=defaultSession, DcmDspDidReadSessionRef=extendedDiagnosticSession  # Diagnostics Data Import
          DidInfo_Application_Diagnostic_Database_Part_Number  # Diagnostics Data Import
            DcmDspDidAccess  # Diagnostics Data Import
              DcmDspDidRead: DcmDspDidReadSessionRef=defaultSession, DcmDspDidReadSessionRef=extendedDiagnosticSession  # Diagnostics Data Import
          DidInfo_DID_EF1D_EOL_config_word_C  # Diagnostics Data Import
            DcmDspDidAccess  # Diagnostics Data Import
              DcmDspDidWrite: DcmDspDidWriteSessionRef=extendedDiagnosticSession, DcmDspDidWriteSecurityLevelRef=CommonUnlock_Level_3  # Diagnostics Data Import
              DcmDspDidRead  # Diagnostics Data Import
          DidInfo_DID_EF1C_EOL_config_word_B  # Diagnostics Data Import
            DcmDspDidAccess  # Diagnostics Data Import
              DcmDspDidWrite: DcmDspDidWriteSessionRef=extendedDiagnosticSession, DcmDspDidWriteSecurityLevelRef=CommonUnlock_Level_3  # Diagnostics Data Import
              DcmDspDidRead  # Diagnostics Data Import
          DidInfo_DID_EF1B_EOL_config_word_A  # Diagnostics Data Import
            DcmDspDidAccess  # Diagnostics Data Import
              DcmDspDidWrite: DcmDspDidWriteSessionRef=extendedDiagnosticSession, DcmDspDidWriteSecurityLevelRef=CommonUnlock_Level_3  # Diagnostics Data Import
              DcmDspDidRead  # Diagnostics Data Import
          DidInfo_DID_EF0A_Active_Discharge_Time  # Diagnostics Data Import
            DcmDspDidAccess  # Diagnostics Data Import
              DcmDspDidRead  # Diagnostics Data Import
          DidInfo_DID_EEFD_Sofware_Project_Version  # Diagnostics Data Import
            DcmDspDidAccess  # Diagnostics Data Import
              DcmDspDidRead: DcmDspDidReadSessionRef=defaultSession, DcmDspDidReadSessionRef=extendedDiagnosticSession  # Diagnostics Data Import
          DidInfo_DID_EED5_Safety_Torque_QF_factor  # Diagnostics Data Import
            DcmDspDidAccess  # Diagnostics Data Import
              DcmDspDidRead  # Diagnostics Data Import
          DidInfo_DID_EED4_Safty_Function_Mode  # Diagnostics Data Import
            DcmDspDidAccess  # Diagnostics Data Import
              DcmDspDidRead  # Diagnostics Data Import
          DidInfo_DID_EED3_Safety_speed  # Diagnostics Data Import
            DcmDspDidAccess  # Diagnostics Data Import
              DcmDspDidRead  # Diagnostics Data Import
          DidInfo_DID_0xEEC7_1  # Diagnostics Data Import
            DcmDspDidAccess  # Diagnostics Data Import
              DcmDspDidRead  # Diagnostics Data Import
          DidInfo_DID_EED1_Safty_monitor_Fault_Indication  # Diagnostics Data Import
            DcmDspDidAccess  # Diagnostics Data Import
              DcmDspDidRead  # Diagnostics Data Import
          DidInfo_DID_EEC5_ImobEng2_node_status  # Diagnostics Data Import
            DcmDspDidAccess  # Diagnostics Data Import
              DcmDspDidRead: DcmDspDidReadSessionRef=defaultSession, DcmDspDidReadSessionRef=extendedDiagnosticSession  # Diagnostics Data Import
          DidInfo_DID_EEC4_Charging_Power_Sustain_Relay_CPSR_Voltage  # Diagnostics Data Import
            DcmDspDidAccess  # Diagnostics Data Import
              DcmDspDidRead: DcmDspDidReadSessionRef=defaultSession, DcmDspDidReadSessionRef=extendedDiagnosticSession  # Diagnostics Data Import
          DidInfo_DID_EEC3_ECU_power_supply_Voltage  # Diagnostics Data Import
            DcmDspDidAccess  # Diagnostics Data Import
              DcmDspDidRead: DcmDspDidReadSessionRef=defaultSession, DcmDspDidReadSessionRef=extendedDiagnosticSession  # Diagnostics Data Import
          DidInfo_DID_EEBF_HV_Main_Relay_Status  # Diagnostics Data Import
            DcmDspDidAccess  # Diagnostics Data Import
              DcmDspDidRead: DcmDspDidReadSessionRef=defaultSession, DcmDspDidReadSessionRef=extendedDiagnosticSession  # Diagnostics Data Import
          DidInfo_DID_EEBE_Offset_angle_status  # Diagnostics Data Import
            DcmDspDidAccess  # Diagnostics Data Import
              DcmDspDidRead: DcmDspDidReadSessionRef=defaultSession, DcmDspDidReadSessionRef=extendedDiagnosticSession  # Diagnostics Data Import
          DidInfo_DID_EEBD_IEM_MGM_rotor_offset_angle  # Diagnostics Data Import
            DcmDspDidAccess  # Diagnostics Data Import
              DcmDspDidWrite: DcmDspDidWriteSessionRef=extendedDiagnosticSession, DcmDspDidWriteSecurityLevelRef=CommonUnlock_Level_3  # Diagnostics Data Import
              DcmDspDidRead: DcmDspDidReadSessionRef=defaultSession, DcmDspDidReadSessionRef=extendedDiagnosticSession  # Diagnostics Data Import
          DidInfo_DID_EEB8_HV_voltage_received_from_BECM  # Diagnostics Data Import
            DcmDspDidAccess  # Diagnostics Data Import
              DcmDspDidRead: DcmDspDidReadSessionRef=defaultSession, DcmDspDidReadSessionRef=extendedDiagnosticSession  # Diagnostics Data Import
          DidInfo_DID_EEB7_ECM_Power_Limitation_minimum  # Diagnostics Data Import
            DcmDspDidAccess  # Diagnostics Data Import
              DcmDspDidRead: DcmDspDidReadSessionRef=defaultSession, DcmDspDidReadSessionRef=extendedDiagnosticSession  # Diagnostics Data Import
          DidInfo_DID_EEB6_ECM_Power_Limitation_maximum  # Diagnostics Data Import
            DcmDspDidAccess  # Diagnostics Data Import
              DcmDspDidRead: DcmDspDidReadSessionRef=defaultSession, DcmDspDidReadSessionRef=extendedDiagnosticSession  # Diagnostics Data Import
          DidInfo_DID_EEB5_IEM_MGM_current_torque  # Diagnostics Data Import
            DcmDspDidAccess  # Diagnostics Data Import
              DcmDspDidRead: DcmDspDidReadSessionRef=defaultSession, DcmDspDidReadSessionRef=extendedDiagnosticSession  # Diagnostics Data Import
          DidInfo_DID_EEB2_Three_Phase_Motor_Current_RMS_Current  # Diagnostics Data Import
            DcmDspDidAccess  # Diagnostics Data Import
              DcmDspDidRead: DcmDspDidReadSessionRef=defaultSession, DcmDspDidReadSessionRef=extendedDiagnosticSession  # Diagnostics Data Import
          DidInfo_DID_EE9F_Gate_Status  # Diagnostics Data Import
            DcmDspDidAccess  # Diagnostics Data Import
              DcmDspDidRead: DcmDspDidReadSessionRef=defaultSession, DcmDspDidReadSessionRef=extendedDiagnosticSession  # Diagnostics Data Import
          DidInfo_DID_EE9E_Transient_Phase_Current_C  # Diagnostics Data Import
            DcmDspDidAccess  # Diagnostics Data Import
              DcmDspDidRead: DcmDspDidReadSessionRef=defaultSession, DcmDspDidReadSessionRef=extendedDiagnosticSession  # Diagnostics Data Import
          DidInfo_DID_EE9D_Transient_Phase_Current_B  # Diagnostics Data Import
            DcmDspDidAccess  # Diagnostics Data Import
              DcmDspDidRead: DcmDspDidReadSessionRef=defaultSession, DcmDspDidReadSessionRef=extendedDiagnosticSession  # Diagnostics Data Import
          DidInfo_DID_EE9C_Transient_Phase_Current_A  # Diagnostics Data Import
            DcmDspDidAccess  # Diagnostics Data Import
              DcmDspDidRead: DcmDspDidReadSessionRef=defaultSession, DcmDspDidReadSessionRef=extendedDiagnosticSession  # Diagnostics Data Import
          DidInfo_DID_EE9A_Inverter_Coolant_Temperature  # Diagnostics Data Import
            DcmDspDidAccess  # Diagnostics Data Import
              DcmDspDidRead: DcmDspDidReadSessionRef=defaultSession, DcmDspDidReadSessionRef=extendedDiagnosticSession  # Diagnostics Data Import
          DidInfo_DID_EDA0_Complete_ECU_Part_Serial_Number_s  # Diagnostics Data Import
            DcmDspDidAccess  # Diagnostics Data Import
              DcmDspDidRead: DcmDspDidReadSessionRef=defaultSession, DcmDspDidReadSessionRef=extendedDiagnosticSession  # Diagnostics Data Import
          DidInfo_DID_ED20_Complete_set_of_ECU_part_serial_numbers_Geely  # Diagnostics Data Import
            DcmDspDidAccess  # Diagnostics Data Import
              DcmDspDidRead: DcmDspDidReadSessionRef=defaultSession, DcmDspDidReadSessionRef=extendedDiagnosticSession  # Diagnostics Data Import
          DidInfo_DID_E364_AURIX_Fault_Indication  # Diagnostics Data Import
            DcmDspDidAccess  # Diagnostics Data Import
              DcmDspDidRead: DcmDspDidReadSessionRef=defaultSession, DcmDspDidReadSessionRef=extendedDiagnosticSession  # Diagnostics Data Import
          DidInfo_DID_E363_Modulation_index  # Diagnostics Data Import
            DcmDspDidAccess  # Diagnostics Data Import
              DcmDspDidRead: DcmDspDidReadSessionRef=defaultSession, DcmDspDidReadSessionRef=extendedDiagnosticSession  # Diagnostics Data Import
          DidInfo_DID_E358_Resolve_angle  # Diagnostics Data Import
            DcmDspDidAccess  # Diagnostics Data Import
              DcmDspDidRead: DcmDspDidReadSessionRef=defaultSession, DcmDspDidReadSessionRef=extendedDiagnosticSession  # Diagnostics Data Import
          DidInfo_DID_E357_Resolve_compensated_angle  # Diagnostics Data Import
            DcmDspDidAccess  # Diagnostics Data Import
              DcmDspDidRead: DcmDspDidReadSessionRef=defaultSession, DcmDspDidReadSessionRef=extendedDiagnosticSession  # Diagnostics Data Import
          DidInfo_DID_E353_Flux_weakening_correction_factor  # Diagnostics Data Import
            DcmDspDidAccess  # Diagnostics Data Import
              DcmDspDidRead: DcmDspDidReadSessionRef=defaultSession, DcmDspDidReadSessionRef=extendedDiagnosticSession  # Diagnostics Data Import
          DidInfo_DID_E350_Phase_W_PWM_duty  # Diagnostics Data Import
            DcmDspDidAccess  # Diagnostics Data Import
              DcmDspDidRead: DcmDspDidReadSessionRef=defaultSession, DcmDspDidReadSessionRef=extendedDiagnosticSession  # Diagnostics Data Import
          DidInfo_DID_E349_Phase_V_PWM_duty  # Diagnostics Data Import
            DcmDspDidAccess  # Diagnostics Data Import
              DcmDspDidRead: DcmDspDidReadSessionRef=defaultSession, DcmDspDidReadSessionRef=extendedDiagnosticSession  # Diagnostics Data Import
          DidInfo_DID_E348_Phase_U_PWM_duty  # Diagnostics Data Import
            DcmDspDidAccess  # Diagnostics Data Import
              DcmDspDidRead: DcmDspDidReadSessionRef=defaultSession, DcmDspDidReadSessionRef=extendedDiagnosticSession  # Diagnostics Data Import
          DidInfo_DID_E347_IGBT_Max_Temperature  # Diagnostics Data Import
            DcmDspDidAccess  # Diagnostics Data Import
              DcmDspDidRead: DcmDspDidReadSessionRef=defaultSession, DcmDspDidReadSessionRef=extendedDiagnosticSession  # Diagnostics Data Import
          DidInfo_DID_E346_ECM_Torque_Allowed_Status  # Diagnostics Data Import
            DcmDspDidAccess  # Diagnostics Data Import
              DcmDspDidRead: DcmDspDidReadSessionRef=defaultSession, DcmDspDidReadSessionRef=extendedDiagnosticSession  # Diagnostics Data Import
          DidInfo_DID_E341_q_axis_voltage  # Diagnostics Data Import
            DcmDspDidAccess  # Diagnostics Data Import
              DcmDspDidRead: DcmDspDidReadSessionRef=defaultSession, DcmDspDidReadSessionRef=extendedDiagnosticSession  # Diagnostics Data Import
          DidInfo_DID_E339_d_axis_voltage  # Diagnostics Data Import
            DcmDspDidAccess  # Diagnostics Data Import
              DcmDspDidRead: DcmDspDidReadSessionRef=defaultSession, DcmDspDidReadSessionRef=extendedDiagnosticSession  # Diagnostics Data Import
          DidInfo_DID_E338_q_axis_current_feedback  # Diagnostics Data Import
            DcmDspDidAccess  # Diagnostics Data Import
              DcmDspDidRead: DcmDspDidReadSessionRef=defaultSession, DcmDspDidReadSessionRef=extendedDiagnosticSession  # Diagnostics Data Import
          DidInfo_DID_E337_q_axis_current_setpoint  # Diagnostics Data Import
            DcmDspDidAccess  # Diagnostics Data Import
              DcmDspDidRead: DcmDspDidReadSessionRef=defaultSession, DcmDspDidReadSessionRef=extendedDiagnosticSession  # Diagnostics Data Import
          DidInfo_DID_E336_d_axis_current_feedback  # Diagnostics Data Import
            DcmDspDidAccess  # Diagnostics Data Import
              DcmDspDidRead: DcmDspDidReadSessionRef=defaultSession, DcmDspDidReadSessionRef=extendedDiagnosticSession  # Diagnostics Data Import
          DidInfo_DID_E335_d_axis_current_setpoint  # Diagnostics Data Import
            DcmDspDidAccess  # Diagnostics Data Import
              DcmDspDidRead: DcmDspDidReadSessionRef=defaultSession, DcmDspDidReadSessionRef=extendedDiagnosticSession  # Diagnostics Data Import
          DidInfo_DID_E333_2002_State  # Diagnostics Data Import
            DcmDspDidAccess  # Diagnostics Data Import
              DcmDspDidWrite: DcmDspDidWriteSessionRef=extendedDiagnosticSession  # Diagnostics Data Import
              DcmDspDidRead  # Diagnostics Data Import
          DidInfo_DID_E331_Software_Version  # Diagnostics Data Import
            DcmDspDidAccess  # Diagnostics Data Import
              DcmDspDidRead: DcmDspDidReadSessionRef=defaultSession, DcmDspDidReadSessionRef=extendedDiagnosticSession  # Diagnostics Data Import
          DidInfo_DID_E324_Motor_Derating_reason_of_IEM_MGM  # Diagnostics Data Import
            DcmDspDidAccess  # Diagnostics Data Import
              DcmDspDidRead: DcmDspDidReadSessionRef=defaultSession, DcmDspDidReadSessionRef=extendedDiagnosticSession  # Diagnostics Data Import
          DidInfo_DID_E320_System_Mode_Mismatch  # Diagnostics Data Import
            DcmDspDidAccess  # Diagnostics Data Import
              DcmDspDidRead: DcmDspDidReadSessionRef=defaultSession, DcmDspDidReadSessionRef=extendedDiagnosticSession  # Diagnostics Data Import
          DidInfo_DID_E319_Torque_Direction  # Diagnostics Data Import
            DcmDspDidAccess  # Diagnostics Data Import
              DcmDspDidRead: DcmDspDidReadSessionRef=defaultSession, DcmDspDidReadSessionRef=extendedDiagnosticSession  # Diagnostics Data Import
          DidInfo_DID_E315_Available_Torque_minimum  # Diagnostics Data Import
            DcmDspDidAccess  # Diagnostics Data Import
              DcmDspDidRead: DcmDspDidReadSessionRef=defaultSession, DcmDspDidReadSessionRef=extendedDiagnosticSession  # Diagnostics Data Import
          DidInfo_DID_E314_Available_Torque_maximum  # Diagnostics Data Import
            DcmDspDidAccess  # Diagnostics Data Import
              DcmDspDidRead: DcmDspDidReadSessionRef=defaultSession, DcmDspDidReadSessionRef=extendedDiagnosticSession  # Diagnostics Data Import
          DidInfo_DID_E313_Active_discharge_status  # Diagnostics Data Import
            DcmDspDidAccess  # Diagnostics Data Import
              DcmDspDidRead: DcmDspDidReadSessionRef=defaultSession, DcmDspDidReadSessionRef=extendedDiagnosticSession  # Diagnostics Data Import
          DidInfo_DID_E312_Wheel_Speed  # Diagnostics Data Import
            DcmDspDidAccess  # Diagnostics Data Import
              DcmDspDidRead: DcmDspDidReadSessionRef=defaultSession, DcmDspDidReadSessionRef=extendedDiagnosticSession  # Diagnostics Data Import
          DidInfo_DID_E311_Crash_Status  # Diagnostics Data Import
            DcmDspDidAccess  # Diagnostics Data Import
              DcmDspDidRead: DcmDspDidReadSessionRef=defaultSession, DcmDspDidReadSessionRef=extendedDiagnosticSession  # Diagnostics Data Import
          DidInfo_DID_E310_IEM_MGM_Derating_Status  # Diagnostics Data Import
            DcmDspDidAccess  # Diagnostics Data Import
              DcmDspDidRead: DcmDspDidReadSessionRef=defaultSession, DcmDspDidReadSessionRef=extendedDiagnosticSession  # Diagnostics Data Import
          DidInfo_DID_E309_ECM_Mode_Request  # Diagnostics Data Import
            DcmDspDidAccess  # Diagnostics Data Import
              DcmDspDidRead: DcmDspDidReadSessionRef=defaultSession, DcmDspDidReadSessionRef=extendedDiagnosticSession  # Diagnostics Data Import
          DidInfo_DID_E308_ECM_Torque_Request  # Diagnostics Data Import
            DcmDspDidAccess  # Diagnostics Data Import
              DcmDspDidRead: DcmDspDidReadSessionRef=defaultSession, DcmDspDidReadSessionRef=extendedDiagnosticSession  # Diagnostics Data Import
          DidInfo_DID_E307_System_Mode  # Diagnostics Data Import
            DcmDspDidAccess  # Diagnostics Data Import
              DcmDspDidRead: DcmDspDidReadSessionRef=defaultSession, DcmDspDidReadSessionRef=extendedDiagnosticSession  # Diagnostics Data Import
          DidInfo_DID_E306_Motor_Temperature  # Diagnostics Data Import
            DcmDspDidAccess  # Diagnostics Data Import
              DcmDspDidRead: DcmDspDidReadSessionRef=defaultSession, DcmDspDidReadSessionRef=extendedDiagnosticSession  # Diagnostics Data Import
          DidInfo_DID_E305_Inverter_IGBT_Junction_Temp  # Diagnostics Data Import
            DcmDspDidAccess  # Diagnostics Data Import
              DcmDspDidRead: DcmDspDidReadSessionRef=defaultSession, DcmDspDidReadSessionRef=extendedDiagnosticSession  # Diagnostics Data Import
          DidInfo_DID_E304_Actual_Torque  # Diagnostics Data Import
            DcmDspDidAccess  # Diagnostics Data Import
              DcmDspDidRead: DcmDspDidReadSessionRef=defaultSession, DcmDspDidReadSessionRef=extendedDiagnosticSession  # Diagnostics Data Import
          DidInfo_DID_E303_Motor_Speed  # Diagnostics Data Import
            DcmDspDidAccess  # Diagnostics Data Import
              DcmDspDidRead: DcmDspDidReadSessionRef=defaultSession, DcmDspDidReadSessionRef=extendedDiagnosticSession  # Diagnostics Data Import
          DidInfo_DID_E301_HVDC_Current  # Diagnostics Data Import
            DcmDspDidAccess  # Diagnostics Data Import
              DcmDspDidRead: DcmDspDidReadSessionRef=defaultSession, DcmDspDidReadSessionRef=extendedDiagnosticSession  # Diagnostics Data Import
          DidInfo_DID_E300_HVDC_Voltage  # Diagnostics Data Import
            DcmDspDidAccess  # Diagnostics Data Import
              DcmDspDidRead: DcmDspDidReadSessionRef=defaultSession, DcmDspDidReadSessionRef=extendedDiagnosticSession  # Diagnostics Data Import
          DidInfo_DID_E103_Car_Configuration_Parameter_Faults  # Diagnostics Data Import
            DcmDspDidAccess  # Diagnostics Data Import
              DcmDspDidRead: DcmDspDidReadSessionRef=defaultSession, DcmDspDidReadSessionRef=extendedDiagnosticSession  # Diagnostics Data Import
          DidInfo_DID_DD0C_Electric_Power_Level  # Diagnostics Data Import
            DcmDspDidAccess  # Diagnostics Data Import
              DcmDspDidRead: DcmDspDidReadSessionRef=defaultSession, DcmDspDidReadSessionRef=extendedDiagnosticSession  # Diagnostics Data Import
          DidInfo_DID_DD0A_Usage_Mode  # Diagnostics Data Import
            DcmDspDidAccess  # Diagnostics Data Import
              DcmDspDidRead: DcmDspDidReadSessionRef=defaultSession, DcmDspDidReadSessionRef=extendedDiagnosticSession  # Diagnostics Data Import
          DidInfo_DID_DD02_Vehicle_Battery_Voltage  # Diagnostics Data Import
            DcmDspDidAccess  # Diagnostics Data Import
              DcmDspDidRead: DcmDspDidReadSessionRef=defaultSession, DcmDspDidReadSessionRef=extendedDiagnosticSession  # Diagnostics Data Import
          DidInfo_DID_DD01_Total_Distance  # Diagnostics Data Import
            DcmDspDidAccess  # Diagnostics Data Import
              DcmDspDidRead: DcmDspDidReadSessionRef=defaultSession, DcmDspDidReadSessionRef=extendedDiagnosticSession  # Diagnostics Data Import
          DidInfo_DID_DD00_Global_Real_Time  # Diagnostics Data Import
            DcmDspDidAccess  # Diagnostics Data Import
              DcmDspDidRead: DcmDspDidReadSessionRef=defaultSession, DcmDspDidReadSessionRef=extendedDiagnosticSession  # Diagnostics Data Import
          DidInfo_DID_D211_Network_Management_History_Propulsion_CAN  # Diagnostics Data Import
            DcmDspDidAccess  # Diagnostics Data Import
              DcmDspDidRead: DcmDspDidReadSessionRef=defaultSession, DcmDspDidReadSessionRef=extendedDiagnosticSession  # Diagnostics Data Import
          DidInfo_DID_D134_Car_Mode  # Diagnostics Data Import
            DcmDspDidAccess  # Diagnostics Data Import
              DcmDspDidRead: DcmDspDidReadSessionRef=defaultSession, DcmDspDidReadSessionRef=extendedDiagnosticSession  # Diagnostics Data Import
          DidInfo_DID_D12F_Security_Constant_Level_11_12  # Diagnostics Data Import
            DcmDspDidAccess  # Diagnostics Data Import
              DcmDspDidWrite: DcmDspDidWriteSessionRef=extendedDiagnosticSession, DcmDspDidWriteSecurityLevelRef=ImmoUnlocked_Level_4  # Diagnostics Data Import
              DcmDspDidRead: DcmDspDidReadSessionRef=extendedDiagnosticSession, DcmDspDidReadSecurityLevelRef=ImmoUnlocked_Level_4  # Diagnostics Data Import
          DidInfo_DID_D0B5_SDB_version  # Diagnostics Data Import
            DcmDspDidAccess  # Diagnostics Data Import
              DcmDspDidRead: DcmDspDidReadSessionRef=defaultSession, DcmDspDidReadSessionRef=extendedDiagnosticSession  # Diagnostics Data Import
          DidInfo_DID_D09A_High_Quiescent_Current_Function_Activation_Deactivation  # Diagnostics Data Import
            DcmDspDidAccess  # Diagnostics Data Import
              DcmDspDidWrite: DcmDspDidWriteSessionRef=extendedDiagnosticSession, DcmDspDidWriteSecurityLevelRef=CommonUnlock_Level_3  # Diagnostics Data Import
              DcmDspDidRead: DcmDspDidReadSessionRef=defaultSession, DcmDspDidReadSessionRef=extendedDiagnosticSession  # Diagnostics Data Import
          DidInfo_DID_D03A_swAuth_Public_Key_CheckSum  # Diagnostics Data Import
            DcmDspDidAccess  # Diagnostics Data Import
              DcmDspDidRead: DcmDspDidReadSessionRef=defaultSession, DcmDspDidReadSessionRef=extendedDiagnosticSession  # Diagnostics Data Import
          DidInfo_DID_D005_High_Quiescent_Current_Fault_Identification_Data  # Diagnostics Data Import
            DcmDspDidAccess  # Diagnostics Data Import
              DcmDspDidRead: DcmDspDidReadSessionRef=defaultSession, DcmDspDidReadSessionRef=extendedDiagnosticSession  # Diagnostics Data Import
          DidInfo_DID_D003_Vehicle_Speed  # Diagnostics Data Import
            DcmDspDidAccess  # Diagnostics Data Import
              DcmDspDidRead: DcmDspDidReadSessionRef=defaultSession, DcmDspDidReadSessionRef=extendedDiagnosticSession  # Diagnostics Data Import
          DidInfo_DID_40E0_Secret_Key_Immobilizer_Target_3  # Diagnostics Data Import
            DcmDspDidAccess  # Diagnostics Data Import
              DcmDspDidWrite: DcmDspDidWriteSessionRef=extendedDiagnosticSession, DcmDspDidWriteSecurityLevelRef=ImmoUnlocked_Level_4  # Diagnostics Data Import
              DcmDspDidRead: DcmDspDidReadSessionRef=extendedDiagnosticSession, DcmDspDidReadSecurityLevelRef=ImmoUnlocked_Level_4  # Diagnostics Data Import

AUTOSAR XML (schema 4-2-2)
package /ActiveEcuC
  module config Spi: implementation-config-variant=VARIANT-POST-BUILD-LOADABLE, module-description=Spi_Impl
    SpiDriver: SpiMaxChannel=2, SpiMaxJob=2, SpiMaxSequence=2, SpiSystemClock=McuClockReferencePointConfig
      SpiChannel_Tja1145 (SpiChannel): SpiChannelId=0, SpiChannelType=EB, SpiDataWidth=8, SpiEbMaxLength=32, SpiIbNBuffers=1, SpiTransferStart=MSB
      SpiChannel_Tlf35584 (SpiChannel): SpiChannelId=1, SpiChannelType=EB, SpiDataWidth=16, SpiEbMaxLength=4, SpiIbNBuffers=1, SpiTransferStart=MSB
      SpiExternalDevice_Tja1145 (SpiExternalDevice):
        SpiBaudrate = 2000000
        SpiCsIdentifier = CHANNEL8
        SpiCsPolarity = LOW
        SpiDataShiftEdge = TRAILING
        SpiEnableCs = true
        SpiHwUnit = QSPI3
        SpiAutoCalcBaudParams = true
        SpiAutoCalcDelayParams = true
        SpiIdleTime = 0.00000128
        SpiTrailingTime = 0.00000128
        SpiShiftClockIdleLevel = LOW
        SpiTimeClk2Cs = 0.00000128
        SpiParitySupport = UNUSED
        SpiCsSelection = CS_VIA_PERIPHERAL_ENGINE
      SpiExternalDevice_Tlf35584 (SpiExternalDevice):
        SpiBaudrate = 5000000
        SpiCsIdentifier = CHANNEL3
        SpiCsPolarity = LOW
        SpiDataShiftEdge = LEADING
        SpiEnableCs = true
        SpiHwUnit = QSPI4
        SpiAutoCalcBaudParams = true
        SpiAutoCalcDelayParams = true
        SpiIdleTime = 0.00000128
        SpiTrailingTime = 0.00000128
        SpiShiftClockIdleLevel = LOW
        SpiTimeClk2Cs = 0.00000128
        SpiParitySupport = UNUSED
        SpiCsSelection = CS_VIA_PERIPHERAL_ENGINE
      SpiJob_Tja1145 (SpiJob): SpiJobId=0, SpiFrameBasedCS=false, SpiJobPriority=0, SpiHwUnitSynchronous=SYNCHRONOUS, SpiDeviceAssignment=SpiExternalDevice_Tja1145
        SpiChannelList_0 (SpiChannelList): SpiChannelIndex=0, SpiChannelAssignment=SpiChannel_Tja1145
      SpiJob_Tlf35584 (SpiJob): SpiJobId=1, SpiFrameBasedCS=false, SpiJobPriority=0, SpiHwUnitSynchronous=SYNCHRONOUS, SpiDeviceAssignment=SpiExternalDevice_Tlf35584
        SpiChannelList_0 (SpiChannelList): SpiChannelIndex=0, SpiChannelAssignment=SpiChannel_Tlf35584
      SpiSequence_Tja1145 (SpiSequence): SpiInterruptibleSequence=false, SpiSequenceId=0, SpiJobAssignment=SpiJob_Tja1145
      SpiSequence_Tlf35584 (SpiSequence): SpiInterruptibleSequence=false, SpiSequenceId=1, SpiJobAssignment=SpiJob_Tlf35584
    SpiGeneral:
      SpiCancelApi = false
      SpiChannelBuffersAllowed = 1
      SpiInitDeInitApiMode = SPI_MCAL_SUPERVISOR
      SpiInitCheckApi = false
      SpiMultiCoreErrorDetect = false
      SpiRuntimeApiMode = SPI_MCAL_SUPERVISOR
      SpiDevErrorDetect = false
      SpiSafetyEnable = false
      SpiHwStatusApi = false
      SpiEnableLoopBackApi = false
      SpiInterruptibleSeqAllowed = false
      SpiLevelDelivered = 0
      SpiSupportConcurrentSyncTransmit = false
      SpiSyncTransmitTimeoutDuration = 65535
      SpiVersionInfoApi = false
    SpiHwConfiguration
      QSPI3 (SpiHwConfigurationQspi):
        SpiHwConfigKernel = QSPI3
        SpiJobQueueLengthQspix = 2
        SpiSleepEnableQspix = false
        SpiHWPinMRSTQspix = MRST3B_PORT10_PIN7
        SpiExternalDemux = false
        SpiSLSO0StrobeDelay = 2
      QSPI4 (SpiHwConfigurationQspi):
        SpiHwConfigKernel = QSPI4
        SpiJobQueueLengthQspix = 2
        SpiSleepEnableQspix = false
        SpiHWPinMRSTQspix = MRST4B_PORT22_PIN1
        SpiExternalDemux = false
        SpiSLSO0StrobeDelay = 2
    SpiPublishedInformation: SpiMaxHwUnit=5
    CommonPublishedInformation:
      ArMajorVersion = 4
      ArMinorVersion = 2
      ArPatchVersion = 2
      SwMajorVersion = 20
      SwMinorVersion = 0
      SwPatchVersion = 2
      ModuleId = 83
      VendorId = 17
      Release = _TRICORE_TC387

AUTOSAR XML (schema 00044)
package /Predefined_DEV/ImplementationDataTypes
  impl type NvM_RequestResultType: compu {0=NVM_REQ_OK, 1=NVM_REQ_NOT_OK, 2=NVM_REQ_PENDING, 3=NVM_REQ_INTEGRITY_FAILED, 4=NVM_REQ_BLOCK_SKIPPED, 5=NVM_REQ_NV_INVALIDATED, 6=NVM_REQ_CANCELED, 7=NVM_REQ_REDUNDANCY_FAILED, 8=NVM_REQ_RESTORED_FROM_ROM}, implementation-data-type=uint8
  impl type NvM_ServiceIdType: compu {6=NVM_READ_BLOCK, 7=NVM_WRITE_BLOCK, 8=NVM_RESTORE_BLOCK_DEFAULTS, 9=NVM_ERASE_BLOCK, 11=NVM_INVALIDATE_NV_BLOCK, 12=NVM_READ_ALL}, implementation-data-type=uint8
  impl type Dem_UdsStatusByteType: compu {mask 1: 1=DEM_UDS_STATUS_TF, mask 2: 2=DEM_UDS_STATUS_TFTOC, mask 4: 4=DEM_UDS_STATUS_PDTC, mask 8: 8=DEM_UDS_STATUS_CDTC, mask 16: 16=DEM_UDS_STATUS_TNCSLC, mask 32: 32=DEM_UDS_STATUS_TFSLC, mask 64: 64=DEM_UDS_STATUS_TNCTOC, mask 128: 128=DEM_UDS_STATUS_WIR}, range raw 0..255, implementation-data-type=uint8
package /ApplicationDataTypes
  5 x app type, all with category=VALUE:
    DMC_1: compu {0=DMC_Init, 1=DMC_On, 2=DMC_Off, 3=DMC_Fault; unit Unitless}, range raw 0..3
    Tq35_1: compu {phys=raw for raw -30000..30000; unit NewtonMeter}, range phys -30000..30000
    UInt4_2: compu {identical; unit Unitless}, range phys 0..15
    UInt8_2: compu {identical; unit Unitless}, range phys 0..255
    UInt16_2: compu {identical; unit Unitless}, range phys 0..65535
  application record data type DmcStsToEsc_1: category=STRUCTURE
    5 x application record element, all with category=VALUE:
      DmcSts: type=DMC_1
      DmcActAppTarTq: type=Tq35_1
      Cntr: type=UInt4_2
      Chks: type=UInt8_2
      DmcSWInfo: type=UInt16_2
  app type AvlSts2_2: category=VALUE, compu {0=AvlSts2_NotAvl, 1=AvlSts2_Avl; unit Unitless}, range raw 0..1
  application record data type ImobEngChk_2: category=STRUCTURE
    8 x application record element, all with category=VALUE:
      ImobEngChkSts: type=AvlSts2_2
      ImobEngDataChk{0..6}: type=UInt8_2
  app type ImobSts_2: category=VALUE, compu {0=ImobSts_ImobUndefd, 1=ImobSts_ImobImobn, 2=ImobSts_ImobMtn, 3=ImobSts_ImobNoMtn; unit Unitless}, range raw 0..3
  application record data type DevDataTyp64_2: category=STRUCTURE
    8 x application record element, all with category=VALUE, type=UInt8_2:
      Byte{0..7}
  9 x app type, all with category=VALUE:
    HvCoolg1_2: compu {0=HvCoolg1_NoRequestForMoreCoolantPower, 1=HvCoolg1_IncreaseLevel1ForMoreCoolantPower, 2=HvCoolg1_IncreaseLevel2ForMoreCoolantPower, 3=HvCoolg1_MaxCoolingPower, 4=HvCoolg1_NotDefined; unit Unitless}, range raw 0..4
    T3_2: compu {phys=raw-50 for raw 0..250; unit degC}, range phys -50..200
    HvT1_3: compu {phys=raw-40 for raw 0..255; unit degC}, range phys -40..215
    IsgHeatPwr_1: compu {phys=raw*50 for raw 0..255; unit W}, range phys 0..12750
    WhlMotSysHeatFdBck_1: compu {0=WhlMotSysHeatFdBck_On, 1=WhlMotSysHeatFdBck_Off, 2=WhlMotSysHeatFdBck_Inhibt, 3=WhlMotSysHeatFdBck_Reserved; unit Unitless}, range raw 0..3
    WhlMotSysModStsTyp2_2: compu {0=WhlMotSysModStsTyp2_Inin, 1=WhlMotSysModStsTyp2_Stb, 2=WhlMotSysModStsTyp2_TqCtrl, 3=WhlMotSysModStsTyp2_SpdCtrlIdle, 4=WhlMotSysModStsTyp2_CluOper, 5=WhlMotSysModStsTyp2_PreChrg, 6=WhlMotSysModStsTyp2_PwrDwn, 7=WhlMotSysModStsTyp2_Flt, 8=WhlMotSysModStsTyp2_TcsCtrl; unit Unitless}, range raw 0..8
    OnOff1_2: compu {0=OnOff1_Off, 1=OnOff1_On; unit Unitless}, range raw 0..1
    AlrmSt_2: compu {0=AlrmSt_Disarmd, 1=AlrmSt_Armd, 2=AlrmSt_Actv; unit Unitless}, range raw 0..2
    ModStatusRms_2: compu {0=ModStatusRms_Invalid, 1=PModStatusRms_wrCns, 2=ModStatusRms_PwrGen, 3=ModStatusRms_OffSts, 4=ModStatusRms_RdySts, 5=ModStatusRms_Abnormal, 6..15=ModStatusRms_Invalid1..ModStatusRms_Invalid10; unit Unitless}, range raw 0..15
  application record data type ElecDrvGen_4: category=STRUCTURE
    16 x application record element, all with category=VALUE:
      EMQnty: type=UInt4_2
      EMSeqNr: type=UInt4_2
      DTCSts: type=UInt8_2
      DTCLow: type=UInt8_2
      DTCMid: type=UInt8_2
      DTCHig: type=UInt8_2
      TypeInfo: type=UInt4_2
      MotTAlrmSt: type=AlrmSt_2
      InvrtTAlrmSt: type=AlrmSt_2
      FltAlrmSt: type=AlrmSt_2
      SpdAlrmSt: type=AlrmSt_2
      IacAlrmSt: type=AlrmSt_2
      UDcAlrmSt: type=AlrmSt_2
      RslAlrmSt: type=AlrmSt_2
      ADAlrmSt: type=AlrmSt_2
      ModStatusRms: type=ModStatusRms_2
  5 x app type, all with category=VALUE:
    Ampr1_1: compu {phys=raw*0.1-818.8 for raw 0..16380; unit A}, range phys -818.8..819.2
    HvU1_2: compu {phys=raw*0.25 for raw 0..2044; unit Volt}, range phys 0..511
    CooltFlowForDtElec1_2: compu {phys=raw*0.01 for raw 0..1023; unit L / min}, range phys 0..10.23
    IsgSpdWSgnTyp_2: compu {phys=raw for raw -16384..16383; unit rpm}, range phys -16384..16383
    HvTq1_2: compu {phys=raw*4-8188 for raw 0..4095; unit NewtonMeter}, range phys -8188..8192
  application record data type WhlMotSysTqAvl_2: category=STRUCTURE
    application record element TqAvlMax: category=VALUE, type=HvTq1_2
    application record element TqAvlMin: category=VALUE, type=HvTq1_2
  app type QualityFactor_2: category=VALUE, compu {0=QualityFactor_QfUndefd, 1=QualityFactor_QfInProgs, 2=QualityFactor_QfNotSpc, 3=QualityFactor_QfSnsrDataOk; unit Unitless}, range raw 0..3
  app type Tq34_1: category=VALUE, compu {phys=raw-8188 for raw 0..16380; unit NewtonMeter}, range phys -8188..8192
  application record data type IsgTqActSafe2_4: category=STRUCTURE
    4 x application record element, all with category=VALUE:
      Cntr: type=UInt4_2
      Chks: type=UInt8_2
      QualityFactor: type=QualityFactor_2
      IsgTqAct: type=Tq34_1
  app type GenQf1_2: category=VALUE, compu {0=GenQf1_UndefindDataAccur, 1=GenQf1_TmpUndefdData, 2=GenQf1_DataAccurNotWithinSpcn, 3=GenQf1_AccurData; unit Unitless}, range raw 0..3
  application record data type SpdSgnSafe_1: category=STRUCTURE
    4 x application record element, all with category=VALUE:
      IsgSpdWSgnTyp: type=IsgSpdWSgnTyp_2
      Chks: type=UInt8_2
      Cntr: type=UInt4_2
      Qf: type=GenQf1_2
  5 x app type, all with category=VALUE:
    ParkSts_1: compu {0=ParkSts_Init, 1=ParkSts_Parked, 2=ParkSts_Parking, 3=ParkSts_StuckInParked, 4=ParkSts_StuckInUnparked, 5=ParkSts_Unparking, 6=ParkSts_Unparked, 7=ParkSts_Unknown, 8=ParkSts_Off; unit Unitless}, range raw 0..8
    FltIndcn_1: compu {0=FltIndcn_NoFlt, 1=FltIndcn_ComFlt, 2=FltIndcn_ActrFlt, 3=FltIndcn_SnsrFlt, 4=FltIndcn_RdmFlt; unit Unitless}, range raw 0..4
    FltLvl_1: compu {0=FltLvl_NoFlt, 1=FltLvl_FltLvl1, 2=FltLvl_FltLvl2; unit Unitless}, range raw 0..2
    GearLvrIndcn2_2: compu {0=GearLvrIndcn2_ParkIndcn, 1=GearLvrIndcn2_RvsIndcn, 2=GearLvrIndcn2_NeutIndcn, 3=GearLvrIndcn2_DrvIndcn, 4=GearLvrIndcn2_ManModeIndcn, 5=GearLvrIndcn2_Resd1, 6=GearLvrIndcn2_Resd2, 7=GearLvrIndcn2_Undefd; unit Unitless}, range raw 0..7
    ModeDMC_1: compu {0=ModeDMC_Off, 1=ModeDMC_Rpm, 2=ModeDMC_Trq; unit Unitless}, range raw 0..2
  application record data type StcStsToDmc_1: category=STRUCTURE
    6 x application record element, all with category=VALUE:
      StcStsToDmcFrnt: type=ModeDMC_1
      StcStsToDmcRear: type=ModeDMC_1
      EngRotTarSpdDMCFrnt: type=UInt16_2
      EngRotTarSpdDMCRear: type=UInt16_2
      Chks: type=UInt8_2
      Cntr: type=UInt4_2
  application record data type EscVariantToDmc_1: category=STRUCTURE
    application record element EscVariantToDmc: category=VALUE, type=UInt8_2
    application record element Chks: category=VALUE, type=UInt8_2
    application record element Cntr: category=VALUE, type=UInt4_2
  5 x app type, all with category=VALUE:
    CarTiGlb_2: compu {phys=raw*0.1 for raw 0..4294967295; unit s}, range phys 0..429496729.40000004
    UsgModSts1_2: compu {0=UsgModSts1_UsgModAbdnd, 1=UsgModSts1_UsgModInActv, 2=UsgModSts1_UsgModCnvinc, 11=UsgModSts1_UsgModActv, 13=UsgModSts1_UsgModDrvg; unit Unitless}, range raw 0..13
    CarModSts1_2: compu {0=CarModSts1_CarModNorm, 1=CarModSts1_CarModTrnsp, 2=CarModSts1_CarModFcy, 3=CarModSts1_CarModCrash, 5=CarModSts1_CarModDyno; unit Unitless}, range raw 0..5
    Nr5_2: compu {identical; unit Unitless}, range phys 0..7
    FltEgyCns1_2: compu {0=FltEgyCns1_NoFlt, 1=FltEgyCns1_Flt; unit Unitless}, range raw 0..1
  application record data type VehModMngtGlbSafe1_2: category=STRUCTURE
    10 x application record element, all with category=VALUE:
      UsgModSts: type=UsgModSts1_2
      CarModSts1: type=CarModSts1_2
      CarModSubtypWdCarModSubtyp: type=Nr5_2
      EgyLvlElecMai: type=UInt4_2
      EgyLvlElecSubtyp: type=UInt4_2
      PwrLvlElecMai: type=UInt4_2
      PwrLvlElecSubtyp: type=UInt4_2
      FltEgyCnsWdSts: type=FltEgyCns1_2
      Chks: type=UInt8_2
      Cntr: type=UInt4_2
  app type U1_2: category=VALUE, compu {phys=raw*0.1 for raw 0..250; unit Volt}, range phys 0..25
  application record data type SysU_4: category=STRUCTURE
    application record element SysU: category=VALUE, type=U1_2
    application record element SysUQf: category=VALUE, type=GenQf1_2
  app type Len31_2: category=VALUE, compu {phys=raw for raw 0..2000000; unit km}, range phys 0..2000000
  app type Nr2_3: category=VALUE, compu {phys=raw for raw 0..255; unit Unitless}, range phys 0..255
  application record data type VehCfgPrm_3: category=STRUCTURE
    8 x application record element, all with category=VALUE, type=Nr2_3:
      BlkIDBytePosn1
      CCPBytePosn{2..8}
  app type ImobEngMgrReqCmd_2: category=VALUE, compu {0=ImobEngMgrReqCmd_ImobEngCmdTarIdle, 1=ImobEngMgrReqCmd_ImobEngMtnStrtReqCmd, 2=ImobEngMgrReqCmd_ImobEngNoMtnStrtReqCmd, 3=ImobEngMgrReqCmd_ImobEngTurnOffCmd; unit Unitless}, range raw 0..3
  application record data type ImobEngMgrReq_2: category=STRUCTURE
    8 x application record element, all with category=VALUE:
      ImobEngMgrCmdTar1: type=ImobEngMgrReqCmd_2
      ImobEngDataMgrReq{0..6}: type=UInt8_2
  app type EngSt1_2: category=VALUE, compu {0=EngSt1_Ini, 1=EngSt1_Awake, 2=EngSt1_Rdy, 3=EngSt1_PreStrtg, 4=EngSt1_StrtgInProgs, 5=EngSt1_RunngRunng, 6=EngSt1_RunngStb, 7=EngSt1_RunngStrtgInProgs, 8=EngSt1_RunngRemStrtd, 9=EngSt1_AftRun; unit Unitless}, range raw 0..9
  application record data type EngSt1WdSts_1: category=STRUCTURE
    application record element EngSt1WdSts: category=VALUE, type=EngSt1_2
    application record element Chks: category=VALUE, type=UInt8_2
    application record element Cntr: category=VALUE, type=UInt4_2
  app type Spd1_2: category=VALUE, compu {phys=raw*0.00391 for raw 0..31970; unit m/s}, range phys 0..125
  application record data type VehSpdLgtSafe1_3: category=STRUCTURE
    4 x application record element, all with category=VALUE:
      VehSpdLgtA: type=Spd1_2
      VehSpdLgtQf: type=GenQf1_2
      VehSpdLgtCntr: type=UInt4_2
      VehSpdLgtChks: type=UInt8_2
  app type HvActvnSts_2: category=VALUE, compu {0=HvActvnSts_Open, 1=HvActvnSts_Clsd, 2=HvActvnSts_KeepSt, 3=HvActvnSts_OpenAndReqActvDcha; unit Unitless}, range raw 0..3
  application record data type HvSysRlySts_1: category=STRUCTURE
    application record element HvSysRlySts: category=VALUE, type=HvActvnSts_2
    application record element Cntr: category=VALUE, type=UInt4_2
    application record element Chks: category=VALUE, type=UInt8_2
  8 x app type, all with category=VALUE:
    CooltFlow2_2: compu {phys=raw*0.1 for raw 0..511; unit L / min}, range phys 0..51.1
    CooltTHiResl_2: compu {phys=raw*0.1-40 for raw 0..1800; unit degC}, range phys -40..140
    WhlMotSysModStsTyp1_2: compu {0=WhlMotSysModStsTyp1_Inin, 1=WhlMotSysModStsTyp1_Stb, 2=WhlMotSysModStsTyp1_TqCtrl, 3=WhlMotSysModStsTyp1_SpdCtrlIdle, 4=WhlMotSysModStsTyp1_CluOper, 5=WhlMotSysModStsTyp1_PreChrg, 6=WhlMotSysModStsTyp1_PwrDwn, 7=WhlMotSysModStsTyp1_Flt; unit Unitless}, range raw 0..7
    WhlMotSysActvDampgModCodSts_2: compu {0=WhlMotSysActvDampgModCodSts_NoDampg, 1=WhlMotSysActvDampgModCodSts_LoDampg, 2=WhlMotSysActvDampgModCodSts_MedDampg, 3=WhlMotSysActvDampgModCodSts_HiDampg; unit Unitless}, range raw 0..3
    PrpsnPwrLimMax_2: compu {phys=raw*0.5 for raw 0..1022; unit kW}, range phys 0..511
    PrpsnPwrLimMin_2: compu {phys=raw*0.5-511 for raw 0..1022; unit kW}, range phys -511..0
    FrntHeatModEnad_1: compu {0=FrntHeatModEnad_Heatg, 1=FrntHeatModEnad_PwrLoss, 2=FrntHeatModEnad_Off, 3=FrntHeatModEnad_Reserved; unit Unitless}, range raw 0..3
    Tq2_2: compu {phys=raw for raw -20000..20000; unit NewtonMeter}, range phys -20000..20000
  application record data type PtTqAtAxleReq_1: category=STRUCTURE
    4 x application record element, all with category=VALUE:
      PtTqAtAxleFrntReq: type=Tq2_2
      PtTqAtAxleReReq: type=Tq2_2
      Chks: type=UInt8_2
      Cntr: type=UInt4_2
  app type VehMtnSt2_2: category=VALUE, compu {0=VehMtnSt2_Ukwn, 1=VehMtnSt2_StandStillVal1, 2=VehMtnSt2_StandStillVal2, 3=VehMtnSt2_StandStillVal3, 4=VehMtnSt2_RollgFwdVal1, 5=VehMtnSt2_RollgFwdVal2, 6=VehMtnSt2_RollgBackwVal1, 7=VehMtnSt2_RollgBackwVal2; unit Unitless}, range raw 0..7
  application record data type VehMtnStSafe1_2: category=STRUCTURE
    application record element VehMtnSt: category=VALUE, type=VehMtnSt2_2
    application record element VehMtnStChks: category=VALUE, type=UInt8_2
    application record element VehMtnStCntr: category=VALUE, type=UInt4_2
  app type CrashSts2_2: category=VALUE, compu {0=CrashSts2_NoCrash, 1=CrashSts2_Crash; unit Unitless}, range raw 0..1
  application record data type CrashStsSafe_1: category=STRUCTURE
    application record element Sts: category=VALUE, type=CrashSts2_2
    application record element Chks: category=VALUE, type=UInt8_2
    application record element Cntr: category=VALUE, type=UInt4_2
  app type UInt2_2: category=VALUE, compu {identical; unit Unitless}, range phys 0..3
  application record data type WhlMotSysTqAllwd_3: category=STRUCTURE
    application record element WhlMotSysTqAllwd: category=VALUE, type=UInt2_2
    application record element Chks: category=VALUE, type=UInt8_2
    application record element Cntr: category=VALUE, type=UInt4_2
  5 x app type, all with category=VALUE:
    Perc7_2: compu {phys=raw*0.05 for raw 0..2000; unit %}, range phys 0..100
    N1_2: compu {phys=raw*0.5 for raw 0..32767; unit rpm}, range phys 0..16383.5
    PLockParkRequest_1: compu {0=PLockParkRequest_NoReq, 1=PLockParkRequest_ReqApply, 2=PLockParkRequest_ReqRels, 3=PLockParkRequest_Reserved; unit Unitless}, range raw 0..3
    OnBdChrgrHndlSts_2: compu {0=OnBdChrgrHndlSts_Disconnected, 1=OnBdChrgrHndlSts_ConnectedWithoutPower, 2=OnBdChrgrHndlSts_PowerAvailableButNotActivated, 3=OnBdChrgrHndlSts_ConnectedWithPower, 4=OnBdChrgrHndlSts_Init, 5=OnBdChrgrHndlSts_Fault; unit Unitless}, range raw 0..5
    OnBdChrgrHndlSts1_2: compu {0=OnBdChrgrHndlSts1_Disconnected, 1=OnBdChrgrHndlSts1_ConnectedWithoutPower, 2=OnBdChrgrHndlSts1_PowerAvailableButNotActivated, 3=OnBdChrgrHndlSts1_ConnectedWithPower, 4=OnBdChrgrHndlSts1_DischargeConnectwithoutpowerincar, 5=OnBdChrgrHndlSts1_DischargeConnectwithoutpoweroutcar, 6=OnBdChrgrHndlSts1_DischargeConnectwithpowerincar, 7=OnBdChrgrHndlSts1_DischargeConnectwithpoweroutcar, 8=OnBdChrgrHndlSts1_Init, 9=OnBdChrgrHndlSts1_Fault, 10=OnBdChrgrHndlSts1_NotCompleteConnnected, 11=OnBdChrgrHndlSts1_Reserved0, 12=OnBdChrgrHndlSts1_Reserved1, 13=OnBdChrgrHndlSts1_Reserved2; unit Unitless}, range raw 0..13
package /Units
  13 x unit:
    NoUnit_1: display-name=Unitless
    Nm_1: display-name=NewtonMeter
    DegCgrd_1: display-name=degC
    Watt_1: display-name=W
    Ampr_1: display-name=A
    Volt_1: display-name=Volt
    LPerMins_1: display-name=L / min
    Rpm_1: display-name=rpm
    Sec_1: display-name=s
    km_1: display-name=km
    MtrPerSec_1: display-name=m/s
    KiloWatt_1: display-name=kW
    Perc_1: display-name=%
package /BaseTypes
  57 x base type, all with category=FIXED_LENGTH:
    DMC_1: base-type-size=4, base-type-encoding=NONE
    Tq35_1: base-type-size=16, base-type-encoding=2C
    UInt4_2: base-type-size=4, base-type-encoding=NONE
    UInt8_2: base-type-size=8, base-type-encoding=NONE
    UInt16_2: base-type-size=16, base-type-encoding=NONE
    AvlSts2_2: base-type-size=1, base-type-encoding=NONE
    ImobSts_2: base-type-size=2, base-type-encoding=NONE
    HvCoolg1_2: base-type-size=3, base-type-encoding=NONE
    T3_2: base-type-size=8, base-type-encoding=NONE
    HvT1_3: base-type-size=8, base-type-encoding=NONE
    IsgHeatPwr_1: base-type-size=8, base-type-encoding=NONE
    WhlMotSysHeatFdBck_1: base-type-size=2, base-type-encoding=NONE
    WhlMotSysModStsTyp2_2: base-type-size=4, base-type-encoding=NONE
    OnOff1_2: base-type-size=1, base-type-encoding=NONE
    AlrmSt_2: base-type-size=2, base-type-encoding=NONE
    ModStatusRms_2: base-type-size=4, base-type-encoding=NONE
    Ampr1_1: base-type-size=14, base-type-encoding=NONE
    HvU1_2: base-type-size=11, base-type-encoding=NONE
    CooltFlowForDtElec1_2: base-type-size=10, base-type-encoding=NONE
    IsgSpdWSgnTyp_2: base-type-size=15, base-type-encoding=2C
    HvTq1_2: base-type-size=12, base-type-encoding=NONE
    QualityFactor_2: base-type-size=2, base-type-encoding=NONE
    Tq34_1: base-type-size=14, base-type-encoding=NONE
    GenQf1_2: base-type-size=2, base-type-encoding=NONE
    ParkSts_1: base-type-size=4, base-type-encoding=NONE
    FltIndcn_1: base-type-size=3, base-type-encoding=NONE
    FltLvl_1: base-type-size=2, base-type-encoding=NONE
    GearLvrIndcn2_2: base-type-size=3, base-type-encoding=NONE
    ModeDMC_1: base-type-size=8, base-type-encoding=NONE
    CarTiGlb_2: base-type-size=32, base-type-encoding=NONE
    UsgModSts1_2: base-type-size=4, base-type-encoding=NONE
    CarModSts1_2: base-type-size=3, base-type-encoding=NONE
    Nr5_2: base-type-size=3, base-type-encoding=NONE
    FltEgyCns1_2: base-type-size=1, base-type-encoding=NONE
    U1_2: base-type-size=8, base-type-encoding=NONE
    Len31_2: base-type-size=21, base-type-encoding=NONE
    Nr2_3: base-type-size=8, base-type-encoding=NONE
    ImobEngMgrReqCmd_2: base-type-size=2, base-type-encoding=NONE
    EngSt1_2: base-type-size=4, base-type-encoding=NONE
    Spd1_2: base-type-size=15, base-type-encoding=NONE
    HvActvnSts_2: base-type-size=2, base-type-encoding=NONE
    CooltFlow2_2: base-type-size=9, base-type-encoding=NONE
    CooltTHiResl_2: base-type-size=11, base-type-encoding=NONE
    WhlMotSysModStsTyp1_2: base-type-size=3, base-type-encoding=NONE
    WhlMotSysActvDampgModCodSts_2: base-type-size=2, base-type-encoding=NONE
    PrpsnPwrLimMax_2: base-type-size=10, base-type-encoding=NONE
    PrpsnPwrLimMin_2: base-type-size=10, base-type-encoding=NONE
    FrntHeatModEnad_1: base-type-size=2, base-type-encoding=NONE
    Tq2_2: base-type-size=16, base-type-encoding=2C
    VehMtnSt2_2: base-type-size=3, base-type-encoding=NONE
    CrashSts2_2: base-type-size=1, base-type-encoding=NONE
    UInt2_2: base-type-size=2, base-type-encoding=NONE
    Perc7_2: base-type-size=11, base-type-encoding=NONE
    N1_2: base-type-size=15, base-type-encoding=NONE
    PLockParkRequest_1: base-type-size=2, base-type-encoding=NONE
    OnBdChrgrHndlSts_2: base-type-size=3, base-type-encoding=NONE
    OnBdChrgrHndlSts1_2: base-type-size=4, base-type-encoding=NONE

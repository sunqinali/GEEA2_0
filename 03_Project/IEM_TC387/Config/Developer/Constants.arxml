AUTOSAR XML (schema 00044)
package /ConstantSpecifications
  64 x constant specification:
    DmcStsRearToEsc_2: value-spec=fields=[0 NoUnit_1, 0 Nm_1, 0 NoUnit_1, 0 NoUnit_1, 0 NoUnit_1]
    ImobEngChk2_4: value-spec=fields=[0 NoUnit_1, 0 NoUnit_1, 0 NoUnit_1, 0 NoUnit_1, 0 NoUnit_1, 0 NoUnit_1, 0 NoUnit_1, 0 NoUnit_1]
    ImobEngSts2_4: value-spec=0 NoUnit_1
    IEMTestFr1_1: value-spec=fields=[0 NoUnit_1, 0 NoUnit_1, 0 NoUnit_1, 0 NoUnit_1, 0 NoUnit_1, 0 NoUnit_1, 0 NoUnit_1, 0 NoUnit_1]
    IEMTestFr2_1: value-spec=fields=[0 NoUnit_1, 0 NoUnit_1, 0 NoUnit_1, 0 NoUnit_1, 0 NoUnit_1, 0 NoUnit_1, 0 NoUnit_1, 0 NoUnit_1]
    IEMTestFr3_3: value-spec=fields=[0 NoUnit_1, 0 NoUnit_1, 0 NoUnit_1, 0 NoUnit_1, 0 NoUnit_1, 0 NoUnit_1, 0 NoUnit_1, 0 NoUnit_1]
    WhlMotSysCoolgReq_4: value-spec=0 NoUnit_1
    WhlMotSysInvrT_4: value-spec=0 DegCgrd_1
    WhlMotSysMotT_3: value-spec=0 DegCgrd_1
    WhlMotSysCooltT_4: value-spec=0 DegCgrd_1
    WhlMotSysHeatPwrMax_1: value-spec=0 Watt_1
    WhlMotSysHeatFdBck_1: value-spec=1 NoUnit_1
    WhlMotSysHeatPwrAct_1: value-spec=0 Watt_1
    WhlMotSysModSts_5: value-spec=0 NoUnit_1
    WhlMotSysLimnIndcn_3: value-spec=0 NoUnit_1
    WhlMotClrRdyReq_4: value-spec=0 NoUnit_1
    WhlMotSysErrIndcnReq_4: value-spec=0 NoUnit_1
    IemGeneric_12: value-spec=fields=[0 NoUnit_1, 0 NoUnit_1, 0 NoUnit_1, 0 NoUnit_1, 0 NoUnit_1, 0 NoUnit_1, 0 NoUnit_1, 0 NoUnit_1, 0 NoUnit_1, 0 NoUnit_1, 0 NoUnit_1, 0 NoUnit_1, 0 NoUnit_1, 0 NoUnit_1, 0 NoUnit_1, 3 NoUnit_1]
    WhlMotSysIdc_5: value-spec=0 Ampr_1
    WhlMotSysUdc_3: value-spec=0 Volt_1
    WhlMotCooltFlowMinReq_2: value-spec=0 LPerMins_1
    WhlMotSysSpdAct_4: value-spec=0 Rpm_1
    WhlMotSysTqAvl_4: value-spec=fields=[0 Nm_1, 0 Nm_1]
    WhlMotSysTqEst_10: value-spec=fields=[0 NoUnit_1, 0 NoUnit_1, 1 NoUnit_1, 0 Nm_1]
    WhlMotSysSpdActSafe_1: value-spec=fields=[0 Rpm_1, 0 NoUnit_1, 0 NoUnit_1, 1 NoUnit_1]
    PLockParkStsRe_1: value-spec=7 NoUnit_1
    PLockFltIndcRe_1: value-spec=0 NoUnit_1
    PLockFltLvlRe_1: value-spec=0 NoUnit_1
    WhlMotSysTqReq_2: value-spec=0 Nm_1
    GearLvrIndcn_6: value-spec=7 NoUnit_1
    StcStsToDmc_3: value-spec=fields=[0 NoUnit_1, 0 NoUnit_1, 0 NoUnit_1, 0 NoUnit_1, 0 NoUnit_1, 0 NoUnit_1]
    EscVariantToDmc_1: value-spec=fields=[0 NoUnit_1, 0 NoUnit_1, 0 NoUnit_1]
    CarTiGlb_5: value-spec=0 Sec_1
    VehModMngtGlbSafe1_7: value-spec=fields=[1 NoUnit_1, 0 NoUnit_1, 0 NoUnit_1, 0 NoUnit_1, 0 NoUnit_1, 0 NoUnit_1, 0 NoUnit_1, 0 NoUnit_1, 0 NoUnit_1, 0 NoUnit_1]
    VehBattU_8: value-spec=fields=[0 Volt_1, 1 NoUnit_1]
    BkpOfDstTrvld_7: value-spec=0 km_1
    VehCfgPrm_5: value-spec=fields=[0 NoUnit_1, 0 NoUnit_1, 0 NoUnit_1, 0 NoUnit_1, 0 NoUnit_1, 0 NoUnit_1, 0 NoUnit_1, 0 NoUnit_1]
    VehCfgPrmExt_2: value-spec=fields=[0 NoUnit_1, 0 NoUnit_1, 0 NoUnit_1, 0 NoUnit_1, 0 NoUnit_1, 0 NoUnit_1, 0 NoUnit_1, 0 NoUnit_1]
    ImobEngMgrReq2_4: value-spec=fields=[0 NoUnit_1, 0 NoUnit_1, 0 NoUnit_1, 0 NoUnit_1, 0 NoUnit_1, 0 NoUnit_1, 0 NoUnit_1, 0 NoUnit_1]
    EngSt1WdSts_4: value-spec=fields=[0 NoUnit_1, 0 NoUnit_1, 0 NoUnit_1]
    VehSpdLgt_15: value-spec=fields=[0 MtrPerSec_1, 1 NoUnit_1, 0 NoUnit_1, 0 NoUnit_1]
    HvSysRlySts_8: value-spec=fields=[2 NoUnit_1, 0 NoUnit_1, 0 NoUnit_1]
    CooltFlowForDtElec_5: value-spec=0 LPerMins_1
    CooltTSigForDtElec_5: value-spec=0 DegCgrd_1
    WhlMotSysModReq_2: value-spec=0 NoUnit_1
    WhlMotSysActvDampgModReq_2: value-spec=0 NoUnit_1
    WhlMotSysPwrLimMax_2: value-spec=0 KiloWatt_1
    WhlMotSysPwrLimMin_2: value-spec=0 KiloWatt_1
    PrpsnFbLimnIndcn_2: value-spec=0 NoUnit_1
    DrvgCyc_3: value-spec=0 NoUnit_1
    RearHeatModEnad_2: value-spec=2 NoUnit_1
    RearHeatPwrAllwd_1: value-spec=0 Watt_1
    PtTqAtAxleMaxReq_2: value-spec=fields=[20000 Nm_1, 20000 Nm_1, 0 NoUnit_1, 0 NoUnit_1]
    VehMtnSt_10: value-spec=fields=[0 NoUnit_1, 0 NoUnit_1, 0 NoUnit_1]
    CrashStsSafe_2: value-spec=fields=[0 NoUnit_1, 255 NoUnit_1, 0 NoUnit_1]
    WhlMotSysTqAllwd_7: value-spec=fields=[0 NoUnit_1, 0 NoUnit_1, 0 NoUnit_1]
    HvBattSoc_2: value-spec=0 Perc_1
    HvBattUDynMinLim_4: value-spec=0 Volt_1
    HvBattUDynMaxLim_4: value-spec=0 Volt_1
    HvBattUDc_3: value-spec=0 Volt_1
    SpdRotlForWhlsAtAxleRe_7: value-spec=0 Rpm_1
    PLockParkReq_1: value-spec=0 NoUnit_1
    DCChrgnHndlSts_5: value-spec=0 NoUnit_1
    OnBdChrgrHndlSts1_8: value-spec=8 NoUnit_1
